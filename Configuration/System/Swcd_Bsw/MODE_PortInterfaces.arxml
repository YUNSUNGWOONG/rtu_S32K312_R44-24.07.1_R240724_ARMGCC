AUTOSAR XML (schema 00047)
package /MODE/ApplicationPrimitiveDataTypes
  4 x app type, all with category=VALUE:
    ENUM_ComMMode: compu {0=COMM_MODE_NO_COM, 2=COMM_MODE_FULL_COM}
    ENUM_PduRouter: compu {0=PDU_ROUTER_ENABLE, 1=PDU_ROUTER_DISABLE}
    ENUM_AppMode: compu {0=APP_MODE_ACTIVE, 1=APP_MODE_INACTIVE_OFF, 2=APP_MODE_INACTIVE_RESET, 3=APP_MODE_INACTIVE_SLEEP}
    ENUM_ComMMode_PNC: compu {0=COMM_MODE_PNC_REQUESTED, 1=COMM_MODE_PNC_READY_SLEEP, 2=COMM_MODE_PNC_PREPARE_SLEEP, 3=COMM_MODE_PNC_NO_COMMUNICATION, 4=COMM_MODE_PNC_FULL_COMMUNICATION}
package /MODE/ModeDeclarationGroups
  9 x mode declaration group, all with category=EXPLICIT_ORDER:
    MDG_ComMMode: initial-mode=MDG_ComMMode/NO_COM, on-transition-value=255
      mode NO_COM: value=0
      mode SILENT_COM: value=1
      mode FULL_COM: value=2
    MDG_CanSMState: initial-mode=MDG_CanSMState/NO_COM, on-transition-value=255
      5 x mode:
        NO_COM: value=0
        SILENT_COM: value=1
        FULL_COM: value=2
        BUS_OFF: value=3
        CHANGE_BAUDRATE: value=4
    MDG_CanSMBORState: initial-mode=initmode, on-transition-value=255
      mode COMPLETE: value=0
      mode START: value=1
      mode initmode: value=2
    MDG_LinSMState: initial-mode=MDG_LinSMState/NO_COM, on-transition-value=255
      mode NO_COM: value=0
      mode FULL_COM: value=1
    MDG_WakeupEvent: initial-mode=INITIAL_MODE, on-transition-value=255
      12 x mode:
        POWER: value=0
        RESET: value=1
        INTERNAL_RESET: value=2
        INTERNAL_WDG: value=3
        EXTERNAL_WDG: value=4
        GPT: value=5
        FD_CAN1_RX: value=6
        FD_CAN1_RX_POLL: value=7
        HS_CAN1_RX: value=8
        HS_CAN1_RX_POLL: value=9
        LIN1_RX: value=10
        INITIAL_MODE: value=32
    MDG_InitState: initial-mode=MDG_InitState/START, on-transition-value=255
      mode START: value=0
      mode COMPLETE: value=1
    MDG_PduGroup: initial-mode=STOP, on-transition-value=255
      mode STOP: value=0
      mode START: value=1
    MDG_EthSMMode: initial-mode=OFFLINE, on-transition-value=254
      6 x mode:
        OFFLINE: value=0
        WAIT_TRCVLINK: value=1
        ONLINE: value=2
        WAIT_ONLINE: value=3
        ONHOLD: value=4
        WAIT_OFFLINE: value=5
    MDG_ComMMode_PNC: initial-mode=PNC_NO_COMMUNICATION, on-transition-value=255
      5 x mode:
        PNC_REQUESTED: value=0
        PNC_READY_SLEEP: value=1
        PNC_PREPARE_SLEEP: value=2
        PNC_NO_COMMUNICATION: value=3
        PNC_FULL_COMMUNICATION: value=4
package /MODE/DataTypeMappingSets
  11 x data type mapping set:
    MAP_ComMMode: data-type-map{application-data-type=ENUM_ComMMode, implementation-data-type=uint8}, mode-request-type-map{implementation-data-type=uint8, mode-group=MDG_ComMMode}
    MAP_CanSMState: mode-request-type-map{implementation-data-type=uint8, mode-group=MDG_CanSMState}
    MAP_CanSMBORState: mode-request-type-map{implementation-data-type=uint8, mode-group=MDG_CanSMBORState}
    MAP_LinSMState: mode-request-type-map{implementation-data-type=uint8, mode-group=MDG_LinSMState}
    MAP_WakeupEvent: mode-request-type-map{implementation-data-type=uint8, mode-group=MDG_WakeupEvent}
    MAP_PduRouter: data-type-map{application-data-type=ENUM_PduRouter, implementation-data-type=uint8}
    MAP_InitState: mode-request-type-map{implementation-data-type=uint8, mode-group=MDG_InitState}
    MAP_AppMode: data-type-map{application-data-type=ENUM_AppMode, implementation-data-type=uint8}
    MAP_PduGroup: mode-request-type-map{implementation-data-type=uint8, mode-group=MDG_PduGroup}
    MAP_EthSMState: mode-request-type-map{implementation-data-type=uint8, mode-group=MDG_EthSMMode}
    MAP_ComMMode_PNC: data-type-map{application-data-type=ENUM_ComMMode_PNC, implementation-data-type=uint8}, mode-request-type-map{implementation-data-type=uint8, mode-group=MDG_ComMMode_PNC}
package /MODE/SenderReceiverInterfaces
  sender receiver interface PduRouterRequestInterface: is-service=true, service-kind=BASIC-SOFTWARE-MODE-MANAGER
    data PduRouter_Test: type=ENUM_PduRouter
  sender receiver interface AppModeRequestInterface: is-service=true, service-kind=BASIC-SOFTWARE-MODE-MANAGER
    data AppMode: type=ENUM_AppMode
package /MODE/ModeSwitchInterfaces
  mode switch interface WakeupEventInterface: is-service=true, service-kind=BASIC-SOFTWARE-MODE-MANAGER
    mode group WakeupEvent: type=MDG_WakeupEvent
  mode switch interface InitStateInterface: is-service=true, service-kind=BASIC-SOFTWARE-MODE-MANAGER
    mode group InitState: type=MDG_InitState
package /MODE_LIN1/ApplicationPrimitiveDataTypes
  app type ENUM_LinSchedule_LIN1: category=VALUE, compu {0=LIN1_NULL, 1=LIN1_SCHEDULER_RPAS_NORMAL, 2=LIN1_SCHEDULER_RPAS_CRC_COMPARE, 3=LIN1_SCHEDULER_PAS_NORMAL, 4=LIN1_SCHEDULER_PAS_CRC_COMPARE, 5=LIN1_SCHEDULER_FRONT_PAS_NORMAL, 6=LIN1_SCHEDULER_PAS_DIAG_IBU, 7=LIN1_SCHEDULER_PAS_DIAG_FL, 8=LIN1_SCHEDULER_PAS_DIAG_FCL, 9=LIN1_SCHEDULER_PAS_DIAG_FCR, 10=LIN1_SCHEDULER_PAS_DIAG_FR, 11=LIN1_SCHEDULER_PAS_DIAG_RL, 12=LIN1_SCHEDULER_PAS_DIAG_RCL, 13=LIN1_SCHEDULER_PAS_DIAG_RCR, 14=LIN1_SCHEDULER_PAS_DIAG_RR, 15=LIN1_SCHEDULER_RPAS_VER_CHECK, 16=LIN1_SCHEDULER_FPAS_VER_CHECK, 17=LIN1_SCHEDULER_RPAS_TUNNING_WRITE, 18=LIN1_SCHEDULER_RPAS_TEMP_COMP, 19=LIN1_SCHEDULER_FPAS_TUNNING_WRITE, 20=LIN1_SCHEDULER_PAS_TEMP_COMP, 21=LIN1_SCHEDULER_PAS_DIAG, 22=LIN1_SCHEDULER_PAS_SENSOR_REQUEST}
package /MODE_LIN1/ModeDeclarationGroups
  mode declaration group MDG_LinSchedule_LIN1: category=EXPLICIT_ORDER, initial-mode=MDG_LinSchedule_LIN1/NULL, on-transition-value=255
    23 x mode:
      NULL: value=0
      SCHEDULER_RPAS_NORMAL: value=1
      SCHEDULER_RPAS_CRC_COMPARE: value=2
      SCHEDULER_PAS_NORMAL: value=3
      SCHEDULER_PAS_CRC_COMPARE: value=4
      SCHEDULER_FRONT_PAS_NORMAL: value=5
      SCHEDULER_PAS_DIAG_IBU: value=6
      SCHEDULER_PAS_DIAG_FL: value=7
      SCHEDULER_PAS_DIAG_FCL: value=8
      SCHEDULER_PAS_DIAG_FCR: value=9
      SCHEDULER_PAS_DIAG_FR: value=10
      SCHEDULER_PAS_DIAG_RL: value=11
      SCHEDULER_PAS_DIAG_RCL: value=12
      SCHEDULER_PAS_DIAG_RCR: value=13
      SCHEDULER_PAS_DIAG_RR: value=14
      SCHEDULER_RPAS_VER_CHECK: value=15
      SCHEDULER_FPAS_VER_CHECK: value=16
      SCHEDULER_RPAS_TUNNING_WRITE: value=17
      SCHEDULER_RPAS_TEMP_COMP: value=18
      SCHEDULER_FPAS_TUNNING_WRITE: value=19
      SCHEDULER_PAS_TEMP_COMP: value=20
      SCHEDULER_PAS_DIAG: value=21
      SCHEDULER_PAS_SENSOR_REQUEST: value=22
package /MODE_LIN1/DataTypeMappingSets
  data type mapping set MAP_LinSchedule_LIN1: data-type-map{application-data-type=ENUM_LinSchedule_LIN1, implementation-data-type=uint8}, mode-request-type-map{implementation-data-type=uint8, mode-group=MDG_LinSchedule_LIN1}
package /MODE_LIN1/SenderReceiverInterfaces
  sender receiver interface LinScheduleRequestInterface_LIN1: is-service=true, service-kind=BASIC-SOFTWARE-MODE-MANAGER
    data LinSchedule_LIN1: type=ENUM_LinSchedule_LIN1, init-value=0
  sender receiver interface ComMModeRequestInterface_LIN1: is-service=true, service-kind=BASIC-SOFTWARE-MODE-MANAGER
    data ComMMode_LIN1: type=ENUM_ComMMode, init-value=0
package /MODE_LIN1/ModeSwitchInterfaces
  5 x mode switch interface, all with is-service=true, service-kind=BASIC-SOFTWARE-MODE-MANAGER:
    LinSMStateInterface_LIN1
      mode group LinSMState_LIN1: type=MDG_LinSMState
    LinScheduleInterface_LIN1
      mode group LinSchedule_LIN1: type=MDG_LinSchedule_LIN1
    ComMModeInterface_LIN1
      mode group ComMMode_LIN1: type=MDG_ComMMode
    PduGroupTxInterface_LIN1
      mode group PduGroupTx_LIN1: type=MDG_PduGroup
    PduGroupRxInterface_LIN1
      mode group PduGroupRx_LIN1: type=MDG_PduGroup
package /MODE_LIN2/ApplicationPrimitiveDataTypes
  app type ENUM_LinSchedule_LIN2: category=VALUE, compu {0=LIN2_NULL, 1=LIN2_SCHEDULER_RPAS_NORMAL, 2=LIN2_SCHEDULER_RPAS_CRC_COMPARE, 3=LIN2_SCHEDULER_PAS_NORMAL, 4=LIN2_SCHEDULER_PAS_CRC_COMPARE, 5=LIN2_SCHEDULER_FRONT_PAS_NORMAL, 6=LIN2_SCHEDULER_PAS_DIAG_IBU, 7=LIN2_SCHEDULER_PAS_DIAG_FL, 8=LIN2_SCHEDULER_PAS_DIAG_FCL, 9=LIN2_SCHEDULER_PAS_DIAG_FCR, 10=LIN2_SCHEDULER_PAS_DIAG_FR, 11=LIN2_SCHEDULER_PAS_DIAG_RL, 12=LIN2_SCHEDULER_PAS_DIAG_RCL, 13=LIN2_SCHEDULER_PAS_DIAG_RCR, 14=LIN2_SCHEDULER_PAS_DIAG_RR, 15=LIN2_SCHEDULER_RPAS_VER_CHECK, 16=LIN2_SCHEDULER_FPAS_VER_CHECK, 17=LIN2_SCHEDULER_RPAS_TUNNING_WRITE, 18=LIN2_SCHEDULER_RPAS_TEMP_COMP, 19=LIN2_SCHEDULER_FPAS_TUNNING_WRITE, 20=LIN2_SCHEDULER_PAS_TEMP_COMP, 21=LIN2_SCHEDULER_PAS_DIAG, 22=LIN2_SCHEDULER_PAS_SENSOR_REQUEST}
package /MODE_LIN2/ModeDeclarationGroups
  mode declaration group MDG_LinSchedule_LIN2: category=EXPLICIT_ORDER, initial-mode=MDG_LinSchedule_LIN2/NULL, on-transition-value=255
    23 x mode:
      NULL: value=0
      SCHEDULER_RPAS_NORMAL: value=1
      SCHEDULER_RPAS_CRC_COMPARE: value=2
      SCHEDULER_PAS_NORMAL: value=3
      SCHEDULER_PAS_CRC_COMPARE: value=4
      SCHEDULER_FRONT_PAS_NORMAL: value=5
      SCHEDULER_PAS_DIAG_IBU: value=6
      SCHEDULER_PAS_DIAG_FL: value=7
      SCHEDULER_PAS_DIAG_FCL: value=8
      SCHEDULER_PAS_DIAG_FCR: value=9
      SCHEDULER_PAS_DIAG_FR: value=10
      SCHEDULER_PAS_DIAG_RL: value=11
      SCHEDULER_PAS_DIAG_RCL: value=12
      SCHEDULER_PAS_DIAG_RCR: value=13
      SCHEDULER_PAS_DIAG_RR: value=14
      SCHEDULER_RPAS_VER_CHECK: value=15
      SCHEDULER_FPAS_VER_CHECK: value=16
      SCHEDULER_RPAS_TUNNING_WRITE: value=17
      SCHEDULER_RPAS_TEMP_COMP: value=18
      SCHEDULER_FPAS_TUNNING_WRITE: value=19
      SCHEDULER_PAS_TEMP_COMP: value=20
      SCHEDULER_PAS_DIAG: value=21
      SCHEDULER_PAS_SENSOR_REQUEST: value=22
package /MODE_LIN2/DataTypeMappingSets
  data type mapping set MAP_LinSchedule_LIN2: data-type-map{application-data-type=ENUM_LinSchedule_LIN2, implementation-data-type=uint8}, mode-request-type-map{implementation-data-type=uint8, mode-group=MDG_LinSchedule_LIN2}
package /MODE_LIN2/SenderReceiverInterfaces
  sender receiver interface LinScheduleRequestInterface_LIN2: is-service=true, service-kind=BASIC-SOFTWARE-MODE-MANAGER
    data LinSchedule_LIN2: type=ENUM_LinSchedule_LIN2, init-value=0
  sender receiver interface ComMModeRequestInterface_LIN2: is-service=true, service-kind=BASIC-SOFTWARE-MODE-MANAGER
    data ComMMode_LIN2: type=ENUM_ComMMode, init-value=0
package /MODE_LIN2/ModeSwitchInterfaces
  5 x mode switch interface, all with is-service=true, service-kind=BASIC-SOFTWARE-MODE-MANAGER:
    LinSMStateInterface_LIN2
      mode group LinSMState_LIN2: type=MDG_LinSMState
    LinScheduleInterface_LIN2
      mode group LinSchedule_LIN2: type=MDG_LinSchedule_LIN2
    ComMModeInterface_LIN2
      mode group ComMMode_LIN2: type=MDG_ComMMode
    PduGroupTxInterface_LIN2
      mode group PduGroupTx_LIN2: type=MDG_PduGroup
    PduGroupRxInterface_LIN2
      mode group PduGroupRx_LIN2: type=MDG_PduGroup
package /MODE_FD_CAN1/ModeSwitchInterfaces
  5 x mode switch interface, all with is-service=true, service-kind=BASIC-SOFTWARE-MODE-MANAGER:
    CanSMBORStateInterface_FD_CAN1
      mode group CanSMBORState_FD_CAN1: type=MDG_CanSMBORState
    CanSMStateInterface_FD_CAN1
      mode group CanSMState_FD_CAN1: type=MDG_CanSMState
    ComMModeInterface_FD_CAN1
      mode group ComMMode_FD_CAN1: type=MDG_ComMMode
    PduGroupTxInterface_FD_CAN1_PNC32
      mode group PduGroupTx_FD_CAN1_PNC32: type=MDG_PduGroup
    PduGroupRxInterface_FD_CAN1_PNC32
      mode group PduGroupRx_FD_CAN1_PNC32: type=MDG_PduGroup
package /MODE_PNC32/SenderReceiverInterfaces
  sender receiver interface ComMModeRequestInterface_PNC32: is-service=true, service-kind=BASIC-SOFTWARE-MODE-MANAGER
    data ComMMode_PNC32: type=ENUM_ComMMode, init-value=0
package /MODE_PNC32/ModeSwitchInterfaces
  mode switch interface ComMModeInterface_PNC32: is-service=true, service-kind=BASIC-SOFTWARE-MODE-MANAGER
    mode group ComMMode_PNC32: type=MDG_ComMMode_PNC
