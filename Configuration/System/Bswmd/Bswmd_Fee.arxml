AUTOSAR XML (schema 00047)
package /AUTOSAR_Fee/BswModuleDescriptions
  bsw module description Fee: module-id=21
    provided-entrys:
      Fee_Cancel
      Fee_EraseImmediateBlock
      Fee_ForceSwapOnNextWrite
      Fee_GetJobResult
      Fee_GetRunTimeInfo
      Fee_GetVersionInfo
      Fee_Init
      Fee_InvalidateBlock
      Fee_JobEndNotification
      Fee_MainFunction
      Fee_Read
      Fee_SetMode
      Fee_Write
    bsw internal behavior InternalBehavior_Fee
      4 x exclusive area:
        FEE_EXCLUSIVE_AREA_{00..03}
      9 x bsw called entity:
        Fee_Cancel: implemented-entry=Fee_Cancel
        Fee_EraseImmediateBlock: can-enter-exclusive-area=FEE_EXCLUSIVE_AREA_03, implemented-entry=Fee_EraseImmediateBlock
        Fee_ForceSwapOnNextWrite: implemented-entry=Fee_ForceSwapOnNextWrite
        Fee_GetJobResult: implemented-entry=Fee_GetJobResult
        Fee_GetRunTimeInfo: implemented-entry=Fee_GetRunTimeInfo
        Fee_GetVersionInfo: implemented-entry=Fee_GetVersionInfo
        Fee_Init: implemented-entry=Fee_Init
        Fee_InvalidateBlock: can-enter-exclusive-area=FEE_EXCLUSIVE_AREA_02, implemented-entry=Fee_InvalidateBlock
        Fee_JobEndNotification: implemented-entry=Fee_JobEndNotification
      bsw schedulable entity Fee_MainFunction: implemented-entry=Fee_MainFunction
      bsw called entity Fee_Read: can-enter-exclusive-area=FEE_EXCLUSIVE_AREA_00, implemented-entry=Fee_Read
      bsw called entity Fee_SetMode: implemented-entry=Fee_SetMode
      bsw called entity Fee_Write: can-enter-exclusive-area=FEE_EXCLUSIVE_AREA_01, implemented-entry=Fee_Write
package /AUTOSAR_Fee/BswModuleEntrys
  13 x bsw module entry, all with sw-service-impl-policy=STANDARD:
    Fee_Cancel: service-id=0x04, is-reentrant=false, is-synchronous=false, call-type=REGULAR, execution-context=UNSPECIFIED
    Fee_EraseImmediateBlock: service-id=0x09, is-reentrant=false, is-synchronous=false, call-type=REGULAR, execution-context=UNSPECIFIED
    Fee_ForceSwapOnNextWrite: service-id=0x14, is-reentrant=true, is-synchronous=true, call-type=REGULAR, execution-context=UNSPECIFIED
    Fee_GetJobResult: service-id=0x06, is-reentrant=false, is-synchronous=true, call-type=REGULAR, execution-context=UNSPECIFIED
    Fee_GetRunTimeInfo: service-id=0x13, is-reentrant=true, is-synchronous=true, call-type=REGULAR, execution-context=UNSPECIFIED
    Fee_GetVersionInfo: service-id=0x08, is-reentrant=true, is-synchronous=true, call-type=REGULAR, execution-context=UNSPECIFIED
    Fee_Init: service-id=0x00, is-reentrant=false, is-synchronous=false, call-type=REGULAR, execution-context=UNSPECIFIED
    Fee_InvalidateBlock: service-id=0x07, is-reentrant=false, is-synchronous=false, call-type=REGULAR, execution-context=UNSPECIFIED
    Fee_JobEndNotification: service-id=0x00, is-reentrant=false, is-synchronous=true, call-type=REGULAR, execution-context=UNSPECIFIED
    Fee_MainFunction: service-id=0x12, is-reentrant=false, is-synchronous=true, call-type=SCHEDULED, execution-context=TASK
    Fee_Read: service-id=0x02, is-reentrant=false, is-synchronous=false, call-type=REGULAR, execution-context=UNSPECIFIED
    Fee_SetMode: service-id=0x01, is-reentrant=false, is-synchronous=false, call-type=REGULAR, execution-context=UNSPECIFIED
    Fee_Write: service-id=0x03, is-reentrant=false, is-synchronous=false, call-type=REGULAR, execution-context=UNSPECIFIED
package /Fee_TS_T40D34M30I0R0/Implementations
  bsw implementation BswImplementation_Fee: programming-language=C, sw-version=3.0.0, vendor-id=43, ar-release-version=4.7.0, behavior=InternalBehavior_Fee, vendor-specific-module-def=Fee
    code-descriptors:
      code Files
        artifact-descriptors:
          short-label=config::Fee.xdm, category=SWCFG
          short-label=doc::RTD_FEE_IM.pdf, category=SWDOC
          short-label=doc::RTD_FEE_UM.pdf, category=SWDOC
          short-label=examples::EBT::S32K358::Fee_Example_S32K358::generate::epc::BaseNXP.xdm, category=SWCFG
          short-label=examples::EBT::S32K358::Fee_Example_S32K358::generate::epc::EcuC.xdm, category=SWCFG
          short-label=examples::EBT::S32K358::Fee_Example_S32K358::generate::epc::Fee.xdm, category=SWCFG
          short-label=examples::EBT::S32K358::Fee_Example_S32K358::generate::epc::Fls.xdm, category=SWCFG
          short-label=examples::EBT::S32K358::Fee_Example_S32K358::generate::epc::Mcl.xdm, category=SWCFG
          short-label=examples::EBT::S32K358::Fee_Example_S32K358::generate::epc::Resource.xdm, category=SWCFG
          short-label=examples::EBT::S32K358::Fee_Example_S32K358::include::check_example.h, category=SWHDR
          short-label=examples::EBT::S32K358::Fee_Example_S32K358::src::main.c, category=SWSRC
          short-label=examples::EBT::S32K358::Fee_Example_S32K358::TresosProject::Fee_Example_S32K358::.prefs::preferences.xdm, category=SWCFG
          short-label=examples::EBT::S32K358::Fee_Example_S32K358::TresosProject::Fee_Example_S32K358::config::BaseNXP.xdm, category=SWCFG
          short-label=examples::EBT::S32K358::Fee_Example_S32K358::TresosProject::Fee_Example_S32K358::config::EcuC.xdm, category=SWCFG
          short-label=examples::EBT::S32K358::Fee_Example_S32K358::TresosProject::Fee_Example_S32K358::config::Fee.xdm, category=SWCFG
          short-label=examples::EBT::S32K358::Fee_Example_S32K358::TresosProject::Fee_Example_S32K358::config::Fls.xdm, category=SWCFG
          short-label=examples::EBT::S32K358::Fee_Example_S32K358::TresosProject::Fee_Example_S32K358::config::Mcl.xdm, category=SWCFG
          short-label=examples::EBT::S32K358::Fee_Example_S32K358::TresosProject::Fee_Example_S32K358::config::Resource.xdm, category=SWCFG
          short-label=examples::EBT::S32K396::Fee_Example_S32K396::generate::epc::BaseNXP.xdm, category=SWCFG
          short-label=examples::EBT::S32K396::Fee_Example_S32K396::generate::epc::EcuC.xdm, category=SWCFG
          short-label=examples::EBT::S32K396::Fee_Example_S32K396::generate::epc::Fee.xdm, category=SWCFG
          short-label=examples::EBT::S32K396::Fee_Example_S32K396::generate::epc::Fls.xdm, category=SWCFG
          short-label=examples::EBT::S32K396::Fee_Example_S32K396::generate::epc::Mcl.xdm, category=SWCFG
          short-label=examples::EBT::S32K396::Fee_Example_S32K396::generate::epc::Resource.xdm, category=SWCFG
          short-label=examples::EBT::S32K396::Fee_Example_S32K396::include::check_example.h, category=SWHDR
          short-label=examples::EBT::S32K396::Fee_Example_S32K396::src::main.c, category=SWSRC
          short-label=examples::EBT::S32K396::Fee_Example_S32K396::TresosProject::Fee_Example_S32K396::.prefs::preferences.xdm, category=SWCFG
          short-label=examples::EBT::S32K396::Fee_Example_S32K396::TresosProject::Fee_Example_S32K396::config::BaseNXP.xdm, category=SWCFG
          short-label=examples::EBT::S32K396::Fee_Example_S32K396::TresosProject::Fee_Example_S32K396::config::EcuC.xdm, category=SWCFG
          short-label=examples::EBT::S32K396::Fee_Example_S32K396::TresosProject::Fee_Example_S32K396::config::Fee.xdm, category=SWCFG
          short-label=examples::EBT::S32K396::Fee_Example_S32K396::TresosProject::Fee_Example_S32K396::config::Fls.xdm, category=SWCFG
          short-label=examples::EBT::S32K396::Fee_Example_S32K396::TresosProject::Fee_Example_S32K396::config::Mcl.xdm, category=SWCFG
          short-label=examples::EBT::S32K396::Fee_Example_S32K396::TresosProject::Fee_Example_S32K396::config::Resource.xdm, category=SWCFG
          short-label=examples::EBT::S32K3XX::Fee_Example_S32K344::generate::epc::BaseNXP.xdm, category=SWCFG
          short-label=examples::EBT::S32K3XX::Fee_Example_S32K344::generate::epc::EcuC.xdm, category=SWCFG
          short-label=examples::EBT::S32K3XX::Fee_Example_S32K344::generate::epc::Fee.xdm, category=SWCFG
          short-label=examples::EBT::S32K3XX::Fee_Example_S32K344::generate::epc::Fls.xdm, category=SWCFG
          short-label=examples::EBT::S32K3XX::Fee_Example_S32K344::generate::epc::Mcl.xdm, category=SWCFG
          short-label=examples::EBT::S32K3XX::Fee_Example_S32K344::generate::epc::Resource.xdm, category=SWCFG
          short-label=examples::EBT::S32K3XX::Fee_Example_S32K344::include::check_example.h, category=SWHDR
          short-label=examples::EBT::S32K3XX::Fee_Example_S32K344::src::main.c, category=SWSRC
          short-label=examples::EBT::S32K3XX::Fee_Example_S32K344::TresosProject::Fee_Example_S32K344::.prefs::preferences.xdm, category=SWCFG
          short-label=examples::EBT::S32K3XX::Fee_Example_S32K344::TresosProject::Fee_Example_S32K344::config::BaseNXP.xdm, category=SWCFG
          short-label=examples::EBT::S32K3XX::Fee_Example_S32K344::TresosProject::Fee_Example_S32K344::config::EcuC.xdm, category=SWCFG
          short-label=examples::EBT::S32K3XX::Fee_Example_S32K344::TresosProject::Fee_Example_S32K344::config::Fee.xdm, category=SWCFG
          short-label=examples::EBT::S32K3XX::Fee_Example_S32K344::TresosProject::Fee_Example_S32K344::config::Fls.xdm, category=SWCFG
          short-label=examples::EBT::S32K3XX::Fee_Example_S32K344::TresosProject::Fee_Example_S32K344::config::Mcl.xdm, category=SWCFG
          short-label=examples::EBT::S32K3XX::Fee_Example_S32K344::TresosProject::Fee_Example_S32K344::config::Resource.xdm, category=SWCFG
          short-label=examples::S32DS::S32K358::Fee_Example_S32K358::include::check_example.h, category=SWHDR
          short-label=examples::S32DS::S32K358::Fee_Example_S32K358::Project_Settings::Startup_Code::exceptions.c, category=SWSRC
          short-label=examples::S32DS::S32K358::Fee_Example_S32K358::Project_Settings::Startup_Code::nvic.c, category=SWSRC
          short-label=examples::S32DS::S32K358::Fee_Example_S32K358::Project_Settings::Startup_Code::startup.c, category=SWSRC
          short-label=examples::S32DS::S32K358::Fee_Example_S32K358::Project_Settings::Startup_Code::system.c, category=SWSRC
          short-label=examples::S32DS::S32K358::Fee_Example_S32K358::src::main.c, category=SWSRC
          short-label=examples::S32DS::S32K396::Fee_Example_S32K396::include::check_example.h, category=SWHDR
          short-label=examples::S32DS::S32K396::Fee_Example_S32K396::Project_Settings::Startup_Code::exceptions.c, category=SWSRC
          short-label=examples::S32DS::S32K396::Fee_Example_S32K396::Project_Settings::Startup_Code::nvic.c, category=SWSRC
          short-label=examples::S32DS::S32K396::Fee_Example_S32K396::Project_Settings::Startup_Code::startup.c, category=SWSRC
          short-label=examples::S32DS::S32K396::Fee_Example_S32K396::Project_Settings::Startup_Code::system.c, category=SWSRC
          short-label=examples::S32DS::S32K396::Fee_Example_S32K396::src::main.c, category=SWSRC
          short-label=examples::S32DS::S32K3XX::Fee_Example_S32K344::include::check_example.h, category=SWHDR
          short-label=examples::S32DS::S32K3XX::Fee_Example_S32K344::Project_Settings::Startup_Code::exceptions.c, category=SWSRC
          short-label=examples::S32DS::S32K3XX::Fee_Example_S32K344::Project_Settings::Startup_Code::nvic.c, category=SWSRC
          short-label=examples::S32DS::S32K3XX::Fee_Example_S32K344::Project_Settings::Startup_Code::startup.c, category=SWSRC
          short-label=examples::S32DS::S32K3XX::Fee_Example_S32K344::Project_Settings::Startup_Code::system.c, category=SWSRC
          short-label=examples::S32DS::S32K3XX::Fee_Example_S32K344::src::main.c, category=SWSRC
          short-label=include::Fee.h, category=SWHDR
          short-label=include::Fee_Cbk.h, category=SWHDR
          short-label=include::Fee_InternalTypes.h, category=SWHDR
          short-label=include::Fee_Types.h, category=SWHDR
          short-label=src::Fee.c, category=SWSRC
    4 x compiler:
      DIAB_Compiler:
        name=Windriver Diab
        options=-tARMCORTEXM7MG:simple -mthumb -std=c99 -Oz -g -fstandalone-debug -Wstrict-prototypes -Wsign-compare -Wdouble-promotion -Wunknown-pragmas -Wundef -Wextra -Wall -pedantic -Werror=implicit-function-declaration -fno-common -fno-signed-char -fno-trigraphs -V -c -DS32K3XX -D $ (DERIVATIVE) -DDIAB -DUSE_SW_VECTOR_MODE -DD_CACHE_ENABLE -DI_CACHE_ENABLE -DENABLE_FPU -DMCAL_ENABLE_USER_MODE_SUPPORT
        vendor=Windriver
        version=Wind River Diab Compiler v7.0.4
      GCC_Compiler:
        name=GCC Compiler
        options=-mcpu=cortex-m7 -mthumb -mlittle-endian -mfpu=fpv5-sp-d16 -mfloat-abi=hard -std=c99 -Os -ggdb3 -Wall -Wextra -pedantic -Wstrict-prototypes -Wundef -Wunused -Werror=implicit-function-declaration -Wsign-compare -Wdouble-promotion -fno-short-enums -funsigned-char -funsigned-bitfields -fno-common -fstack-usage -fdump-ipa-all -c -DS32K3XX -D $ (DERIVATIVE) -DGCC -DUSE_SW_VECTOR_MODE -DD_CACHE_ENABLE -DI_CACHE_ENABLE -DENABLE_FPU -DMCAL_ENABLE_USER_MODE_SUPPORT --sysroot=$(NEWLIB_DIR) -specs=nano.specs -specs=nosys.specs
        vendor=GCC Systems
        version=NXP GCC 10.2.0 20200723
      GHS_Compiler:
        name=Green Hills
        options=-cpu=cortexm7 -thumb -fpu=vfpv5_d16 -fsingle -C99 --ghstd=last -Osize --gnu_asm -dual_debug -G -keeptempfiles -Wimplicit-int -Wshadow -Wtrigraphs -Wundef --unsigned_chars --unsigned_fields --no_commons --no_exceptions --no_slash_comment --prototype_errors --incorrect_pragma_warnings -c -DS32K3XX -D $ (DERIVATIVE) -DGHS -DUSE_SW_VECTOR_MODE -DD_CACHE_ENABLE -DI_CACHE_ENABLE -DENABLE_FPU -DMCAL_ENABLE_USER_MODE_SUPPORT
        vendor=Green Hills
        version=Green Hills Multi 7.1.6d / Compiler 2021.1.4
      IAR_Compiler:
        name=IAR Compiler
        options=--cpu Cortex-M7 --cpu_mode thumb --endian little --fpu VFPv5-SP -e -Ohz --debug --no_clustering --no_mem_idioms --do_explicit_zero_opt_in_named_sections --require_prototypes --no_wrap_diagnostics --diag_suppress Pa050 -DS32K3XX -D $ (DERIVATIVE) -DIAR -DUSE_SW_VECTOR_MODE -DD_CACHE_ENABLE -DI_CACHE_ENABLE -DENABLE_FPU -DMCAL_ENABLE_USER_MODE_SUPPORT
        vendor=IAR Systems
        version=IAR ANSI C/C++ Compiler v.8.50.10 (safety version)
    generated-artifacts:
      dependency on artifact Fee_Cfg_h: artifact-descriptor={short-label=generate_PC::include::Fee_Cfg.h, category=SWHDR}, usages=COMPILE
      dependency on artifact Fee_Features_h: artifact-descriptor={short-label=generate_PC::include::Fee_Features.h, category=SWHDR}, usages=COMPILE
      dependency on artifact Fee_Cfg_c: artifact-descriptor={short-label=generate_PC::src::Fee_Cfg.c, category=SWSRC}, usages=COMPILE
    4 x linker:
      DIAB_Linker: name=Windriver Diab, options=-e Reset_Handler linker_script_file.dld -m30 -Xstack-usage -Xpreprocess-lecl -Llibrary_path -lc -lm -tARMCORTEXM7MG:simple, vendor=Windriver, version=Wind River Diab Compiler v7.0.4
      GCC_Linker: name=GCC Compiler, options=-Wl,-Map,filename -T linkerfile --entry=Reset_Handler -nostartfiles -mcpu=cortexm7 -mthumb -mfpu=fpv5-sp-d16 -mfloat-abi=hard -mlittle-endian -ggdb3 -lc -lm -lgcc -specs=nano.specs -specs=nosys.specs, vendor=GCC Systems, version=NXP GCC 10.2.0 20200723
      GHS_Linker: name=Green Hills, options=-e Reset_Handler -T linker_script_file.ld -map -keepmap -Mn -delete -ignore_debug_references -Llibrary_path -larch -lstartup -lind_sd -v -keep=C40_Ip_AccessCode -nostartfiles, vendor=Green Hills, version=Green Hills Multi 7.1.6d / Compiler 2021.1.4
      IAR_Linker: name=IAR Compiler, options=--map filename --config linkerfile --cpu=Cortex-M7 --fpu VFPv5-SP --entry _start --enable_stack_usage --skip_dynamic_initialization --no_wrap_diagnostics, vendor=IAR Systems, version=IAR ANSI C/C++ Compiler v.8.50.10 (safety version)
    resource consumption ResourceConsumption
      9 x memory section:
        FEE_CODE: alignment=UNSPECIFIED, sw-addrmethod=CODE, symbol=CODE
        FEE_CONFIG_DATA_UNSPECIFIED: alignment=UNSPECIFIED, sw-addrmethod=CONFIG_DATA, symbol=CONFIG_DATA_UNSPECIFIED
        FEE_CONST_32: alignment=32, sw-addrmethod=CONST, symbol=CONST_32
        FEE_VAR_CLEARED_16: alignment=16, sw-addrmethod=VAR_CLEARED, symbol=VAR_CLEARED_16
        FEE_VAR_CLEARED_32: alignment=32, sw-addrmethod=VAR_CLEARED, symbol=VAR_CLEARED_32
        FEE_VAR_CLEARED_8: alignment=8, sw-addrmethod=VAR_CLEARED, symbol=VAR_CLEARED_8
        FEE_VAR_CLEARED_BOOLEAN: alignment=BOOLEAN, sw-addrmethod=VAR_CLEARED, symbol=VAR_CLEARED_BOOLEAN
        FEE_VAR_CLEARED_UNSPECIFIED: alignment=UNSPECIFIED, sw-addrmethod=VAR_CLEARED, symbol=VAR_CLEARED_UNSPECIFIED
        FEE_VAR_INIT_UNSPECIFIED: alignment=UNSPECIFIED, sw-addrmethod=VAR_INIT, symbol=VAR_INIT_UNSPECIFIED
