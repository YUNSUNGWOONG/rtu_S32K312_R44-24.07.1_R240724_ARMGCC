AUTOSAR XML (schema 00047)
package /AUTOSAR_Icu/BswModuleDescriptions
  bsw module description Icu: module-id=122
    provided-entrys:
      Icu_CheckWakeup
      Icu_DeInit
      Icu_DisableEdgeCount
      Icu_DisableEdgeDetection
      Icu_DisableNotification
      Icu_DisableWakeup
      Icu_EnableEdgeCount
      Icu_EnableEdgeDetection
      Icu_EnableNotification
      Icu_EnableWakeup
      Icu_GetCaptureRegisterValue
      Icu_GetDutyCycleValues
      Icu_GetEdgeNumbers
      Icu_GetInputLevel
      Icu_GetInputState
      Icu_GetPulseWidth
      Icu_GetTimeElapsed
      Icu_GetTimestampIndex
      Icu_GetVersionInfo
      Icu_Init
      Icu_ResetEdgeCount
      Icu_SetActivationCondition
      Icu_SetClockMode
      Icu_SetMode
      Icu_SignalMeasurementDmaProcessing
      Icu_StartSignalMeasurement
      Icu_StartTimestamp
      Icu_StopSignalMeasurement
      Icu_StopTimestamp
      Icu_TimestampDmaProcessing
      CMP_{0..2}_ISR
      SIUL2_0_ICU_EIRQ_SINGLE_INT_HANDLER
      SIUL2_1_ICU_EIRQ_SINGLE_INT_HANDLER
      SIUL2_4_ICU_EIRQ_SINGLE_INT_HANDLER
      SIUL2_5_ICU_EIRQ_SINGLE_INT_HANDLER
      SIUL2_AE_ICU_EIRQ_SINGLE_INT_HANDLER
      SIUL2_EXT_IRQ_0_7_ISR
      SIUL2_EXT_IRQ_16_23_ISR
      SIUL2_EXT_IRQ_24_31_ISR
      SIUL2_EXT_IRQ_8_15_ISR
      WKPU_EXT_IRQ_SINGLE_ISR
    bsw internal behavior InternalBehavior_Icu
      16 x exclusive area:
        ICU_EXCLUSIVE_AREA_{00..03}
        ICU_EXCLUSIVE_AREA_08
        ICU_EXCLUSIVE_AREA_09
        ICU_EXCLUSIVE_AREA_{46..53}
        ICU_EXCLUSIVE_AREA_57
        ICU_EXCLUSIVE_AREA_58
      30 x bsw called entity:
        Icu_CheckWakeup: can-enter-exclusive-area=ICU_EXCLUSIVE_AREA_01, implemented-entry=Icu_CheckWakeup
        Icu_DeInit: implemented-entry=Icu_DeInit
        Icu_DisableEdgeCount: can-enter-exclusive-area=[ICU_EXCLUSIVE_AREA_01, ICU_EXCLUSIVE_AREA_47, ICU_EXCLUSIVE_AREA_48], implemented-entry=Icu_DisableEdgeCount
        Icu_DisableEdgeDetection: can-enter-exclusive-area=[ICU_EXCLUSIVE_AREA_01, ICU_EXCLUSIVE_AREA_47, ICU_EXCLUSIVE_AREA_48], implemented-entry=Icu_DisableEdgeDetection
        Icu_DisableNotification: can-enter-exclusive-area=ICU_EXCLUSIVE_AREA_01, implemented-entry=Icu_DisableNotification
        Icu_DisableWakeup: can-enter-exclusive-area=ICU_EXCLUSIVE_AREA_01, implemented-entry=Icu_DisableWakeup
        Icu_EnableEdgeCount: can-enter-exclusive-area=[ICU_EXCLUSIVE_AREA_00, ICU_EXCLUSIVE_AREA_01, ICU_EXCLUSIVE_AREA_46, ICU_EXCLUSIVE_AREA_48], implemented-entry=Icu_EnableEdgeCount
        Icu_EnableEdgeDetection: can-enter-exclusive-area=[ICU_EXCLUSIVE_AREA_00, ICU_EXCLUSIVE_AREA_46, ICU_EXCLUSIVE_AREA_48, ICU_EXCLUSIVE_AREA_57, ICU_EXCLUSIVE_AREA_58], implemented-entry=Icu_EnableEdgeDetection
        Icu_EnableNotification: can-enter-exclusive-area=ICU_EXCLUSIVE_AREA_00, implemented-entry=Icu_EnableNotification
        Icu_EnableWakeup: can-enter-exclusive-area=ICU_EXCLUSIVE_AREA_00, implemented-entry=Icu_EnableWakeup
        Icu_GetCaptureRegisterValue: implemented-entry=Icu_GetCaptureRegisterValue
        Icu_GetDutyCycleValues: implemented-entry=Icu_GetDutyCycleValues
        Icu_GetEdgeNumbers: implemented-entry=Icu_GetEdgeNumbers
        Icu_GetInputLevel: implemented-entry=Icu_GetInputLevel
        Icu_GetInputState: can-enter-exclusive-area=ICU_EXCLUSIVE_AREA_01, implemented-entry=Icu_GetInputState
        Icu_GetPulseWidth: implemented-entry=Icu_GetPulseWidth
        Icu_GetTimeElapsed: can-enter-exclusive-area=ICU_EXCLUSIVE_AREA_01, implemented-entry=Icu_GetTimeElapsed
        Icu_GetTimestampIndex: implemented-entry=Icu_GetTimestampIndex
        Icu_GetVersionInfo: implemented-entry=Icu_GetVersionInfo
        Icu_Init: can-enter-exclusive-area=[ICU_EXCLUSIVE_AREA_47, ICU_EXCLUSIVE_AREA_58], implemented-entry=Icu_Init
        Icu_ResetEdgeCount: can-enter-exclusive-area=[ICU_EXCLUSIVE_AREA_01, ICU_EXCLUSIVE_AREA_46, ICU_EXCLUSIVE_AREA_47, ICU_EXCLUSIVE_AREA_48], implemented-entry=Icu_ResetEdgeCount
        Icu_SetActivationCondition: can-enter-exclusive-area=[ICU_EXCLUSIVE_AREA_01, ICU_EXCLUSIVE_AREA_50], implemented-entry=Icu_SetActivationCondition
        Icu_SetClockMode: can-enter-exclusive-area=ICU_EXCLUSIVE_AREA_53, implemented-entry=Icu_SetClockMode
        Icu_SetMode: can-enter-exclusive-area=[ICU_EXCLUSIVE_AREA_46, ICU_EXCLUSIVE_AREA_47, ICU_EXCLUSIVE_AREA_57, ICU_EXCLUSIVE_AREA_58], implemented-entry=Icu_SetMode
        Icu_SignalMeasurementDmaProcessing: can-enter-exclusive-area=ICU_EXCLUSIVE_AREA_09, implemented-entry=Icu_SignalMeasurementDmaProcessing
        Icu_StartSignalMeasurement: can-enter-exclusive-area=[ICU_EXCLUSIVE_AREA_00, ICU_EXCLUSIVE_AREA_01, ICU_EXCLUSIVE_AREA_08, ICU_EXCLUSIVE_AREA_46, ICU_EXCLUSIVE_AREA_47, ICU_EXCLUSIVE_AREA_48, ICU_EXCLUSIVE_AREA_50, ICU_EXCLUSIVE_AREA_52], implemented-entry=Icu_StartSignalMeasurement
        Icu_StartTimestamp: can-enter-exclusive-area=[ICU_EXCLUSIVE_AREA_00, ICU_EXCLUSIVE_AREA_01, ICU_EXCLUSIVE_AREA_02, ICU_EXCLUSIVE_AREA_46, ICU_EXCLUSIVE_AREA_48, ICU_EXCLUSIVE_AREA_51], implemented-entry=Icu_StartTimestamp
        Icu_StopSignalMeasurement: can-enter-exclusive-area=[ICU_EXCLUSIVE_AREA_01, ICU_EXCLUSIVE_AREA_47, ICU_EXCLUSIVE_AREA_48, ICU_EXCLUSIVE_AREA_49], implemented-entry=Icu_StopSignalMeasurement
        Icu_StopTimestamp: can-enter-exclusive-area=[ICU_EXCLUSIVE_AREA_01, ICU_EXCLUSIVE_AREA_47, ICU_EXCLUSIVE_AREA_48], implemented-entry=Icu_StopTimestamp
        Icu_TimestampDmaProcessing: can-enter-exclusive-area=ICU_EXCLUSIVE_AREA_03, implemented-entry=Icu_TimestampDmaProcessing
      13 x bsw interrupt entity, all with interrupt-category=CAT-2, interrupt-source=Hardware:
        CMP_{0..2}_ISR: implemented-entry=CMP_{0..2}_ISR
        SIUL2_0_ICU_EIRQ_SINGLE_INT_HANDLER: implemented-entry=SIUL2_0_ICU_EIRQ_SINGLE_INT_HANDLER
        SIUL2_1_ICU_EIRQ_SINGLE_INT_HANDLER: implemented-entry=SIUL2_1_ICU_EIRQ_SINGLE_INT_HANDLER
        SIUL2_4_ICU_EIRQ_SINGLE_INT_HANDLER: implemented-entry=SIUL2_4_ICU_EIRQ_SINGLE_INT_HANDLER
        SIUL2_5_ICU_EIRQ_SINGLE_INT_HANDLER: implemented-entry=SIUL2_5_ICU_EIRQ_SINGLE_INT_HANDLER
        SIUL2_AE_ICU_EIRQ_SINGLE_INT_HANDLER: implemented-entry=SIUL2_AE_ICU_EIRQ_SINGLE_INT_HANDLER
        SIUL2_EXT_IRQ_0_7_ISR: implemented-entry=SIUL2_EXT_IRQ_0_7_ISR
        SIUL2_EXT_IRQ_16_23_ISR: implemented-entry=SIUL2_EXT_IRQ_16_23_ISR
        SIUL2_EXT_IRQ_24_31_ISR: implemented-entry=SIUL2_EXT_IRQ_24_31_ISR
        SIUL2_EXT_IRQ_8_15_ISR: implemented-entry=SIUL2_EXT_IRQ_8_15_ISR
        WKPU_EXT_IRQ_SINGLE_ISR: implemented-entry=WKPU_EXT_IRQ_SINGLE_ISR
package /AUTOSAR_Icu/BswModuleEntrys
  43 x bsw module entry, all with sw-service-impl-policy=STANDARD:
    Icu_CheckWakeup: service-id=0x15, is-reentrant=false, is-synchronous=true, call-type=REGULAR, execution-context=UNSPECIFIED
    Icu_DeInit: service-id=0x01, is-reentrant=false, is-synchronous=true, call-type=REGULAR, execution-context=UNSPECIFIED
    Icu_DisableEdgeCount: service-id=0x0e, is-reentrant=false, is-synchronous=true, call-type=REGULAR, execution-context=UNSPECIFIED
    Icu_DisableEdgeDetection: service-id=0x17, is-reentrant=false, is-synchronous=true, call-type=REGULAR, execution-context=UNSPECIFIED
    Icu_DisableNotification: service-id=0x06, is-reentrant=false, is-synchronous=true, call-type=REGULAR, execution-context=UNSPECIFIED
    Icu_DisableWakeup: service-id=0x03, is-reentrant=false, is-synchronous=true, call-type=REGULAR, execution-context=UNSPECIFIED
    Icu_EnableEdgeCount: service-id=0x0d, is-reentrant=false, is-synchronous=true, call-type=REGULAR, execution-context=UNSPECIFIED
    Icu_EnableEdgeDetection: service-id=0x16, is-reentrant=false, is-synchronous=true, call-type=REGULAR, execution-context=UNSPECIFIED
    Icu_EnableNotification: service-id=0x07, is-reentrant=false, is-synchronous=true, call-type=REGULAR, execution-context=UNSPECIFIED
    Icu_EnableWakeup: service-id=0x04, is-reentrant=false, is-synchronous=true, call-type=REGULAR, execution-context=UNSPECIFIED
    Icu_GetCaptureRegisterValue: service-id=0x19, is-reentrant=true, is-synchronous=true, call-type=REGULAR, execution-context=UNSPECIFIED
    Icu_GetDutyCycleValues: service-id=0x11, is-reentrant=false, is-synchronous=true, call-type=REGULAR, execution-context=UNSPECIFIED
    Icu_GetEdgeNumbers: service-id=0x0f, is-reentrant=false, is-synchronous=true, call-type=REGULAR, execution-context=UNSPECIFIED
    Icu_GetInputLevel: service-id=0x7c, is-reentrant=true, is-synchronous=true, call-type=REGULAR, execution-context=UNSPECIFIED
    Icu_GetInputState: service-id=0x08, is-reentrant=false, is-synchronous=true, call-type=REGULAR, execution-context=UNSPECIFIED
    Icu_GetPulseWidth: service-id=0x1a, is-reentrant=true, is-synchronous=true, call-type=REGULAR, execution-context=UNSPECIFIED
    Icu_GetTimeElapsed: service-id=0x10, is-reentrant=false, is-synchronous=true, call-type=REGULAR, execution-context=UNSPECIFIED
    Icu_GetTimestampIndex: service-id=0x0b, is-reentrant=false, is-synchronous=true, call-type=REGULAR, execution-context=UNSPECIFIED
    Icu_GetVersionInfo: service-id=0x12, is-reentrant=true, is-synchronous=true, call-type=REGULAR, execution-context=UNSPECIFIED
    Icu_Init: service-id=0x00, is-reentrant=false, is-synchronous=true, call-type=REGULAR, execution-context=UNSPECIFIED
    Icu_ResetEdgeCount: service-id=0x0c, is-reentrant=false, is-synchronous=true, call-type=REGULAR, execution-context=UNSPECIFIED
    Icu_SetActivationCondition: service-id=0x05, is-reentrant=false, is-synchronous=true, call-type=REGULAR, execution-context=UNSPECIFIED
    Icu_SetClockMode: service-id=0x7b, is-reentrant=false, is-synchronous=true, call-type=REGULAR, execution-context=UNSPECIFIED
    Icu_SetMode: service-id=0x02, is-reentrant=false, is-synchronous=true, call-type=REGULAR, execution-context=UNSPECIFIED
    Icu_SignalMeasurementDmaProcessing: service-id=0x21, is-reentrant=true, is-synchronous=true, call-type=REGULAR, execution-context=UNSPECIFIED
    Icu_StartSignalMeasurement: service-id=0x13, is-reentrant=false, is-synchronous=false, call-type=REGULAR, execution-context=UNSPECIFIED
    Icu_StartTimestamp: service-id=0x09, is-reentrant=false, is-synchronous=false, call-type=REGULAR, execution-context=UNSPECIFIED
    Icu_StopSignalMeasurement: service-id=0x14, is-reentrant=false, is-synchronous=true, call-type=REGULAR, execution-context=UNSPECIFIED
    Icu_StopTimestamp: service-id=0x0a, is-reentrant=false, is-synchronous=true, call-type=REGULAR, execution-context=UNSPECIFIED
    Icu_TimestampDmaProcessing: service-id=0x20, is-reentrant=true, is-synchronous=true, call-type=REGULAR, execution-context=UNSPECIFIED
    CMP_{0..2}_ISR: service-id=0, is-reentrant=false, is-synchronous=true, call-type=INTERRUPT, execution-context=INTERRUPT-CAT-2
    SIUL2_0_ICU_EIRQ_SINGLE_INT_HANDLER: service-id=0, is-reentrant=false, is-synchronous=true, call-type=INTERRUPT, execution-context=INTERRUPT-CAT-2
    SIUL2_1_ICU_EIRQ_SINGLE_INT_HANDLER: service-id=0, is-reentrant=false, is-synchronous=true, call-type=INTERRUPT, execution-context=INTERRUPT-CAT-2
    SIUL2_4_ICU_EIRQ_SINGLE_INT_HANDLER: service-id=0, is-reentrant=false, is-synchronous=true, call-type=INTERRUPT, execution-context=INTERRUPT-CAT-2
    SIUL2_5_ICU_EIRQ_SINGLE_INT_HANDLER: service-id=0, is-reentrant=false, is-synchronous=true, call-type=INTERRUPT, execution-context=INTERRUPT-CAT-2
    SIUL2_AE_ICU_EIRQ_SINGLE_INT_HANDLER: service-id=0, is-reentrant=false, is-synchronous=true, call-type=INTERRUPT, execution-context=INTERRUPT-CAT-2
    SIUL2_EXT_IRQ_0_7_ISR: service-id=0, is-reentrant=false, is-synchronous=true, call-type=INTERRUPT, execution-context=INTERRUPT-CAT-2
    SIUL2_EXT_IRQ_16_23_ISR: service-id=0, is-reentrant=false, is-synchronous=true, call-type=INTERRUPT, execution-context=INTERRUPT-CAT-2
    SIUL2_EXT_IRQ_24_31_ISR: service-id=0, is-reentrant=false, is-synchronous=true, call-type=INTERRUPT, execution-context=INTERRUPT-CAT-2
    SIUL2_EXT_IRQ_8_15_ISR: service-id=0, is-reentrant=false, is-synchronous=true, call-type=INTERRUPT, execution-context=INTERRUPT-CAT-2
    WKPU_EXT_IRQ_SINGLE_ISR: service-id=0, is-reentrant=false, is-synchronous=true, call-type=INTERRUPT, execution-context=INTERRUPT-CAT-2
package /Icu_TS_T40D34M30I0R0/Implementations
  bsw implementation BswImplementation_Icu: programming-language=C, sw-version=3.0.0, vendor-id=43, ar-release-version=4.7.0, behavior=InternalBehavior_Icu, vendor-specific-module-def=Icu
    code-descriptors:
      code Files
        artifact-descriptors:
          short-label=config::Icu.xdm, category=SWCFG
          short-label=doc::RTD_ICU_IM.pdf, category=SWDOC
          short-label=doc::RTD_ICU_UM.pdf, category=SWDOC
          short-label=examples::EBT::S32K358::Icu_example_S32K358::generate::epc::BaseNXP.xdm, category=SWCFG
          short-label=examples::EBT::S32K358::Icu_example_S32K358::generate::epc::Dem.xdm, category=SWCFG
          short-label=examples::EBT::S32K358::Icu_example_S32K358::generate::epc::Dio.xdm, category=SWCFG
          short-label=examples::EBT::S32K358::Icu_example_S32K358::generate::epc::Icu.xdm, category=SWCFG
          short-label=examples::EBT::S32K358::Icu_example_S32K358::generate::epc::Mcl.xdm, category=SWCFG
          short-label=examples::EBT::S32K358::Icu_example_S32K358::generate::epc::Mcu.xdm, category=SWCFG
          short-label=examples::EBT::S32K358::Icu_example_S32K358::generate::epc::Platform.xdm, category=SWCFG
          short-label=examples::EBT::S32K358::Icu_example_S32K358::generate::epc::Port.xdm, category=SWCFG
          short-label=examples::EBT::S32K358::Icu_example_S32K358::generate::epc::Resource.xdm, category=SWCFG
          short-label=examples::EBT::S32K358::Icu_example_S32K358::include::check_example.h, category=SWHDR
          short-label=examples::EBT::S32K358::Icu_example_S32K358::src::main.c, category=SWSRC
          short-label=examples::EBT::S32K358::Icu_example_S32K358::TresosProject::Icu_example_S32K358::.prefs::preferences.xdm, category=SWCFG
          short-label=examples::EBT::S32K358::Icu_example_S32K358::TresosProject::Icu_example_S32K358::config::BaseNXP.xdm, category=SWCFG
          short-label=examples::EBT::S32K358::Icu_example_S32K358::TresosProject::Icu_example_S32K358::config::Dem.xdm, category=SWCFG
          short-label=examples::EBT::S32K358::Icu_example_S32K358::TresosProject::Icu_example_S32K358::config::Dio.xdm, category=SWCFG
          short-label=examples::EBT::S32K358::Icu_example_S32K358::TresosProject::Icu_example_S32K358::config::EcuC.xdm, category=SWCFG
          short-label=examples::EBT::S32K358::Icu_example_S32K358::TresosProject::Icu_example_S32K358::config::Icu.xdm, category=SWCFG
          short-label=examples::EBT::S32K358::Icu_example_S32K358::TresosProject::Icu_example_S32K358::config::Mcl.xdm, category=SWCFG
          short-label=examples::EBT::S32K358::Icu_example_S32K358::TresosProject::Icu_example_S32K358::config::Mcu.xdm, category=SWCFG
          short-label=examples::EBT::S32K358::Icu_example_S32K358::TresosProject::Icu_example_S32K358::config::Platform.xdm, category=SWCFG
          short-label=examples::EBT::S32K358::Icu_example_S32K358::TresosProject::Icu_example_S32K358::config::Port.xdm, category=SWCFG
          short-label=examples::EBT::S32K358::Icu_example_S32K358::TresosProject::Icu_example_S32K358::config::Resource.xdm, category=SWCFG
          short-label=examples::EBT::S32K396::Icu_example_S32K396::generate::epc::BaseNXP.xdm, category=SWCFG
          short-label=examples::EBT::S32K396::Icu_example_S32K396::generate::epc::Dem.xdm, category=SWCFG
          short-label=examples::EBT::S32K396::Icu_example_S32K396::generate::epc::Dio.xdm, category=SWCFG
          short-label=examples::EBT::S32K396::Icu_example_S32K396::generate::epc::Icu.xdm, category=SWCFG
          short-label=examples::EBT::S32K396::Icu_example_S32K396::generate::epc::Mcl.xdm, category=SWCFG
          short-label=examples::EBT::S32K396::Icu_example_S32K396::generate::epc::Mcu.xdm, category=SWCFG
          short-label=examples::EBT::S32K396::Icu_example_S32K396::generate::epc::Platform.xdm, category=SWCFG
          short-label=examples::EBT::S32K396::Icu_example_S32K396::generate::epc::Port.xdm, category=SWCFG
          short-label=examples::EBT::S32K396::Icu_example_S32K396::generate::epc::Resource.xdm, category=SWCFG
          short-label=examples::EBT::S32K396::Icu_example_S32K396::include::check_example.h, category=SWHDR
          short-label=examples::EBT::S32K396::Icu_example_S32K396::src::main.c, category=SWSRC
          short-label=examples::EBT::S32K396::Icu_example_S32K396::TresosProject::Icu_example_S32K396::.prefs::preferences.xdm, category=SWCFG
          short-label=examples::EBT::S32K396::Icu_example_S32K396::TresosProject::Icu_example_S32K396::config::BaseNXP.xdm, category=SWCFG
          short-label=examples::EBT::S32K396::Icu_example_S32K396::TresosProject::Icu_example_S32K396::config::Dem.xdm, category=SWCFG
          short-label=examples::EBT::S32K396::Icu_example_S32K396::TresosProject::Icu_example_S32K396::config::Dio.xdm, category=SWCFG
          short-label=examples::EBT::S32K396::Icu_example_S32K396::TresosProject::Icu_example_S32K396::config::EcuC.xdm, category=SWCFG
          short-label=examples::EBT::S32K396::Icu_example_S32K396::TresosProject::Icu_example_S32K396::config::Icu.xdm, category=SWCFG
          short-label=examples::EBT::S32K396::Icu_example_S32K396::TresosProject::Icu_example_S32K396::config::Mcl.xdm, category=SWCFG
          short-label=examples::EBT::S32K396::Icu_example_S32K396::TresosProject::Icu_example_S32K396::config::Mcu.xdm, category=SWCFG
          short-label=examples::EBT::S32K396::Icu_example_S32K396::TresosProject::Icu_example_S32K396::config::Platform.xdm, category=SWCFG
          short-label=examples::EBT::S32K396::Icu_example_S32K396::TresosProject::Icu_example_S32K396::config::Port.xdm, category=SWCFG
          short-label=examples::EBT::S32K396::Icu_example_S32K396::TresosProject::Icu_example_S32K396::config::Resource.xdm, category=SWCFG
          short-label=examples::EBT::S32K3XX::Icu_example_S32K344::generate::epc::BaseNXP.xdm, category=SWCFG
          short-label=examples::EBT::S32K3XX::Icu_example_S32K344::generate::epc::Dem.xdm, category=SWCFG
          short-label=examples::EBT::S32K3XX::Icu_example_S32K344::generate::epc::Dio.xdm, category=SWCFG
          short-label=examples::EBT::S32K3XX::Icu_example_S32K344::generate::epc::Icu.xdm, category=SWCFG
          short-label=examples::EBT::S32K3XX::Icu_example_S32K344::generate::epc::Mcl.xdm, category=SWCFG
          short-label=examples::EBT::S32K3XX::Icu_example_S32K344::generate::epc::Mcu.xdm, category=SWCFG
          short-label=examples::EBT::S32K3XX::Icu_example_S32K344::generate::epc::Platform.xdm, category=SWCFG
          short-label=examples::EBT::S32K3XX::Icu_example_S32K344::generate::epc::Port.xdm, category=SWCFG
          short-label=examples::EBT::S32K3XX::Icu_example_S32K344::generate::epc::Resource.xdm, category=SWCFG
          short-label=examples::EBT::S32K3XX::Icu_example_S32K344::include::check_example.h, category=SWHDR
          short-label=examples::EBT::S32K3XX::Icu_example_S32K344::src::main.c, category=SWSRC
          short-label=examples::EBT::S32K3XX::Icu_example_S32K344::TresosProject::Icu_example_S32K344::.prefs::preferences.xdm, category=SWCFG
          short-label=examples::EBT::S32K3XX::Icu_example_S32K344::TresosProject::Icu_example_S32K344::config::BaseNXP.xdm, category=SWCFG
          short-label=examples::EBT::S32K3XX::Icu_example_S32K344::TresosProject::Icu_example_S32K344::config::Dem.xdm, category=SWCFG
          short-label=examples::EBT::S32K3XX::Icu_example_S32K344::TresosProject::Icu_example_S32K344::config::Dio.xdm, category=SWCFG
          short-label=examples::EBT::S32K3XX::Icu_example_S32K344::TresosProject::Icu_example_S32K344::config::EcuC.xdm, category=SWCFG
          short-label=examples::EBT::S32K3XX::Icu_example_S32K344::TresosProject::Icu_example_S32K344::config::Icu.xdm, category=SWCFG
          short-label=examples::EBT::S32K3XX::Icu_example_S32K344::TresosProject::Icu_example_S32K344::config::Mcl.xdm, category=SWCFG
          short-label=examples::EBT::S32K3XX::Icu_example_S32K344::TresosProject::Icu_example_S32K344::config::Mcu.xdm, category=SWCFG
          short-label=examples::EBT::S32K3XX::Icu_example_S32K344::TresosProject::Icu_example_S32K344::config::Platform.xdm, category=SWCFG
          short-label=examples::EBT::S32K3XX::Icu_example_S32K344::TresosProject::Icu_example_S32K344::config::Port.xdm, category=SWCFG
          short-label=examples::EBT::S32K3XX::Icu_example_S32K344::TresosProject::Icu_example_S32K344::config::Resource.xdm, category=SWCFG
          short-label=examples::S32DS::S32K358::Emios_Icu_Ip_BlinkLed_S32K358::include::check_example.h, category=SWHDR
          short-label=examples::S32DS::S32K358::Emios_Icu_Ip_BlinkLed_S32K358::Project_Settings::Startup_Code::exceptions.c, category=SWSRC
          short-label=examples::S32DS::S32K358::Emios_Icu_Ip_BlinkLed_S32K358::Project_Settings::Startup_Code::nvic.c, category=SWSRC
          short-label=examples::S32DS::S32K358::Emios_Icu_Ip_BlinkLed_S32K358::Project_Settings::Startup_Code::startup.c, category=SWSRC
          short-label=examples::S32DS::S32K358::Emios_Icu_Ip_BlinkLed_S32K358::Project_Settings::Startup_Code::system.c, category=SWSRC
          short-label=examples::S32DS::S32K358::Emios_Icu_Ip_BlinkLed_S32K358::src::main.c, category=SWSRC
          short-label=examples::S32DS::S32K358::Icu_BlinkLed_ASR_Emios_S32K358::include::check_example.h, category=SWHDR
          short-label=examples::S32DS::S32K358::Icu_BlinkLed_ASR_Emios_S32K358::Project_Settings::Startup_Code::exceptions.c, category=SWSRC
          short-label=examples::S32DS::S32K358::Icu_BlinkLed_ASR_Emios_S32K358::Project_Settings::Startup_Code::nvic.c, category=SWSRC
          short-label=examples::S32DS::S32K358::Icu_BlinkLed_ASR_Emios_S32K358::Project_Settings::Startup_Code::startup.c, category=SWSRC
          short-label=examples::S32DS::S32K358::Icu_BlinkLed_ASR_Emios_S32K358::Project_Settings::Startup_Code::system.c, category=SWSRC
          short-label=examples::S32DS::S32K358::Icu_BlinkLed_ASR_Emios_S32K358::src::main.c, category=SWSRC
          short-label=examples::S32DS::S32K396::Emios_Icu_Ip_BlinkLed_S32K396::include::check_example.h, category=SWHDR
          short-label=examples::S32DS::S32K396::Emios_Icu_Ip_BlinkLed_S32K396::Project_Settings::Startup_Code::exceptions.c, category=SWSRC
          short-label=examples::S32DS::S32K396::Emios_Icu_Ip_BlinkLed_S32K396::Project_Settings::Startup_Code::nvic.c, category=SWSRC
          short-label=examples::S32DS::S32K396::Emios_Icu_Ip_BlinkLed_S32K396::Project_Settings::Startup_Code::startup.c, category=SWSRC
          short-label=examples::S32DS::S32K396::Emios_Icu_Ip_BlinkLed_S32K396::Project_Settings::Startup_Code::system.c, category=SWSRC
          short-label=examples::S32DS::S32K396::Emios_Icu_Ip_BlinkLed_S32K396::src::main.c, category=SWSRC
          short-label=examples::S32DS::S32K396::Icu_BlinkLed_ASR_Emios_S32K396::include::check_example.h, category=SWHDR
          short-label=examples::S32DS::S32K396::Icu_BlinkLed_ASR_Emios_S32K396::Project_Settings::Startup_Code::exceptions.c, category=SWSRC
          short-label=examples::S32DS::S32K396::Icu_BlinkLed_ASR_Emios_S32K396::Project_Settings::Startup_Code::nvic.c, category=SWSRC
          short-label=examples::S32DS::S32K396::Icu_BlinkLed_ASR_Emios_S32K396::Project_Settings::Startup_Code::startup.c, category=SWSRC
          short-label=examples::S32DS::S32K396::Icu_BlinkLed_ASR_Emios_S32K396::Project_Settings::Startup_Code::system.c, category=SWSRC
          short-label=examples::S32DS::S32K396::Icu_BlinkLed_ASR_Emios_S32K396::src::main.c, category=SWSRC
          short-label=examples::S32DS::S32K3XX::Emios_Icu_Ip_BlinkLed_S32K344::include::check_example.h, category=SWHDR
          short-label=examples::S32DS::S32K3XX::Emios_Icu_Ip_BlinkLed_S32K344::Project_Settings::Startup_Code::exceptions.c, category=SWSRC
          short-label=examples::S32DS::S32K3XX::Emios_Icu_Ip_BlinkLed_S32K344::Project_Settings::Startup_Code::nvic.c, category=SWSRC
          short-label=examples::S32DS::S32K3XX::Emios_Icu_Ip_BlinkLed_S32K344::Project_Settings::Startup_Code::startup.c, category=SWSRC
          short-label=examples::S32DS::S32K3XX::Emios_Icu_Ip_BlinkLed_S32K344::Project_Settings::Startup_Code::system.c, category=SWSRC
          short-label=examples::S32DS::S32K3XX::Emios_Icu_Ip_BlinkLed_S32K344::src::main.c, category=SWSRC
          short-label=examples::S32DS::S32K3XX::Icu_BlinkLed_ASR_Emios_S32K344::include::check_example.h, category=SWHDR
          short-label=examples::S32DS::S32K3XX::Icu_BlinkLed_ASR_Emios_S32K344::Project_Settings::Startup_Code::exceptions.c, category=SWSRC
          short-label=examples::S32DS::S32K3XX::Icu_BlinkLed_ASR_Emios_S32K344::Project_Settings::Startup_Code::nvic.c, category=SWSRC
          short-label=examples::S32DS::S32K3XX::Icu_BlinkLed_ASR_Emios_S32K344::Project_Settings::Startup_Code::startup.c, category=SWSRC
          short-label=examples::S32DS::S32K3XX::Icu_BlinkLed_ASR_Emios_S32K344::Project_Settings::Startup_Code::system.c, category=SWSRC
          short-label=examples::S32DS::S32K3XX::Icu_BlinkLed_ASR_Emios_S32K344::src::main.c, category=SWSRC
          short-label=include::Cmp_Ip.h, category=SWHDR
          short-label=include::Cmp_Ip_Types.h, category=SWHDR
          short-label=include::Emios_Icu_Ip.h, category=SWHDR
          short-label=include::Emios_Icu_Ip_Irq.h, category=SWHDR
          short-label=include::Emios_Icu_Ip_TrustedFunctions.h, category=SWHDR
          short-label=include::Emios_Icu_Ip_Types.h, category=SWHDR
          short-label=include::Icu.h, category=SWHDR
          short-label=include::Icu_EnvCfg.h, category=SWHDR
          short-label=include::Icu_Ipw.h, category=SWHDR
          short-label=include::Icu_Ipw_Irq.h, category=SWHDR
          short-label=include::Icu_Ipw_Types.h, category=SWHDR
          short-label=include::Icu_Irq.h, category=SWHDR
          short-label=include::Icu_Types.h, category=SWHDR
          short-label=include::Siul2_Icu_Ip.h, category=SWHDR
          short-label=include::Siul2_Icu_Ip_Irq.h, category=SWHDR
          short-label=include::Siul2_Icu_Ip_TrustedFunctions.h, category=SWHDR
          short-label=include::Siul2_Icu_Ip_Types.h, category=SWHDR
          short-label=include::Wkpu_Ip.h, category=SWHDR
          short-label=include::Wkpu_Ip_Irq.h, category=SWHDR
          short-label=include::Wkpu_Ip_Types.h, category=SWHDR
          short-label=src::Cmp_Ip.c, category=SWSRC
          short-label=src::Emios_Icu_Ip.c, category=SWSRC
          short-label=src::Emios_Icu_Ip_Irq.c, category=SWSRC
          short-label=src::Icu.c, category=SWSRC
          short-label=src::Icu_Ipw.c, category=SWSRC
          short-label=src::Siul2_Icu_Ip.c, category=SWSRC
          short-label=src::Siul2_Icu_Ip_Irq.c, category=SWSRC
          short-label=src::Wkpu_Ip.c, category=SWSRC
          short-label=src::Wkpu_Ip_Irq.c, category=SWSRC
    4 x compiler:
      DIAB_Compiler:
        name=Windriver Diab
        options=-tARMCORTEXM7MG:simple -mthumb -std=c99 -Oz -g -fstandalone-debug -Wstrict-prototypes -Wsign-compare -Wdouble-promotion -Wunknown-pragmas -Wundef -Wextra -Wall -pedantic -Werror=implicit-function-declaration -fno-common -fno-signed-char -fno-trigraphs -V -c -DS32K3XX -D $ (DERIVATIVE) -DDIAB -DUSE_SW_VECTOR_MODE -DD_CACHE_ENABLE -DI_CACHE_ENABLE -DENABLE_FPU -DMCAL_ENABLE_USER_MODE_SUPPORT
        vendor=Windriver
        version=Wind River Diab Compiler v7.0.4
      GCC_Compiler:
        name=GCC Compiler
        options=-mcpu=cortex-m7 -mthumb -mlittle-endian -mfpu=fpv5-sp-d16 -mfloat-abi=hard -std=c99 -Os -ggdb3 -Wall -Wextra -pedantic -Wstrict-prototypes -Wundef -Wunused -Werror=implicit-function-declaration -Wsign-compare -Wdouble-promotion -fno-short-enums -funsigned-char -funsigned-bitfields -fno-common -fstack-usage -fdump-ipa-all -c -DS32K3XX -D $ (DERIVATIVE) -DGCC -DUSE_SW_VECTOR_MODE -DD_CACHE_ENABLE -DI_CACHE_ENABLE -DENABLE_FPU -DMCAL_ENABLE_USER_MODE_SUPPORT --sysroot=$(NEWLIB_DIR) -specs=nano.specs -specs=nosys.specs
        vendor=GCC Systems
        version=NXP GCC 10.2.0 20200723
      GHS_Compiler:
        name=Green Hills
        options=-cpu=cortexm7 -thumb -fpu=vfpv5_d16 -fsingle -C99 --ghstd=last -Osize --gnu_asm -dual_debug -G -keeptempfiles -Wimplicit-int -Wshadow -Wtrigraphs -Wundef --unsigned_chars --unsigned_fields --no_commons --no_exceptions --no_slash_comment --prototype_errors --incorrect_pragma_warnings -c -DS32K3XX -D $ (DERIVATIVE) -DGHS -DUSE_SW_VECTOR_MODE -DD_CACHE_ENABLE -DI_CACHE_ENABLE -DENABLE_FPU -DMCAL_ENABLE_USER_MODE_SUPPORT
        vendor=Green Hills
        version=Green Hills Multi 7.1.6d / Compiler 2021.1.4
      IAR_Compiler:
        name=IAR Compiler
        options=--cpu Cortex-M7 --cpu_mode thumb --endian little --fpu VFPv5-SP -e -Ohz --debug --no_clustering --no_mem_idioms --do_explicit_zero_opt_in_named_sections --require_prototypes --no_wrap_diagnostics --diag_suppress Pa050 -DS32K3XX -D $ (DERIVATIVE) -DIAR -DUSE_SW_VECTOR_MODE -DD_CACHE_ENABLE -DI_CACHE_ENABLE -DENABLE_FPU -DMCAL_ENABLE_USER_MODE_SUPPORT
        vendor=IAR Systems
        version=IAR ANSI C/C++ Compiler v.8.50.10 (safety version)
    generated-artifacts:
      24 x dependency on artifact:
        Cmp_Ip_PBcfg_h: artifact-descriptor={short-label=generate_PB::include::Cmp_Ip_PBcfg.h, category=SWHDR}, usages=EXECUTE
        Emios_Icu_Ip_PBcfg_h: artifact-descriptor={short-label=generate_PB::include::Emios_Icu_Ip_PBcfg.h, category=SWHDR}, usages=EXECUTE
        Icu_Ipw_PBcfg_h: artifact-descriptor={short-label=generate_PB::include::Icu_Ipw_PBcfg.h, category=SWHDR}, usages=EXECUTE
        Icu_PBcfg_h: artifact-descriptor={short-label=generate_PB::include::Icu_PBcfg.h, category=SWHDR}, usages=EXECUTE
        Siul2_Icu_Ip_PBcfg_h: artifact-descriptor={short-label=generate_PB::include::Siul2_Icu_Ip_PBcfg.h, category=SWHDR}, usages=EXECUTE
        Wkpu_Ip_PBcfg_h: artifact-descriptor={short-label=generate_PB::include::Wkpu_Ip_PBcfg.h, category=SWHDR}, usages=EXECUTE
        Cmp_Ip_PBcfg_c: artifact-descriptor={short-label=generate_PB::src::Cmp_Ip_PBcfg.c, category=SWSRC}, usages=EXECUTE
        Emios_Icu_Ip_PBcfg_c: artifact-descriptor={short-label=generate_PB::src::Emios_Icu_Ip_PBcfg.c, category=SWSRC}, usages=EXECUTE
        Icu_DmaNotification_c: artifact-descriptor={short-label=generate_PB::src::Icu_DmaNotification.c, category=SWSRC}, usages=EXECUTE
        Icu_Ipw_PBcfg_c: artifact-descriptor={short-label=generate_PB::src::Icu_Ipw_PBcfg.c, category=SWSRC}, usages=EXECUTE
        Icu_PBcfg_c: artifact-descriptor={short-label=generate_PB::src::Icu_PBcfg.c, category=SWSRC}, usages=EXECUTE
        Siul2_Icu_Ip_PBcfg_c: artifact-descriptor={short-label=generate_PB::src::Siul2_Icu_Ip_PBcfg.c, category=SWSRC}, usages=EXECUTE
        Wkpu_Ip_PBcfg_c: artifact-descriptor={short-label=generate_PB::src::Wkpu_Ip_PBcfg.c, category=SWSRC}, usages=EXECUTE
        Cmp_Ip_Cfg_h: artifact-descriptor={short-label=generate_PC::include::Cmp_Ip_Cfg.h, category=SWHDR}, usages=COMPILE
        Cmp_Ip_Defines_h: artifact-descriptor={short-label=generate_PC::include::Cmp_Ip_Defines.h, category=SWHDR}, usages=COMPILE
        Emios_Icu_Ip_Cfg_h: artifact-descriptor={short-label=generate_PC::include::Emios_Icu_Ip_Cfg.h, category=SWHDR}, usages=COMPILE
        Emios_Icu_Ip_Defines_h: artifact-descriptor={short-label=generate_PC::include::Emios_Icu_Ip_Defines.h, category=SWHDR}, usages=COMPILE
        Icu_Cfg_h: artifact-descriptor={short-label=generate_PC::include::Icu_Cfg.h, category=SWHDR}, usages=COMPILE
        Icu_Ipw_Cfg_h: artifact-descriptor={short-label=generate_PC::include::Icu_Ipw_Cfg.h, category=SWHDR}, usages=COMPILE
        Siul2_Icu_Ip_Cfg_h: artifact-descriptor={short-label=generate_PC::include::Siul2_Icu_Ip_Cfg.h, category=SWHDR}, usages=COMPILE
        Siul2_Icu_Ip_Defines_h: artifact-descriptor={short-label=generate_PC::include::Siul2_Icu_Ip_Defines.h, category=SWHDR}, usages=COMPILE
        Wkpu_Ip_Cfg_h: artifact-descriptor={short-label=generate_PC::include::Wkpu_Ip_Cfg.h, category=SWHDR}, usages=COMPILE
        Wkpu_Ip_Defines_h: artifact-descriptor={short-label=generate_PC::include::Wkpu_Ip_Defines.h, category=SWHDR}, usages=COMPILE
        Icu_Cfg_c: artifact-descriptor={short-label=generate_PC::src::Icu_Cfg.c, category=SWSRC}, usages=COMPILE
    4 x linker:
      DIAB_Linker: name=Windriver Diab, options=-e Reset_Handler linker_script_file.dld -m30 -Xstack-usage -Xpreprocess-lecl -Llibrary_path -lc -lm -tARMCORTEXM7MG:simple, vendor=Windriver, version=Wind River Diab Compiler v7.0.4
      GCC_Linker: name=GCC Compiler, options=-Wl,-Map,filename -T linkerfile --entry=Reset_Handler -nostartfiles -mcpu=cortexm7 -mthumb -mfpu=fpv5-sp-d16 -mfloat-abi=hard -mlittle-endian -ggdb3 -lc -lm -lgcc -specs=nano.specs -specs=nosys.specs, vendor=GCC Systems, version=NXP GCC 10.2.0 20200723
      GHS_Linker: name=Green Hills, options=-e Reset_Handler -T linker_script_file.ld -map -keepmap -Mn -delete -ignore_debug_references -Llibrary_path -larch -lstartup -lind_sd -v -keep=C40_Ip_AccessCode -nostartfiles, vendor=Green Hills, version=Green Hills Multi 7.1.6d / Compiler 2021.1.4
      IAR_Linker: name=IAR Compiler, options=--map filename --config linkerfile --cpu=Cortex-M7 --fpu VFPv5-SP --entry _start --enable_stack_usage --skip_dynamic_initialization --no_wrap_diagnostics, vendor=IAR Systems, version=IAR ANSI C/C++ Compiler v.8.50.10 (safety version)
    resource consumption ResourceConsumption
      7 x memory section:
        ICU_CODE: alignment=UNSPECIFIED, sw-addrmethod=CODE, symbol=CODE
        ICU_CONFIG_DATA_UNSPECIFIED: alignment=UNSPECIFIED, sw-addrmethod=CONFIG_DATA, symbol=CONFIG_DATA_UNSPECIFIED
        ICU_CONST_UNSPECIFIED: alignment=UNSPECIFIED, sw-addrmethod=CONST, symbol=CONST_UNSPECIFIED
        ICU_VAR_CLEARED_BOOLEAN: alignment=BOOLEAN, sw-addrmethod=VAR_CLEARED, symbol=VAR_CLEARED_BOOLEAN
        ICU_VAR_CLEARED_UNSPECIFIED: alignment=UNSPECIFIED, sw-addrmethod=VAR_CLEARED, symbol=VAR_CLEARED_UNSPECIFIED
        ICU_VAR_CLEARED_UNSPECIFIED_NO_CACHEABLE: alignment=UNSPECIFIED, sw-addrmethod=VAR_CLEARED_NO_CACHEABLE, symbol=VAR_CLEARED_UNSPECIFIED_NO_CACHEABLE
        ICU_VAR_INIT_8: alignment=8, sw-addrmethod=VAR_INIT, symbol=VAR_INIT_8
