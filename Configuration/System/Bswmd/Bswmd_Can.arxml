AUTOSAR XML (schema 00047)
package /AUTOSAR_Can_43_FLEXCAN/BswModuleDescriptions
  bsw module description Can: module-id=80
    provided-entrys:
      Can_AbortMb
      Can_CheckWakeup
      Can_DeInit
      Can_DisableControllerInterrupts
      Can_EnableControllerInterrupts
      Can_EnableEgressTimeStamp
      Can_GetControllerErrorState
      Can_GetControllerMode
      Can_GetControllerRxErrorCounter
      Can_GetControllerTxErrorCounter
      Can_GetCurrentTime
      Can_GetEgressTimeStamp
      Can_GetIngressTimeStamp
      Can_GetVersionInfo
      Can_Init
      Can_ListenOnlyMode
      Can_MainFunction_BusOff
      Can_MainFunction_Mode
      Can_MainFunction_Read
      Can_MainFunction_Wakeup
      Can_MainFunction_Write
      Can_SetBaudrate
      Can_SetClockMode
      Can_SetControllerMode
      Can_SetCurrentTime
      Can_Write
      FlexCAN_Ip_ClearTDCFail
      FlexCAN_Ip_ManualBusOffRecovery
      CAN0_ORED_0_31_MB_IRQHandler
      CAN0_ORED_32_63_MB_IRQHandler
      CAN0_ORED_64_95_MB_IRQHandler
      CAN0_ORED_IRQHandler
      CAN1_ORED_0_31_MB_IRQHandler
      CAN1_ORED_32_63_MB_IRQHandler
      CAN1_ORED_64_95_MB_IRQHandler
      CAN1_ORED_IRQHandler
      CAN2_ORED_0_31_MB_IRQHandler
      CAN2_ORED_32_63_MB_IRQHandler
      CAN2_ORED_64_95_MB_IRQHandler
      CAN2_ORED_IRQHandler
      CAN3_ORED_0_31_MB_IRQHandler
      CAN3_ORED_32_63_MB_IRQHandler
      CAN3_ORED_IRQHandler
      CAN4_ORED_0_31_MB_IRQHandler
      CAN4_ORED_32_63_MB_IRQHandler
      CAN4_ORED_IRQHandler
      CAN5_ORED_0_31_MB_IRQHandler
      CAN5_ORED_32_63_MB_IRQHandler
      CAN5_ORED_IRQHandler
      CAN6_ORED_0_31_MB_IRQHandler
      CAN6_ORED_32_63_MB_IRQHandler
      CAN6_ORED_IRQHandler
      CAN7_ORED_0_31_MB_IRQHandler
      CAN7_ORED_32_63_MB_IRQHandler
      CAN7_ORED_IRQHandler
    bsw internal behavior InternalBehavior_Can
      20 x exclusive area:
        CAN_EXCLUSIVE_AREA_{00..11}
        CAN_EXCLUSIVE_AREA_{13..20}
      16 x bsw called entity:
        Can_43_FLEXCAN_AbortMb: can-enter-exclusive-area=CAN_EXCLUSIVE_AREA_11, implemented-entry=Can_AbortMb
        Can_43_FLEXCAN_CheckWakeup: implemented-entry=Can_CheckWakeup
        Can_43_FLEXCAN_DeInit: can-enter-exclusive-area=[CAN_EXCLUSIVE_AREA_02, CAN_EXCLUSIVE_AREA_05], implemented-entry=Can_DeInit
        Can_43_FLEXCAN_DisableControllerInterrupts: can-enter-exclusive-area=[CAN_EXCLUSIVE_AREA_00, CAN_EXCLUSIVE_AREA_03, CAN_EXCLUSIVE_AREA_05, CAN_EXCLUSIVE_AREA_06], implemented-entry=Can_DisableControllerInterrupts
        Can_43_FLEXCAN_EnableControllerInterrupts: can-enter-exclusive-area=[CAN_EXCLUSIVE_AREA_01, CAN_EXCLUSIVE_AREA_03, CAN_EXCLUSIVE_AREA_05, CAN_EXCLUSIVE_AREA_06], implemented-entry=Can_EnableControllerInterrupts
        Can_43_FLEXCAN_EnableEgressTimeStamp: implemented-entry=Can_EnableEgressTimeStamp
        Can_43_FLEXCAN_GetControllerErrorState: implemented-entry=Can_GetControllerErrorState
        Can_43_FLEXCAN_GetControllerMode: implemented-entry=Can_GetControllerMode
        Can_43_FLEXCAN_GetControllerRxErrorCounter: implemented-entry=Can_GetControllerRxErrorCounter
        Can_43_FLEXCAN_GetControllerTxErrorCounter: implemented-entry=Can_GetControllerTxErrorCounter
        Can_43_FLEXCAN_GetCurrentTime: implemented-entry=Can_GetCurrentTime
        Can_43_FLEXCAN_GetEgressTimeStamp: implemented-entry=Can_GetEgressTimeStamp
        Can_43_FLEXCAN_GetIngressTimeStamp: implemented-entry=Can_GetIngressTimeStamp
        Can_43_FLEXCAN_GetVersionInfo: implemented-entry=Can_GetVersionInfo
        Can_43_FLEXCAN_Init: can-enter-exclusive-area=[CAN_EXCLUSIVE_AREA_02, CAN_EXCLUSIVE_AREA_05, CAN_EXCLUSIVE_AREA_08, CAN_EXCLUSIVE_AREA_13, CAN_EXCLUSIVE_AREA_16, CAN_EXCLUSIVE_AREA_17, CAN_EXCLUSIVE_AREA_19], implemented-entry=Can_Init
        Can_43_FLEXCAN_ListenOnlyMode: can-enter-exclusive-area=[CAN_EXCLUSIVE_AREA_03, CAN_EXCLUSIVE_AREA_05, CAN_EXCLUSIVE_AREA_10], implemented-entry=Can_ListenOnlyMode
      5 x bsw schedulable entity:
        Can_43_FLEXCAN_MainFunction_BusOff: implemented-entry=Can_MainFunction_BusOff
        Can_43_FLEXCAN_MainFunction_Mode: implemented-entry=Can_MainFunction_Mode
        Can_43_FLEXCAN_MainFunction_Read: implemented-entry=Can_MainFunction_Read
        Can_43_FLEXCAN_MainFunction_Wakeup: implemented-entry=Can_MainFunction_Wakeup
        Can_43_FLEXCAN_MainFunction_Write: implemented-entry=Can_MainFunction_Write
      7 x bsw called entity:
        Can_43_FLEXCAN_SetBaudrate: can-enter-exclusive-area=[CAN_EXCLUSIVE_AREA_02, CAN_EXCLUSIVE_AREA_05, CAN_EXCLUSIVE_AREA_14, CAN_EXCLUSIVE_AREA_15, CAN_EXCLUSIVE_AREA_16, CAN_EXCLUSIVE_AREA_17], implemented-entry=Can_SetBaudrate
        Can_43_FLEXCAN_SetClockMode: can-enter-exclusive-area=[CAN_EXCLUSIVE_AREA_03, CAN_EXCLUSIVE_AREA_05, CAN_EXCLUSIVE_AREA_14, CAN_EXCLUSIVE_AREA_15], implemented-entry=Can_SetClockMode
        Can_43_FLEXCAN_SetControllerMode: can-enter-exclusive-area=[CAN_EXCLUSIVE_AREA_02, CAN_EXCLUSIVE_AREA_04, CAN_EXCLUSIVE_AREA_05, CAN_EXCLUSIVE_AREA_06, CAN_EXCLUSIVE_AREA_07, CAN_EXCLUSIVE_AREA_08, CAN_EXCLUSIVE_AREA_10, CAN_EXCLUSIVE_AREA_11, CAN_EXCLUSIVE_AREA_13, CAN_EXCLUSIVE_AREA_14, CAN_EXCLUSIVE_AREA_15, CAN_EXCLUSIVE_AREA_16, CAN_EXCLUSIVE_AREA_17, CAN_EXCLUSIVE_AREA_18, CAN_EXCLUSIVE_AREA_19], implemented-entry=Can_SetControllerMode
        Can_43_FLEXCAN_SetCurrentTime: implemented-entry=Can_SetCurrentTime
        Can_43_FLEXCAN_Write: can-enter-exclusive-area=CAN_EXCLUSIVE_AREA_18, implemented-entry=Can_Write
        FlexCAN_Ip_ClearTDCFail: can-enter-exclusive-area=CAN_EXCLUSIVE_AREA_09, implemented-entry=FlexCAN_Ip_ClearTDCFail
        FlexCAN_Ip_ManualBusOffRecovery: can-enter-exclusive-area=CAN_EXCLUSIVE_AREA_20, implemented-entry=FlexCAN_Ip_ManualBusOffRecovery
      27 x bsw interrupt entity, all with interrupt-category=CAT-2, interrupt-source=Hardware:
        CAN0_ORED_0_31_MB_IRQHandler: can-enter-exclusive-area=CAN_EXCLUSIVE_AREA_18, implemented-entry=CAN0_ORED_0_31_MB_IRQHandler
        CAN0_ORED_32_63_MB_IRQHandler: can-enter-exclusive-area=CAN_EXCLUSIVE_AREA_18, implemented-entry=CAN0_ORED_32_63_MB_IRQHandler
        CAN0_ORED_64_95_MB_IRQHandler: can-enter-exclusive-area=CAN_EXCLUSIVE_AREA_18, implemented-entry=CAN0_ORED_64_95_MB_IRQHandler
        CAN0_ORED_IRQHandler: implemented-entry=CAN0_ORED_IRQHandler
        CAN1_ORED_0_31_MB_IRQHandler: can-enter-exclusive-area=CAN_EXCLUSIVE_AREA_18, implemented-entry=CAN1_ORED_0_31_MB_IRQHandler
        CAN1_ORED_32_63_MB_IRQHandler: can-enter-exclusive-area=CAN_EXCLUSIVE_AREA_18, implemented-entry=CAN1_ORED_32_63_MB_IRQHandler
        CAN1_ORED_64_95_MB_IRQHandler: can-enter-exclusive-area=CAN_EXCLUSIVE_AREA_18, implemented-entry=CAN1_ORED_64_95_MB_IRQHandler
        CAN1_ORED_IRQHandler: implemented-entry=CAN1_ORED_IRQHandler
        CAN2_ORED_0_31_MB_IRQHandler: can-enter-exclusive-area=CAN_EXCLUSIVE_AREA_18, implemented-entry=CAN2_ORED_0_31_MB_IRQHandler
        CAN2_ORED_32_63_MB_IRQHandler: can-enter-exclusive-area=CAN_EXCLUSIVE_AREA_18, implemented-entry=CAN2_ORED_32_63_MB_IRQHandler
        CAN2_ORED_64_95_MB_IRQHandler: can-enter-exclusive-area=CAN_EXCLUSIVE_AREA_18, implemented-entry=CAN2_ORED_64_95_MB_IRQHandler
        CAN2_ORED_IRQHandler: implemented-entry=CAN2_ORED_IRQHandler
        CAN3_ORED_0_31_MB_IRQHandler: can-enter-exclusive-area=CAN_EXCLUSIVE_AREA_18, implemented-entry=CAN3_ORED_0_31_MB_IRQHandler
        CAN3_ORED_32_63_MB_IRQHandler: can-enter-exclusive-area=CAN_EXCLUSIVE_AREA_18, implemented-entry=CAN3_ORED_32_63_MB_IRQHandler
        CAN3_ORED_IRQHandler: implemented-entry=CAN3_ORED_IRQHandler
        CAN4_ORED_0_31_MB_IRQHandler: can-enter-exclusive-area=CAN_EXCLUSIVE_AREA_18, implemented-entry=CAN4_ORED_0_31_MB_IRQHandler
        CAN4_ORED_32_63_MB_IRQHandler: can-enter-exclusive-area=CAN_EXCLUSIVE_AREA_18, implemented-entry=CAN4_ORED_32_63_MB_IRQHandler
        CAN4_ORED_IRQHandler: implemented-entry=CAN4_ORED_IRQHandler
        CAN5_ORED_0_31_MB_IRQHandler: can-enter-exclusive-area=CAN_EXCLUSIVE_AREA_18, implemented-entry=CAN5_ORED_0_31_MB_IRQHandler
        CAN5_ORED_32_63_MB_IRQHandler: can-enter-exclusive-area=CAN_EXCLUSIVE_AREA_18, implemented-entry=CAN5_ORED_32_63_MB_IRQHandler
        CAN5_ORED_IRQHandler: implemented-entry=CAN5_ORED_IRQHandler
        CAN6_ORED_0_31_MB_IRQHandler: implemented-entry=CAN6_ORED_0_31_MB_IRQHandler
        CAN6_ORED_32_63_MB_IRQHandler: implemented-entry=CAN6_ORED_32_63_MB_IRQHandler
        CAN6_ORED_IRQHandler: implemented-entry=CAN6_ORED_IRQHandler
        CAN7_ORED_0_31_MB_IRQHandler: implemented-entry=CAN7_ORED_0_31_MB_IRQHandler
        CAN7_ORED_32_63_MB_IRQHandler: implemented-entry=CAN7_ORED_32_63_MB_IRQHandler
        CAN7_ORED_IRQHandler: implemented-entry=CAN7_ORED_IRQHandler
package /AUTOSAR_Can_43_FLEXCAN/BswModuleEntrys
  55 x bsw module entry, all with sw-service-impl-policy=STANDARD:
    Can_AbortMb: service-id=0x19, is-reentrant=true, is-synchronous=true, call-type=REGULAR, execution-context=UNSPECIFIED
    Can_CheckWakeup: service-id=0x0b, is-reentrant=false, is-synchronous=true, call-type=REGULAR, execution-context=UNSPECIFIED
    Can_DeInit: service-id=0x10, is-reentrant=false, is-synchronous=true, call-type=REGULAR, execution-context=UNSPECIFIED
    Can_DisableControllerInterrupts: service-id=0x04, is-reentrant=true, is-synchronous=true, call-type=REGULAR, execution-context=UNSPECIFIED
    Can_EnableControllerInterrupts: service-id=0x05, is-reentrant=true, is-synchronous=true, call-type=REGULAR, execution-context=UNSPECIFIED
    Can_EnableEgressTimeStamp: service-id=0x14, is-reentrant=true, is-synchronous=true, call-type=REGULAR, execution-context=UNSPECIFIED
    Can_GetControllerErrorState: service-id=0x11, is-reentrant=false, is-synchronous=true, call-type=REGULAR, execution-context=UNSPECIFIED
    Can_GetControllerMode: service-id=0x12, is-reentrant=false, is-synchronous=true, call-type=REGULAR, execution-context=UNSPECIFIED
    Can_GetControllerRxErrorCounter: service-id=0x30, is-reentrant=false, is-synchronous=true, call-type=REGULAR, execution-context=UNSPECIFIED
    Can_GetControllerTxErrorCounter: service-id=0x31, is-reentrant=false, is-synchronous=true, call-type=REGULAR, execution-context=UNSPECIFIED
    Can_GetCurrentTime: service-id=0x13, is-reentrant=true, is-synchronous=true, call-type=REGULAR, execution-context=UNSPECIFIED
    Can_GetEgressTimeStamp: service-id=0x15, is-reentrant=true, is-synchronous=true, call-type=REGULAR, execution-context=UNSPECIFIED
    Can_GetIngressTimeStamp: service-id=0x16, is-reentrant=true, is-synchronous=true, call-type=REGULAR, execution-context=UNSPECIFIED
    Can_GetVersionInfo: service-id=0x07, is-reentrant=true, is-synchronous=true, call-type=REGULAR, execution-context=UNSPECIFIED
    Can_Init: service-id=0x00, is-reentrant=false, is-synchronous=true, call-type=REGULAR, execution-context=UNSPECIFIED
    Can_ListenOnlyMode: service-id=0x32, is-reentrant=true, is-synchronous=true, call-type=REGULAR, execution-context=UNSPECIFIED
    Can_MainFunction_BusOff: service-id=0x09, is-reentrant=false, is-synchronous=true, call-type=SCHEDULED, execution-context=TASK
    Can_MainFunction_Mode: service-id=0x0c, is-reentrant=false, is-synchronous=true, call-type=SCHEDULED, execution-context=TASK
    Can_MainFunction_Read: service-id=0x08, is-reentrant=false, is-synchronous=true, call-type=SCHEDULED, execution-context=TASK
    Can_MainFunction_Wakeup: service-id=0x0a, is-reentrant=false, is-synchronous=true, call-type=SCHEDULED, execution-context=TASK
    Can_MainFunction_Write: service-id=0x01, is-reentrant=false, is-synchronous=true, call-type=SCHEDULED, execution-context=TASK
    Can_SetBaudrate: service-id=0x0f, is-reentrant=false, is-synchronous=true, call-type=REGULAR, execution-context=UNSPECIFIED
    Can_SetClockMode: service-id=0x18, is-reentrant=true, is-synchronous=true, call-type=REGULAR, execution-context=UNSPECIFIED
    Can_SetControllerMode: service-id=0x03, is-reentrant=false, is-synchronous=false, call-type=REGULAR, execution-context=UNSPECIFIED
    Can_SetCurrentTime: service-id=0x17, is-reentrant=true, is-synchronous=true, call-type=REGULAR, execution-context=UNSPECIFIED
    Can_Write: service-id=0x06, is-reentrant=false, is-synchronous=true, call-type=REGULAR, execution-context=UNSPECIFIED
    FlexCAN_Ip_ClearTDCFail: service-id=0x100, is-reentrant=false, is-synchronous=true, call-type=REGULAR, execution-context=UNSPECIFIED
    FlexCAN_Ip_ManualBusOffRecovery: service-id=0x100, is-reentrant=false, is-synchronous=true, call-type=REGULAR, execution-context=UNSPECIFIED
    CAN0_ORED_0_31_MB_IRQHandler: service-id=0, is-reentrant=false, is-synchronous=true, call-type=INTERRUPT, execution-context=INTERRUPT-CAT-2
    CAN0_ORED_32_63_MB_IRQHandler: service-id=0, is-reentrant=false, is-synchronous=true, call-type=INTERRUPT, execution-context=INTERRUPT-CAT-2
    CAN0_ORED_64_95_MB_IRQHandler: service-id=0, is-reentrant=false, is-synchronous=true, call-type=INTERRUPT, execution-context=INTERRUPT-CAT-2
    CAN0_ORED_IRQHandler: service-id=0, is-reentrant=false, is-synchronous=true, call-type=INTERRUPT, execution-context=INTERRUPT-CAT-2
    CAN1_ORED_0_31_MB_IRQHandler: service-id=0, is-reentrant=false, is-synchronous=true, call-type=INTERRUPT, execution-context=INTERRUPT-CAT-2
    CAN1_ORED_32_63_MB_IRQHandler: service-id=0, is-reentrant=false, is-synchronous=true, call-type=INTERRUPT, execution-context=INTERRUPT-CAT-2
    CAN1_ORED_64_95_MB_IRQHandler: service-id=0, is-reentrant=false, is-synchronous=true, call-type=INTERRUPT, execution-context=INTERRUPT-CAT-2
    CAN1_ORED_IRQHandler: service-id=0, is-reentrant=false, is-synchronous=true, call-type=INTERRUPT, execution-context=INTERRUPT-CAT-2
    CAN2_ORED_0_31_MB_IRQHandler: service-id=0, is-reentrant=false, is-synchronous=true, call-type=INTERRUPT, execution-context=INTERRUPT-CAT-2
    CAN2_ORED_32_63_MB_IRQHandler: service-id=0, is-reentrant=false, is-synchronous=true, call-type=INTERRUPT, execution-context=INTERRUPT-CAT-2
    CAN2_ORED_64_95_MB_IRQHandler: service-id=0, is-reentrant=false, is-synchronous=true, call-type=INTERRUPT, execution-context=INTERRUPT-CAT-2
    CAN2_ORED_IRQHandler: service-id=0, is-reentrant=false, is-synchronous=true, call-type=INTERRUPT, execution-context=INTERRUPT-CAT-2
    CAN3_ORED_0_31_MB_IRQHandler: service-id=0, is-reentrant=false, is-synchronous=true, call-type=INTERRUPT, execution-context=INTERRUPT-CAT-2
    CAN3_ORED_32_63_MB_IRQHandler: service-id=0, is-reentrant=false, is-synchronous=true, call-type=INTERRUPT, execution-context=INTERRUPT-CAT-2
    CAN3_ORED_IRQHandler: service-id=0, is-reentrant=false, is-synchronous=true, call-type=INTERRUPT, execution-context=INTERRUPT-CAT-2
    CAN4_ORED_0_31_MB_IRQHandler: service-id=0, is-reentrant=false, is-synchronous=true, call-type=INTERRUPT, execution-context=INTERRUPT-CAT-2
    CAN4_ORED_32_63_MB_IRQHandler: service-id=0, is-reentrant=false, is-synchronous=true, call-type=INTERRUPT, execution-context=INTERRUPT-CAT-2
    CAN4_ORED_IRQHandler: service-id=0, is-reentrant=false, is-synchronous=true, call-type=INTERRUPT, execution-context=INTERRUPT-CAT-2
    CAN5_ORED_0_31_MB_IRQHandler: service-id=0, is-reentrant=false, is-synchronous=true, call-type=INTERRUPT, execution-context=INTERRUPT-CAT-2
    CAN5_ORED_32_63_MB_IRQHandler: service-id=0, is-reentrant=false, is-synchronous=true, call-type=INTERRUPT, execution-context=INTERRUPT-CAT-2
    CAN5_ORED_IRQHandler: service-id=0, is-reentrant=false, is-synchronous=true, call-type=INTERRUPT, execution-context=INTERRUPT-CAT-2
    CAN6_ORED_0_31_MB_IRQHandler: service-id=0, is-reentrant=false, is-synchronous=true, call-type=INTERRUPT, execution-context=INTERRUPT-CAT-2
    CAN6_ORED_32_63_MB_IRQHandler: service-id=0, is-reentrant=false, is-synchronous=true, call-type=INTERRUPT, execution-context=INTERRUPT-CAT-2
    CAN6_ORED_IRQHandler: service-id=0, is-reentrant=false, is-synchronous=true, call-type=INTERRUPT, execution-context=INTERRUPT-CAT-2
    CAN7_ORED_0_31_MB_IRQHandler: service-id=0, is-reentrant=false, is-synchronous=true, call-type=INTERRUPT, execution-context=INTERRUPT-CAT-2
    CAN7_ORED_32_63_MB_IRQHandler: service-id=0, is-reentrant=false, is-synchronous=true, call-type=INTERRUPT, execution-context=INTERRUPT-CAT-2
    CAN7_ORED_IRQHandler: service-id=0, is-reentrant=false, is-synchronous=true, call-type=INTERRUPT, execution-context=INTERRUPT-CAT-2
package /Can_43_FLEXCAN_TS_T40D34M30I0R0/Implementations
  bsw implementation BswImplementation_Can: programming-language=C, sw-version=3.0.0, vendor-id=43, ar-release-version=4.7.0, behavior=InternalBehavior_Can, vendor-api-infix=FLEXCAN, vendor-specific-module-def=Can
    code-descriptors:
      code Files
        artifact-descriptors:
          short-label=config::Can_43_FLEXCAN.xdm, category=SWCFG
          short-label=doc::RTD_CAN_43_FLEXCAN_IM.pdf, category=SWDOC
          short-label=doc::RTD_CAN_43_FLEXCAN_UM.pdf, category=SWDOC
          short-label=examples::EBT::S32K358::Can_example_S32K358::generate::epc::BaseNXP.xdm, category=SWCFG
          short-label=examples::EBT::S32K358::Can_example_S32K358::generate::epc::CanIf.xdm, category=SWCFG
          short-label=examples::EBT::S32K358::Can_example_S32K358::generate::epc::Can_43_FLEXCAN.xdm, category=SWCFG
          short-label=examples::EBT::S32K358::Can_example_S32K358::generate::epc::EcuC.xdm, category=SWCFG
          short-label=examples::EBT::S32K358::Can_example_S32K358::generate::epc::EcuM.xdm, category=SWCFG
          short-label=examples::EBT::S32K358::Can_example_S32K358::generate::epc::Mcu.xdm, category=SWCFG
          short-label=examples::EBT::S32K358::Can_example_S32K358::generate::epc::Platform.xdm, category=SWCFG
          short-label=examples::EBT::S32K358::Can_example_S32K358::generate::epc::Resource.xdm, category=SWCFG
          short-label=examples::EBT::S32K358::Can_example_S32K358::include::check_example.h, category=SWHDR
          short-label=examples::EBT::S32K358::Can_example_S32K358::src::main.c, category=SWSRC
          short-label=examples::EBT::S32K358::Can_example_S32K358::TresosProject::Can_example_S32K358::.prefs::preferences.xdm, category=SWCFG
          short-label=examples::EBT::S32K358::Can_example_S32K358::TresosProject::Can_example_S32K358::config::BaseNXP.xdm, category=SWCFG
          short-label=examples::EBT::S32K358::Can_example_S32K358::TresosProject::Can_example_S32K358::config::CanIf.xdm, category=SWCFG
          short-label=examples::EBT::S32K358::Can_example_S32K358::TresosProject::Can_example_S32K358::config::Can_43_FLEXCAN.xdm, category=SWCFG
          short-label=examples::EBT::S32K358::Can_example_S32K358::TresosProject::Can_example_S32K358::config::EcuC.xdm, category=SWCFG
          short-label=examples::EBT::S32K358::Can_example_S32K358::TresosProject::Can_example_S32K358::config::EcuM.xdm, category=SWCFG
          short-label=examples::EBT::S32K358::Can_example_S32K358::TresosProject::Can_example_S32K358::config::Mcu.xdm, category=SWCFG
          short-label=examples::EBT::S32K358::Can_example_S32K358::TresosProject::Can_example_S32K358::config::Platform.xdm, category=SWCFG
          short-label=examples::EBT::S32K358::Can_example_S32K358::TresosProject::Can_example_S32K358::config::Resource.xdm, category=SWCFG
          short-label=examples::EBT::S32K396::Can_example_S32K396::generate::epc::BaseNXP.xdm, category=SWCFG
          short-label=examples::EBT::S32K396::Can_example_S32K396::generate::epc::CanIf.xdm, category=SWCFG
          short-label=examples::EBT::S32K396::Can_example_S32K396::generate::epc::Can_43_FLEXCAN.xdm, category=SWCFG
          short-label=examples::EBT::S32K396::Can_example_S32K396::generate::epc::EcuC.xdm, category=SWCFG
          short-label=examples::EBT::S32K396::Can_example_S32K396::generate::epc::EcuM.xdm, category=SWCFG
          short-label=examples::EBT::S32K396::Can_example_S32K396::generate::epc::Mcu.xdm, category=SWCFG
          short-label=examples::EBT::S32K396::Can_example_S32K396::generate::epc::Platform.xdm, category=SWCFG
          short-label=examples::EBT::S32K396::Can_example_S32K396::generate::epc::Resource.xdm, category=SWCFG
          short-label=examples::EBT::S32K396::Can_example_S32K396::include::check_example.h, category=SWHDR
          short-label=examples::EBT::S32K396::Can_example_S32K396::src::main.c, category=SWSRC
          short-label=examples::EBT::S32K396::Can_example_S32K396::TresosProject::Can_example_S32K396::.prefs::preferences.xdm, category=SWCFG
          short-label=examples::EBT::S32K396::Can_example_S32K396::TresosProject::Can_example_S32K396::config::BaseNXP.xdm, category=SWCFG
          short-label=examples::EBT::S32K396::Can_example_S32K396::TresosProject::Can_example_S32K396::config::CanIf.xdm, category=SWCFG
          short-label=examples::EBT::S32K396::Can_example_S32K396::TresosProject::Can_example_S32K396::config::Can_43_FLEXCAN.xdm, category=SWCFG
          short-label=examples::EBT::S32K396::Can_example_S32K396::TresosProject::Can_example_S32K396::config::EcuC.xdm, category=SWCFG
          short-label=examples::EBT::S32K396::Can_example_S32K396::TresosProject::Can_example_S32K396::config::EcuM.xdm, category=SWCFG
          short-label=examples::EBT::S32K396::Can_example_S32K396::TresosProject::Can_example_S32K396::config::Mcu.xdm, category=SWCFG
          short-label=examples::EBT::S32K396::Can_example_S32K396::TresosProject::Can_example_S32K396::config::Platform.xdm, category=SWCFG
          short-label=examples::EBT::S32K396::Can_example_S32K396::TresosProject::Can_example_S32K396::config::Resource.xdm, category=SWCFG
          short-label=examples::EBT::S32K3XX::Can_example_S32K344::generate::epc::BaseNXP.xdm, category=SWCFG
          short-label=examples::EBT::S32K3XX::Can_example_S32K344::generate::epc::CanIf.xdm, category=SWCFG
          short-label=examples::EBT::S32K3XX::Can_example_S32K344::generate::epc::Can_43_FLEXCAN.xdm, category=SWCFG
          short-label=examples::EBT::S32K3XX::Can_example_S32K344::generate::epc::EcuC.xdm, category=SWCFG
          short-label=examples::EBT::S32K3XX::Can_example_S32K344::generate::epc::EcuM.xdm, category=SWCFG
          short-label=examples::EBT::S32K3XX::Can_example_S32K344::generate::epc::Mcu.xdm, category=SWCFG
          short-label=examples::EBT::S32K3XX::Can_example_S32K344::generate::epc::Platform.xdm, category=SWCFG
          short-label=examples::EBT::S32K3XX::Can_example_S32K344::generate::epc::Resource.xdm, category=SWCFG
          short-label=examples::EBT::S32K3XX::Can_example_S32K344::include::check_example.h, category=SWHDR
          short-label=examples::EBT::S32K3XX::Can_example_S32K344::src::main.c, category=SWSRC
          short-label=examples::EBT::S32K3XX::Can_example_S32K344::TresosProject::Can_example_S32K344::.prefs::preferences.xdm, category=SWCFG
          short-label=examples::EBT::S32K3XX::Can_example_S32K344::TresosProject::Can_example_S32K344::config::BaseNXP.xdm, category=SWCFG
          short-label=examples::EBT::S32K3XX::Can_example_S32K344::TresosProject::Can_example_S32K344::config::CanIf.xdm, category=SWCFG
          short-label=examples::EBT::S32K3XX::Can_example_S32K344::TresosProject::Can_example_S32K344::config::Can_43_FLEXCAN.xdm, category=SWCFG
          short-label=examples::EBT::S32K3XX::Can_example_S32K344::TresosProject::Can_example_S32K344::config::EcuC.xdm, category=SWCFG
          short-label=examples::EBT::S32K3XX::Can_example_S32K344::TresosProject::Can_example_S32K344::config::EcuM.xdm, category=SWCFG
          short-label=examples::EBT::S32K3XX::Can_example_S32K344::TresosProject::Can_example_S32K344::config::Mcu.xdm, category=SWCFG
          short-label=examples::EBT::S32K3XX::Can_example_S32K344::TresosProject::Can_example_S32K344::config::Platform.xdm, category=SWCFG
          short-label=examples::EBT::S32K3XX::Can_example_S32K344::TresosProject::Can_example_S32K344::config::Resource.xdm, category=SWCFG
          short-label=examples::S32DS::S32K358::Can_Example_S32K358::include::check_example.h, category=SWHDR
          short-label=examples::S32DS::S32K358::Can_Example_S32K358::Project_Settings::Startup_Code::exceptions.c, category=SWSRC
          short-label=examples::S32DS::S32K358::Can_Example_S32K358::Project_Settings::Startup_Code::nvic.c, category=SWSRC
          short-label=examples::S32DS::S32K358::Can_Example_S32K358::Project_Settings::Startup_Code::startup.c, category=SWSRC
          short-label=examples::S32DS::S32K358::Can_Example_S32K358::Project_Settings::Startup_Code::system.c, category=SWSRC
          short-label=examples::S32DS::S32K358::Can_Example_S32K358::src::main.c, category=SWSRC
          short-label=examples::S32DS::S32K358::FlexCAN_Ip_Example_S32K358::include::check_example.h, category=SWHDR
          short-label=examples::S32DS::S32K358::FlexCAN_Ip_Example_S32K358::Project_Settings::Startup_Code::exceptions.c, category=SWSRC
          short-label=examples::S32DS::S32K358::FlexCAN_Ip_Example_S32K358::Project_Settings::Startup_Code::nvic.c, category=SWSRC
          short-label=examples::S32DS::S32K358::FlexCAN_Ip_Example_S32K358::Project_Settings::Startup_Code::startup.c, category=SWSRC
          short-label=examples::S32DS::S32K358::FlexCAN_Ip_Example_S32K358::Project_Settings::Startup_Code::system.c, category=SWSRC
          short-label=examples::S32DS::S32K358::FlexCAN_Ip_Example_S32K358::src::main.c, category=SWSRC
          short-label=examples::S32DS::S32K396::Can_Example_S32K396::include::check_example.h, category=SWHDR
          short-label=examples::S32DS::S32K396::Can_Example_S32K396::Project_Settings::Startup_Code::exceptions.c, category=SWSRC
          short-label=examples::S32DS::S32K396::Can_Example_S32K396::Project_Settings::Startup_Code::nvic.c, category=SWSRC
          short-label=examples::S32DS::S32K396::Can_Example_S32K396::Project_Settings::Startup_Code::startup.c, category=SWSRC
          short-label=examples::S32DS::S32K396::Can_Example_S32K396::Project_Settings::Startup_Code::system.c, category=SWSRC
          short-label=examples::S32DS::S32K396::Can_Example_S32K396::src::main.c, category=SWSRC
          short-label=examples::S32DS::S32K396::FlexCAN_Ip_Example_S32K396::include::check_example.h, category=SWHDR
          short-label=examples::S32DS::S32K396::FlexCAN_Ip_Example_S32K396::Project_Settings::Startup_Code::exceptions.c, category=SWSRC
          short-label=examples::S32DS::S32K396::FlexCAN_Ip_Example_S32K396::Project_Settings::Startup_Code::nvic.c, category=SWSRC
          short-label=examples::S32DS::S32K396::FlexCAN_Ip_Example_S32K396::Project_Settings::Startup_Code::startup.c, category=SWSRC
          short-label=examples::S32DS::S32K396::FlexCAN_Ip_Example_S32K396::Project_Settings::Startup_Code::system.c, category=SWSRC
          short-label=examples::S32DS::S32K396::FlexCAN_Ip_Example_S32K396::src::main.c, category=SWSRC
          short-label=examples::S32DS::S32K3XX::Can_Example_S32K344::include::check_example.h, category=SWHDR
          short-label=examples::S32DS::S32K3XX::Can_Example_S32K344::Project_Settings::Startup_Code::exceptions.c, category=SWSRC
          short-label=examples::S32DS::S32K3XX::Can_Example_S32K344::Project_Settings::Startup_Code::nvic.c, category=SWSRC
          short-label=examples::S32DS::S32K3XX::Can_Example_S32K344::Project_Settings::Startup_Code::startup.c, category=SWSRC
          short-label=examples::S32DS::S32K3XX::Can_Example_S32K344::Project_Settings::Startup_Code::system.c, category=SWSRC
          short-label=examples::S32DS::S32K3XX::Can_Example_S32K344::src::main.c, category=SWSRC
          short-label=examples::S32DS::S32K3XX::FlexCAN_Ip_Example_S32K344::include::check_example.h, category=SWHDR
          short-label=examples::S32DS::S32K3XX::FlexCAN_Ip_Example_S32K344::Project_Settings::Startup_Code::exceptions.c, category=SWSRC
          short-label=examples::S32DS::S32K3XX::FlexCAN_Ip_Example_S32K344::Project_Settings::Startup_Code::nvic.c, category=SWSRC
          short-label=examples::S32DS::S32K3XX::FlexCAN_Ip_Example_S32K344::Project_Settings::Startup_Code::startup.c, category=SWSRC
          short-label=examples::S32DS::S32K3XX::FlexCAN_Ip_Example_S32K344::Project_Settings::Startup_Code::system.c, category=SWSRC
          short-label=examples::S32DS::S32K3XX::FlexCAN_Ip_Example_S32K344::src::main.c, category=SWSRC
          short-label=include::Can_43_FLEXCAN.h, category=SWHDR
          short-label=include::Can_43_FLEXCAN_Ipw.h, category=SWHDR
          short-label=include::Can_43_FLEXCAN_Ipw_Irq.h, category=SWHDR
          short-label=include::Can_43_FLEXCAN_Ipw_Types.h, category=SWHDR
          short-label=include::Can_43_FLEXCAN_Irq.h, category=SWHDR
          short-label=include::Can_Flexcan_Types.h, category=SWHDR
          short-label=include::FlexCAN_Ip.h, category=SWHDR
          short-label=include::FlexCAN_Ip_DeviceReg.h, category=SWHDR
          short-label=include::FlexCAN_Ip_HwAccess.h, category=SWHDR
          short-label=include::FlexCAN_Ip_Irq.h, category=SWHDR
          short-label=include::FlexCAN_Ip_TrustedFunctions.h, category=SWHDR
          short-label=include::FlexCAN_Ip_Types.h, category=SWHDR
          short-label=include::FlexCAN_Ip_Wrapper.h, category=SWHDR
          short-label=src::Can_43_FLEXCAN.c, category=SWSRC
          short-label=src::Can_43_FLEXCAN_Ipw.c, category=SWSRC
          short-label=src::Can_43_FLEXCAN_Irq.c, category=SWSRC
          short-label=src::FlexCAN_Ip.c, category=SWSRC
          short-label=src::FlexCAN_Ip_HwAccess.c, category=SWSRC
          short-label=src::FlexCAN_Ip_Irq.c, category=SWSRC
    4 x compiler:
      DIAB_Compiler:
        name=Windriver Diab
        options=-tARMCORTEXM7MG:simple -mthumb -std=c99 -Oz -g -fstandalone-debug -Wstrict-prototypes -Wsign-compare -Wdouble-promotion -Wunknown-pragmas -Wundef -Wextra -Wall -pedantic -Werror=implicit-function-declaration -fno-common -fno-signed-char -fno-trigraphs -V -c -DS32K3XX -D $ (DERIVATIVE) -DDIAB -DUSE_SW_VECTOR_MODE -DD_CACHE_ENABLE -DI_CACHE_ENABLE -DENABLE_FPU -DMCAL_ENABLE_USER_MODE_SUPPORT
        vendor=Windriver
        version=Wind River Diab Compiler v7.0.4
      GCC_Compiler:
        name=GCC Compiler
        options=-mcpu=cortex-m7 -mthumb -mlittle-endian -mfpu=fpv5-sp-d16 -mfloat-abi=hard -std=c99 -Os -ggdb3 -Wall -Wextra -pedantic -Wstrict-prototypes -Wundef -Wunused -Werror=implicit-function-declaration -Wsign-compare -Wdouble-promotion -fno-short-enums -funsigned-char -funsigned-bitfields -fno-common -fstack-usage -fdump-ipa-all -c -DS32K3XX -D $ (DERIVATIVE) -DGCC -DUSE_SW_VECTOR_MODE -DD_CACHE_ENABLE -DI_CACHE_ENABLE -DENABLE_FPU -DMCAL_ENABLE_USER_MODE_SUPPORT --sysroot=$(NEWLIB_DIR) -specs=nano.specs -specs=nosys.specs
        vendor=GCC Systems
        version=NXP GCC 10.2.0 20200723
      GHS_Compiler:
        name=Green Hills
        options=-cpu=cortexm7 -thumb -fpu=vfpv5_d16 -fsingle -C99 --ghstd=last -Osize --gnu_asm -dual_debug -G -keeptempfiles -Wimplicit-int -Wshadow -Wtrigraphs -Wundef --unsigned_chars --unsigned_fields --no_commons --no_exceptions --no_slash_comment --prototype_errors --incorrect_pragma_warnings -c -DS32K3XX -D $ (DERIVATIVE) -DGHS -DUSE_SW_VECTOR_MODE -DD_CACHE_ENABLE -DI_CACHE_ENABLE -DENABLE_FPU -DMCAL_ENABLE_USER_MODE_SUPPORT
        vendor=Green Hills
        version=Green Hills Multi 7.1.6d / Compiler 2021.1.4
      IAR_Compiler:
        name=IAR Compiler
        options=--cpu Cortex-M7 --cpu_mode thumb --endian little --fpu VFPv5-SP -e -Ohz --debug --no_clustering --no_mem_idioms --do_explicit_zero_opt_in_named_sections --require_prototypes --no_wrap_diagnostics --diag_suppress Pa050 -DS32K3XX -D $ (DERIVATIVE) -DIAR -DUSE_SW_VECTOR_MODE -DD_CACHE_ENABLE -DI_CACHE_ENABLE -DENABLE_FPU -DMCAL_ENABLE_USER_MODE_SUPPORT
        vendor=IAR Systems
        version=IAR ANSI C/C++ Compiler v.8.50.10 (safety version)
    generated-artifacts:
      11 x dependency on artifact:
        Can_43_FLEXCAN_Ipw_PBcfg_h: artifact-descriptor={short-label=generate_PB::include::Can_43_FLEXCAN_Ipw_PBcfg.h, category=SWHDR}, usages=EXECUTE
        Can_43_FLEXCAN_PBcfg_h: artifact-descriptor={short-label=generate_PB::include::Can_43_FLEXCAN_PBcfg.h, category=SWHDR}, usages=EXECUTE
        FlexCAN_Ip_PBcfg_h: artifact-descriptor={short-label=generate_PB::include::FlexCAN_Ip_PBcfg.h, category=SWHDR}, usages=EXECUTE
        Can_43_FLEXCAN_Ipw_PBcfg_c: artifact-descriptor={short-label=generate_PB::src::Can_43_FLEXCAN_Ipw_PBcfg.c, category=SWSRC}, usages=EXECUTE
        Can_43_FLEXCAN_PBcfg_c: artifact-descriptor={short-label=generate_PB::src::Can_43_FLEXCAN_PBcfg.c, category=SWSRC}, usages=EXECUTE
        FlexCAN_Ip_PBcfg_c: artifact-descriptor={short-label=generate_PB::src::FlexCAN_Ip_PBcfg.c, category=SWSRC}, usages=EXECUTE
        Can_43_FLEXCAN_Cfg_h: artifact-descriptor={short-label=generate_PC::include::Can_43_FLEXCAN_Cfg.h, category=SWHDR}, usages=COMPILE
        Can_43_FLEXCAN_Externals_h: artifact-descriptor={short-label=generate_PC::include::Can_43_FLEXCAN_Externals.h, category=SWHDR}, usages=COMPILE
        Can_43_FLEXCAN_Ipw_Cfg_h: artifact-descriptor={short-label=generate_PC::include::Can_43_FLEXCAN_Ipw_Cfg.h, category=SWHDR}, usages=COMPILE
        FlexCAN_Ip_Cfg_h: artifact-descriptor={short-label=generate_PC::include::FlexCAN_Ip_Cfg.h, category=SWHDR}, usages=COMPILE
        FlexCAN_Ip_CfgDefines_h: artifact-descriptor={short-label=generate_PC::include::FlexCAN_Ip_CfgDefines.h, category=SWHDR}, usages=COMPILE
    4 x linker:
      DIAB_Linker: name=Windriver Diab, options=-e Reset_Handler linker_script_file.dld -m30 -Xstack-usage -Xpreprocess-lecl -Llibrary_path -lc -lm -tARMCORTEXM7MG:simple, vendor=Windriver, version=Wind River Diab Compiler v7.0.4
      GCC_Linker: name=GCC Compiler, options=-Wl,-Map,filename -T linkerfile --entry=Reset_Handler -nostartfiles -mcpu=cortexm7 -mthumb -mfpu=fpv5-sp-d16 -mfloat-abi=hard -mlittle-endian -ggdb3 -lc -lm -lgcc -specs=nano.specs -specs=nosys.specs, vendor=GCC Systems, version=NXP GCC 10.2.0 20200723
      GHS_Linker: name=Green Hills, options=-e Reset_Handler -T linker_script_file.ld -map -keepmap -Mn -delete -ignore_debug_references -Llibrary_path -larch -lstartup -lind_sd -v -keep=C40_Ip_AccessCode -nostartfiles, vendor=Green Hills, version=Green Hills Multi 7.1.6d / Compiler 2021.1.4
      IAR_Linker: name=IAR Compiler, options=--map filename --config linkerfile --cpu=Cortex-M7 --fpu VFPv5-SP --entry _start --enable_stack_usage --skip_dynamic_initialization --no_wrap_diagnostics, vendor=IAR Systems, version=IAR ANSI C/C++ Compiler v.8.50.10 (safety version)
    resource consumption ResourceConsumption
      17 x memory section:
        CAN_43_FLEXCAN_CODE: alignment=UNSPECIFIED, sw-addrmethod=CODE, symbol=CODE
        CAN_43_FLEXCAN_CONFIG_DATA_32: alignment=32, sw-addrmethod=CONFIG_DATA, symbol=CONFIG_DATA_32
        CAN_43_FLEXCAN_CONFIG_DATA_8: alignment=8, sw-addrmethod=CONFIG_DATA, symbol=CONFIG_DATA_8
        CAN_43_FLEXCAN_CONFIG_DATA_UNSPECIFIED: alignment=UNSPECIFIED, sw-addrmethod=CONFIG_DATA, symbol=CONFIG_DATA_UNSPECIFIED
        CAN_43_FLEXCAN_CONST_UNSPECIFIED: alignment=UNSPECIFIED, sw-addrmethod=CONST, symbol=CONST_UNSPECIFIED
        CAN_43_FLEXCAN_VAR_CLEARED_16: alignment=16, sw-addrmethod=VAR_CLEARED, symbol=VAR_CLEARED_16
        CAN_43_FLEXCAN_VAR_CLEARED_16_NO_CACHEABLE: alignment=16, sw-addrmethod=VAR_CLEARED_NO_CACHEABLE, symbol=VAR_CLEARED_16_NO_CACHEABLE
        CAN_43_FLEXCAN_VAR_CLEARED_32: alignment=32, sw-addrmethod=VAR_CLEARED, symbol=VAR_CLEARED_32
        CAN_43_FLEXCAN_VAR_CLEARED_32_NO_CACHEABLE: alignment=32, sw-addrmethod=VAR_CLEARED_NO_CACHEABLE, symbol=VAR_CLEARED_32_NO_CACHEABLE
        CAN_43_FLEXCAN_VAR_CLEARED_8: alignment=8, sw-addrmethod=VAR_CLEARED, symbol=VAR_CLEARED_8
        CAN_43_FLEXCAN_VAR_CLEARED_8_NO_CACHEABLE: alignment=8, sw-addrmethod=VAR_CLEARED_NO_CACHEABLE, symbol=VAR_CLEARED_8_NO_CACHEABLE
        CAN_43_FLEXCAN_VAR_CLEARED_BOOLEAN: alignment=BOOLEAN, sw-addrmethod=VAR_CLEARED, symbol=VAR_CLEARED_BOOLEAN
        CAN_43_FLEXCAN_VAR_CLEARED_BOOLEAN_NO_CACHEABLE: alignment=BOOLEAN, sw-addrmethod=VAR_CLEARED_NO_CACHEABLE, symbol=VAR_CLEARED_BOOLEAN_NO_CACHEABLE
        CAN_43_FLEXCAN_VAR_CLEARED_UNSPECIFIED: alignment=UNSPECIFIED, sw-addrmethod=VAR_CLEARED, symbol=VAR_CLEARED_UNSPECIFIED
        CAN_43_FLEXCAN_VAR_CLEARED_UNSPECIFIED_NO_CACHEABLE: alignment=UNSPECIFIED, sw-addrmethod=VAR_CLEARED_NO_CACHEABLE, symbol=VAR_CLEARED_UNSPECIFIED_NO_CACHEABLE
        CAN_43_FLEXCAN_VAR_INIT_32: alignment=32, sw-addrmethod=VAR_INIT, symbol=VAR_INIT_32
        CAN_43_FLEXCAN_VAR_INIT_32_NO_CACHEABLE: alignment=32, sw-addrmethod=VAR_INIT_NO_CACHEABLE, symbol=VAR_INIT_32_NO_CACHEABLE
