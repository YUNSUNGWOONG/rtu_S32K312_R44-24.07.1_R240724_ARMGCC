AUTOSAR XML (schema 00047)
package /AUTOSAR_BaseNXP/BswModuleDescriptions
  bsw module description BaseNXP: module-id=0, provided-entrys=[OsIf_GetCounter, OsIf_GetElapsed, OsIf_Init, OsIf_MicrosToTicks, OsIf_SetTimerFrequency]
    bsw internal behavior InternalBehavior_Base
      5 x bsw called entity:
        OsIf_GetCounter: implemented-entry=OsIf_GetCounter
        OsIf_GetElapsed: implemented-entry=OsIf_GetElapsed
        OsIf_Init: implemented-entry=OsIf_Init
        OsIf_MicrosToTicks: implemented-entry=OsIf_MicrosToTicks
        OsIf_SetTimerFrequency: implemented-entry=OsIf_SetTimerFrequency
package /AUTOSAR_BaseNXP/BswModuleEntrys
  5 x bsw module entry, all with is-synchronous=true, call-type=REGULAR, execution-context=UNSPECIFIED, sw-service-impl-policy=STANDARD:
    OsIf_GetCounter: service-id=0x02, is-reentrant=true
    OsIf_GetElapsed: service-id=0x03, is-reentrant=true
    OsIf_Init: service-id=0x01, is-reentrant=false
    OsIf_MicrosToTicks: service-id=0x05, is-reentrant=true
    OsIf_SetTimerFrequency: service-id=0x04, is-reentrant=true
package /BaseNXP_TS_T40D34M30I0R0/Implementations
  bsw implementation BswImplementation_Base: programming-language=C, sw-version=3.0.0, vendor-id=43, ar-release-version=4.7.0, behavior=InternalBehavior_Base, vendor-specific-module-def=BaseNXP
    code-descriptors:
      code Files
        artifact-descriptors:
          short-label=config::BaseNXP.xdm, category=SWCFG
          short-label=doc::howto::HOWTO_Port_An_S32DS_Example_To_Use_Another_Compiler.pdf, category=SWDOC
          short-label=doc::RTD_BASE_IM.pdf, category=SWDOC
          short-label=doc::RTD_BASE_UM.pdf, category=SWDOC
          short-label=header::S32K311.h, category=SWHDR
          short-label=header::S32K311_ADC.h, category=SWHDR
          short-label=header::S32K311_BCTU.h, category=SWHDR
          short-label=header::S32K311_CMU_FC.h, category=SWHDR
          short-label=header::S32K311_CMU_FM.h, category=SWHDR
          short-label=header::S32K311_COMMON.h, category=SWHDR
          short-label=header::S32K311_CONFIGURATION_GPR.h, category=SWHDR
          short-label=header::S32K311_CRC.h, category=SWHDR
          short-label=header::S32K311_DCM.h, category=SWHDR
          short-label=header::S32K311_DCM_GPR.h, category=SWHDR
          short-label=header::S32K311_DMAMUX.h, category=SWHDR
          short-label=header::S32K311_DMA_TCD.h, category=SWHDR
          short-label=header::S32K311_EDMA.h, category=SWHDR
          short-label=header::S32K311_EIM.h, category=SWHDR
          short-label=header::S32K311_EMIOS.h, category=SWHDR
          short-label=header::S32K311_ERM.h, category=SWHDR
          short-label=header::S32K311_FCCU.h, category=SWHDR
          short-label=header::S32K311_FIRC.h, category=SWHDR
          short-label=header::S32K311_FLASH.h, category=SWHDR
          short-label=header::S32K311_FLEXCAN.h, category=SWHDR
          short-label=header::S32K311_FLEXIO.h, category=SWHDR
          short-label=header::S32K311_FXOSC.h, category=SWHDR
          short-label=header::S32K311_INTM.h, category=SWHDR
          short-label=header::S32K311_JDC.h, category=SWHDR
          short-label=header::S32K311_LCU.h, category=SWHDR
          short-label=header::S32K311_LPCMP.h, category=SWHDR
          short-label=header::S32K311_LPI2C.h, category=SWHDR
          short-label=header::S32K311_LPSPI.h, category=SWHDR
          short-label=header::S32K311_LPUART.h, category=SWHDR
          short-label=header::S32K311_MCM_CM7.h, category=SWHDR
          short-label=header::S32K311_MC_CGM.h, category=SWHDR
          short-label=header::S32K311_MC_ME.h, category=SWHDR
          short-label=header::S32K311_MC_RGM.h, category=SWHDR
          short-label=header::S32K311_MDM_AP.h, category=SWHDR
          short-label=header::S32K311_MPU.h, category=SWHDR
          short-label=header::S32K311_MSCM.h, category=SWHDR
          short-label=header::S32K311_MU.h, category=SWHDR
          short-label=header::S32K311_NVIC.h, category=SWHDR
          short-label=header::S32K311_PFLASH.h, category=SWHDR
          short-label=header::S32K311_PIT.h, category=SWHDR
          short-label=header::S32K311_PLL.h, category=SWHDR
          short-label=header::S32K311_PMC.h, category=SWHDR
          short-label=header::S32K311_PRAMC.h, category=SWHDR
          short-label=header::S32K311_RTC.h, category=SWHDR
          short-label=header::S32K311_SCB.h, category=SWHDR
          short-label=header::S32K311_SDA_AP.h, category=SWHDR
          short-label=header::S32K311_SIRC.h, category=SWHDR
          short-label=header::S32K311_SIUL2.h, category=SWHDR
          short-label=header::S32K311_STCU.h, category=SWHDR
          short-label=header::S32K311_STM.h, category=SWHDR
          short-label=header::S32K311_SWT.h, category=SWHDR
          short-label=header::S32K311_SYSTICK.h, category=SWHDR
          short-label=header::S32K311_TEMPSENSE.h, category=SWHDR
          short-label=header::S32K311_TRGMUX.h, category=SWHDR
          short-label=header::S32K311_TSPC.h, category=SWHDR
          short-label=header::S32K311_VIRT_WRAPPER.h, category=SWHDR
          short-label=header::S32K311_WKPU.h, category=SWHDR
          short-label=header::S32K311_XBIC.h, category=SWHDR
          short-label=header::S32K311_XRDC.h, category=SWHDR
          short-label=header::S32K312.h, category=SWHDR
          short-label=header::S32K312_ADC.h, category=SWHDR
          short-label=header::S32K312_BCTU.h, category=SWHDR
          short-label=header::S32K312_CMU_FC.h, category=SWHDR
          short-label=header::S32K312_CMU_FM.h, category=SWHDR
          short-label=header::S32K312_COMMON.h, category=SWHDR
          short-label=header::S32K312_CONFIGURATION_GPR.h, category=SWHDR
          short-label=header::S32K312_CRC.h, category=SWHDR
          short-label=header::S32K312_DCM.h, category=SWHDR
          short-label=header::S32K312_DCM_GPR.h, category=SWHDR
          short-label=header::S32K312_DMA.h, category=SWHDR
          short-label=header::S32K312_DMAMUX.h, category=SWHDR
          short-label=header::S32K312_DMA_TCD.h, category=SWHDR
          short-label=header::S32K312_EIM.h, category=SWHDR
          short-label=header::S32K312_EMIOS.h, category=SWHDR
          short-label=header::S32K312_ERM.h, category=SWHDR
          short-label=header::S32K312_FCCU.h, category=SWHDR
          short-label=header::S32K312_FIRC.h, category=SWHDR
          short-label=header::S32K312_FLASH.h, category=SWHDR
          short-label=header::S32K312_FLEXCAN.h, category=SWHDR
          short-label=header::S32K312_FLEXIO.h, category=SWHDR
          short-label=header::S32K312_FXOSC.h, category=SWHDR
          short-label=header::S32K312_INTM.h, category=SWHDR
          short-label=header::S32K312_JDC.h, category=SWHDR
          short-label=header::S32K312_LCU.h, category=SWHDR
          short-label=header::S32K312_LPCMP.h, category=SWHDR
          short-label=header::S32K312_LPI2C.h, category=SWHDR
          short-label=header::S32K312_LPSPI.h, category=SWHDR
          short-label=header::S32K312_LPUART.h, category=SWHDR
          short-label=header::S32K312_MCM_CM7.h, category=SWHDR
          short-label=header::S32K312_MC_CGM.h, category=SWHDR
          short-label=header::S32K312_MC_ME.h, category=SWHDR
          short-label=header::S32K312_MC_RGM.h, category=SWHDR
          short-label=header::S32K312_MDM_AP.h, category=SWHDR
          short-label=header::S32K312_MPU.h, category=SWHDR
          short-label=header::S32K312_MSCM.h, category=SWHDR
          short-label=header::S32K312_MU.h, category=SWHDR
          short-label=header::S32K312_NVIC.h, category=SWHDR
          short-label=header::S32K312_PFLASH.h, category=SWHDR
          short-label=header::S32K312_PIT.h, category=SWHDR
          short-label=header::S32K312_PLL.h, category=SWHDR
          short-label=header::S32K312_PMC.h, category=SWHDR
          short-label=header::S32K312_PRAMC.h, category=SWHDR
          short-label=header::S32K312_RTC.h, category=SWHDR
          short-label=header::S32K312_SCB.h, category=SWHDR
          short-label=header::S32K312_SDA_AP.h, category=SWHDR
          short-label=header::S32K312_SIRC.h, category=SWHDR
          short-label=header::S32K312_SIUL2.h, category=SWHDR
          short-label=header::S32K312_STCU.h, category=SWHDR
          short-label=header::S32K312_STM.h, category=SWHDR
          short-label=header::S32K312_SWT.h, category=SWHDR
          short-label=header::S32K312_SXOSC.h, category=SWHDR
          short-label=header::S32K312_SYSTICK.h, category=SWHDR
          short-label=header::S32K312_TEMPSENSE.h, category=SWHDR
          short-label=header::S32K312_TRGMUX.h, category=SWHDR
          short-label=header::S32K312_TSPC.h, category=SWHDR
          short-label=header::S32K312_VIRT_WRAPPER.h, category=SWHDR
          short-label=header::S32K312_WKPU.h, category=SWHDR
          short-label=header::S32K312_XBIC.h, category=SWHDR
          short-label=header::S32K312_XRDC.h, category=SWHDR
          short-label=header::S32K314.h, category=SWHDR
          short-label=header::S32K314_ADC.h, category=SWHDR
          short-label=header::S32K314_AXBS_LITE.h, category=SWHDR
          short-label=header::S32K314_BCTU.h, category=SWHDR
          short-label=header::S32K314_CMU_FC.h, category=SWHDR
          short-label=header::S32K314_CMU_FM.h, category=SWHDR
          short-label=header::S32K314_COMMON.h, category=SWHDR
          short-label=header::S32K314_CONFIGURATION_GPR.h, category=SWHDR
          short-label=header::S32K314_CRC.h, category=SWHDR
          short-label=header::S32K314_DCM.h, category=SWHDR
          short-label=header::S32K314_DCM_GPR.h, category=SWHDR
          short-label=header::S32K314_DMA.h, category=SWHDR
          short-label=header::S32K314_DMAMUX.h, category=SWHDR
          short-label=header::S32K314_DMA_TCD.h, category=SWHDR
          short-label=header::S32K314_EIM.h, category=SWHDR
          short-label=header::S32K314_EMAC.h, category=SWHDR
          short-label=header::S32K314_EMIOS.h, category=SWHDR
          short-label=header::S32K314_ERM.h, category=SWHDR
          short-label=header::S32K314_FCCU.h, category=SWHDR
          short-label=header::S32K314_FIRC.h, category=SWHDR
          short-label=header::S32K314_FLASH.h, category=SWHDR
          short-label=header::S32K314_FLEXCAN.h, category=SWHDR
          short-label=header::S32K314_FLEXIO.h, category=SWHDR
          short-label=header::S32K314_FXOSC.h, category=SWHDR
          short-label=header::S32K314_INTM.h, category=SWHDR
          short-label=header::S32K314_JDC.h, category=SWHDR
          short-label=header::S32K314_LCU.h, category=SWHDR
          short-label=header::S32K314_LPCMP.h, category=SWHDR
          short-label=header::S32K314_LPI2C.h, category=SWHDR
          short-label=header::S32K314_LPSPI.h, category=SWHDR
          short-label=header::S32K314_LPUART.h, category=SWHDR
          short-label=header::S32K314_MCM_CM7.h, category=SWHDR
          short-label=header::S32K314_MC_CGM.h, category=SWHDR
          short-label=header::S32K314_MC_ME.h, category=SWHDR
          short-label=header::S32K314_MC_RGM.h, category=SWHDR
          short-label=header::S32K314_MDM_AP.h, category=SWHDR
          short-label=header::S32K314_MPU.h, category=SWHDR
          short-label=header::S32K314_MSCM.h, category=SWHDR
          short-label=header::S32K314_MU.h, category=SWHDR
          short-label=header::S32K314_NVIC.h, category=SWHDR
          short-label=header::S32K314_PFLASH.h, category=SWHDR
          short-label=header::S32K314_PIT.h, category=SWHDR
          short-label=header::S32K314_PLL.h, category=SWHDR
          short-label=header::S32K314_PMC.h, category=SWHDR
          short-label=header::S32K314_PRAMC.h, category=SWHDR
          short-label=header::S32K314_QUADSPI.h, category=SWHDR
          short-label=header::S32K314_QUADSPI_ARDB.h, category=SWHDR
          short-label=header::S32K314_RTC.h, category=SWHDR
          short-label=header::S32K314_SAI.h, category=SWHDR
          short-label=header::S32K314_SCB.h, category=SWHDR
          short-label=header::S32K314_SDA_AP.h, category=SWHDR
          short-label=header::S32K314_SELFTEST_GPR.h, category=SWHDR
          short-label=header::S32K314_SEMA42.h, category=SWHDR
          short-label=header::S32K314_SIRC.h, category=SWHDR
          short-label=header::S32K314_SIUL2.h, category=SWHDR
          short-label=header::S32K314_STCU.h, category=SWHDR
          short-label=header::S32K314_STM.h, category=SWHDR
          short-label=header::S32K314_SWT.h, category=SWHDR
          short-label=header::S32K314_SXOSC.h, category=SWHDR
          short-label=header::S32K314_SYSTICK.h, category=SWHDR
          short-label=header::S32K314_TEMPSENSE.h, category=SWHDR
          short-label=header::S32K314_TRGMUX.h, category=SWHDR
          short-label=header::S32K314_TSPC.h, category=SWHDR
          short-label=header::S32K314_VIRT_WRAPPER.h, category=SWHDR
          short-label=header::S32K314_WKPU.h, category=SWHDR
          short-label=header::S32K314_XBIC.h, category=SWHDR
          short-label=header::S32K314_XRDC.h, category=SWHDR
          short-label=header::S32K322.h, category=SWHDR
          short-label=header::S32K322_ADC.h, category=SWHDR
          short-label=header::S32K322_AXBS_LITE.h, category=SWHDR
          short-label=header::S32K322_BCTU.h, category=SWHDR
          short-label=header::S32K322_CMU_FC.h, category=SWHDR
          short-label=header::S32K322_CMU_FM.h, category=SWHDR
          short-label=header::S32K322_COMMON.h, category=SWHDR
          short-label=header::S32K322_CONFIGURATION_GPR.h, category=SWHDR
          short-label=header::S32K322_CRC.h, category=SWHDR
          short-label=header::S32K322_DCM.h, category=SWHDR
          short-label=header::S32K322_DCM_GPR.h, category=SWHDR
          short-label=header::S32K322_DMA.h, category=SWHDR
          short-label=header::S32K322_DMAMUX.h, category=SWHDR
          short-label=header::S32K322_DMA_TCD.h, category=SWHDR
          short-label=header::S32K322_EIM.h, category=SWHDR
          short-label=header::S32K322_EMAC.h, category=SWHDR
          short-label=header::S32K322_EMIOS.h, category=SWHDR
          short-label=header::S32K322_ERM.h, category=SWHDR
          short-label=header::S32K322_FCCU.h, category=SWHDR
          short-label=header::S32K322_FIRC.h, category=SWHDR
          short-label=header::S32K322_FLASH.h, category=SWHDR
          short-label=header::S32K322_FLEXCAN.h, category=SWHDR
          short-label=header::S32K322_FLEXIO.h, category=SWHDR
          short-label=header::S32K322_FXOSC.h, category=SWHDR
          short-label=header::S32K322_INTM.h, category=SWHDR
          short-label=header::S32K322_JDC.h, category=SWHDR
          short-label=header::S32K322_LCU.h, category=SWHDR
          short-label=header::S32K322_LPCMP.h, category=SWHDR
          short-label=header::S32K322_LPI2C.h, category=SWHDR
          short-label=header::S32K322_LPSPI.h, category=SWHDR
          short-label=header::S32K322_LPUART.h, category=SWHDR
          short-label=header::S32K322_MCM_CM7.h, category=SWHDR
          short-label=header::S32K322_MC_CGM.h, category=SWHDR
          short-label=header::S32K322_MC_ME.h, category=SWHDR
          short-label=header::S32K322_MC_RGM.h, category=SWHDR
          short-label=header::S32K322_MDM_AP.h, category=SWHDR
          short-label=header::S32K322_MPU.h, category=SWHDR
          short-label=header::S32K322_MSCM.h, category=SWHDR
          short-label=header::S32K322_MU.h, category=SWHDR
          short-label=header::S32K322_NVIC.h, category=SWHDR
          short-label=header::S32K322_PFLASH.h, category=SWHDR
          short-label=header::S32K322_PIT.h, category=SWHDR
          short-label=header::S32K322_PLL.h, category=SWHDR
          short-label=header::S32K322_PMC.h, category=SWHDR
          short-label=header::S32K322_PRAMC.h, category=SWHDR
          short-label=header::S32K322_QUADSPI.h, category=SWHDR
          short-label=header::S32K322_QUADSPI_ARDB.h, category=SWHDR
          short-label=header::S32K322_RTC.h, category=SWHDR
          short-label=header::S32K322_SAI.h, category=SWHDR
          short-label=header::S32K322_SCB.h, category=SWHDR
          short-label=header::S32K322_SDA_AP.h, category=SWHDR
          short-label=header::S32K322_SEMA42.h, category=SWHDR
          short-label=header::S32K322_SIRC.h, category=SWHDR
          short-label=header::S32K322_SIUL2.h, category=SWHDR
          short-label=header::S32K322_STCU.h, category=SWHDR
          short-label=header::S32K322_STM.h, category=SWHDR
          short-label=header::S32K322_SWT.h, category=SWHDR
          short-label=header::S32K322_SXOSC.h, category=SWHDR
          short-label=header::S32K322_SYSTICK.h, category=SWHDR
          short-label=header::S32K322_TEMPSENSE.h, category=SWHDR
          short-label=header::S32K322_TRGMUX.h, category=SWHDR
          short-label=header::S32K322_TSPC.h, category=SWHDR
          short-label=header::S32K322_VIRT_WRAPPER.h, category=SWHDR
          short-label=header::S32K322_WKPU.h, category=SWHDR
          short-label=header::S32K322_XBIC.h, category=SWHDR
          short-label=header::S32K322_XRDC.h, category=SWHDR
          short-label=header::S32K324.h, category=SWHDR
          short-label=header::S32K324_ADC.h, category=SWHDR
          short-label=header::S32K324_AXBS_LITE.h, category=SWHDR
          short-label=header::S32K324_BCTU.h, category=SWHDR
          short-label=header::S32K324_CMU_FC.h, category=SWHDR
          short-label=header::S32K324_CMU_FM.h, category=SWHDR
          short-label=header::S32K324_COMMON.h, category=SWHDR
          short-label=header::S32K324_CONFIGURATION_GPR.h, category=SWHDR
          short-label=header::S32K324_CRC.h, category=SWHDR
          short-label=header::S32K324_DCM.h, category=SWHDR
          short-label=header::S32K324_DCM_GPR.h, category=SWHDR
          short-label=header::S32K324_DMA.h, category=SWHDR
          short-label=header::S32K324_DMAMUX.h, category=SWHDR
          short-label=header::S32K324_DMA_TCD.h, category=SWHDR
          short-label=header::S32K324_EIM.h, category=SWHDR
          short-label=header::S32K324_EMAC.h, category=SWHDR
          short-label=header::S32K324_EMIOS.h, category=SWHDR
          short-label=header::S32K324_ERM.h, category=SWHDR
          short-label=header::S32K324_FCCU.h, category=SWHDR
          short-label=header::S32K324_FIRC.h, category=SWHDR
          short-label=header::S32K324_FLASH.h, category=SWHDR
          short-label=header::S32K324_FLEXCAN.h, category=SWHDR
          short-label=header::S32K324_FLEXIO.h, category=SWHDR
          short-label=header::S32K324_FXOSC.h, category=SWHDR
          short-label=header::S32K324_INTM.h, category=SWHDR
          short-label=header::S32K324_JDC.h, category=SWHDR
          short-label=header::S32K324_LCU.h, category=SWHDR
          short-label=header::S32K324_LPCMP.h, category=SWHDR
          short-label=header::S32K324_LPI2C.h, category=SWHDR
          short-label=header::S32K324_LPSPI.h, category=SWHDR
          short-label=header::S32K324_LPUART.h, category=SWHDR
          short-label=header::S32K324_MCM_CM7.h, category=SWHDR
          short-label=header::S32K324_MC_CGM.h, category=SWHDR
          short-label=header::S32K324_MC_ME.h, category=SWHDR
          short-label=header::S32K324_MC_RGM.h, category=SWHDR
          short-label=header::S32K324_MDM_AP.h, category=SWHDR
          short-label=header::S32K324_MPU.h, category=SWHDR
          short-label=header::S32K324_MSCM.h, category=SWHDR
          short-label=header::S32K324_MU.h, category=SWHDR
          short-label=header::S32K324_NVIC.h, category=SWHDR
          short-label=header::S32K324_PFLASH.h, category=SWHDR
          short-label=header::S32K324_PIT.h, category=SWHDR
          short-label=header::S32K324_PLL.h, category=SWHDR
          short-label=header::S32K324_PMC.h, category=SWHDR
          short-label=header::S32K324_PRAMC.h, category=SWHDR
          short-label=header::S32K324_QUADSPI.h, category=SWHDR
          short-label=header::S32K324_QUADSPI_ARDB.h, category=SWHDR
          short-label=header::S32K324_RTC.h, category=SWHDR
          short-label=header::S32K324_SAI.h, category=SWHDR
          short-label=header::S32K324_SCB.h, category=SWHDR
          short-label=header::S32K324_SDA_AP.h, category=SWHDR
          short-label=header::S32K324_SELFTEST_GPR.h, category=SWHDR
          short-label=header::S32K324_SEMA42.h, category=SWHDR
          short-label=header::S32K324_SIRC.h, category=SWHDR
          short-label=header::S32K324_SIUL2.h, category=SWHDR
          short-label=header::S32K324_STCU.h, category=SWHDR
          short-label=header::S32K324_STM.h, category=SWHDR
          short-label=header::S32K324_SWT.h, category=SWHDR
          short-label=header::S32K324_SXOSC.h, category=SWHDR
          short-label=header::S32K324_SYSTICK.h, category=SWHDR
          short-label=header::S32K324_TEMPSENSE.h, category=SWHDR
          short-label=header::S32K324_TRGMUX.h, category=SWHDR
          short-label=header::S32K324_TSPC.h, category=SWHDR
          short-label=header::S32K324_VIRT_WRAPPER.h, category=SWHDR
          short-label=header::S32K324_WKPU.h, category=SWHDR
          short-label=header::S32K324_XBIC.h, category=SWHDR
          short-label=header::S32K324_XRDC.h, category=SWHDR
          short-label=header::S32K341.h, category=SWHDR
          short-label=header::S32K341_ADC.h, category=SWHDR
          short-label=header::S32K341_AXBS_LITE.h, category=SWHDR
          short-label=header::S32K341_BCTU.h, category=SWHDR
          short-label=header::S32K341_CMU_FC.h, category=SWHDR
          short-label=header::S32K341_CMU_FM.h, category=SWHDR
          short-label=header::S32K341_COMMON.h, category=SWHDR
          short-label=header::S32K341_CONFIGURATION_GPR.h, category=SWHDR
          short-label=header::S32K341_CRC.h, category=SWHDR
          short-label=header::S32K341_DCM.h, category=SWHDR
          short-label=header::S32K341_DCM_GPR.h, category=SWHDR
          short-label=header::S32K341_DMA.h, category=SWHDR
          short-label=header::S32K341_DMAMUX.h, category=SWHDR
          short-label=header::S32K341_DMA_TCD.h, category=SWHDR
          short-label=header::S32K341_EIM.h, category=SWHDR
          short-label=header::S32K341_EMAC.h, category=SWHDR
          short-label=header::S32K341_EMIOS.h, category=SWHDR
          short-label=header::S32K341_ERM.h, category=SWHDR
          short-label=header::S32K341_FCCU.h, category=SWHDR
          short-label=header::S32K341_FIRC.h, category=SWHDR
          short-label=header::S32K341_FLASH.h, category=SWHDR
          short-label=header::S32K341_FLEXCAN.h, category=SWHDR
          short-label=header::S32K341_FLEXIO.h, category=SWHDR
          short-label=header::S32K341_FXOSC.h, category=SWHDR
          short-label=header::S32K341_INTM.h, category=SWHDR
          short-label=header::S32K341_JDC.h, category=SWHDR
          short-label=header::S32K341_LCU.h, category=SWHDR
          short-label=header::S32K341_LPCMP.h, category=SWHDR
          short-label=header::S32K341_LPI2C.h, category=SWHDR
          short-label=header::S32K341_LPSPI.h, category=SWHDR
          short-label=header::S32K341_LPUART.h, category=SWHDR
          short-label=header::S32K341_MCM_CM7.h, category=SWHDR
          short-label=header::S32K341_MC_CGM.h, category=SWHDR
          short-label=header::S32K341_MC_ME.h, category=SWHDR
          short-label=header::S32K341_MC_RGM.h, category=SWHDR
          short-label=header::S32K341_MDM_AP.h, category=SWHDR
          short-label=header::S32K341_MPU.h, category=SWHDR
          short-label=header::S32K341_MSCM.h, category=SWHDR
          short-label=header::S32K341_MU.h, category=SWHDR
          short-label=header::S32K341_NVIC.h, category=SWHDR
          short-label=header::S32K341_PFLASH.h, category=SWHDR
          short-label=header::S32K341_PIT.h, category=SWHDR
          short-label=header::S32K341_PLL.h, category=SWHDR
          short-label=header::S32K341_PMC.h, category=SWHDR
          short-label=header::S32K341_PRAMC.h, category=SWHDR
          short-label=header::S32K341_QUADSPI.h, category=SWHDR
          short-label=header::S32K341_QUADSPI_ARDB.h, category=SWHDR
          short-label=header::S32K341_RTC.h, category=SWHDR
          short-label=header::S32K341_SAI.h, category=SWHDR
          short-label=header::S32K341_SCB.h, category=SWHDR
          short-label=header::S32K341_SDA_AP.h, category=SWHDR
          short-label=header::S32K341_SEMA42.h, category=SWHDR
          short-label=header::S32K341_SIRC.h, category=SWHDR
          short-label=header::S32K341_SIUL2.h, category=SWHDR
          short-label=header::S32K341_STCU.h, category=SWHDR
          short-label=header::S32K341_STM.h, category=SWHDR
          short-label=header::S32K341_SWT.h, category=SWHDR
          short-label=header::S32K341_SXOSC.h, category=SWHDR
          short-label=header::S32K341_SYSTICK.h, category=SWHDR
          short-label=header::S32K341_TEMPSENSE.h, category=SWHDR
          short-label=header::S32K341_TRGMUX.h, category=SWHDR
          short-label=header::S32K341_TSPC.h, category=SWHDR
          short-label=header::S32K341_VIRT_WRAPPER.h, category=SWHDR
          short-label=header::S32K341_WKPU.h, category=SWHDR
          short-label=header::S32K341_XBIC.h, category=SWHDR
          short-label=header::S32K341_XRDC.h, category=SWHDR
          short-label=header::S32K342.h, category=SWHDR
          short-label=header::S32K342_ADC.h, category=SWHDR
          short-label=header::S32K342_AXBS_LITE.h, category=SWHDR
          short-label=header::S32K342_BCTU.h, category=SWHDR
          short-label=header::S32K342_CMU_FC.h, category=SWHDR
          short-label=header::S32K342_CMU_FM.h, category=SWHDR
          short-label=header::S32K342_COMMON.h, category=SWHDR
          short-label=header::S32K342_CONFIGURATION_GPR.h, category=SWHDR
          short-label=header::S32K342_CRC.h, category=SWHDR
          short-label=header::S32K342_DCM.h, category=SWHDR
          short-label=header::S32K342_DCM_GPR.h, category=SWHDR
          short-label=header::S32K342_DMA.h, category=SWHDR
          short-label=header::S32K342_DMAMUX.h, category=SWHDR
          short-label=header::S32K342_DMA_TCD.h, category=SWHDR
          short-label=header::S32K342_EIM.h, category=SWHDR
          short-label=header::S32K342_EMAC.h, category=SWHDR
          short-label=header::S32K342_EMIOS.h, category=SWHDR
          short-label=header::S32K342_ERM.h, category=SWHDR
          short-label=header::S32K342_FCCU.h, category=SWHDR
          short-label=header::S32K342_FIRC.h, category=SWHDR
          short-label=header::S32K342_FLASH.h, category=SWHDR
          short-label=header::S32K342_FLEXCAN.h, category=SWHDR
          short-label=header::S32K342_FLEXIO.h, category=SWHDR
          short-label=header::S32K342_FXOSC.h, category=SWHDR
          short-label=header::S32K342_INTM.h, category=SWHDR
          short-label=header::S32K342_JDC.h, category=SWHDR
          short-label=header::S32K342_LCU.h, category=SWHDR
          short-label=header::S32K342_LPCMP.h, category=SWHDR
          short-label=header::S32K342_LPI2C.h, category=SWHDR
          short-label=header::S32K342_LPSPI.h, category=SWHDR
          short-label=header::S32K342_LPUART.h, category=SWHDR
          short-label=header::S32K342_MCM_CM7.h, category=SWHDR
          short-label=header::S32K342_MC_CGM.h, category=SWHDR
          short-label=header::S32K342_MC_ME.h, category=SWHDR
          short-label=header::S32K342_MC_RGM.h, category=SWHDR
          short-label=header::S32K342_MDM_AP.h, category=SWHDR
          short-label=header::S32K342_MPU.h, category=SWHDR
          short-label=header::S32K342_MSCM.h, category=SWHDR
          short-label=header::S32K342_MU.h, category=SWHDR
          short-label=header::S32K342_NVIC.h, category=SWHDR
          short-label=header::S32K342_PFLASH.h, category=SWHDR
          short-label=header::S32K342_PIT.h, category=SWHDR
          short-label=header::S32K342_PLL.h, category=SWHDR
          short-label=header::S32K342_PMC.h, category=SWHDR
          short-label=header::S32K342_PRAMC.h, category=SWHDR
          short-label=header::S32K342_QUADSPI.h, category=SWHDR
          short-label=header::S32K342_QUADSPI_ARDB.h, category=SWHDR
          short-label=header::S32K342_RTC.h, category=SWHDR
          short-label=header::S32K342_SAI.h, category=SWHDR
          short-label=header::S32K342_SCB.h, category=SWHDR
          short-label=header::S32K342_SDA_AP.h, category=SWHDR
          short-label=header::S32K342_SEMA42.h, category=SWHDR
          short-label=header::S32K342_SIRC.h, category=SWHDR
          short-label=header::S32K342_SIUL2.h, category=SWHDR
          short-label=header::S32K342_STCU.h, category=SWHDR
          short-label=header::S32K342_STM.h, category=SWHDR
          short-label=header::S32K342_SWT.h, category=SWHDR
          short-label=header::S32K342_SXOSC.h, category=SWHDR
          short-label=header::S32K342_SYSTICK.h, category=SWHDR
          short-label=header::S32K342_TEMPSENSE.h, category=SWHDR
          short-label=header::S32K342_TRGMUX.h, category=SWHDR
          short-label=header::S32K342_TSPC.h, category=SWHDR
          short-label=header::S32K342_VIRT_WRAPPER.h, category=SWHDR
          short-label=header::S32K342_WKPU.h, category=SWHDR
          short-label=header::S32K342_XBIC.h, category=SWHDR
          short-label=header::S32K342_XRDC.h, category=SWHDR
          short-label=header::S32K344.h, category=SWHDR
          short-label=header::S32K344_ADC.h, category=SWHDR
          short-label=header::S32K344_AXBS_LITE.h, category=SWHDR
          short-label=header::S32K344_BCTU.h, category=SWHDR
          short-label=header::S32K344_CMU_FC.h, category=SWHDR
          short-label=header::S32K344_CMU_FM.h, category=SWHDR
          short-label=header::S32K344_COMMON.h, category=SWHDR
          short-label=header::S32K344_CONFIGURATION_GPR.h, category=SWHDR
          short-label=header::S32K344_CRC.h, category=SWHDR
          short-label=header::S32K344_DCM.h, category=SWHDR
          short-label=header::S32K344_DCM_GPR.h, category=SWHDR
          short-label=header::S32K344_DMA.h, category=SWHDR
          short-label=header::S32K344_DMAMUX.h, category=SWHDR
          short-label=header::S32K344_DMA_TCD.h, category=SWHDR
          short-label=header::S32K344_EIM.h, category=SWHDR
          short-label=header::S32K344_EMAC.h, category=SWHDR
          short-label=header::S32K344_EMIOS.h, category=SWHDR
          short-label=header::S32K344_ERM.h, category=SWHDR
          short-label=header::S32K344_FCCU.h, category=SWHDR
          short-label=header::S32K344_FIRC.h, category=SWHDR
          short-label=header::S32K344_FLASH.h, category=SWHDR
          short-label=header::S32K344_FLEXCAN.h, category=SWHDR
          short-label=header::S32K344_FLEXIO.h, category=SWHDR
          short-label=header::S32K344_FXOSC.h, category=SWHDR
          short-label=header::S32K344_INTM.h, category=SWHDR
          short-label=header::S32K344_JDC.h, category=SWHDR
          short-label=header::S32K344_LCU.h, category=SWHDR
          short-label=header::S32K344_LPCMP.h, category=SWHDR
          short-label=header::S32K344_LPI2C.h, category=SWHDR
          short-label=header::S32K344_LPSPI.h, category=SWHDR
          short-label=header::S32K344_LPUART.h, category=SWHDR
          short-label=header::S32K344_MCM_CM7.h, category=SWHDR
          short-label=header::S32K344_MC_CGM.h, category=SWHDR
          short-label=header::S32K344_MC_ME.h, category=SWHDR
          short-label=header::S32K344_MC_RGM.h, category=SWHDR
          short-label=header::S32K344_MDM_AP.h, category=SWHDR
          short-label=header::S32K344_MPU.h, category=SWHDR
          short-label=header::S32K344_MSCM.h, category=SWHDR
          short-label=header::S32K344_MU.h, category=SWHDR
          short-label=header::S32K344_NVIC.h, category=SWHDR
          short-label=header::S32K344_PFLASH.h, category=SWHDR
          short-label=header::S32K344_PIT.h, category=SWHDR
          short-label=header::S32K344_PLL.h, category=SWHDR
          short-label=header::S32K344_PMC.h, category=SWHDR
          short-label=header::S32K344_PRAMC.h, category=SWHDR
          short-label=header::S32K344_QUADSPI.h, category=SWHDR
          short-label=header::S32K344_QUADSPI_ARDB.h, category=SWHDR
          short-label=header::S32K344_RTC.h, category=SWHDR
          short-label=header::S32K344_SAI.h, category=SWHDR
          short-label=header::S32K344_SCB.h, category=SWHDR
          short-label=header::S32K344_SDA_AP.h, category=SWHDR
          short-label=header::S32K344_SELFTEST_GPR.h, category=SWHDR
          short-label=header::S32K344_SEMA42.h, category=SWHDR
          short-label=header::S32K344_SIRC.h, category=SWHDR
          short-label=header::S32K344_SIUL2.h, category=SWHDR
          short-label=header::S32K344_STCU.h, category=SWHDR
          short-label=header::S32K344_STM.h, category=SWHDR
          short-label=header::S32K344_SWT.h, category=SWHDR
          short-label=header::S32K344_SXOSC.h, category=SWHDR
          short-label=header::S32K344_SYSTICK.h, category=SWHDR
          short-label=header::S32K344_TEMPSENSE.h, category=SWHDR
          short-label=header::S32K344_TRGMUX.h, category=SWHDR
          short-label=header::S32K344_TSPC.h, category=SWHDR
          short-label=header::S32K344_VIRT_WRAPPER.h, category=SWHDR
          short-label=header::S32K344_WKPU.h, category=SWHDR
          short-label=header::S32K344_XBIC.h, category=SWHDR
          short-label=header::S32K344_XRDC.h, category=SWHDR
          short-label=header::S32K358.h, category=SWHDR
          short-label=header::S32K358_ADC.h, category=SWHDR
          short-label=header::S32K358_AXBS_LITE.h, category=SWHDR
          short-label=header::S32K358_BCTU.h, category=SWHDR
          short-label=header::S32K358_CMU_FC.h, category=SWHDR
          short-label=header::S32K358_CMU_FM.h, category=SWHDR
          short-label=header::S32K358_COMMON.h, category=SWHDR
          short-label=header::S32K358_CONFIGURATION_GPR.h, category=SWHDR
          short-label=header::S32K358_CRC.h, category=SWHDR
          short-label=header::S32K358_DCM.h, category=SWHDR
          short-label=header::S32K358_DCM_GPR.h, category=SWHDR
          short-label=header::S32K358_DMAMUX.h, category=SWHDR
          short-label=header::S32K358_DMA_TCD.h, category=SWHDR
          short-label=header::S32K358_EDMA.h, category=SWHDR
          short-label=header::S32K358_EIM.h, category=SWHDR
          short-label=header::S32K358_EMIOS.h, category=SWHDR
          short-label=header::S32K358_ERM.h, category=SWHDR
          short-label=header::S32K358_FCCU.h, category=SWHDR
          short-label=header::S32K358_FIRC.h, category=SWHDR
          short-label=header::S32K358_FLASH.h, category=SWHDR
          short-label=header::S32K358_FLEXCAN.h, category=SWHDR
          short-label=header::S32K358_FLEXIO.h, category=SWHDR
          short-label=header::S32K358_FXOSC.h, category=SWHDR
          short-label=header::S32K358_GMAC.h, category=SWHDR
          short-label=header::S32K358_INTM.h, category=SWHDR
          short-label=header::S32K358_JDC.h, category=SWHDR
          short-label=header::S32K358_LCU.h, category=SWHDR
          short-label=header::S32K358_LPCMP.h, category=SWHDR
          short-label=header::S32K358_LPI2C.h, category=SWHDR
          short-label=header::S32K358_LPSPI.h, category=SWHDR
          short-label=header::S32K358_LPUART.h, category=SWHDR
          short-label=header::S32K358_MCM_CM7.h, category=SWHDR
          short-label=header::S32K358_MC_CGM.h, category=SWHDR
          short-label=header::S32K358_MC_ME.h, category=SWHDR
          short-label=header::S32K358_MC_RGM.h, category=SWHDR
          short-label=header::S32K358_MDM_AP.h, category=SWHDR
          short-label=header::S32K358_MPU.h, category=SWHDR
          short-label=header::S32K358_MSCM.h, category=SWHDR
          short-label=header::S32K358_MU.h, category=SWHDR
          short-label=header::S32K358_NVIC.h, category=SWHDR
          short-label=header::S32K358_PFLASH.h, category=SWHDR
          short-label=header::S32K358_PIT.h, category=SWHDR
          short-label=header::S32K358_PLL.h, category=SWHDR
          short-label=header::S32K358_PMC.h, category=SWHDR
          short-label=header::S32K358_PRAMC.h, category=SWHDR
          short-label=header::S32K358_QUADSPI.h, category=SWHDR
          short-label=header::S32K358_QUADSPI_ARDB.h, category=SWHDR
          short-label=header::S32K358_RTC.h, category=SWHDR
          short-label=header::S32K358_SAI.h, category=SWHDR
          short-label=header::S32K358_SCB.h, category=SWHDR
          short-label=header::S32K358_SDA_AP.h, category=SWHDR
          short-label=header::S32K358_SELFTEST_GPR.h, category=SWHDR
          short-label=header::S32K358_SEMA42.h, category=SWHDR
          short-label=header::S32K358_SIRC.h, category=SWHDR
          short-label=header::S32K358_SIUL2.h, category=SWHDR
          short-label=header::S32K358_STCU.h, category=SWHDR
          short-label=header::S32K358_STM.h, category=SWHDR
          short-label=header::S32K358_SWT.h, category=SWHDR
          short-label=header::S32K358_SXOSC.h, category=SWHDR
          short-label=header::S32K358_SYSTICK.h, category=SWHDR
          short-label=header::S32K358_TEMPSENSE.h, category=SWHDR
          short-label=header::S32K358_TRGMUX.h, category=SWHDR
          short-label=header::S32K358_TSPC.h, category=SWHDR
          short-label=header::S32K358_USDHC.h, category=SWHDR
          short-label=header::S32K358_VIRT_WRAPPER.h, category=SWHDR
          short-label=header::S32K358_WKPU.h, category=SWHDR
          short-label=header::S32K358_XBIC.h, category=SWHDR
          short-label=header::S32K358_XRDC.h, category=SWHDR
          short-label=header::S32K388.h, category=SWHDR
          short-label=header::S32K388_ACE.h, category=SWHDR
          short-label=header::S32K388_ADC.h, category=SWHDR
          short-label=header::S32K388_AES_ACCEL.h, category=SWHDR
          short-label=header::S32K388_AXBS_LITE.h, category=SWHDR
          short-label=header::S32K388_BCTU.h, category=SWHDR
          short-label=header::S32K388_CMU_FC.h, category=SWHDR
          short-label=header::S32K388_CMU_FM.h, category=SWHDR
          short-label=header::S32K388_COMMON.h, category=SWHDR
          short-label=header::S32K388_CONFIGURATION_GPR.h, category=SWHDR
          short-label=header::S32K388_CRC.h, category=SWHDR
          short-label=header::S32K388_DCM.h, category=SWHDR
          short-label=header::S32K388_DCM_GPR.h, category=SWHDR
          short-label=header::S32K388_DMAMUX.h, category=SWHDR
          short-label=header::S32K388_DMA_TCD.h, category=SWHDR
          short-label=header::S32K388_EDMA.h, category=SWHDR
          short-label=header::S32K388_EIM.h, category=SWHDR
          short-label=header::S32K388_EMIOS.h, category=SWHDR
          short-label=header::S32K388_ERM.h, category=SWHDR
          short-label=header::S32K388_FCCU.h, category=SWHDR
          short-label=header::S32K388_FEED_DMA_MP.h, category=SWHDR
          short-label=header::S32K388_FEED_DMA_TCD.h, category=SWHDR
          short-label=header::S32K388_FIRC.h, category=SWHDR
          short-label=header::S32K388_FLASH.h, category=SWHDR
          short-label=header::S32K388_FLEXCAN.h, category=SWHDR
          short-label=header::S32K388_FLEXIO.h, category=SWHDR
          short-label=header::S32K388_FXOSC.h, category=SWHDR
          short-label=header::S32K388_GMAC.h, category=SWHDR
          short-label=header::S32K388_INTM.h, category=SWHDR
          short-label=header::S32K388_JDC.h, category=SWHDR
          short-label=header::S32K388_LCU.h, category=SWHDR
          short-label=header::S32K388_LPCMP.h, category=SWHDR
          short-label=header::S32K388_LPI2C.h, category=SWHDR
          short-label=header::S32K388_LPSPI.h, category=SWHDR
          short-label=header::S32K388_LPUART.h, category=SWHDR
          short-label=header::S32K388_MCM_CM7.h, category=SWHDR
          short-label=header::S32K388_MC_CGM.h, category=SWHDR
          short-label=header::S32K388_MC_ME.h, category=SWHDR
          short-label=header::S32K388_MC_RGM.h, category=SWHDR
          short-label=header::S32K388_MDM_AP.h, category=SWHDR
          short-label=header::S32K388_MPU.h, category=SWHDR
          short-label=header::S32K388_MSCM.h, category=SWHDR
          short-label=header::S32K388_MU.h, category=SWHDR
          short-label=header::S32K388_NVIC.h, category=SWHDR
          short-label=header::S32K388_PFLASH.h, category=SWHDR
          short-label=header::S32K388_PIT.h, category=SWHDR
          short-label=header::S32K388_PLL.h, category=SWHDR
          short-label=header::S32K388_PMC.h, category=SWHDR
          short-label=header::S32K388_PRAMC.h, category=SWHDR
          short-label=header::S32K388_QUADSPI.h, category=SWHDR
          short-label=header::S32K388_QUADSPI_ARDB.h, category=SWHDR
          short-label=header::S32K388_RESULT_DMA_MP.h, category=SWHDR
          short-label=header::S32K388_RESULT_DMA_TCD.h, category=SWHDR
          short-label=header::S32K388_RTC.h, category=SWHDR
          short-label=header::S32K388_SAI.h, category=SWHDR
          short-label=header::S32K388_SCB.h, category=SWHDR
          short-label=header::S32K388_SDA_AP.h, category=SWHDR
          short-label=header::S32K388_SELFTEST_GPR.h, category=SWHDR
          short-label=header::S32K388_SEMA42.h, category=SWHDR
          short-label=header::S32K388_SIRC.h, category=SWHDR
          short-label=header::S32K388_SIUL2.h, category=SWHDR
          short-label=header::S32K388_STCU.h, category=SWHDR
          short-label=header::S32K388_STM.h, category=SWHDR
          short-label=header::S32K388_SWT.h, category=SWHDR
          short-label=header::S32K388_SXOSC.h, category=SWHDR
          short-label=header::S32K388_SYSTICK.h, category=SWHDR
          short-label=header::S32K388_TEMPSENSE.h, category=SWHDR
          short-label=header::S32K388_TRGMUX.h, category=SWHDR
          short-label=header::S32K388_TSPC.h, category=SWHDR
          short-label=header::S32K388_VIRT_WRAPPER.h, category=SWHDR
          short-label=header::S32K388_WKPU.h, category=SWHDR
          short-label=header::S32K388_XBIC.h, category=SWHDR
          short-label=header::S32K388_XRDC.h, category=SWHDR
          short-label=header::S32K39.h, category=SWHDR
          short-label=header::S32K39_ADC.h, category=SWHDR
          short-label=header::S32K39_ADC_BIST.h, category=SWHDR
          short-label=header::S32K39_ADC_BIST_FIR.h, category=SWHDR
          short-label=header::S32K39_AXBS_LITE.h, category=SWHDR
          short-label=header::S32K39_BCTU.h, category=SWHDR
          short-label=header::S32K39_CMU_FC.h, category=SWHDR
          short-label=header::S32K39_CMU_FM.h, category=SWHDR
          short-label=header::S32K39_COMMON.h, category=SWHDR
          short-label=header::S32K39_CONFIGURATION_GPR.h, category=SWHDR
          short-label=header::S32K39_CRC.h, category=SWHDR
          short-label=header::S32K39_DCM.h, category=SWHDR
          short-label=header::S32K39_DCM_GPR.h, category=SWHDR
          short-label=header::S32K39_DIGRF_TOP.h, category=SWHDR
          short-label=header::S32K39_DMAMUX.h, category=SWHDR
          short-label=header::S32K39_DMA_TCD_0.h, category=SWHDR
          short-label=header::S32K39_DMA_TCD_1.h, category=SWHDR
          short-label=header::S32K39_DSPI_MSC.h, category=SWHDR
          short-label=header::S32K39_DSPSS.h, category=SWHDR
          short-label=header::S32K39_D_IP_SWG_SYN.h, category=SWHDR
          short-label=header::S32K39_EDMA.h, category=SWHDR
          short-label=header::S32K39_EIM.h, category=SWHDR
          short-label=header::S32K39_EIM_1.h, category=SWHDR
          short-label=header::S32K39_EIM_2.h, category=SWHDR
          short-label=header::S32K39_EMAC.h, category=SWHDR
          short-label=header::S32K39_EMIOS.h, category=SWHDR
          short-label=header::S32K39_ERM.h, category=SWHDR
          short-label=header::S32K39_ETPU.h, category=SWHDR
          short-label=header::S32K39_FCCU.h, category=SWHDR
          short-label=header::S32K39_FIRC.h, category=SWHDR
          short-label=header::S32K39_FLASH.h, category=SWHDR
          short-label=header::S32K39_FLEXCAN.h, category=SWHDR
          short-label=header::S32K39_FLEXIO.h, category=SWHDR
          short-label=header::S32K39_FLEXPWM.h, category=SWHDR
          short-label=header::S32K39_FXOSC.h, category=SWHDR
          short-label=header::S32K39_IGF.h, category=SWHDR
          short-label=header::S32K39_INTM.h, category=SWHDR
          short-label=header::S32K39_JDC.h, category=SWHDR
          short-label=header::S32K39_LCU.h, category=SWHDR
          short-label=header::S32K39_LPCMP.h, category=SWHDR
          short-label=header::S32K39_LPI2C.h, category=SWHDR
          short-label=header::S32K39_LPSPI.h, category=SWHDR
          short-label=header::S32K39_LPUART.h, category=SWHDR
          short-label=header::S32K39_MCM_CM7.h, category=SWHDR
          short-label=header::S32K39_MC_CGM.h, category=SWHDR
          short-label=header::S32K39_MC_ME.h, category=SWHDR
          short-label=header::S32K39_MC_RGM.h, category=SWHDR
          short-label=header::S32K39_MDM_AP.h, category=SWHDR
          short-label=header::S32K39_MPU.h, category=SWHDR
          short-label=header::S32K39_MSCM.h, category=SWHDR
          short-label=header::S32K39_MU.h, category=SWHDR
          short-label=header::S32K39_NVIC.h, category=SWHDR
          short-label=header::S32K39_OMU_CM7.h, category=SWHDR
          short-label=header::S32K39_PFLASH.h, category=SWHDR
          short-label=header::S32K39_PIT.h, category=SWHDR
          short-label=header::S32K39_PLL.h, category=SWHDR
          short-label=header::S32K39_PMC.h, category=SWHDR
          short-label=header::S32K39_PRAMC.h, category=SWHDR
          short-label=header::S32K39_QUADSPI.h, category=SWHDR
          short-label=header::S32K39_QUADSPI_ARDB.h, category=SWHDR
          short-label=header::S32K39_RTC.h, category=SWHDR
          short-label=header::S32K39_SCB.h, category=SWHDR
          short-label=header::S32K39_SDADC.h, category=SWHDR
          short-label=header::S32K39_SDA_AP.h, category=SWHDR
          short-label=header::S32K39_SELFTEST_GPR.h, category=SWHDR
          short-label=header::S32K39_SEMA42.h, category=SWHDR
          short-label=header::S32K39_SIPI1.h, category=SWHDR
          short-label=header::S32K39_SIRC.h, category=SWHDR
          short-label=header::S32K39_SIUL2.h, category=SWHDR
          short-label=header::S32K39_STCU.h, category=SWHDR
          short-label=header::S32K39_STM.h, category=SWHDR
          short-label=header::S32K39_SWT.h, category=SWHDR
          short-label=header::S32K39_SYSTICK.h, category=SWHDR
          short-label=header::S32K39_TEMPSENSE.h, category=SWHDR
          short-label=header::S32K39_TRGMUX_APP.h, category=SWHDR
          short-label=header::S32K39_TRGMUX_MSC.h, category=SWHDR
          short-label=header::S32K39_VIRT_WRAPPER.h, category=SWHDR
          short-label=header::S32K39_WKPU.h, category=SWHDR
          short-label=header::S32K39_XBIC.h, category=SWHDR
          short-label=header::S32K39_XRDC.h, category=SWHDR
          short-label=header::S32M27x.h, category=SWHDR
          short-label=header::S32M27x_ADC.h, category=SWHDR
          short-label=header::S32M27x_AEC_AE.h, category=SWHDR
          short-label=header::S32M27x_BCTU.h, category=SWHDR
          short-label=header::S32M27x_CMU_FC.h, category=SWHDR
          short-label=header::S32M27x_CMU_FM.h, category=SWHDR
          short-label=header::S32M27x_COMMON.h, category=SWHDR
          short-label=header::S32M27x_CONFIGURATION_GPR.h, category=SWHDR
          short-label=header::S32M27x_CRC.h, category=SWHDR
          short-label=header::S32M27x_DCM.h, category=SWHDR
          short-label=header::S32M27x_DCM_GPR.h, category=SWHDR
          short-label=header::S32M27x_DMAMUX.h, category=SWHDR
          short-label=header::S32M27x_DMA_TCD.h, category=SWHDR
          short-label=header::S32M27x_DPGA_AE.h, category=SWHDR
          short-label=header::S32M27x_EDMA.h, category=SWHDR
          short-label=header::S32M27x_EIM.h, category=SWHDR
          short-label=header::S32M27x_EMIOS.h, category=SWHDR
          short-label=header::S32M27x_ERM.h, category=SWHDR
          short-label=header::S32M27x_FCCU.h, category=SWHDR
          short-label=header::S32M27x_FIRC.h, category=SWHDR
          short-label=header::S32M27x_FLASH.h, category=SWHDR
          short-label=header::S32M27x_FLEXCAN.h, category=SWHDR
          short-label=header::S32M27x_FLEXIO.h, category=SWHDR
          short-label=header::S32M27x_FXOSC.h, category=SWHDR
          short-label=header::S32M27x_GDU_AE.h, category=SWHDR
          short-label=header::S32M27x_HVI_AE.h, category=SWHDR
          short-label=header::S32M27x_INTM.h, category=SWHDR
          short-label=header::S32M27x_JDC.h, category=SWHDR
          short-label=header::S32M27x_LCU.h, category=SWHDR
          short-label=header::S32M27x_LPCMP.h, category=SWHDR
          short-label=header::S32M27x_LPI2C.h, category=SWHDR
          short-label=header::S32M27x_LPSPI.h, category=SWHDR
          short-label=header::S32M27x_LPUART.h, category=SWHDR
          short-label=header::S32M27x_MCM_CM7.h, category=SWHDR
          short-label=header::S32M27x_MC_CGM.h, category=SWHDR
          short-label=header::S32M27x_MC_ME.h, category=SWHDR
          short-label=header::S32M27x_MC_RGM.h, category=SWHDR
          short-label=header::S32M27x_MDM_AP.h, category=SWHDR
          short-label=header::S32M27x_MEM_OTP_AE.h, category=SWHDR
          short-label=header::S32M27x_MPU.h, category=SWHDR
          short-label=header::S32M27x_MSCM.h, category=SWHDR
          short-label=header::S32M27x_MU.h, category=SWHDR
          short-label=header::S32M27x_NVIC.h, category=SWHDR
          short-label=header::S32M27x_PFLASH.h, category=SWHDR
          short-label=header::S32M27x_PIT.h, category=SWHDR
          short-label=header::S32M27x_PLL.h, category=SWHDR
          short-label=header::S32M27x_PMC.h, category=SWHDR
          short-label=header::S32M27x_PMC_AE.h, category=SWHDR
          short-label=header::S32M27x_PRAMC.h, category=SWHDR
          short-label=header::S32M27x_RTC.h, category=SWHDR
          short-label=header::S32M27x_SCB.h, category=SWHDR
          short-label=header::S32M27x_SDA_AP.h, category=SWHDR
          short-label=header::S32M27x_SELFTEST_GPR.h, category=SWHDR
          short-label=header::S32M27x_SIRC.h, category=SWHDR
          short-label=header::S32M27x_SIUL2.h, category=SWHDR
          short-label=header::S32M27x_STCU.h, category=SWHDR
          short-label=header::S32M27x_STM.h, category=SWHDR
          short-label=header::S32M27x_SWT.h, category=SWHDR
          short-label=header::S32M27x_SYSTICK.h, category=SWHDR
          short-label=header::S32M27x_TEMPSENSE.h, category=SWHDR
          short-label=header::S32M27x_TRGMUX.h, category=SWHDR
          short-label=header::S32M27x_TSPC.h, category=SWHDR
          short-label=header::S32M27x_VIRT_WRAPPER.h, category=SWHDR
          short-label=header::S32M27x_WKPU.h, category=SWHDR
          short-label=header::S32M27x_XBIC.h, category=SWHDR
          short-label=header::S32M27x_XRDC.h, category=SWHDR
          short-label=include::Adc_MemMap.h, category=SWHDR
          short-label=include::Ae_MemMap.h, category=SWHDR
          short-label=include::BaseNXP_MemMap.h, category=SWHDR
          short-label=include::BasicTypes.h, category=SWHDR
          short-label=include::Bcc_775a_MemMap.h, category=SWHDR
          short-label=include::CanIf_MemMap.h, category=SWHDR
          short-label=include::CanTrcv_43_AE_MemMap.h, category=SWHDR
          short-label=include::Can_43_FLEXCAN_MemMap.h, category=SWHDR
          short-label=include::Can_43_LLCE_MemMap.h, category=SWHDR
          short-label=include::Can_GeneralTypes.h, category=SWHDR
          short-label=include::Can_MemMap.h, category=SWHDR
          short-label=include::Compiler.h, category=SWHDR
          short-label=include::CompilerDefinition.h, category=SWHDR
          short-label=include::Compiler_Cfg.h, category=SWHDR
          short-label=include::ComStackTypes.h, category=SWHDR
          short-label=include::ComStack_Cfg.h, category=SWHDR
          short-label=include::ComStack_Types.h, category=SWHDR
          short-label=include::Crc_MemMap.h, category=SWHDR
          short-label=include::Crypto_MemMap.h, category=SWHDR
          short-label=include::Csec_MemMap.h, category=SWHDR
          short-label=include::Dem_MemMap.h, category=SWHDR
          short-label=include::Det_MemMap.h, category=SWHDR
          short-label=include::Devassert.h, category=SWHDR
          short-label=include::Dio_MemMap.h, category=SWHDR
          short-label=include::Dpga_MemMap.h, category=SWHDR
          short-label=include::Ecum_MemMap.h, category=SWHDR
          short-label=include::Eep_MemMap.h, category=SWHDR
          short-label=include::EthSwitch_43_SJA1105P_MemMap.h, category=SWHDR
          short-label=include::EthSwt_43_SJA11XX_MemMap.h, category=SWHDR
          short-label=include::EthTrcv_43_PHY_MemMap.h, category=SWHDR
          short-label=include::EthTrcv_43_TJA110X_MemMap.h, category=SWHDR
          short-label=include::Eth_43_GMAC_MemMap.h, category=SWHDR
          short-label=include::Eth_43_PFE_MemMap.h, category=SWHDR
          short-label=include::Eth_GeneralTypes.h, category=SWHDR
          short-label=include::Eth_MemMap.h, category=SWHDR
          short-label=include::Fee_MemMap.h, category=SWHDR
          short-label=include::Fls_MemMap.h, category=SWHDR
          short-label=include::Fr_43_LLCE_MemMap.h, category=SWHDR
          short-label=include::Fr_GeneralTypes.h, category=SWHDR
          short-label=include::Fr_MemMap.h, category=SWHDR
          short-label=include::Gd3162_MemMap.h, category=SWHDR
          short-label=include::Gdu_MemMap.h, category=SWHDR
          short-label=include::Gpt_MemMap.h, category=SWHDR
          short-label=include::I2c_MemMap.h, category=SWHDR
          short-label=include::I2s_MemMap.h, category=SWHDR
          short-label=include::Icu_MemMap.h, category=SWHDR
          short-label=include::Ipcf_MemMap.h, category=SWHDR
          short-label=include::IpVersionMacros.h, category=SWHDR
          short-label=include::Iseled_MemMap.h, category=SWHDR
          short-label=include::LinTrcv_43_AE_MemMap.h, category=SWHDR
          short-label=include::Lin_43_LLCE_MemMap.h, category=SWHDR
          short-label=include::Lin_43_LPUART_FLEXIO_MemMap.h, category=SWHDR
          short-label=include::Lin_GeneralTypes.h, category=SWHDR
          short-label=include::Lin_MemMap.h, category=SWHDR
          short-label=include::Mcal.h, category=SWHDR
          short-label=include::Mcem_MemMap.h, category=SWHDR
          short-label=include::Mcl_MemMap.h, category=SWHDR
          short-label=include::Mcu_MemMap.h, category=SWHDR
          short-label=include::MemAcc_MemMap.h, category=SWHDR
          short-label=include::Mem_43_Eep_MemMap.h, category=SWHDR
          short-label=include::Mem_43_ExFls_MemMap.h, category=SWHDR
          short-label=include::Mem_43_InFls_MemMap.h, category=SWHDR
          short-label=include::Ocotp_MemMap.h, category=SWHDR
          short-label=include::Ocu_MemMap.h, category=SWHDR
          short-label=include::OsIf.h, category=SWHDR
          short-label=include::OsIf_Cfg_TypesDef.h, category=SWHDR
          short-label=include::OsIf_DeviceRegisters.h, category=SWHDR
          short-label=include::OsIf_Internal.h, category=SWHDR
          short-label=include::OsIf_Interrupts.h, category=SWHDR
          short-label=include::OsIf_Timer_Custom.h, category=SWHDR
          short-label=include::OsIf_Timer_System.h, category=SWHDR
          short-label=include::OsIf_Timer_System_Internal_Systick.h, category=SWHDR
          short-label=include::PlatformTypes.h, category=SWHDR
          short-label=include::Platform_MemMap.h, category=SWHDR
          short-label=include::Platform_Types.h, category=SWHDR
          short-label=include::Pmic_MemMap.h, category=SWHDR
          short-label=include::Port_MemMap.h, category=SWHDR
          short-label=include::Pwm_MemMap.h, category=SWHDR
          short-label=include::RegLockMacros.h, category=SWHDR
          short-label=include::Reg_eSys.h, category=SWHDR
          short-label=include::Rm_MemMap.h, category=SWHDR
          short-label=include::Rte_MemMap.h, category=SWHDR
          short-label=include::Sbc_fs26_MemMap.h, category=SWHDR
          short-label=include::Sbc_fs8x_MemMap.h, category=SWHDR
          short-label=include::Sent_MemMap.h, category=SWHDR
          short-label=include::Soc_Ips.h, category=SWHDR
          short-label=include::Spi_MemMap.h, category=SWHDR
          short-label=include::StandardTypes.h, category=SWHDR
          short-label=include::Std_Types.h, category=SWHDR
          short-label=include::Uart_MemMap.h, category=SWHDR
          short-label=include::Wdg_43_fs26_MemMap.h, category=SWHDR
          short-label=include::Wdg_43_fs8x_MemMap.h, category=SWHDR
          short-label=include::Wdg_MemMap.h, category=SWHDR
          short-label=include::Zipwire_MemMap.h, category=SWHDR
          short-label=src::OsIf_Interrupts.c, category=SWSRC
          short-label=src::OsIf_Timer.c, category=SWSRC
          short-label=src::OsIf_Timer_System.c, category=SWSRC
          short-label=src::OsIf_Timer_System_Internal_Systick.c, category=SWSRC
          short-label=wizard_data::main.c, category=SWSRC
          short-label=wizard_data::modules.h, category=SWHDR
          short-label=wizard_data::OsIf_Cfg.c, category=SWSRC
          short-label=wizard_data::S32K310::Clock_Ip_Cfg.c, category=SWSRC
          short-label=wizard_data::S32K310::Clock_Ip_Cfg.h, category=SWHDR
          short-label=wizard_data::S32K310::Clock_Ip_Cfg_Defines.h, category=SWHDR
          short-label=wizard_data::S32K310::Igf_Port_Ip_Cfg.c, category=SWSRC
          short-label=wizard_data::S32K310::Igf_Port_Ip_Cfg.h, category=SWHDR
          short-label=wizard_data::S32K310::OsIf_ArchCfg.h, category=SWHDR
          short-label=wizard_data::S32K310::OsIf_Cfg.h, category=SWHDR
          short-label=wizard_data::S32K310::Siul2_Port_Ip_Cfg.c, category=SWSRC
          short-label=wizard_data::S32K310::Siul2_Port_Ip_Cfg.h, category=SWHDR
          short-label=wizard_data::S32K310::Siul2_Port_Ip_Defines.h, category=SWHDR
          short-label=wizard_data::S32K310::Tspc_Port_Ip_Cfg.c, category=SWSRC
          short-label=wizard_data::S32K310::Tspc_Port_Ip_Cfg.h, category=SWHDR
          short-label=wizard_data::S32K311::Clock_Ip_Cfg.c, category=SWSRC
          short-label=wizard_data::S32K311::Clock_Ip_Cfg.h, category=SWHDR
          short-label=wizard_data::S32K311::Clock_Ip_Cfg_Defines.h, category=SWHDR
          short-label=wizard_data::S32K311::Igf_Port_Ip_Cfg.c, category=SWSRC
          short-label=wizard_data::S32K311::Igf_Port_Ip_Cfg.h, category=SWHDR
          short-label=wizard_data::S32K311::OsIf_ArchCfg.h, category=SWHDR
          short-label=wizard_data::S32K311::OsIf_Cfg.h, category=SWHDR
          short-label=wizard_data::S32K311::Siul2_Port_Ip_Cfg.c, category=SWSRC
          short-label=wizard_data::S32K311::Siul2_Port_Ip_Cfg.h, category=SWHDR
          short-label=wizard_data::S32K311::Siul2_Port_Ip_Defines.h, category=SWHDR
          short-label=wizard_data::S32K311::Tspc_Port_Ip_Cfg.c, category=SWSRC
          short-label=wizard_data::S32K311::Tspc_Port_Ip_Cfg.h, category=SWHDR
          short-label=wizard_data::S32K312::Clock_Ip_Cfg.c, category=SWSRC
          short-label=wizard_data::S32K312::Clock_Ip_Cfg.h, category=SWHDR
          short-label=wizard_data::S32K312::Clock_Ip_Cfg_Defines.h, category=SWHDR
          short-label=wizard_data::S32K312::Igf_Port_Ip_Cfg.c, category=SWSRC
          short-label=wizard_data::S32K312::Igf_Port_Ip_Cfg.h, category=SWHDR
          short-label=wizard_data::S32K312::OsIf_ArchCfg.h, category=SWHDR
          short-label=wizard_data::S32K312::OsIf_Cfg.h, category=SWHDR
          short-label=wizard_data::S32K312::Siul2_Port_Ip_Cfg.c, category=SWSRC
          short-label=wizard_data::S32K312::Siul2_Port_Ip_Cfg.h, category=SWHDR
          short-label=wizard_data::S32K312::Siul2_Port_Ip_Defines.h, category=SWHDR
          short-label=wizard_data::S32K312::Tspc_Port_Ip_Cfg.c, category=SWSRC
          short-label=wizard_data::S32K312::Tspc_Port_Ip_Cfg.h, category=SWHDR
          short-label=wizard_data::S32K314::Clock_Ip_Cfg.c, category=SWSRC
          short-label=wizard_data::S32K314::Clock_Ip_Cfg.h, category=SWHDR
          short-label=wizard_data::S32K314::Clock_Ip_Cfg_Defines.h, category=SWHDR
          short-label=wizard_data::S32K314::Igf_Port_Ip_Cfg.c, category=SWSRC
          short-label=wizard_data::S32K314::Igf_Port_Ip_Cfg.h, category=SWHDR
          short-label=wizard_data::S32K314::OsIf_ArchCfg.h, category=SWHDR
          short-label=wizard_data::S32K314::OsIf_Cfg.h, category=SWHDR
          short-label=wizard_data::S32K314::Siul2_Port_Ip_Cfg.c, category=SWSRC
          short-label=wizard_data::S32K314::Siul2_Port_Ip_Cfg.h, category=SWHDR
          short-label=wizard_data::S32K314::Siul2_Port_Ip_Defines.h, category=SWHDR
          short-label=wizard_data::S32K314::Tspc_Port_Ip_Cfg.c, category=SWSRC
          short-label=wizard_data::S32K314::Tspc_Port_Ip_Cfg.h, category=SWHDR
          short-label=wizard_data::S32K322::Clock_Ip_Cfg.c, category=SWSRC
          short-label=wizard_data::S32K322::Clock_Ip_Cfg.h, category=SWHDR
          short-label=wizard_data::S32K322::Clock_Ip_Cfg_Defines.h, category=SWHDR
          short-label=wizard_data::S32K322::Igf_Port_Ip_Cfg.c, category=SWSRC
          short-label=wizard_data::S32K322::Igf_Port_Ip_Cfg.h, category=SWHDR
          short-label=wizard_data::S32K322::OsIf_ArchCfg.h, category=SWHDR
          short-label=wizard_data::S32K322::OsIf_Cfg.h, category=SWHDR
          short-label=wizard_data::S32K322::Siul2_Port_Ip_Cfg.c, category=SWSRC
          short-label=wizard_data::S32K322::Siul2_Port_Ip_Cfg.h, category=SWHDR
          short-label=wizard_data::S32K322::Siul2_Port_Ip_Defines.h, category=SWHDR
          short-label=wizard_data::S32K322::Tspc_Port_Ip_Cfg.c, category=SWSRC
          short-label=wizard_data::S32K322::Tspc_Port_Ip_Cfg.h, category=SWHDR
          short-label=wizard_data::S32K324::Clock_Ip_Cfg.c, category=SWSRC
          short-label=wizard_data::S32K324::Clock_Ip_Cfg.h, category=SWHDR
          short-label=wizard_data::S32K324::Clock_Ip_Cfg_Defines.h, category=SWHDR
          short-label=wizard_data::S32K324::Igf_Port_Ip_Cfg.c, category=SWSRC
          short-label=wizard_data::S32K324::Igf_Port_Ip_Cfg.h, category=SWHDR
          short-label=wizard_data::S32K324::OsIf_ArchCfg.h, category=SWHDR
          short-label=wizard_data::S32K324::OsIf_Cfg.h, category=SWHDR
          short-label=wizard_data::S32K324::Siul2_Port_Ip_Cfg.c, category=SWSRC
          short-label=wizard_data::S32K324::Siul2_Port_Ip_Cfg.h, category=SWHDR
          short-label=wizard_data::S32K324::Siul2_Port_Ip_Defines.h, category=SWHDR
          short-label=wizard_data::S32K324::Tspc_Port_Ip_Cfg.c, category=SWSRC
          short-label=wizard_data::S32K324::Tspc_Port_Ip_Cfg.h, category=SWHDR
          short-label=wizard_data::S32K328::Clock_Ip_Cfg.c, category=SWSRC
          short-label=wizard_data::S32K328::Clock_Ip_Cfg.h, category=SWHDR
          short-label=wizard_data::S32K328::Clock_Ip_Cfg_Defines.h, category=SWHDR
          short-label=wizard_data::S32K328::Igf_Port_Ip_Cfg.c, category=SWSRC
          short-label=wizard_data::S32K328::Igf_Port_Ip_Cfg.h, category=SWHDR
          short-label=wizard_data::S32K328::OsIf_ArchCfg.h, category=SWHDR
          short-label=wizard_data::S32K328::OsIf_Cfg.h, category=SWHDR
          short-label=wizard_data::S32K328::Siul2_Port_Ip_Cfg.c, category=SWSRC
          short-label=wizard_data::S32K328::Siul2_Port_Ip_Cfg.h, category=SWHDR
          short-label=wizard_data::S32K328::Siul2_Port_Ip_Defines.h, category=SWHDR
          short-label=wizard_data::S32K328::Tspc_Port_Ip_Cfg.c, category=SWSRC
          short-label=wizard_data::S32K328::Tspc_Port_Ip_Cfg.h, category=SWHDR
          short-label=wizard_data::S32K338::Clock_Ip_Cfg.c, category=SWSRC
          short-label=wizard_data::S32K338::Clock_Ip_Cfg.h, category=SWHDR
          short-label=wizard_data::S32K338::Clock_Ip_Cfg_Defines.h, category=SWHDR
          short-label=wizard_data::S32K338::Igf_Port_Ip_Cfg.c, category=SWSRC
          short-label=wizard_data::S32K338::Igf_Port_Ip_Cfg.h, category=SWHDR
          short-label=wizard_data::S32K338::OsIf_ArchCfg.h, category=SWHDR
          short-label=wizard_data::S32K338::OsIf_Cfg.h, category=SWHDR
          short-label=wizard_data::S32K338::Siul2_Port_Ip_Cfg.c, category=SWSRC
          short-label=wizard_data::S32K338::Siul2_Port_Ip_Cfg.h, category=SWHDR
          short-label=wizard_data::S32K338::Siul2_Port_Ip_Defines.h, category=SWHDR
          short-label=wizard_data::S32K338::Tspc_Port_Ip_Cfg.c, category=SWSRC
          short-label=wizard_data::S32K338::Tspc_Port_Ip_Cfg.h, category=SWHDR
          short-label=wizard_data::S32K341::Clock_Ip_Cfg.c, category=SWSRC
          short-label=wizard_data::S32K341::Clock_Ip_Cfg.h, category=SWHDR
          short-label=wizard_data::S32K341::Clock_Ip_Cfg_Defines.h, category=SWHDR
          short-label=wizard_data::S32K341::Igf_Port_Ip_Cfg.c, category=SWSRC
          short-label=wizard_data::S32K341::Igf_Port_Ip_Cfg.h, category=SWHDR
          short-label=wizard_data::S32K341::OsIf_ArchCfg.h, category=SWHDR
          short-label=wizard_data::S32K341::OsIf_Cfg.h, category=SWHDR
          short-label=wizard_data::S32K341::Siul2_Port_Ip_Cfg.c, category=SWSRC
          short-label=wizard_data::S32K341::Siul2_Port_Ip_Cfg.h, category=SWHDR
          short-label=wizard_data::S32K341::Siul2_Port_Ip_Defines.h, category=SWHDR
          short-label=wizard_data::S32K341::Tspc_Port_Ip_Cfg.c, category=SWSRC
          short-label=wizard_data::S32K341::Tspc_Port_Ip_Cfg.h, category=SWHDR
          short-label=wizard_data::S32K342::Clock_Ip_Cfg.c, category=SWSRC
          short-label=wizard_data::S32K342::Clock_Ip_Cfg.h, category=SWHDR
          short-label=wizard_data::S32K342::Clock_Ip_Cfg_Defines.h, category=SWHDR
          short-label=wizard_data::S32K342::Igf_Port_Ip_Cfg.c, category=SWSRC
          short-label=wizard_data::S32K342::Igf_Port_Ip_Cfg.h, category=SWHDR
          short-label=wizard_data::S32K342::OsIf_ArchCfg.h, category=SWHDR
          short-label=wizard_data::S32K342::OsIf_Cfg.h, category=SWHDR
          short-label=wizard_data::S32K342::Siul2_Port_Ip_Cfg.c, category=SWSRC
          short-label=wizard_data::S32K342::Siul2_Port_Ip_Cfg.h, category=SWHDR
          short-label=wizard_data::S32K342::Siul2_Port_Ip_Defines.h, category=SWHDR
          short-label=wizard_data::S32K342::Tspc_Port_Ip_Cfg.c, category=SWSRC
          short-label=wizard_data::S32K342::Tspc_Port_Ip_Cfg.h, category=SWHDR
          short-label=wizard_data::S32K344::Clock_Ip_Cfg.c, category=SWSRC
          short-label=wizard_data::S32K344::Clock_Ip_Cfg.h, category=SWHDR
          short-label=wizard_data::S32K344::Clock_Ip_Cfg_Defines.h, category=SWHDR
          short-label=wizard_data::S32K344::Igf_Port_Ip_Cfg.c, category=SWSRC
          short-label=wizard_data::S32K344::Igf_Port_Ip_Cfg.h, category=SWHDR
          short-label=wizard_data::S32K344::OsIf_ArchCfg.h, category=SWHDR
          short-label=wizard_data::S32K344::OsIf_Cfg.h, category=SWHDR
          short-label=wizard_data::S32K344::Siul2_Port_Ip_Cfg.c, category=SWSRC
          short-label=wizard_data::S32K344::Siul2_Port_Ip_Cfg.h, category=SWHDR
          short-label=wizard_data::S32K344::Siul2_Port_Ip_Defines.h, category=SWHDR
          short-label=wizard_data::S32K344::Tspc_Port_Ip_Cfg.c, category=SWSRC
          short-label=wizard_data::S32K344::Tspc_Port_Ip_Cfg.h, category=SWHDR
          short-label=wizard_data::S32K348::Clock_Ip_Cfg.c, category=SWSRC
          short-label=wizard_data::S32K348::Clock_Ip_Cfg.h, category=SWHDR
          short-label=wizard_data::S32K348::Clock_Ip_Cfg_Defines.h, category=SWHDR
          short-label=wizard_data::S32K348::Igf_Port_Ip_Cfg.c, category=SWSRC
          short-label=wizard_data::S32K348::Igf_Port_Ip_Cfg.h, category=SWHDR
          short-label=wizard_data::S32K348::OsIf_ArchCfg.h, category=SWHDR
          short-label=wizard_data::S32K348::OsIf_Cfg.h, category=SWHDR
          short-label=wizard_data::S32K348::Siul2_Port_Ip_Cfg.c, category=SWSRC
          short-label=wizard_data::S32K348::Siul2_Port_Ip_Cfg.h, category=SWHDR
          short-label=wizard_data::S32K348::Siul2_Port_Ip_Defines.h, category=SWHDR
          short-label=wizard_data::S32K348::Tspc_Port_Ip_Cfg.c, category=SWSRC
          short-label=wizard_data::S32K348::Tspc_Port_Ip_Cfg.h, category=SWHDR
          short-label=wizard_data::S32K358::Clock_Ip_Cfg.c, category=SWSRC
          short-label=wizard_data::S32K358::Clock_Ip_Cfg.h, category=SWHDR
          short-label=wizard_data::S32K358::Clock_Ip_Cfg_Defines.h, category=SWHDR
          short-label=wizard_data::S32K358::Igf_Port_Ip_Cfg.c, category=SWSRC
          short-label=wizard_data::S32K358::Igf_Port_Ip_Cfg.h, category=SWHDR
          short-label=wizard_data::S32K358::OsIf_ArchCfg.h, category=SWHDR
          short-label=wizard_data::S32K358::OsIf_Cfg.h, category=SWHDR
          short-label=wizard_data::S32K358::Siul2_Port_Ip_Cfg.c, category=SWSRC
          short-label=wizard_data::S32K358::Siul2_Port_Ip_Cfg.h, category=SWHDR
          short-label=wizard_data::S32K358::Siul2_Port_Ip_Defines.h, category=SWHDR
          short-label=wizard_data::S32K358::Tspc_Port_Ip_Cfg.c, category=SWSRC
          short-label=wizard_data::S32K358::Tspc_Port_Ip_Cfg.h, category=SWHDR
          short-label=wizard_data::S32K388::Clock_Ip_Cfg.c, category=SWSRC
          short-label=wizard_data::S32K388::Clock_Ip_Cfg.h, category=SWHDR
          short-label=wizard_data::S32K388::Clock_Ip_Cfg_Defines.h, category=SWHDR
          short-label=wizard_data::S32K388::Igf_Port_Ip_Cfg.c, category=SWSRC
          short-label=wizard_data::S32K388::Igf_Port_Ip_Cfg.h, category=SWHDR
          short-label=wizard_data::S32K388::OsIf_ArchCfg.h, category=SWHDR
          short-label=wizard_data::S32K388::OsIf_Cfg.h, category=SWHDR
          short-label=wizard_data::S32K388::Siul2_Port_Ip_Cfg.c, category=SWSRC
          short-label=wizard_data::S32K388::Siul2_Port_Ip_Cfg.h, category=SWHDR
          short-label=wizard_data::S32K388::Siul2_Port_Ip_Defines.h, category=SWHDR
          short-label=wizard_data::S32K388::Tspc_Port_Ip_Cfg.c, category=SWSRC
          short-label=wizard_data::S32K388::Tspc_Port_Ip_Cfg.h, category=SWHDR
          short-label=wizard_data::S32K394::Clock_Ip_Cfg.c, category=SWSRC
          short-label=wizard_data::S32K394::Clock_Ip_Cfg.h, category=SWHDR
          short-label=wizard_data::S32K394::Clock_Ip_Cfg_Defines.h, category=SWHDR
          short-label=wizard_data::S32K394::Igf_Port_Ip_Cfg.c, category=SWSRC
          short-label=wizard_data::S32K394::Igf_Port_Ip_Cfg.h, category=SWHDR
          short-label=wizard_data::S32K394::OsIf_ArchCfg.h, category=SWHDR
          short-label=wizard_data::S32K394::OsIf_Cfg.h, category=SWHDR
          short-label=wizard_data::S32K394::Siul2_Port_Ip_Cfg.c, category=SWSRC
          short-label=wizard_data::S32K394::Siul2_Port_Ip_Cfg.h, category=SWHDR
          short-label=wizard_data::S32K394::Siul2_Port_Ip_Defines.h, category=SWHDR
          short-label=wizard_data::S32K394::Tspc_Port_Ip_Cfg.c, category=SWSRC
          short-label=wizard_data::S32K394::Tspc_Port_Ip_Cfg.h, category=SWHDR
          short-label=wizard_data::S32K396::Clock_Ip_Cfg.c, category=SWSRC
          short-label=wizard_data::S32K396::Clock_Ip_Cfg.h, category=SWHDR
          short-label=wizard_data::S32K396::Clock_Ip_Cfg_Defines.h, category=SWHDR
          short-label=wizard_data::S32K396::Igf_Port_Ip_Cfg.c, category=SWSRC
          short-label=wizard_data::S32K396::Igf_Port_Ip_Cfg.h, category=SWHDR
          short-label=wizard_data::S32K396::OsIf_ArchCfg.h, category=SWHDR
          short-label=wizard_data::S32K396::OsIf_Cfg.h, category=SWHDR
          short-label=wizard_data::S32K396::Siul2_Port_Ip_Cfg.c, category=SWSRC
          short-label=wizard_data::S32K396::Siul2_Port_Ip_Cfg.h, category=SWHDR
          short-label=wizard_data::S32K396::Siul2_Port_Ip_Defines.h, category=SWHDR
          short-label=wizard_data::S32K396::Tspc_Port_Ip_Cfg.c, category=SWSRC
          short-label=wizard_data::S32K396::Tspc_Port_Ip_Cfg.h, category=SWHDR
          short-label=wizard_data::S32M274::Clock_Ip_Cfg.c, category=SWSRC
          short-label=wizard_data::S32M274::Clock_Ip_Cfg.h, category=SWHDR
          short-label=wizard_data::S32M274::Clock_Ip_Cfg_Defines.h, category=SWHDR
          short-label=wizard_data::S32M274::OsIf_ArchCfg.h, category=SWHDR
          short-label=wizard_data::S32M274::OsIf_Cfg.h, category=SWHDR
          short-label=wizard_data::S32M274::Siul2_Port_Ip_Cfg.c, category=SWSRC
          short-label=wizard_data::S32M274::Siul2_Port_Ip_Cfg.h, category=SWHDR
          short-label=wizard_data::S32M274::Siul2_Port_Ip_Defines.h, category=SWHDR
          short-label=wizard_data::S32M274::Tspc_Port_Ip_Cfg.c, category=SWSRC
          short-label=wizard_data::S32M274::Tspc_Port_Ip_Cfg.h, category=SWHDR
          short-label=wizard_data::S32M276::Clock_Ip_Cfg.c, category=SWSRC
          short-label=wizard_data::S32M276::Clock_Ip_Cfg.h, category=SWHDR
          short-label=wizard_data::S32M276::Clock_Ip_Cfg_Defines.h, category=SWHDR
          short-label=wizard_data::S32M276::OsIf_ArchCfg.h, category=SWHDR
          short-label=wizard_data::S32M276::OsIf_Cfg.h, category=SWHDR
          short-label=wizard_data::S32M276::Siul2_Port_Ip_Cfg.c, category=SWSRC
          short-label=wizard_data::S32M276::Siul2_Port_Ip_Cfg.h, category=SWHDR
          short-label=wizard_data::S32M276::Siul2_Port_Ip_Defines.h, category=SWHDR
          short-label=wizard_data::S32M276::Tspc_Port_Ip_Cfg.c, category=SWSRC
          short-label=wizard_data::S32M276::Tspc_Port_Ip_Cfg.h, category=SWHDR
    4 x compiler:
      DIAB_Compiler:
        name=Windriver Diab
        options=-tARMCORTEXM7MG:simple -mthumb -std=c99 -Oz -g -fstandalone-debug -Wstrict-prototypes -Wsign-compare -Wdouble-promotion -Wunknown-pragmas -Wundef -Wextra -Wall -pedantic -Werror=implicit-function-declaration -fno-common -fno-signed-char -fno-trigraphs -V -c -DS32K3XX -D $ (DERIVATIVE) -DDIAB -DUSE_SW_VECTOR_MODE -DD_CACHE_ENABLE -DI_CACHE_ENABLE -DENABLE_FPU -DMCAL_ENABLE_USER_MODE_SUPPORT
        vendor=Windriver
        version=Wind River Diab Compiler v7.0.4
      GCC_Compiler:
        name=GCC Compiler
        options=-mcpu=cortex-m7 -mthumb -mlittle-endian -mfpu=fpv5-sp-d16 -mfloat-abi=hard -std=c99 -Os -ggdb3 -Wall -Wextra -pedantic -Wstrict-prototypes -Wundef -Wunused -Werror=implicit-function-declaration -Wsign-compare -Wdouble-promotion -fno-short-enums -funsigned-char -funsigned-bitfields -fno-common -fstack-usage -fdump-ipa-all -c -DS32K3XX -D $ (DERIVATIVE) -DGCC -DUSE_SW_VECTOR_MODE -DD_CACHE_ENABLE -DI_CACHE_ENABLE -DENABLE_FPU -DMCAL_ENABLE_USER_MODE_SUPPORT --sysroot=$(NEWLIB_DIR) -specs=nano.specs -specs=nosys.specs
        vendor=GCC Systems
        version=NXP GCC 10.2.0 20200723
      GHS_Compiler:
        name=Green Hills
        options=-cpu=cortexm7 -thumb -fpu=vfpv5_d16 -fsingle -C99 --ghstd=last -Osize --gnu_asm -dual_debug -G -keeptempfiles -Wimplicit-int -Wshadow -Wtrigraphs -Wundef --unsigned_chars --unsigned_fields --no_commons --no_exceptions --no_slash_comment --prototype_errors --incorrect_pragma_warnings -c -DS32K3XX -D $ (DERIVATIVE) -DGHS -DUSE_SW_VECTOR_MODE -DD_CACHE_ENABLE -DI_CACHE_ENABLE -DENABLE_FPU -DMCAL_ENABLE_USER_MODE_SUPPORT
        vendor=Green Hills
        version=Green Hills Multi 7.1.6d / Compiler 2021.1.4
      IAR_Compiler:
        name=IAR Compiler
        options=--cpu Cortex-M7 --cpu_mode thumb --endian little --fpu VFPv5-SP -e -Ohz --debug --no_clustering --no_mem_idioms --do_explicit_zero_opt_in_named_sections --require_prototypes --no_wrap_diagnostics --diag_suppress Pa050 -DS32K3XX -D $ (DERIVATIVE) -DIAR -DUSE_SW_VECTOR_MODE -DD_CACHE_ENABLE -DI_CACHE_ENABLE -DENABLE_FPU -DMCAL_ENABLE_USER_MODE_SUPPORT
        vendor=IAR Systems
        version=IAR ANSI C/C++ Compiler v.8.50.10 (safety version)
    generated-artifacts:
      4 x dependency on artifact, all with usages=COMPILE:
        modules_h: artifact-descriptor={short-label=generate_PC::include::modules.h, category=SWHDR}
        OsIf_ArchCfg_h: artifact-descriptor={short-label=generate_PC::include::OsIf_ArchCfg.h, category=SWHDR}
        OsIf_Cfg_h: artifact-descriptor={short-label=generate_PC::include::OsIf_Cfg.h, category=SWHDR}
        OsIf_Cfg_c: artifact-descriptor={short-label=generate_PC::src::OsIf_Cfg.c, category=SWSRC}
    4 x linker:
      DIAB_Linker: name=Windriver Diab, options=-e Reset_Handler linker_script_file.dld -m30 -Xstack-usage -Xpreprocess-lecl -Llibrary_path -lc -lm -tARMCORTEXM7MG:simple, vendor=Windriver, version=Wind River Diab Compiler v7.0.4
      GCC_Linker: name=GCC Compiler, options=-Wl,-Map,filename -T linkerfile --entry=Reset_Handler -nostartfiles -mcpu=cortexm7 -mthumb -mfpu=fpv5-sp-d16 -mfloat-abi=hard -mlittle-endian -ggdb3 -lc -lm -lgcc -specs=nano.specs -specs=nosys.specs, vendor=GCC Systems, version=NXP GCC 10.2.0 20200723
      GHS_Linker: name=Green Hills, options=-e Reset_Handler -T linker_script_file.ld -map -keepmap -Mn -delete -ignore_debug_references -Llibrary_path -larch -lstartup -lind_sd -v -keep=C40_Ip_AccessCode -nostartfiles, vendor=Green Hills, version=Green Hills Multi 7.1.6d / Compiler 2021.1.4
      IAR_Linker: name=IAR Compiler, options=--map filename --config linkerfile --cpu=Cortex-M7 --fpu VFPv5-SP --entry _start --enable_stack_usage --skip_dynamic_initialization --no_wrap_diagnostics, vendor=IAR Systems, version=IAR ANSI C/C++ Compiler v.8.50.10 (safety version)
    resource consumption ResourceConsumption
      5 x memory section:
        BASENXP_CODE: alignment=UNSPECIFIED, sw-addrmethod=CODE, symbol=CODE
        BASENXP_CONFIG_DATA_UNSPECIFIED: alignment=UNSPECIFIED, sw-addrmethod=CONFIG_DATA, symbol=CONFIG_DATA_UNSPECIFIED
        BASENXP_VAR_CLEARED_32: alignment=32, sw-addrmethod=VAR_CLEARED, symbol=VAR_CLEARED_32
        BASENXP_VAR_CLEARED_BOOLEAN: alignment=BOOLEAN, sw-addrmethod=VAR_CLEARED, symbol=VAR_CLEARED_BOOLEAN
        BASENXP_VAR_CLEARED_UNSPECIFIED: alignment=UNSPECIFIED, sw-addrmethod=VAR_CLEARED, symbol=VAR_CLEARED_UNSPECIFIED
