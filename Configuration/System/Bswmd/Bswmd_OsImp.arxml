AUTOSAR XML (schema 00047)
package /Bsw_OsImp
  bsw module description OsImp: module-id=255
    bsw internal behavior BswInternalBehavior_OsImp
  bsw implementation BswImplementation_OsImp: sw-version=1.3.1, vendor-id=76, ar-release-version=4.0.3, behavior=BswInternalBehavior_OsImp
