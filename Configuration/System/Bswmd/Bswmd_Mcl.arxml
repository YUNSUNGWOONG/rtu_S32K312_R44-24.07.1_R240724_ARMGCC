AUTOSAR XML (schema 00047)
package /AUTOSAR_Mcl/BswModuleDescriptions
  bsw module description Mcl: module-id=255
    provided-entrys:
      Lcu_Ip_SetAsyncInputList
      Lcu_Ip_SetAsyncOutputList
      Lcu_Ip_SetSyncInputSwOverrideValue
      Lcu_Ip_SetSyncInputSwSyncMode
      Lcu_Ip_SetSyncOutputDebugMode
      Lcu_Ip_SetSyncOutputEnable
      Lcu_Ip_SetSyncOutputFallFilter
      Lcu_Ip_SetSyncOutputForceClearingMode
      Lcu_Ip_SetSyncOutputForceDma
      Lcu_Ip_SetSyncOutputForceInputSensitivity
      Lcu_Ip_SetSyncOutputForceInt
      Lcu_Ip_SetSyncOutputForceSyncSelect
      Lcu_Ip_SetSyncOutputLutDma
      Lcu_Ip_SetSyncOutputLutInt
      Lcu_Ip_SetSyncOutputPolarity
      Lcu_Ip_SetSyncOutputRiseFilter
      Mcl_CacheClean
      Mcl_CacheCleanByAddr
      Mcl_CacheDisable
      Mcl_CacheEnable
      Mcl_CacheInvalidate
      Mcl_CacheInvalidateByAddr
      Mcl_ClearLcuSyncOutputForceEvent
      Mcl_DeInit
      Mcl_GetDmaChannelParam
      Mcl_GetDmaChannelStatus
      Mcl_GetDmaInstanceStatus
      Mcl_GetLcuAsyncLogicInputInfo
      Mcl_GetLcuAsyncLogicOutputInfo
      Mcl_GetLcuSyncCombineForceInput
      Mcl_GetLcuSyncForceOutput
      Mcl_GetLcuSyncForceStatus
      Mcl_GetLcuSyncLogicInput
      Mcl_GetLcuSyncLogicOutput
      Mcl_GetLcuSyncSwOverrideInput
      Mcl_GetVersionInfo
      Mcl_Init
      Mcl_SetDmaChannelCommand
      Mcl_SetDmaChannelGlobalList
      Mcl_SetDmaChannelScatterGatherConfig
      Mcl_SetDmaChannelScatterGatherList
      Mcl_SetDmaChannelTransferList
      Mcl_SetDmaInstanceCommand
      Mcl_SetLcuAsyncInputList
      Mcl_SetLcuAsyncOutputList
      Mcl_SetLcuSyncInputMuxSelect
      Mcl_SetLcuSyncInputSwOverrideEnable
      Mcl_SetLcuSyncInputSwOverrideValue
      Mcl_SetLcuSyncInputSwSyncMode
      Mcl_SetLcuSyncOutputDebugMode
      Mcl_SetLcuSyncOutputEnable
      Mcl_SetLcuSyncOutputFallFilter
      Mcl_SetLcuSyncOutputForceClearingMode
      Mcl_SetLcuSyncOutputForceDma
      Mcl_SetLcuSyncOutputForceInputSensitivity
      Mcl_SetLcuSyncOutputForceInt
      Mcl_SetLcuSyncOutputForceSyncSelect
      Mcl_SetLcuSyncOutputLutControl
      Mcl_SetLcuSyncOutputLutDma
      Mcl_SetLcuSyncOutputLutInt
      Mcl_SetLcuSyncOutputPolarity
      Mcl_SetLcuSyncOutputRiseFilter
      Mcl_SetLcuWriteProtect
      Mcl_SetTrgMuxInput
      Mcl_SetTrgMuxLock
      Dma0_Ch0_Ch1_IrqHandler
      Dma0_Ch0_IRQHandler
      Dma0_Ch10_Ch11_IrqHandler
      Dma0_Ch10_IRQHandler
      Dma0_Ch11_IRQHandler
      Dma0_Ch12_Ch13_IrqHandler
      Dma0_Ch12_IRQHandler
      Dma0_Ch13_IRQHandler
      Dma0_Ch14_Ch15_IrqHandler
      Dma0_Ch14_IRQHandler
      Dma0_Ch15_IRQHandler
      Dma0_Ch16_Ch17_IrqHandler
      Dma0_Ch16_IRQHandler
      Dma0_Ch17_IRQHandler
      Dma0_Ch18_Ch19_IrqHandler
      Dma0_Ch18_IRQHandler
      Dma0_Ch19_IRQHandler
      Dma0_Ch1_IRQHandler
      Dma0_Ch20_Ch21_IrqHandler
      Dma0_Ch20_IRQHandler
      Dma0_Ch21_IRQHandler
      Dma0_Ch22_Ch23_IrqHandler
      Dma0_Ch22_IRQHandler
      Dma0_Ch23_IRQHandler
      Dma0_Ch24_Ch25_IrqHandler
      Dma0_Ch24_IRQHandler
      Dma0_Ch25_IRQHandler
      Dma0_Ch26_Ch27_IrqHandler
      Dma0_Ch26_IRQHandler
      Dma0_Ch27_IRQHandler
      Dma0_Ch28_Ch29_IrqHandler
      Dma0_Ch28_IRQHandler
      Dma0_Ch29_IRQHandler
      Dma0_Ch2_Ch3_IrqHandler
      Dma0_Ch2_IRQHandler
      Dma0_Ch30_Ch31_IrqHandler
      Dma0_Ch30_IRQHandler
      Dma0_Ch31_IRQHandler
      Dma0_Ch3_IRQHandler
      Dma0_Ch4_Ch5_IrqHandler
      Dma0_Ch4_IRQHandler
      Dma0_Ch5_IRQHandler
      Dma0_Ch6_Ch7_IrqHandler
      Dma0_Ch6_IRQHandler
      Dma0_Ch7_IRQHandler
      Dma0_Ch8_Ch9_IrqHandler
      Dma0_Ch8_IRQHandler
      Dma0_Ch9_IRQHandler
      Dma1_Ch0_Ch1_IrqHandler
      Dma1_Ch10_Ch11_IrqHandler
      Dma1_Ch12_Ch13_IrqHandler
      Dma1_Ch14_Ch15_IrqHandler
      Dma1_Ch16_Ch17_IrqHandler
      Dma1_Ch18_Ch19_IrqHandler
      Dma1_Ch20_Ch21_IrqHandler
      Dma1_Ch22_Ch23_IrqHandler
      Dma1_Ch24_Ch25_IrqHandler
      Dma1_Ch26_Ch27_IrqHandler
      Dma1_Ch28_Ch29_IrqHandler
      Dma1_Ch2_Ch3_IrqHandler
      Dma1_Ch30_Ch31_IrqHandler
      Dma1_Ch4_Ch5_IrqHandler
      Dma1_Ch6_Ch7_IrqHandler
      Dma1_Ch8_Ch9_IrqHandler
      EMIOS0_{0..5}_IRQ
      EMIOS1_{0..5}_IRQ
      EMIOS2_{0..5}_IRQ
      Lcu0_Ip_IRQHandler
      Lcu1_Ip_IRQHandler
      MCL_FLEXIO_ISR
    bsw internal behavior InternalBehavior_Mcl
      45 x exclusive area:
        MCL_EXCLUSIVE_AREA_{00..02}
        MCL_EXCLUSIVE_AREA_{04..09}
        MCL_EXCLUSIVE_AREA_{11..46}
      65 x bsw called entity:
        Lcu_Ip_SetAsyncInputList: can-enter-exclusive-area=MCL_EXCLUSIVE_AREA_36, implemented-entry=Lcu_Ip_SetAsyncInputList
        Lcu_Ip_SetAsyncOutputList: can-enter-exclusive-area=MCL_EXCLUSIVE_AREA_37, implemented-entry=Lcu_Ip_SetAsyncOutputList
        Lcu_Ip_SetSyncInputSwOverrideValue: can-enter-exclusive-area=MCL_EXCLUSIVE_AREA_23, implemented-entry=Lcu_Ip_SetSyncInputSwOverrideValue
        Lcu_Ip_SetSyncInputSwSyncMode: can-enter-exclusive-area=MCL_EXCLUSIVE_AREA_24, implemented-entry=Lcu_Ip_SetSyncInputSwSyncMode
        Lcu_Ip_SetSyncOutputDebugMode: can-enter-exclusive-area=MCL_EXCLUSIVE_AREA_25, implemented-entry=Lcu_Ip_SetSyncOutputDebugMode
        Lcu_Ip_SetSyncOutputEnable: can-enter-exclusive-area=MCL_EXCLUSIVE_AREA_38, implemented-entry=Lcu_Ip_SetSyncOutputEnable
        Lcu_Ip_SetSyncOutputFallFilter: can-enter-exclusive-area=MCL_EXCLUSIVE_AREA_34, implemented-entry=Lcu_Ip_SetSyncOutputFallFilter
        Lcu_Ip_SetSyncOutputForceClearingMode: can-enter-exclusive-area=MCL_EXCLUSIVE_AREA_27, implemented-entry=Lcu_Ip_SetSyncOutputForceClearingMode
        Lcu_Ip_SetSyncOutputForceDma: can-enter-exclusive-area=MCL_EXCLUSIVE_AREA_30, implemented-entry=Lcu_Ip_SetSyncOutputForceDma
        Lcu_Ip_SetSyncOutputForceInputSensitivity: can-enter-exclusive-area=MCL_EXCLUSIVE_AREA_26, implemented-entry=Lcu_Ip_SetSyncOutputForceInputSensitivity
        Lcu_Ip_SetSyncOutputForceInt: can-enter-exclusive-area=MCL_EXCLUSIVE_AREA_31, implemented-entry=Lcu_Ip_SetSyncOutputForceInt
        Lcu_Ip_SetSyncOutputForceSyncSelect: can-enter-exclusive-area=MCL_EXCLUSIVE_AREA_28, implemented-entry=Lcu_Ip_SetSyncOutputForceSyncSelect
        Lcu_Ip_SetSyncOutputLutDma: can-enter-exclusive-area=MCL_EXCLUSIVE_AREA_32, implemented-entry=Lcu_Ip_SetSyncOutputLutDma
        Lcu_Ip_SetSyncOutputLutInt: can-enter-exclusive-area=MCL_EXCLUSIVE_AREA_33, implemented-entry=Lcu_Ip_SetSyncOutputLutInt
        Lcu_Ip_SetSyncOutputPolarity: can-enter-exclusive-area=MCL_EXCLUSIVE_AREA_29, implemented-entry=Lcu_Ip_SetSyncOutputPolarity
        Lcu_Ip_SetSyncOutputRiseFilter: can-enter-exclusive-area=MCL_EXCLUSIVE_AREA_35, implemented-entry=Lcu_Ip_SetSyncOutputRiseFilter
        Mcl_CacheClean: can-enter-exclusive-area=MCL_EXCLUSIVE_AREA_16, implemented-entry=Mcl_CacheClean
        Mcl_CacheCleanByAddr: can-enter-exclusive-area=MCL_EXCLUSIVE_AREA_18, implemented-entry=Mcl_CacheCleanByAddr
        Mcl_CacheDisable: can-enter-exclusive-area=MCL_EXCLUSIVE_AREA_14, implemented-entry=Mcl_CacheDisable
        Mcl_CacheEnable: can-enter-exclusive-area=MCL_EXCLUSIVE_AREA_13, implemented-entry=Mcl_CacheEnable
        Mcl_CacheInvalidate: can-enter-exclusive-area=MCL_EXCLUSIVE_AREA_15, implemented-entry=Mcl_CacheInvalidate
        Mcl_CacheInvalidateByAddr: can-enter-exclusive-area=MCL_EXCLUSIVE_AREA_17, implemented-entry=Mcl_CacheInvalidateByAddr
        Mcl_ClearLcuSyncOutputForceEvent: implemented-entry=Mcl_ClearLcuSyncOutputForceEvent
        Mcl_DeInit: can-enter-exclusive-area=[MCL_EXCLUSIVE_AREA_01, MCL_EXCLUSIVE_AREA_04], implemented-entry=Mcl_DeInit
        Mcl_GetDmaChannelParam: implemented-entry=Mcl_GetDmaChannelParam
        Mcl_GetDmaChannelStatus: can-enter-exclusive-area=MCL_EXCLUSIVE_AREA_06, implemented-entry=Mcl_GetDmaChannelStatus
        Mcl_GetDmaInstanceStatus: implemented-entry=Mcl_GetDmaInstanceStatus
        Mcl_GetLcuAsyncLogicInputInfo: implemented-entry=Mcl_GetLcuAsyncLogicInputInfo
        Mcl_GetLcuAsyncLogicOutputInfo: implemented-entry=Mcl_GetLcuAsyncLogicOutputInfo
        Mcl_GetLcuSyncCombineForceInput: implemented-entry=Mcl_GetLcuSyncCombineForceInput
        Mcl_GetLcuSyncForceOutput: implemented-entry=Mcl_GetLcuSyncForceOutput
        Mcl_GetLcuSyncForceStatus: implemented-entry=Mcl_GetLcuSyncForceStatus
        Mcl_GetLcuSyncLogicInput: implemented-entry=Mcl_GetLcuSyncLogicInput
        Mcl_GetLcuSyncLogicOutput: implemented-entry=Mcl_GetLcuSyncLogicOutput
        Mcl_GetLcuSyncSwOverrideInput: implemented-entry=Mcl_GetLcuSyncSwOverrideInput
        Mcl_GetVersionInfo: implemented-entry=Mcl_GetVersionInfo
        Mcl_Init: can-enter-exclusive-area=[MCL_EXCLUSIVE_AREA_00, MCL_EXCLUSIVE_AREA_12, MCL_EXCLUSIVE_AREA_19, MCL_EXCLUSIVE_AREA_39, MCL_EXCLUSIVE_AREA_40, MCL_EXCLUSIVE_AREA_41, MCL_EXCLUSIVE_AREA_42, MCL_EXCLUSIVE_AREA_43, MCL_EXCLUSIVE_AREA_44, MCL_EXCLUSIVE_AREA_45, MCL_EXCLUSIVE_AREA_46], implemented-entry=Mcl_Init
        Mcl_SetDmaChannelCommand: can-enter-exclusive-area=MCL_EXCLUSIVE_AREA_05, implemented-entry=Mcl_SetDmaChannelCommand
        Mcl_SetDmaChannelGlobalList: can-enter-exclusive-area=[MCL_EXCLUSIVE_AREA_07, MCL_EXCLUSIVE_AREA_08], implemented-entry=Mcl_SetDmaChannelGlobalList
        Mcl_SetDmaChannelScatterGatherConfig: can-enter-exclusive-area=MCL_EXCLUSIVE_AREA_11, implemented-entry=Mcl_SetDmaChannelScatterGatherConfig
        Mcl_SetDmaChannelScatterGatherList: can-enter-exclusive-area=MCL_EXCLUSIVE_AREA_09, implemented-entry=Mcl_SetDmaChannelScatterGatherList
        Mcl_SetDmaChannelTransferList: implemented-entry=Mcl_SetDmaChannelTransferList
        Mcl_SetDmaInstanceCommand: can-enter-exclusive-area=MCL_EXCLUSIVE_AREA_02, implemented-entry=Mcl_SetDmaInstanceCommand
        Mcl_SetLcuAsyncInputList: implemented-entry=Mcl_SetLcuAsyncInputList
        Mcl_SetLcuAsyncOutputList: implemented-entry=Mcl_SetLcuAsyncOutputList
        Mcl_SetLcuSyncInputMuxSelect: implemented-entry=Mcl_SetLcuSyncInputMuxSelect
        Mcl_SetLcuSyncInputSwOverrideEnable: can-enter-exclusive-area=MCL_EXCLUSIVE_AREA_22, implemented-entry=Mcl_SetLcuSyncInputSwOverrideEnable
        Mcl_SetLcuSyncInputSwOverrideValue: implemented-entry=Mcl_SetLcuSyncInputSwOverrideValue
        Mcl_SetLcuSyncInputSwSyncMode: implemented-entry=Mcl_SetLcuSyncInputSwSyncMode
        Mcl_SetLcuSyncOutputDebugMode: implemented-entry=Mcl_SetLcuSyncOutputDebugMode
        Mcl_SetLcuSyncOutputEnable: implemented-entry=Mcl_SetLcuSyncOutputEnable
        Mcl_SetLcuSyncOutputFallFilter: implemented-entry=Mcl_SetLcuSyncOutputFallFilter
        Mcl_SetLcuSyncOutputForceClearingMode: implemented-entry=Mcl_SetLcuSyncOutputForceClearingMode
        Mcl_SetLcuSyncOutputForceDma: implemented-entry=Mcl_SetLcuSyncOutputForceDma
        Mcl_SetLcuSyncOutputForceInputSensitivity: implemented-entry=Mcl_SetLcuSyncOutputForceInputSensitivity
        Mcl_SetLcuSyncOutputForceInt: implemented-entry=Mcl_SetLcuSyncOutputForceInt
        Mcl_SetLcuSyncOutputForceSyncSelect: implemented-entry=Mcl_SetLcuSyncOutputForceSyncSelect
        Mcl_SetLcuSyncOutputLutControl: implemented-entry=Mcl_SetLcuSyncOutputLutControl
        Mcl_SetLcuSyncOutputLutDma: implemented-entry=Mcl_SetLcuSyncOutputLutDma
        Mcl_SetLcuSyncOutputLutInt: implemented-entry=Mcl_SetLcuSyncOutputLutInt
        Mcl_SetLcuSyncOutputPolarity: implemented-entry=Mcl_SetLcuSyncOutputPolarity
        Mcl_SetLcuSyncOutputRiseFilter: implemented-entry=Mcl_SetLcuSyncOutputRiseFilter
        Mcl_SetLcuWriteProtect: implemented-entry=Mcl_SetLcuWriteProtect
        Mcl_SetTrgMuxInput: can-enter-exclusive-area=MCL_EXCLUSIVE_AREA_20, implemented-entry=Mcl_SetTrgMuxInput
        Mcl_SetTrgMuxLock: can-enter-exclusive-area=MCL_EXCLUSIVE_AREA_21, implemented-entry=Mcl_SetTrgMuxLock
      85 x bsw interrupt entity, all with interrupt-category=CAT-2, interrupt-source=Hardware:
        Dma0_Ch0_Ch1_IrqHandler: implemented-entry=Dma0_Ch0_Ch1_IrqHandler
        Dma0_Ch0_IRQHandler: implemented-entry=Dma0_Ch0_IRQHandler
        Dma0_Ch10_Ch11_IrqHandler: implemented-entry=Dma0_Ch10_Ch11_IrqHandler
        Dma0_Ch10_IRQHandler: implemented-entry=Dma0_Ch10_IRQHandler
        Dma0_Ch11_IRQHandler: implemented-entry=Dma0_Ch11_IRQHandler
        Dma0_Ch12_Ch13_IrqHandler: implemented-entry=Dma0_Ch12_Ch13_IrqHandler
        Dma0_Ch12_IRQHandler: implemented-entry=Dma0_Ch12_IRQHandler
        Dma0_Ch13_IRQHandler: implemented-entry=Dma0_Ch13_IRQHandler
        Dma0_Ch14_Ch15_IrqHandler: implemented-entry=Dma0_Ch14_Ch15_IrqHandler
        Dma0_Ch14_IRQHandler: implemented-entry=Dma0_Ch14_IRQHandler
        Dma0_Ch15_IRQHandler: implemented-entry=Dma0_Ch15_IRQHandler
        Dma0_Ch16_Ch17_IrqHandler: implemented-entry=Dma0_Ch16_Ch17_IrqHandler
        Dma0_Ch16_IRQHandler: implemented-entry=Dma0_Ch16_IRQHandler
        Dma0_Ch17_IRQHandler: implemented-entry=Dma0_Ch17_IRQHandler
        Dma0_Ch18_Ch19_IrqHandler: implemented-entry=Dma0_Ch18_Ch19_IrqHandler
        Dma0_Ch18_IRQHandler: implemented-entry=Dma0_Ch18_IRQHandler
        Dma0_Ch19_IRQHandler: implemented-entry=Dma0_Ch19_IRQHandler
        Dma0_Ch1_IRQHandler: implemented-entry=Dma0_Ch1_IRQHandler
        Dma0_Ch20_Ch21_IrqHandler: implemented-entry=Dma0_Ch20_Ch21_IrqHandler
        Dma0_Ch20_IRQHandler: implemented-entry=Dma0_Ch20_IRQHandler
        Dma0_Ch21_IRQHandler: implemented-entry=Dma0_Ch21_IRQHandler
        Dma0_Ch22_Ch23_IrqHandler: implemented-entry=Dma0_Ch22_Ch23_IrqHandler
        Dma0_Ch22_IRQHandler: implemented-entry=Dma0_Ch22_IRQHandler
        Dma0_Ch23_IRQHandler: implemented-entry=Dma0_Ch23_IRQHandler
        Dma0_Ch24_Ch25_IrqHandler: implemented-entry=Dma0_Ch24_Ch25_IrqHandler
        Dma0_Ch24_IRQHandler: implemented-entry=Dma0_Ch24_IRQHandler
        Dma0_Ch25_IRQHandler: implemented-entry=Dma0_Ch25_IRQHandler
        Dma0_Ch26_Ch27_IrqHandler: implemented-entry=Dma0_Ch26_Ch27_IrqHandler
        Dma0_Ch26_IRQHandler: implemented-entry=Dma0_Ch26_IRQHandler
        Dma0_Ch27_IRQHandler: implemented-entry=Dma0_Ch27_IRQHandler
        Dma0_Ch28_Ch29_IrqHandler: implemented-entry=Dma0_Ch28_Ch29_IrqHandler
        Dma0_Ch28_IRQHandler: implemented-entry=Dma0_Ch28_IRQHandler
        Dma0_Ch29_IRQHandler: implemented-entry=Dma0_Ch29_IRQHandler
        Dma0_Ch2_Ch3_IrqHandler: implemented-entry=Dma0_Ch2_Ch3_IrqHandler
        Dma0_Ch2_IRQHandler: implemented-entry=Dma0_Ch2_IRQHandler
        Dma0_Ch30_Ch31_IrqHandler: implemented-entry=Dma0_Ch30_Ch31_IrqHandler
        Dma0_Ch30_IRQHandler: implemented-entry=Dma0_Ch30_IRQHandler
        Dma0_Ch31_IRQHandler: implemented-entry=Dma0_Ch31_IRQHandler
        Dma0_Ch3_IRQHandler: implemented-entry=Dma0_Ch3_IRQHandler
        Dma0_Ch4_Ch5_IrqHandler: implemented-entry=Dma0_Ch4_Ch5_IrqHandler
        Dma0_Ch4_IRQHandler: implemented-entry=Dma0_Ch4_IRQHandler
        Dma0_Ch5_IRQHandler: implemented-entry=Dma0_Ch5_IRQHandler
        Dma0_Ch6_Ch7_IrqHandler: implemented-entry=Dma0_Ch6_Ch7_IrqHandler
        Dma0_Ch6_IRQHandler: implemented-entry=Dma0_Ch6_IRQHandler
        Dma0_Ch7_IRQHandler: implemented-entry=Dma0_Ch7_IRQHandler
        Dma0_Ch8_Ch9_IrqHandler: implemented-entry=Dma0_Ch8_Ch9_IrqHandler
        Dma0_Ch8_IRQHandler: implemented-entry=Dma0_Ch8_IRQHandler
        Dma0_Ch9_IRQHandler: implemented-entry=Dma0_Ch9_IRQHandler
        Dma1_Ch0_Ch1_IrqHandler: implemented-entry=Dma1_Ch0_Ch1_IrqHandler
        Dma1_Ch10_Ch11_IrqHandler: implemented-entry=Dma1_Ch10_Ch11_IrqHandler
        Dma1_Ch12_Ch13_IrqHandler: implemented-entry=Dma1_Ch12_Ch13_IrqHandler
        Dma1_Ch14_Ch15_IrqHandler: implemented-entry=Dma1_Ch14_Ch15_IrqHandler
        Dma1_Ch16_Ch17_IrqHandler: implemented-entry=Dma1_Ch16_Ch17_IrqHandler
        Dma1_Ch18_Ch19_IrqHandler: implemented-entry=Dma1_Ch18_Ch19_IrqHandler
        Dma1_Ch20_Ch21_IrqHandler: implemented-entry=Dma1_Ch20_Ch21_IrqHandler
        Dma1_Ch22_Ch23_IrqHandler: implemented-entry=Dma1_Ch22_Ch23_IrqHandler
        Dma1_Ch24_Ch25_IrqHandler: implemented-entry=Dma1_Ch24_Ch25_IrqHandler
        Dma1_Ch26_Ch27_IrqHandler: implemented-entry=Dma1_Ch26_Ch27_IrqHandler
        Dma1_Ch28_Ch29_IrqHandler: implemented-entry=Dma1_Ch28_Ch29_IrqHandler
        Dma1_Ch2_Ch3_IrqHandler: implemented-entry=Dma1_Ch2_Ch3_IrqHandler
        Dma1_Ch30_Ch31_IrqHandler: implemented-entry=Dma1_Ch30_Ch31_IrqHandler
        Dma1_Ch4_Ch5_IrqHandler: implemented-entry=Dma1_Ch4_Ch5_IrqHandler
        Dma1_Ch6_Ch7_IrqHandler: implemented-entry=Dma1_Ch6_Ch7_IrqHandler
        Dma1_Ch8_Ch9_IrqHandler: implemented-entry=Dma1_Ch8_Ch9_IrqHandler
        EMIOS0_{0..5}_IRQ: implemented-entry=EMIOS0_{0..5}_IRQ
        EMIOS1_{0..5}_IRQ: implemented-entry=EMIOS1_{0..5}_IRQ
        EMIOS2_{0..5}_IRQ: implemented-entry=EMIOS2_{0..5}_IRQ
        Lcu0_Ip_IRQHandler: implemented-entry=Lcu0_Ip_IRQHandler
        Lcu1_Ip_IRQHandler: implemented-entry=Lcu1_Ip_IRQHandler
        MCL_FLEXIO_ISR: implemented-entry=MCL_FLEXIO_ISR
package /AUTOSAR_Mcl/BswModuleEntrys
  150 x bsw module entry, all with is-synchronous=true, sw-service-impl-policy=STANDARD:
    Lcu_Ip_SetAsyncInputList: service-id=0x5d, is-reentrant=true, call-type=REGULAR, execution-context=UNSPECIFIED
    Lcu_Ip_SetAsyncOutputList: service-id=0x5e, is-reentrant=true, call-type=REGULAR, execution-context=UNSPECIFIED
    Lcu_Ip_SetSyncInputSwOverrideValue: service-id=0x50, is-reentrant=true, call-type=REGULAR, execution-context=UNSPECIFIED
    Lcu_Ip_SetSyncInputSwSyncMode: service-id=0x51, is-reentrant=true, call-type=REGULAR, execution-context=UNSPECIFIED
    Lcu_Ip_SetSyncOutputDebugMode: service-id=0x52, is-reentrant=true, call-type=REGULAR, execution-context=UNSPECIFIED
    Lcu_Ip_SetSyncOutputEnable: service-id=0x5f, is-reentrant=true, call-type=REGULAR, execution-context=UNSPECIFIED
    Lcu_Ip_SetSyncOutputFallFilter: service-id=0x5b, is-reentrant=true, call-type=REGULAR, execution-context=UNSPECIFIED
    Lcu_Ip_SetSyncOutputForceClearingMode: service-id=0x54, is-reentrant=true, call-type=REGULAR, execution-context=UNSPECIFIED
    Lcu_Ip_SetSyncOutputForceDma: service-id=0x57, is-reentrant=true, call-type=REGULAR, execution-context=UNSPECIFIED
    Lcu_Ip_SetSyncOutputForceInputSensitivity: service-id=0x53, is-reentrant=true, call-type=REGULAR, execution-context=UNSPECIFIED
    Lcu_Ip_SetSyncOutputForceInt: service-id=0x58, is-reentrant=true, call-type=REGULAR, execution-context=UNSPECIFIED
    Lcu_Ip_SetSyncOutputForceSyncSelect: service-id=0x55, is-reentrant=true, call-type=REGULAR, execution-context=UNSPECIFIED
    Lcu_Ip_SetSyncOutputLutDma: service-id=0x59, is-reentrant=true, call-type=REGULAR, execution-context=UNSPECIFIED
    Lcu_Ip_SetSyncOutputLutInt: service-id=0x5a, is-reentrant=true, call-type=REGULAR, execution-context=UNSPECIFIED
    Lcu_Ip_SetSyncOutputPolarity: service-id=0x56, is-reentrant=true, call-type=REGULAR, execution-context=UNSPECIFIED
    Lcu_Ip_SetSyncOutputRiseFilter: service-id=0x5c, is-reentrant=true, call-type=REGULAR, execution-context=UNSPECIFIED
    Mcl_CacheClean: service-id=0x13, is-reentrant=true, call-type=REGULAR, execution-context=UNSPECIFIED
    Mcl_CacheCleanByAddr: service-id=0x15, is-reentrant=true, call-type=REGULAR, execution-context=UNSPECIFIED
    Mcl_CacheDisable: service-id=0x11, is-reentrant=true, call-type=REGULAR, execution-context=UNSPECIFIED
    Mcl_CacheEnable: service-id=0x10, is-reentrant=true, call-type=REGULAR, execution-context=UNSPECIFIED
    Mcl_CacheInvalidate: service-id=0x12, is-reentrant=true, call-type=REGULAR, execution-context=UNSPECIFIED
    Mcl_CacheInvalidateByAddr: service-id=0x14, is-reentrant=true, call-type=REGULAR, execution-context=UNSPECIFIED
    Mcl_ClearLcuSyncOutputForceEvent: service-id=0x49, is-reentrant=true, call-type=REGULAR, execution-context=UNSPECIFIED
    Mcl_DeInit: service-id=0x0b, is-reentrant=false, call-type=REGULAR, execution-context=UNSPECIFIED
    Mcl_GetDmaChannelParam: service-id=0x08, is-reentrant=true, call-type=REGULAR, execution-context=UNSPECIFIED
    Mcl_GetDmaChannelStatus: service-id=0x04, is-reentrant=true, call-type=REGULAR, execution-context=UNSPECIFIED
    Mcl_GetDmaInstanceStatus: service-id=0x02, is-reentrant=true, call-type=REGULAR, execution-context=UNSPECIFIED
    Mcl_GetLcuAsyncLogicInputInfo: service-id=0x4a, is-reentrant=true, call-type=REGULAR, execution-context=UNSPECIFIED
    Mcl_GetLcuAsyncLogicOutputInfo: service-id=0x4b, is-reentrant=true, call-type=REGULAR, execution-context=UNSPECIFIED
    Mcl_GetLcuSyncCombineForceInput: service-id=0x46, is-reentrant=true, call-type=REGULAR, execution-context=UNSPECIFIED
    Mcl_GetLcuSyncForceOutput: service-id=0x44, is-reentrant=true, call-type=REGULAR, execution-context=UNSPECIFIED
    Mcl_GetLcuSyncForceStatus: service-id=0x45, is-reentrant=true, call-type=REGULAR, execution-context=UNSPECIFIED
    Mcl_GetLcuSyncLogicInput: service-id=0x41, is-reentrant=true, call-type=REGULAR, execution-context=UNSPECIFIED
    Mcl_GetLcuSyncLogicOutput: service-id=0x43, is-reentrant=true, call-type=REGULAR, execution-context=UNSPECIFIED
    Mcl_GetLcuSyncSwOverrideInput: service-id=0x42, is-reentrant=true, call-type=REGULAR, execution-context=UNSPECIFIED
    Mcl_GetVersionInfo: service-id=0x60, is-reentrant=true, call-type=REGULAR, execution-context=UNSPECIFIED
    Mcl_Init: service-id=0x00, is-reentrant=false, call-type=REGULAR, execution-context=UNSPECIFIED
    Mcl_SetDmaChannelCommand: service-id=0x03, is-reentrant=true, call-type=REGULAR, execution-context=UNSPECIFIED
    Mcl_SetDmaChannelGlobalList: service-id=0x05, is-reentrant=true, call-type=REGULAR, execution-context=UNSPECIFIED
    Mcl_SetDmaChannelScatterGatherConfig: service-id=0x09, is-reentrant=true, call-type=REGULAR, execution-context=UNSPECIFIED
    Mcl_SetDmaChannelScatterGatherList: service-id=0x07, is-reentrant=true, call-type=REGULAR, execution-context=UNSPECIFIED
    Mcl_SetDmaChannelTransferList: service-id=0x06, is-reentrant=true, call-type=REGULAR, execution-context=UNSPECIFIED
    Mcl_SetDmaInstanceCommand: service-id=0x01, is-reentrant=true, call-type=REGULAR, execution-context=UNSPECIFIED
    Mcl_SetLcuAsyncInputList: service-id=0x47, is-reentrant=true, call-type=REGULAR, execution-context=UNSPECIFIED
    Mcl_SetLcuAsyncOutputList: service-id=0x48, is-reentrant=true, call-type=REGULAR, execution-context=UNSPECIFIED
    Mcl_SetLcuSyncInputMuxSelect: service-id=0x32, is-reentrant=true, call-type=REGULAR, execution-context=UNSPECIFIED
    Mcl_SetLcuSyncInputSwOverrideEnable: service-id=0x30, is-reentrant=true, call-type=REGULAR, execution-context=UNSPECIFIED
    Mcl_SetLcuSyncInputSwOverrideValue: service-id=0x31, is-reentrant=true, call-type=REGULAR, execution-context=UNSPECIFIED
    Mcl_SetLcuSyncInputSwSyncMode: service-id=0x33, is-reentrant=true, call-type=REGULAR, execution-context=UNSPECIFIED
    Mcl_SetLcuSyncOutputDebugMode: service-id=0x34, is-reentrant=true, call-type=REGULAR, execution-context=UNSPECIFIED
    Mcl_SetLcuSyncOutputEnable: service-id=0x35, is-reentrant=true, call-type=REGULAR, execution-context=UNSPECIFIED
    Mcl_SetLcuSyncOutputFallFilter: service-id=0x3e, is-reentrant=true, call-type=REGULAR, execution-context=UNSPECIFIED
    Mcl_SetLcuSyncOutputForceClearingMode: service-id=0x37, is-reentrant=true, call-type=REGULAR, execution-context=UNSPECIFIED
    Mcl_SetLcuSyncOutputForceDma: service-id=0x3a, is-reentrant=true, call-type=REGULAR, execution-context=UNSPECIFIED
    Mcl_SetLcuSyncOutputForceInputSensitivity: service-id=0x36, is-reentrant=true, call-type=REGULAR, execution-context=UNSPECIFIED
    Mcl_SetLcuSyncOutputForceInt: service-id=0x3c, is-reentrant=true, call-type=REGULAR, execution-context=UNSPECIFIED
    Mcl_SetLcuSyncOutputForceSyncSelect: service-id=0x38, is-reentrant=true, call-type=REGULAR, execution-context=UNSPECIFIED
    Mcl_SetLcuSyncOutputLutControl: service-id=0x40, is-reentrant=true, call-type=REGULAR, execution-context=UNSPECIFIED
    Mcl_SetLcuSyncOutputLutDma: service-id=0x3b, is-reentrant=true, call-type=REGULAR, execution-context=UNSPECIFIED
    Mcl_SetLcuSyncOutputLutInt: service-id=0x3d, is-reentrant=true, call-type=REGULAR, execution-context=UNSPECIFIED
    Mcl_SetLcuSyncOutputPolarity: service-id=0x39, is-reentrant=true, call-type=REGULAR, execution-context=UNSPECIFIED
    Mcl_SetLcuSyncOutputRiseFilter: service-id=0x3f, is-reentrant=true, call-type=REGULAR, execution-context=UNSPECIFIED
    Mcl_SetLcuWriteProtect: service-id=0x4c, is-reentrant=true, call-type=REGULAR, execution-context=UNSPECIFIED
    Mcl_SetTrgMuxInput: service-id=0x20, is-reentrant=true, call-type=REGULAR, execution-context=UNSPECIFIED
    Mcl_SetTrgMuxLock: service-id=0x21, is-reentrant=true, call-type=REGULAR, execution-context=UNSPECIFIED
    Dma0_Ch0_Ch1_IrqHandler: service-id=0, is-reentrant=false, call-type=INTERRUPT, execution-context=INTERRUPT-CAT-2
    Dma0_Ch0_IRQHandler: service-id=0, is-reentrant=false, call-type=INTERRUPT, execution-context=INTERRUPT-CAT-2
    Dma0_Ch10_Ch11_IrqHandler: service-id=0, is-reentrant=false, call-type=INTERRUPT, execution-context=INTERRUPT-CAT-2
    Dma0_Ch10_IRQHandler: service-id=0, is-reentrant=false, call-type=INTERRUPT, execution-context=INTERRUPT-CAT-2
    Dma0_Ch11_IRQHandler: service-id=0, is-reentrant=false, call-type=INTERRUPT, execution-context=INTERRUPT-CAT-2
    Dma0_Ch12_Ch13_IrqHandler: service-id=0, is-reentrant=false, call-type=INTERRUPT, execution-context=INTERRUPT-CAT-2
    Dma0_Ch12_IRQHandler: service-id=0, is-reentrant=false, call-type=INTERRUPT, execution-context=INTERRUPT-CAT-2
    Dma0_Ch13_IRQHandler: service-id=0, is-reentrant=false, call-type=INTERRUPT, execution-context=INTERRUPT-CAT-2
    Dma0_Ch14_Ch15_IrqHandler: service-id=0, is-reentrant=false, call-type=INTERRUPT, execution-context=INTERRUPT-CAT-2
    Dma0_Ch14_IRQHandler: service-id=0, is-reentrant=false, call-type=INTERRUPT, execution-context=INTERRUPT-CAT-2
    Dma0_Ch15_IRQHandler: service-id=0, is-reentrant=false, call-type=INTERRUPT, execution-context=INTERRUPT-CAT-2
    Dma0_Ch16_Ch17_IrqHandler: service-id=0, is-reentrant=false, call-type=INTERRUPT, execution-context=INTERRUPT-CAT-2
    Dma0_Ch16_IRQHandler: service-id=0, is-reentrant=false, call-type=INTERRUPT, execution-context=INTERRUPT-CAT-2
    Dma0_Ch17_IRQHandler: service-id=0, is-reentrant=false, call-type=INTERRUPT, execution-context=INTERRUPT-CAT-2
    Dma0_Ch18_Ch19_IrqHandler: service-id=0, is-reentrant=false, call-type=INTERRUPT, execution-context=INTERRUPT-CAT-2
    Dma0_Ch18_IRQHandler: service-id=0, is-reentrant=false, call-type=INTERRUPT, execution-context=INTERRUPT-CAT-2
    Dma0_Ch19_IRQHandler: service-id=0, is-reentrant=false, call-type=INTERRUPT, execution-context=INTERRUPT-CAT-2
    Dma0_Ch1_IRQHandler: service-id=0, is-reentrant=false, call-type=INTERRUPT, execution-context=INTERRUPT-CAT-2
    Dma0_Ch20_Ch21_IrqHandler: service-id=0, is-reentrant=false, call-type=INTERRUPT, execution-context=INTERRUPT-CAT-2
    Dma0_Ch20_IRQHandler: service-id=0, is-reentrant=false, call-type=INTERRUPT, execution-context=INTERRUPT-CAT-2
    Dma0_Ch21_IRQHandler: service-id=0, is-reentrant=false, call-type=INTERRUPT, execution-context=INTERRUPT-CAT-2
    Dma0_Ch22_Ch23_IrqHandler: service-id=0, is-reentrant=false, call-type=INTERRUPT, execution-context=INTERRUPT-CAT-2
    Dma0_Ch22_IRQHandler: service-id=0, is-reentrant=false, call-type=INTERRUPT, execution-context=INTERRUPT-CAT-2
    Dma0_Ch23_IRQHandler: service-id=0, is-reentrant=false, call-type=INTERRUPT, execution-context=INTERRUPT-CAT-2
    Dma0_Ch24_Ch25_IrqHandler: service-id=0, is-reentrant=false, call-type=INTERRUPT, execution-context=INTERRUPT-CAT-2
    Dma0_Ch24_IRQHandler: service-id=0, is-reentrant=false, call-type=INTERRUPT, execution-context=INTERRUPT-CAT-2
    Dma0_Ch25_IRQHandler: service-id=0, is-reentrant=false, call-type=INTERRUPT, execution-context=INTERRUPT-CAT-2
    Dma0_Ch26_Ch27_IrqHandler: service-id=0, is-reentrant=false, call-type=INTERRUPT, execution-context=INTERRUPT-CAT-2
    Dma0_Ch26_IRQHandler: service-id=0, is-reentrant=false, call-type=INTERRUPT, execution-context=INTERRUPT-CAT-2
    Dma0_Ch27_IRQHandler: service-id=0, is-reentrant=false, call-type=INTERRUPT, execution-context=INTERRUPT-CAT-2
    Dma0_Ch28_Ch29_IrqHandler: service-id=0, is-reentrant=false, call-type=INTERRUPT, execution-context=INTERRUPT-CAT-2
    Dma0_Ch28_IRQHandler: service-id=0, is-reentrant=false, call-type=INTERRUPT, execution-context=INTERRUPT-CAT-2
    Dma0_Ch29_IRQHandler: service-id=0, is-reentrant=false, call-type=INTERRUPT, execution-context=INTERRUPT-CAT-2
    Dma0_Ch2_Ch3_IrqHandler: service-id=0, is-reentrant=false, call-type=INTERRUPT, execution-context=INTERRUPT-CAT-2
    Dma0_Ch2_IRQHandler: service-id=0, is-reentrant=false, call-type=INTERRUPT, execution-context=INTERRUPT-CAT-2
    Dma0_Ch30_Ch31_IrqHandler: service-id=0, is-reentrant=false, call-type=INTERRUPT, execution-context=INTERRUPT-CAT-2
    Dma0_Ch30_IRQHandler: service-id=0, is-reentrant=false, call-type=INTERRUPT, execution-context=INTERRUPT-CAT-2
    Dma0_Ch31_IRQHandler: service-id=0, is-reentrant=false, call-type=INTERRUPT, execution-context=INTERRUPT-CAT-2
    Dma0_Ch3_IRQHandler: service-id=0, is-reentrant=false, call-type=INTERRUPT, execution-context=INTERRUPT-CAT-2
    Dma0_Ch4_Ch5_IrqHandler: service-id=0, is-reentrant=false, call-type=INTERRUPT, execution-context=INTERRUPT-CAT-2
    Dma0_Ch4_IRQHandler: service-id=0, is-reentrant=false, call-type=INTERRUPT, execution-context=INTERRUPT-CAT-2
    Dma0_Ch5_IRQHandler: service-id=0, is-reentrant=false, call-type=INTERRUPT, execution-context=INTERRUPT-CAT-2
    Dma0_Ch6_Ch7_IrqHandler: service-id=0, is-reentrant=false, call-type=INTERRUPT, execution-context=INTERRUPT-CAT-2
    Dma0_Ch6_IRQHandler: service-id=0, is-reentrant=false, call-type=INTERRUPT, execution-context=INTERRUPT-CAT-2
    Dma0_Ch7_IRQHandler: service-id=0, is-reentrant=false, call-type=INTERRUPT, execution-context=INTERRUPT-CAT-2
    Dma0_Ch8_Ch9_IrqHandler: service-id=0, is-reentrant=false, call-type=INTERRUPT, execution-context=INTERRUPT-CAT-2
    Dma0_Ch8_IRQHandler: service-id=0, is-reentrant=false, call-type=INTERRUPT, execution-context=INTERRUPT-CAT-2
    Dma0_Ch9_IRQHandler: service-id=0, is-reentrant=false, call-type=INTERRUPT, execution-context=INTERRUPT-CAT-2
    Dma1_Ch0_Ch1_IrqHandler: service-id=0, is-reentrant=false, call-type=INTERRUPT, execution-context=INTERRUPT-CAT-2
    Dma1_Ch10_Ch11_IrqHandler: service-id=0, is-reentrant=false, call-type=INTERRUPT, execution-context=INTERRUPT-CAT-2
    Dma1_Ch12_Ch13_IrqHandler: service-id=0, is-reentrant=false, call-type=INTERRUPT, execution-context=INTERRUPT-CAT-2
    Dma1_Ch14_Ch15_IrqHandler: service-id=0, is-reentrant=false, call-type=INTERRUPT, execution-context=INTERRUPT-CAT-2
    Dma1_Ch16_Ch17_IrqHandler: service-id=0, is-reentrant=false, call-type=INTERRUPT, execution-context=INTERRUPT-CAT-2
    Dma1_Ch18_Ch19_IrqHandler: service-id=0, is-reentrant=false, call-type=INTERRUPT, execution-context=INTERRUPT-CAT-2
    Dma1_Ch20_Ch21_IrqHandler: service-id=0, is-reentrant=false, call-type=INTERRUPT, execution-context=INTERRUPT-CAT-2
    Dma1_Ch22_Ch23_IrqHandler: service-id=0, is-reentrant=false, call-type=INTERRUPT, execution-context=INTERRUPT-CAT-2
    Dma1_Ch24_Ch25_IrqHandler: service-id=0, is-reentrant=false, call-type=INTERRUPT, execution-context=INTERRUPT-CAT-2
    Dma1_Ch26_Ch27_IrqHandler: service-id=0, is-reentrant=false, call-type=INTERRUPT, execution-context=INTERRUPT-CAT-2
    Dma1_Ch28_Ch29_IrqHandler: service-id=0, is-reentrant=false, call-type=INTERRUPT, execution-context=INTERRUPT-CAT-2
    Dma1_Ch2_Ch3_IrqHandler: service-id=0, is-reentrant=false, call-type=INTERRUPT, execution-context=INTERRUPT-CAT-2
    Dma1_Ch30_Ch31_IrqHandler: service-id=0, is-reentrant=false, call-type=INTERRUPT, execution-context=INTERRUPT-CAT-2
    Dma1_Ch4_Ch5_IrqHandler: service-id=0, is-reentrant=false, call-type=INTERRUPT, execution-context=INTERRUPT-CAT-2
    Dma1_Ch6_Ch7_IrqHandler: service-id=0, is-reentrant=false, call-type=INTERRUPT, execution-context=INTERRUPT-CAT-2
    Dma1_Ch8_Ch9_IrqHandler: service-id=0, is-reentrant=false, call-type=INTERRUPT, execution-context=INTERRUPT-CAT-2
    EMIOS0_{0..5}_IRQ: service-id=0, is-reentrant=false, call-type=INTERRUPT, execution-context=INTERRUPT-CAT-2
    EMIOS1_{0..5}_IRQ: service-id=0, is-reentrant=false, call-type=INTERRUPT, execution-context=INTERRUPT-CAT-2
    EMIOS2_{0..5}_IRQ: service-id=0, is-reentrant=false, call-type=INTERRUPT, execution-context=INTERRUPT-CAT-2
    Lcu0_Ip_IRQHandler: service-id=0, is-reentrant=false, call-type=INTERRUPT, execution-context=INTERRUPT-CAT-2
    Lcu1_Ip_IRQHandler: service-id=0, is-reentrant=false, call-type=INTERRUPT, execution-context=INTERRUPT-CAT-2
    MCL_FLEXIO_ISR: service-id=0, is-reentrant=false, call-type=INTERRUPT, execution-context=INTERRUPT-CAT-2
package /Mcl_TS_T40D34M30I0R0/Implementations
  bsw implementation BswImplementation_Mcl: programming-language=C, sw-version=3.0.0, vendor-id=43, ar-release-version=4.7.0, behavior=InternalBehavior_Mcl, vendor-specific-module-def=Mcl
    code-descriptors:
      code Files
        artifact-descriptors:
          short-label=config::Mcl.xdm, category=SWCFG
          short-label=doc::RTD_MCL_IM.pdf, category=SWDOC
          short-label=doc::RTD_MCL_UM.pdf, category=SWDOC
          short-label=examples::EBT::S32K358::Mcl_DmaTransfer_S32K358::generate::epc::BaseNXP.xdm, category=SWCFG
          short-label=examples::EBT::S32K358::Mcl_DmaTransfer_S32K358::generate::epc::Mcl.xdm, category=SWCFG
          short-label=examples::EBT::S32K358::Mcl_DmaTransfer_S32K358::generate::epc::Mcu.xdm, category=SWCFG
          short-label=examples::EBT::S32K358::Mcl_DmaTransfer_S32K358::generate::epc::Platform.xdm, category=SWCFG
          short-label=examples::EBT::S32K358::Mcl_DmaTransfer_S32K358::generate::epc::Resource.xdm, category=SWCFG
          short-label=examples::EBT::S32K358::Mcl_DmaTransfer_S32K358::include::check_example.h, category=SWHDR
          short-label=examples::EBT::S32K358::Mcl_DmaTransfer_S32K358::include::Mcl_Example_EBT.h, category=SWHDR
          short-label=examples::EBT::S32K358::Mcl_DmaTransfer_S32K358::src::main.c, category=SWSRC
          short-label=examples::EBT::S32K358::Mcl_DmaTransfer_S32K358::TresosProject::Mcl_DmaTransfer_S32K358::.prefs::preferences.xdm, category=SWCFG
          short-label=examples::EBT::S32K358::Mcl_DmaTransfer_S32K358::TresosProject::Mcl_DmaTransfer_S32K358::config::BaseNXP.xdm, category=SWCFG
          short-label=examples::EBT::S32K358::Mcl_DmaTransfer_S32K358::TresosProject::Mcl_DmaTransfer_S32K358::config::EcuC.xdm, category=SWCFG
          short-label=examples::EBT::S32K358::Mcl_DmaTransfer_S32K358::TresosProject::Mcl_DmaTransfer_S32K358::config::Mcl.xdm, category=SWCFG
          short-label=examples::EBT::S32K358::Mcl_DmaTransfer_S32K358::TresosProject::Mcl_DmaTransfer_S32K358::config::Mcu.xdm, category=SWCFG
          short-label=examples::EBT::S32K358::Mcl_DmaTransfer_S32K358::TresosProject::Mcl_DmaTransfer_S32K358::config::Platform.xdm, category=SWCFG
          short-label=examples::EBT::S32K358::Mcl_DmaTransfer_S32K358::TresosProject::Mcl_DmaTransfer_S32K358::config::Resource.xdm, category=SWCFG
          short-label=examples::EBT::S32K358::Mcl_LcuControlMotor_S32K358::generate::epc::BaseNXP.xdm, category=SWCFG
          short-label=examples::EBT::S32K358::Mcl_LcuControlMotor_S32K358::generate::epc::Mcl.xdm, category=SWCFG
          short-label=examples::EBT::S32K358::Mcl_LcuControlMotor_S32K358::generate::epc::Mcu.xdm, category=SWCFG
          short-label=examples::EBT::S32K358::Mcl_LcuControlMotor_S32K358::generate::epc::Platform.xdm, category=SWCFG
          short-label=examples::EBT::S32K358::Mcl_LcuControlMotor_S32K358::generate::epc::Resource.xdm, category=SWCFG
          short-label=examples::EBT::S32K358::Mcl_LcuControlMotor_S32K358::include::check_example.h, category=SWHDR
          short-label=examples::EBT::S32K358::Mcl_LcuControlMotor_S32K358::include::Mcl_Example_EBT_OVER_LCU.h, category=SWHDR
          short-label=examples::EBT::S32K358::Mcl_LcuControlMotor_S32K358::src::main.c, category=SWSRC
          short-label=examples::EBT::S32K358::Mcl_LcuControlMotor_S32K358::TresosProject::Mcl_LcuControlMotor_S32K358::.prefs::preferences.xdm, category=SWCFG
          short-label=examples::EBT::S32K358::Mcl_LcuControlMotor_S32K358::TresosProject::Mcl_LcuControlMotor_S32K358::config::BaseNXP.xdm, category=SWCFG
          short-label=examples::EBT::S32K358::Mcl_LcuControlMotor_S32K358::TresosProject::Mcl_LcuControlMotor_S32K358::config::EcuC.xdm, category=SWCFG
          short-label=examples::EBT::S32K358::Mcl_LcuControlMotor_S32K358::TresosProject::Mcl_LcuControlMotor_S32K358::config::Mcl.xdm, category=SWCFG
          short-label=examples::EBT::S32K358::Mcl_LcuControlMotor_S32K358::TresosProject::Mcl_LcuControlMotor_S32K358::config::Mcu.xdm, category=SWCFG
          short-label=examples::EBT::S32K358::Mcl_LcuControlMotor_S32K358::TresosProject::Mcl_LcuControlMotor_S32K358::config::Platform.xdm, category=SWCFG
          short-label=examples::EBT::S32K358::Mcl_LcuControlMotor_S32K358::TresosProject::Mcl_LcuControlMotor_S32K358::config::Resource.xdm, category=SWCFG
          short-label=examples::EBT::S32K396::Mcl_DmaTransfer_S32K396::generate::epc::BaseNXP.xdm, category=SWCFG
          short-label=examples::EBT::S32K396::Mcl_DmaTransfer_S32K396::generate::epc::Mcl.xdm, category=SWCFG
          short-label=examples::EBT::S32K396::Mcl_DmaTransfer_S32K396::generate::epc::Mcu.xdm, category=SWCFG
          short-label=examples::EBT::S32K396::Mcl_DmaTransfer_S32K396::generate::epc::Platform.xdm, category=SWCFG
          short-label=examples::EBT::S32K396::Mcl_DmaTransfer_S32K396::generate::epc::Resource.xdm, category=SWCFG
          short-label=examples::EBT::S32K396::Mcl_DmaTransfer_S32K396::include::check_example.h, category=SWHDR
          short-label=examples::EBT::S32K396::Mcl_DmaTransfer_S32K396::include::Mcl_Example_EBT.h, category=SWHDR
          short-label=examples::EBT::S32K396::Mcl_DmaTransfer_S32K396::src::main.c, category=SWSRC
          short-label=examples::EBT::S32K396::Mcl_DmaTransfer_S32K396::TresosProject::Mcl_DmaTransfer_S32K396::.prefs::preferences.xdm, category=SWCFG
          short-label=examples::EBT::S32K396::Mcl_DmaTransfer_S32K396::TresosProject::Mcl_DmaTransfer_S32K396::config::BaseNXP.xdm, category=SWCFG
          short-label=examples::EBT::S32K396::Mcl_DmaTransfer_S32K396::TresosProject::Mcl_DmaTransfer_S32K396::config::EcuC.xdm, category=SWCFG
          short-label=examples::EBT::S32K396::Mcl_DmaTransfer_S32K396::TresosProject::Mcl_DmaTransfer_S32K396::config::Mcl.xdm, category=SWCFG
          short-label=examples::EBT::S32K396::Mcl_DmaTransfer_S32K396::TresosProject::Mcl_DmaTransfer_S32K396::config::Mcu.xdm, category=SWCFG
          short-label=examples::EBT::S32K396::Mcl_DmaTransfer_S32K396::TresosProject::Mcl_DmaTransfer_S32K396::config::Platform.xdm, category=SWCFG
          short-label=examples::EBT::S32K396::Mcl_DmaTransfer_S32K396::TresosProject::Mcl_DmaTransfer_S32K396::config::Resource.xdm, category=SWCFG
          short-label=examples::EBT::S32K396::Mcl_LcuControlMotor_S32K396::generate::epc::BaseNXP.xdm, category=SWCFG
          short-label=examples::EBT::S32K396::Mcl_LcuControlMotor_S32K396::generate::epc::Mcl.xdm, category=SWCFG
          short-label=examples::EBT::S32K396::Mcl_LcuControlMotor_S32K396::generate::epc::Mcu.xdm, category=SWCFG
          short-label=examples::EBT::S32K396::Mcl_LcuControlMotor_S32K396::generate::epc::Platform.xdm, category=SWCFG
          short-label=examples::EBT::S32K396::Mcl_LcuControlMotor_S32K396::generate::epc::Resource.xdm, category=SWCFG
          short-label=examples::EBT::S32K396::Mcl_LcuControlMotor_S32K396::include::check_example.h, category=SWHDR
          short-label=examples::EBT::S32K396::Mcl_LcuControlMotor_S32K396::include::Mcl_Example_EBT_OVER_LCU.h, category=SWHDR
          short-label=examples::EBT::S32K396::Mcl_LcuControlMotor_S32K396::src::main.c, category=SWSRC
          short-label=examples::EBT::S32K396::Mcl_LcuControlMotor_S32K396::TresosProject::Mcl_LcuControlMotor_S32K396::.prefs::preferences.xdm, category=SWCFG
          short-label=examples::EBT::S32K396::Mcl_LcuControlMotor_S32K396::TresosProject::Mcl_LcuControlMotor_S32K396::config::BaseNXP.xdm, category=SWCFG
          short-label=examples::EBT::S32K396::Mcl_LcuControlMotor_S32K396::TresosProject::Mcl_LcuControlMotor_S32K396::config::EcuC.xdm, category=SWCFG
          short-label=examples::EBT::S32K396::Mcl_LcuControlMotor_S32K396::TresosProject::Mcl_LcuControlMotor_S32K396::config::Mcl.xdm, category=SWCFG
          short-label=examples::EBT::S32K396::Mcl_LcuControlMotor_S32K396::TresosProject::Mcl_LcuControlMotor_S32K396::config::Mcu.xdm, category=SWCFG
          short-label=examples::EBT::S32K396::Mcl_LcuControlMotor_S32K396::TresosProject::Mcl_LcuControlMotor_S32K396::config::Platform.xdm, category=SWCFG
          short-label=examples::EBT::S32K396::Mcl_LcuControlMotor_S32K396::TresosProject::Mcl_LcuControlMotor_S32K396::config::Resource.xdm, category=SWCFG
          short-label=examples::EBT::S32K3XX::Mcl_DmaTransfer_S32K344::generate::epc::BaseNXP.xdm, category=SWCFG
          short-label=examples::EBT::S32K3XX::Mcl_DmaTransfer_S32K344::generate::epc::Mcl.xdm, category=SWCFG
          short-label=examples::EBT::S32K3XX::Mcl_DmaTransfer_S32K344::generate::epc::Mcu.xdm, category=SWCFG
          short-label=examples::EBT::S32K3XX::Mcl_DmaTransfer_S32K344::generate::epc::Platform.xdm, category=SWCFG
          short-label=examples::EBT::S32K3XX::Mcl_DmaTransfer_S32K344::generate::epc::Resource.xdm, category=SWCFG
          short-label=examples::EBT::S32K3XX::Mcl_DmaTransfer_S32K344::include::check_example.h, category=SWHDR
          short-label=examples::EBT::S32K3XX::Mcl_DmaTransfer_S32K344::include::Mcl_Example_EBT.h, category=SWHDR
          short-label=examples::EBT::S32K3XX::Mcl_DmaTransfer_S32K344::src::main.c, category=SWSRC
          short-label=examples::EBT::S32K3XX::Mcl_DmaTransfer_S32K344::TresosProject::Mcl_DmaTransfer_S32K344::.prefs::preferences.xdm, category=SWCFG
          short-label=examples::EBT::S32K3XX::Mcl_DmaTransfer_S32K344::TresosProject::Mcl_DmaTransfer_S32K344::config::BaseNXP.xdm, category=SWCFG
          short-label=examples::EBT::S32K3XX::Mcl_DmaTransfer_S32K344::TresosProject::Mcl_DmaTransfer_S32K344::config::EcuC.xdm, category=SWCFG
          short-label=examples::EBT::S32K3XX::Mcl_DmaTransfer_S32K344::TresosProject::Mcl_DmaTransfer_S32K344::config::Mcl.xdm, category=SWCFG
          short-label=examples::EBT::S32K3XX::Mcl_DmaTransfer_S32K344::TresosProject::Mcl_DmaTransfer_S32K344::config::Mcu.xdm, category=SWCFG
          short-label=examples::EBT::S32K3XX::Mcl_DmaTransfer_S32K344::TresosProject::Mcl_DmaTransfer_S32K344::config::Platform.xdm, category=SWCFG
          short-label=examples::EBT::S32K3XX::Mcl_DmaTransfer_S32K344::TresosProject::Mcl_DmaTransfer_S32K344::config::Resource.xdm, category=SWCFG
          short-label=examples::EBT::S32K3XX::Mcl_LcuControlMotor_S32K344::generate::epc::BaseNXP.xdm, category=SWCFG
          short-label=examples::EBT::S32K3XX::Mcl_LcuControlMotor_S32K344::generate::epc::Mcl.xdm, category=SWCFG
          short-label=examples::EBT::S32K3XX::Mcl_LcuControlMotor_S32K344::generate::epc::Mcu.xdm, category=SWCFG
          short-label=examples::EBT::S32K3XX::Mcl_LcuControlMotor_S32K344::generate::epc::Platform.xdm, category=SWCFG
          short-label=examples::EBT::S32K3XX::Mcl_LcuControlMotor_S32K344::generate::epc::Resource.xdm, category=SWCFG
          short-label=examples::EBT::S32K3XX::Mcl_LcuControlMotor_S32K344::include::check_example.h, category=SWHDR
          short-label=examples::EBT::S32K3XX::Mcl_LcuControlMotor_S32K344::include::Mcl_Example_EBT_OVER_LCU.h, category=SWHDR
          short-label=examples::EBT::S32K3XX::Mcl_LcuControlMotor_S32K344::src::main.c, category=SWSRC
          short-label=examples::EBT::S32K3XX::Mcl_LcuControlMotor_S32K344::TresosProject::Mcl_LcuControlMotor_S32K344::.prefs::preferences.xdm, category=SWCFG
          short-label=examples::EBT::S32K3XX::Mcl_LcuControlMotor_S32K344::TresosProject::Mcl_LcuControlMotor_S32K344::config::BaseNXP.xdm, category=SWCFG
          short-label=examples::EBT::S32K3XX::Mcl_LcuControlMotor_S32K344::TresosProject::Mcl_LcuControlMotor_S32K344::config::EcuC.xdm, category=SWCFG
          short-label=examples::EBT::S32K3XX::Mcl_LcuControlMotor_S32K344::TresosProject::Mcl_LcuControlMotor_S32K344::config::Mcl.xdm, category=SWCFG
          short-label=examples::EBT::S32K3XX::Mcl_LcuControlMotor_S32K344::TresosProject::Mcl_LcuControlMotor_S32K344::config::Mcu.xdm, category=SWCFG
          short-label=examples::EBT::S32K3XX::Mcl_LcuControlMotor_S32K344::TresosProject::Mcl_LcuControlMotor_S32K344::config::Platform.xdm, category=SWCFG
          short-label=examples::EBT::S32K3XX::Mcl_LcuControlMotor_S32K344::TresosProject::Mcl_LcuControlMotor_S32K344::config::Resource.xdm, category=SWCFG
          short-label=examples::S32DS::S32K358::Dma_Ip_DmaTransfer_S32K358::include::check_example.h, category=SWHDR
          short-label=examples::S32DS::S32K358::Dma_Ip_DmaTransfer_S32K358::Project_Settings::Startup_Code::exceptions.c, category=SWSRC
          short-label=examples::S32DS::S32K358::Dma_Ip_DmaTransfer_S32K358::Project_Settings::Startup_Code::nvic.c, category=SWSRC
          short-label=examples::S32DS::S32K358::Dma_Ip_DmaTransfer_S32K358::Project_Settings::Startup_Code::startup.c, category=SWSRC
          short-label=examples::S32DS::S32K358::Dma_Ip_DmaTransfer_S32K358::Project_Settings::Startup_Code::system.c, category=SWSRC
          short-label=examples::S32DS::S32K358::Dma_Ip_DmaTransfer_S32K358::src::main.c, category=SWSRC
          short-label=examples::S32DS::S32K358::Lcu_Ip_LcuControlMotor_S32K358::include::check_example.h, category=SWHDR
          short-label=examples::S32DS::S32K358::Lcu_Ip_LcuControlMotor_S32K358::Project_Settings::Startup_Code::exceptions.c, category=SWSRC
          short-label=examples::S32DS::S32K358::Lcu_Ip_LcuControlMotor_S32K358::Project_Settings::Startup_Code::nvic.c, category=SWSRC
          short-label=examples::S32DS::S32K358::Lcu_Ip_LcuControlMotor_S32K358::Project_Settings::Startup_Code::startup.c, category=SWSRC
          short-label=examples::S32DS::S32K358::Lcu_Ip_LcuControlMotor_S32K358::Project_Settings::Startup_Code::system.c, category=SWSRC
          short-label=examples::S32DS::S32K358::Lcu_Ip_LcuControlMotor_S32K358::src::main.c, category=SWSRC
          short-label=examples::S32DS::S32K358::Mcl_DmaTransfer_S32K358::include::check_example.h, category=SWHDR
          short-label=examples::S32DS::S32K358::Mcl_DmaTransfer_S32K358::Project_Settings::Startup_Code::exceptions.c, category=SWSRC
          short-label=examples::S32DS::S32K358::Mcl_DmaTransfer_S32K358::Project_Settings::Startup_Code::nvic.c, category=SWSRC
          short-label=examples::S32DS::S32K358::Mcl_DmaTransfer_S32K358::Project_Settings::Startup_Code::startup.c, category=SWSRC
          short-label=examples::S32DS::S32K358::Mcl_DmaTransfer_S32K358::Project_Settings::Startup_Code::system.c, category=SWSRC
          short-label=examples::S32DS::S32K358::Mcl_DmaTransfer_S32K358::src::main.c, category=SWSRC
          short-label=examples::S32DS::S32K396::Dma_Ip_DmaTransfer_S32K396::include::check_example.h, category=SWHDR
          short-label=examples::S32DS::S32K396::Dma_Ip_DmaTransfer_S32K396::Project_Settings::Startup_Code::exceptions.c, category=SWSRC
          short-label=examples::S32DS::S32K396::Dma_Ip_DmaTransfer_S32K396::Project_Settings::Startup_Code::nvic.c, category=SWSRC
          short-label=examples::S32DS::S32K396::Dma_Ip_DmaTransfer_S32K396::Project_Settings::Startup_Code::startup.c, category=SWSRC
          short-label=examples::S32DS::S32K396::Dma_Ip_DmaTransfer_S32K396::Project_Settings::Startup_Code::system.c, category=SWSRC
          short-label=examples::S32DS::S32K396::Dma_Ip_DmaTransfer_S32K396::src::main.c, category=SWSRC
          short-label=examples::S32DS::S32K396::Lcu_Ip_LcuControlMotor_S32K396::include::check_example.h, category=SWHDR
          short-label=examples::S32DS::S32K396::Lcu_Ip_LcuControlMotor_S32K396::Project_Settings::Startup_Code::exceptions.c, category=SWSRC
          short-label=examples::S32DS::S32K396::Lcu_Ip_LcuControlMotor_S32K396::Project_Settings::Startup_Code::nvic.c, category=SWSRC
          short-label=examples::S32DS::S32K396::Lcu_Ip_LcuControlMotor_S32K396::Project_Settings::Startup_Code::startup.c, category=SWSRC
          short-label=examples::S32DS::S32K396::Lcu_Ip_LcuControlMotor_S32K396::Project_Settings::Startup_Code::system.c, category=SWSRC
          short-label=examples::S32DS::S32K396::Lcu_Ip_LcuControlMotor_S32K396::src::main.c, category=SWSRC
          short-label=examples::S32DS::S32K396::Mcl_DmaTransfer_S32K396::include::check_example.h, category=SWHDR
          short-label=examples::S32DS::S32K396::Mcl_DmaTransfer_S32K396::Project_Settings::Startup_Code::exceptions.c, category=SWSRC
          short-label=examples::S32DS::S32K396::Mcl_DmaTransfer_S32K396::Project_Settings::Startup_Code::nvic.c, category=SWSRC
          short-label=examples::S32DS::S32K396::Mcl_DmaTransfer_S32K396::Project_Settings::Startup_Code::startup.c, category=SWSRC
          short-label=examples::S32DS::S32K396::Mcl_DmaTransfer_S32K396::Project_Settings::Startup_Code::system.c, category=SWSRC
          short-label=examples::S32DS::S32K396::Mcl_DmaTransfer_S32K396::src::main.c, category=SWSRC
          short-label=examples::S32DS::S32K3XX::Dma_Ip_DmaTransfer_S32K344::include::check_example.h, category=SWHDR
          short-label=examples::S32DS::S32K3XX::Dma_Ip_DmaTransfer_S32K344::Project_Settings::Startup_Code::exceptions.c, category=SWSRC
          short-label=examples::S32DS::S32K3XX::Dma_Ip_DmaTransfer_S32K344::Project_Settings::Startup_Code::nvic.c, category=SWSRC
          short-label=examples::S32DS::S32K3XX::Dma_Ip_DmaTransfer_S32K344::Project_Settings::Startup_Code::startup.c, category=SWSRC
          short-label=examples::S32DS::S32K3XX::Dma_Ip_DmaTransfer_S32K344::Project_Settings::Startup_Code::system.c, category=SWSRC
          short-label=examples::S32DS::S32K3XX::Dma_Ip_DmaTransfer_S32K344::src::main.c, category=SWSRC
          short-label=examples::S32DS::S32K3XX::Lcu_Ip_LcuControlMotor_S32K344::include::check_example.h, category=SWHDR
          short-label=examples::S32DS::S32K3XX::Lcu_Ip_LcuControlMotor_S32K344::Project_Settings::Startup_Code::exceptions.c, category=SWSRC
          short-label=examples::S32DS::S32K3XX::Lcu_Ip_LcuControlMotor_S32K344::Project_Settings::Startup_Code::nvic.c, category=SWSRC
          short-label=examples::S32DS::S32K3XX::Lcu_Ip_LcuControlMotor_S32K344::Project_Settings::Startup_Code::startup.c, category=SWSRC
          short-label=examples::S32DS::S32K3XX::Lcu_Ip_LcuControlMotor_S32K344::Project_Settings::Startup_Code::system.c, category=SWSRC
          short-label=examples::S32DS::S32K3XX::Lcu_Ip_LcuControlMotor_S32K344::src::main.c, category=SWSRC
          short-label=examples::S32DS::S32K3XX::Mcl_DmaTransfer_S32K344::include::check_example.h, category=SWHDR
          short-label=examples::S32DS::S32K3XX::Mcl_DmaTransfer_S32K344::Project_Settings::Startup_Code::exceptions.c, category=SWSRC
          short-label=examples::S32DS::S32K3XX::Mcl_DmaTransfer_S32K344::Project_Settings::Startup_Code::nvic.c, category=SWSRC
          short-label=examples::S32DS::S32K3XX::Mcl_DmaTransfer_S32K344::Project_Settings::Startup_Code::startup.c, category=SWSRC
          short-label=examples::S32DS::S32K3XX::Mcl_DmaTransfer_S32K344::Project_Settings::Startup_Code::system.c, category=SWSRC
          short-label=examples::S32DS::S32K3XX::Mcl_DmaTransfer_S32K344::src::main.c, category=SWSRC
          short-label=include::Cache_Ip.h, category=SWHDR
          short-label=include::Cache_Ip_Devassert.h, category=SWHDR
          short-label=include::Cache_Ip_HwAcc_ArmCoreMx.h, category=SWHDR
          short-label=include::Cache_Ip_TrustedFunctions.h, category=SWHDR
          short-label=include::Cache_Ip_Types.h, category=SWHDR
          short-label=include::CDD_Mcl.h, category=SWHDR
          short-label=include::CDD_Mcl_Ipw.h, category=SWHDR
          short-label=include::CDD_Mcl_Irq.h, category=SWHDR
          short-label=include::Dma_Ip.h, category=SWHDR
          short-label=include::Dma_Ip_Devassert.h, category=SWHDR
          short-label=include::Dma_Ip_Driver_State.h, category=SWHDR
          short-label=include::Dma_Ip_Hwv3_AccessInline.h, category=SWHDR
          short-label=include::Dma_Ip_Hw_Access.h, category=SWHDR
          short-label=include::Dma_Ip_Irq.h, category=SWHDR
          short-label=include::Dma_Ip_Multicore.h, category=SWHDR
          short-label=include::Dma_Ip_TrustedFunctions.h, category=SWHDR
          short-label=include::Dma_Ip_Types.h, category=SWHDR
          short-label=include::Emios_Mcl_Ip.h, category=SWHDR
          short-label=include::Emios_Mcl_Ip_Irq.h, category=SWHDR
          short-label=include::Emios_Mcl_Ip_Types.h, category=SWHDR
          short-label=include::Flexio_Mcl_Ip.h, category=SWHDR
          short-label=include::Flexio_Mcl_Ip_HwAccess.h, category=SWHDR
          short-label=include::Flexio_Mcl_Ip_Types.h, category=SWHDR
          short-label=include::Lcu_Ip.h, category=SWHDR
          short-label=include::Lcu_Ip_Devassert.h, category=SWHDR
          short-label=include::Lcu_Ip_Hw_Access.h, category=SWHDR
          short-label=include::Lcu_Ip_Irq.h, category=SWHDR
          short-label=include::Lcu_Ip_Multicore.h, category=SWHDR
          short-label=include::Lcu_Ip_Types.h, category=SWHDR
          short-label=include::Mcl.h, category=SWHDR
          short-label=include::Mcl_TrustedFunctions.h, category=SWHDR
          short-label=include::Mcl_Types.h, category=SWHDR
          short-label=include::Trgmux_Ip.h, category=SWHDR
          short-label=include::Trgmux_Ip_Devassert.h, category=SWHDR
          short-label=include::Trgmux_Ip_HwAcc.h, category=SWHDR
          short-label=include::Trgmux_Ip_TrustedFunctions.h, category=SWHDR
          short-label=include::Trgmux_Ip_Types.h, category=SWHDR
          short-label=src::Cache_Ip.c, category=SWSRC
          short-label=src::Cache_Ip_HwAcc_ArmCoreMx.c, category=SWSRC
          short-label=src::CDD_Mcl.c, category=SWSRC
          short-label=src::CDD_Mcl_Ipw.c, category=SWSRC
          short-label=src::Dma_Ip.c, category=SWSRC
          short-label=src::Dma_Ip_Driver_State.c, category=SWSRC
          short-label=src::Dma_Ip_Hw_Access.c, category=SWSRC
          short-label=src::Dma_Ip_Irq.c, category=SWSRC
          short-label=src::Dma_Ip_Multicore.c, category=SWSRC
          short-label=src::Emios_Mcl_Ip.c, category=SWSRC
          short-label=src::Emios_Mcl_Ip_Irq.c, category=SWSRC
          short-label=src::Flexio_Mcl_Ip.c, category=SWSRC
          short-label=src::Flexio_Mcl_Ip_HwAccess.c, category=SWSRC
          short-label=src::Flexio_Mcl_Ip_Irq.c, category=SWSRC
          short-label=src::Lcu_Ip.c, category=SWSRC
          short-label=src::Lcu_Ip_Hw_Access.c, category=SWSRC
          short-label=src::Lcu_Ip_Irq.c, category=SWSRC
          short-label=src::Lcu_Ip_Multicore.c, category=SWSRC
          short-label=src::Trgmux_Ip.c, category=SWSRC
          short-label=src::Trgmux_Ip_HwAcc.c, category=SWSRC
    4 x compiler:
      DIAB_Compiler:
        name=Windriver Diab
        options=-tARMCORTEXM7MG:simple -mthumb -std=c99 -Oz -g -fstandalone-debug -Wstrict-prototypes -Wsign-compare -Wdouble-promotion -Wunknown-pragmas -Wundef -Wextra -Wall -pedantic -Werror=implicit-function-declaration -fno-common -fno-signed-char -fno-trigraphs -V -c -DS32K3XX -D $ (DERIVATIVE) -DDIAB -DUSE_SW_VECTOR_MODE -DD_CACHE_ENABLE -DI_CACHE_ENABLE -DENABLE_FPU -DMCAL_ENABLE_USER_MODE_SUPPORT
        vendor=Windriver
        version=Wind River Diab Compiler v7.0.4
      GCC_Compiler:
        name=GCC Compiler
        options=-mcpu=cortex-m7 -mthumb -mlittle-endian -mfpu=fpv5-sp-d16 -mfloat-abi=hard -std=c99 -Os -ggdb3 -Wall -Wextra -pedantic -Wstrict-prototypes -Wundef -Wunused -Werror=implicit-function-declaration -Wsign-compare -Wdouble-promotion -fno-short-enums -funsigned-char -funsigned-bitfields -fno-common -fstack-usage -fdump-ipa-all -c -DS32K3XX -D $ (DERIVATIVE) -DGCC -DUSE_SW_VECTOR_MODE -DD_CACHE_ENABLE -DI_CACHE_ENABLE -DENABLE_FPU -DMCAL_ENABLE_USER_MODE_SUPPORT --sysroot=$(NEWLIB_DIR) -specs=nano.specs -specs=nosys.specs
        vendor=GCC Systems
        version=NXP GCC 10.2.0 20200723
      GHS_Compiler:
        name=Green Hills
        options=-cpu=cortexm7 -thumb -fpu=vfpv5_d16 -fsingle -C99 --ghstd=last -Osize --gnu_asm -dual_debug -G -keeptempfiles -Wimplicit-int -Wshadow -Wtrigraphs -Wundef --unsigned_chars --unsigned_fields --no_commons --no_exceptions --no_slash_comment --prototype_errors --incorrect_pragma_warnings -c -DS32K3XX -D $ (DERIVATIVE) -DGHS -DUSE_SW_VECTOR_MODE -DD_CACHE_ENABLE -DI_CACHE_ENABLE -DENABLE_FPU -DMCAL_ENABLE_USER_MODE_SUPPORT
        vendor=Green Hills
        version=Green Hills Multi 7.1.6d / Compiler 2021.1.4
      IAR_Compiler:
        name=IAR Compiler
        options=--cpu Cortex-M7 --cpu_mode thumb --endian little --fpu VFPv5-SP -e -Ohz --debug --no_clustering --no_mem_idioms --do_explicit_zero_opt_in_named_sections --require_prototypes --no_wrap_diagnostics --diag_suppress Pa050 -DS32K3XX -D $ (DERIVATIVE) -DIAR -DUSE_SW_VECTOR_MODE -DD_CACHE_ENABLE -DI_CACHE_ENABLE -DENABLE_FPU -DMCAL_ENABLE_USER_MODE_SUPPORT
        vendor=IAR Systems
        version=IAR ANSI C/C++ Compiler v.8.50.10 (safety version)
    generated-artifacts:
      37 x dependency on artifact:
        CDD_Mcl_PBcfg_h: artifact-descriptor={short-label=generate_PB::include::CDD_Mcl_PBcfg.h, category=SWHDR}, usages=EXECUTE
        Dma_Ip_PBcfg_h: artifact-descriptor={short-label=generate_PB::include::Dma_Ip_PBcfg.h, category=SWHDR}, usages=EXECUTE
        Emios_Mcl_Ip_PBcfg_h: artifact-descriptor={short-label=generate_PB::include::Emios_Mcl_Ip_PBcfg.h, category=SWHDR}, usages=EXECUTE
        Flexio_Mcl_Ip_PBcfg_h: artifact-descriptor={short-label=generate_PB::include::Flexio_Mcl_Ip_PBcfg.h, category=SWHDR}, usages=EXECUTE
        Lcu_Ip_PBcfg_h: artifact-descriptor={short-label=generate_PB::include::Lcu_Ip_PBcfg.h, category=SWHDR}, usages=EXECUTE
        Trgmux_Ip_PBcfg_h: artifact-descriptor={short-label=generate_PB::include::Trgmux_Ip_PBcfg.h, category=SWHDR}, usages=EXECUTE
        CDD_Mcl_PBcfg_c: artifact-descriptor={short-label=generate_PB::src::CDD_Mcl_PBcfg.c, category=SWSRC}, usages=EXECUTE
        Dma_Ip_PBcfg_c: artifact-descriptor={short-label=generate_PB::src::Dma_Ip_PBcfg.c, category=SWSRC}, usages=EXECUTE
        Emios_Mcl_Ip_PBcfg_c: artifact-descriptor={short-label=generate_PB::src::Emios_Mcl_Ip_PBcfg.c, category=SWSRC}, usages=EXECUTE
        Flexio_Mcl_Ip_PBcfg_c: artifact-descriptor={short-label=generate_PB::src::Flexio_Mcl_Ip_PBcfg.c, category=SWSRC}, usages=EXECUTE
        Lcu_Ip_PBcfg_c: artifact-descriptor={short-label=generate_PB::src::Lcu_Ip_PBcfg.c, category=SWSRC}, usages=EXECUTE
        Trgmux_Ip_PBcfg_c: artifact-descriptor={short-label=generate_PB::src::Trgmux_Ip_PBcfg.c, category=SWSRC}, usages=EXECUTE
        Cache_Ip_Cfg_Defines_h: artifact-descriptor={short-label=generate_PC::include::Cache_Ip_Cfg_Defines.h, category=SWHDR}, usages=COMPILE
        Cache_Ip_Cfg_DeviceRegisters_h: artifact-descriptor={short-label=generate_PC::include::Cache_Ip_Cfg_DeviceRegisters.h, category=SWHDR}, usages=COMPILE
        CDD_Mcl_Cfg_h: artifact-descriptor={short-label=generate_PC::include::CDD_Mcl_Cfg.h, category=SWHDR}, usages=COMPILE
        CDD_Mcl_Cfg_Defines_h: artifact-descriptor={short-label=generate_PC::include::CDD_Mcl_Cfg_Defines.h, category=SWHDR}, usages=COMPILE
        Dma_Ip_Cfg_h: artifact-descriptor={short-label=generate_PC::include::Dma_Ip_Cfg.h, category=SWHDR}, usages=COMPILE
        Dma_Ip_Cfg_Defines_h: artifact-descriptor={short-label=generate_PC::include::Dma_Ip_Cfg_Defines.h, category=SWHDR}, usages=COMPILE
        Dma_Ip_Cfg_DeviceRegistersV3_h: artifact-descriptor={short-label=generate_PC::include::Dma_Ip_Cfg_DeviceRegistersV3.h, category=SWHDR}, usages=COMPILE
        Dma_Ip_Cfg_Devices_h: artifact-descriptor={short-label=generate_PC::include::Dma_Ip_Cfg_Devices.h, category=SWHDR}, usages=COMPILE
        Emios_Mcl_Ip_Cfg_h: artifact-descriptor={short-label=generate_PC::include::Emios_Mcl_Ip_Cfg.h, category=SWHDR}, usages=COMPILE
        Emios_Mcl_Ip_Cfg_Defines_h: artifact-descriptor={short-label=generate_PC::include::Emios_Mcl_Ip_Cfg_Defines.h, category=SWHDR}, usages=COMPILE
        Emios_Mcl_Ip_Cfg_DeviceRegisters_h: artifact-descriptor={short-label=generate_PC::include::Emios_Mcl_Ip_Cfg_DeviceRegisters.h, category=SWHDR}, usages=COMPILE
        Flexio_Mcl_Ip_Cfg_h: artifact-descriptor={short-label=generate_PC::include::Flexio_Mcl_Ip_Cfg.h, category=SWHDR}, usages=COMPILE
        Flexio_Mcl_Ip_Cfg_Defines_h: artifact-descriptor={short-label=generate_PC::include::Flexio_Mcl_Ip_Cfg_Defines.h, category=SWHDR}, usages=COMPILE
        Flexio_Mcl_Ip_Cfg_DeviceRegisters_h: artifact-descriptor={short-label=generate_PC::include::Flexio_Mcl_Ip_Cfg_DeviceRegisters.h, category=SWHDR}, usages=COMPILE
        Lcu_Ip_Cfg_h: artifact-descriptor={short-label=generate_PC::include::Lcu_Ip_Cfg.h, category=SWHDR}, usages=COMPILE
        Lcu_Ip_Cfg_Defines_h: artifact-descriptor={short-label=generate_PC::include::Lcu_Ip_Cfg_Defines.h, category=SWHDR}, usages=COMPILE
        Lcu_Ip_Features_h: artifact-descriptor={short-label=generate_PC::include::Lcu_Ip_Features.h, category=SWHDR}, usages=COMPILE
        Lcu_Ip_Regs_h: artifact-descriptor={short-label=generate_PC::include::Lcu_Ip_Regs.h, category=SWHDR}, usages=COMPILE
        Trgmux_Ip_Cfg_h: artifact-descriptor={short-label=generate_PC::include::Trgmux_Ip_Cfg.h, category=SWHDR}, usages=COMPILE
        Trgmux_Ip_Cfg_Defines_h: artifact-descriptor={short-label=generate_PC::include::Trgmux_Ip_Cfg_Defines.h, category=SWHDR}, usages=COMPILE
        Trgmux_Ip_Cfg_DeviceRegisters_h: artifact-descriptor={short-label=generate_PC::include::Trgmux_Ip_Cfg_DeviceRegisters.h, category=SWHDR}, usages=COMPILE
        CDD_Mcl_Cfg_c: artifact-descriptor={short-label=generate_PC::src::CDD_Mcl_Cfg.c, category=SWSRC}, usages=COMPILE
        Dma_Ip_Cfg_c: artifact-descriptor={short-label=generate_PC::src::Dma_Ip_Cfg.c, category=SWSRC}, usages=COMPILE
        Lcu_Ip_Cfg_c: artifact-descriptor={short-label=generate_PC::src::Lcu_Ip_Cfg.c, category=SWSRC}, usages=COMPILE
        Trgmux_Ip_Cfg_c: artifact-descriptor={short-label=generate_PC::src::Trgmux_Ip_Cfg.c, category=SWSRC}, usages=COMPILE
    4 x linker:
      DIAB_Linker: name=Windriver Diab, options=-e Reset_Handler linker_script_file.dld -m30 -Xstack-usage -Xpreprocess-lecl -Llibrary_path -lc -lm -tARMCORTEXM7MG:simple, vendor=Windriver, version=Wind River Diab Compiler v7.0.4
      GCC_Linker: name=GCC Compiler, options=-Wl,-Map,filename -T linkerfile --entry=Reset_Handler -nostartfiles -mcpu=cortexm7 -mthumb -mfpu=fpv5-sp-d16 -mfloat-abi=hard -mlittle-endian -ggdb3 -lc -lm -lgcc -specs=nano.specs -specs=nosys.specs, vendor=GCC Systems, version=NXP GCC 10.2.0 20200723
      GHS_Linker: name=Green Hills, options=-e Reset_Handler -T linker_script_file.ld -map -keepmap -Mn -delete -ignore_debug_references -Llibrary_path -larch -lstartup -lind_sd -v -keep=C40_Ip_AccessCode -nostartfiles, vendor=Green Hills, version=Green Hills Multi 7.1.6d / Compiler 2021.1.4
      IAR_Linker: name=IAR Compiler, options=--map filename --config linkerfile --cpu=Cortex-M7 --fpu VFPv5-SP --entry _start --enable_stack_usage --skip_dynamic_initialization --no_wrap_diagnostics, vendor=IAR Systems, version=IAR ANSI C/C++ Compiler v.8.50.10 (safety version)
    resource consumption ResourceConsumption
      12 x memory section:
        MCL_CODE: alignment=UNSPECIFIED, sw-addrmethod=CODE, symbol=CODE
        MCL_CONFIG_DATA_UNSPECIFIED: alignment=UNSPECIFIED, sw-addrmethod=CONFIG_DATA, symbol=CONFIG_DATA_UNSPECIFIED
        MCL_CONST_8: alignment=8, sw-addrmethod=CONST, symbol=CONST_8
        MCL_CONST_UNSPECIFIED: alignment=UNSPECIFIED, sw-addrmethod=CONST, symbol=CONST_UNSPECIFIED
        MCL_VAR_CLEARED_16: alignment=16, sw-addrmethod=VAR_CLEARED, symbol=VAR_CLEARED_16
        MCL_VAR_CLEARED_32: alignment=32, sw-addrmethod=VAR_CLEARED, symbol=VAR_CLEARED_32
        MCL_VAR_CLEARED_8_NO_CACHEABLE: alignment=8, sw-addrmethod=VAR_CLEARED_NO_CACHEABLE, symbol=VAR_CLEARED_8_NO_CACHEABLE
        MCL_VAR_CLEARED_BOOLEAN_NO_CACHEABLE: alignment=BOOLEAN, sw-addrmethod=VAR_CLEARED_NO_CACHEABLE, symbol=VAR_CLEARED_BOOLEAN_NO_CACHEABLE
        MCL_VAR_CLEARED_UNSPECIFIED: alignment=UNSPECIFIED, sw-addrmethod=VAR_CLEARED, symbol=VAR_CLEARED_UNSPECIFIED
        MCL_VAR_CLEARED_UNSPECIFIED_NO_CACHEABLE: alignment=UNSPECIFIED, sw-addrmethod=VAR_CLEARED_NO_CACHEABLE, symbol=VAR_CLEARED_UNSPECIFIED_NO_CACHEABLE
        MCL_VAR_INIT_UNSPECIFIED: alignment=UNSPECIFIED, sw-addrmethod=VAR_INIT, symbol=VAR_INIT_UNSPECIFIED
        MCL_VAR_INIT_UNSPECIFIED_NO_CACHEABLE: alignment=UNSPECIFIED, sw-addrmethod=VAR_INIT_NO_CACHEABLE, symbol=VAR_INIT_UNSPECIFIED_NO_CACHEABLE
