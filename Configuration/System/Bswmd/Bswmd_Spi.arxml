AUTOSAR XML (schema 00047)
package /AUTOSAR_Spi/BswModuleDescriptions
  bsw module description Spi: module-id=83
    provided-entrys:
      Spi_AsyncTransmit
      Spi_Cancel
      Spi_DeInit
      Spi_GetHWUnitStatus
      Spi_GetJobResult
      Spi_GetSequenceResult
      Spi_GetStatus
      Spi_GetVersionInfo
      Spi_Init
      Spi_MainFunction_Handling
      Spi_ReadIB
      Spi_SetAsyncMode
      Spi_SetupEB
      Spi_SyncTransmit
      Spi_WriteIB
      Lpspi_Ip_LPSPI_{0..5}_IRQHandler
    bsw internal behavior InternalBehavior_Spi
      19 x exclusive area:
        SPI_EXCLUSIVE_AREA_{00..18}
      9 x bsw called entity:
        Spi_AsyncTransmit: can-enter-exclusive-area=[SPI_EXCLUSIVE_AREA_00, SPI_EXCLUSIVE_AREA_01, SPI_EXCLUSIVE_AREA_03, SPI_EXCLUSIVE_AREA_09, SPI_EXCLUSIVE_AREA_11, SPI_EXCLUSIVE_AREA_12, SPI_EXCLUSIVE_AREA_13, SPI_EXCLUSIVE_AREA_14, SPI_EXCLUSIVE_AREA_15, SPI_EXCLUSIVE_AREA_18], implemented-entry=Spi_AsyncTransmit
        Spi_Cancel: can-enter-exclusive-area=[SPI_EXCLUSIVE_AREA_02, SPI_EXCLUSIVE_AREA_10, SPI_EXCLUSIVE_AREA_16], implemented-entry=Spi_Cancel
        Spi_DeInit: implemented-entry=Spi_DeInit
        Spi_GetHWUnitStatus: implemented-entry=Spi_GetHWUnitStatus
        Spi_GetJobResult: implemented-entry=Spi_GetJobResult
        Spi_GetSequenceResult: implemented-entry=Spi_GetSequenceResult
        Spi_GetStatus: implemented-entry=Spi_GetStatus
        Spi_GetVersionInfo: implemented-entry=Spi_GetVersionInfo
        Spi_Init: implemented-entry=Spi_Init
      bsw schedulable entity Spi_MainFunction_Handling: implemented-entry=Spi_MainFunction_Handling
      5 x bsw called entity:
        Spi_ReadIB: implemented-entry=Spi_ReadIB
        Spi_SetAsyncMode: implemented-entry=Spi_SetAsyncMode
        Spi_SetupEB: can-enter-exclusive-area=SPI_EXCLUSIVE_AREA_05, implemented-entry=Spi_SetupEB
        Spi_SyncTransmit: can-enter-exclusive-area=[SPI_EXCLUSIVE_AREA_06, SPI_EXCLUSIVE_AREA_07, SPI_EXCLUSIVE_AREA_08, SPI_EXCLUSIVE_AREA_11, SPI_EXCLUSIVE_AREA_17], implemented-entry=Spi_SyncTransmit
        Spi_WriteIB: can-enter-exclusive-area=SPI_EXCLUSIVE_AREA_04, implemented-entry=Spi_WriteIB
      6 x bsw interrupt entity, all with can-enter-exclusive-area=SPI_EXCLUSIVE_AREA_02, interrupt-category=CAT-2, interrupt-source=Hardware:
        Lpspi_Ip_LPSPI_{0..5}_IRQHandler: implemented-entry=Lpspi_Ip_LPSPI_{0..5}_IRQHandler
package /AUTOSAR_Spi/BswModuleEntrys
  21 x bsw module entry, all with sw-service-impl-policy=STANDARD:
    Spi_AsyncTransmit: service-id=0x03, is-reentrant=true, is-synchronous=false, call-type=REGULAR, execution-context=UNSPECIFIED
    Spi_Cancel: service-id=0x0c, is-reentrant=true, is-synchronous=false, call-type=REGULAR, execution-context=UNSPECIFIED
    Spi_DeInit: service-id=0x01, is-reentrant=false, is-synchronous=true, call-type=REGULAR, execution-context=UNSPECIFIED
    Spi_GetHWUnitStatus: service-id=0x0b, is-reentrant=true, is-synchronous=true, call-type=REGULAR, execution-context=UNSPECIFIED
    Spi_GetJobResult: service-id=0x07, is-reentrant=true, is-synchronous=true, call-type=REGULAR, execution-context=UNSPECIFIED
    Spi_GetSequenceResult: service-id=0x08, is-reentrant=true, is-synchronous=true, call-type=REGULAR, execution-context=UNSPECIFIED
    Spi_GetStatus: service-id=0x06, is-reentrant=true, is-synchronous=true, call-type=REGULAR, execution-context=UNSPECIFIED
    Spi_GetVersionInfo: service-id=0x09, is-reentrant=true, is-synchronous=true, call-type=REGULAR, execution-context=UNSPECIFIED
    Spi_Init: service-id=0x00, is-reentrant=false, is-synchronous=true, call-type=REGULAR, execution-context=UNSPECIFIED
    Spi_MainFunction_Handling: service-id=0x10, is-reentrant=false, is-synchronous=true, call-type=SCHEDULED, execution-context=TASK
    Spi_ReadIB: service-id=0x04, is-reentrant=true, is-synchronous=true, call-type=REGULAR, execution-context=UNSPECIFIED
    Spi_SetAsyncMode: service-id=0x0d, is-reentrant=false, is-synchronous=true, call-type=REGULAR, execution-context=UNSPECIFIED
    Spi_SetupEB: service-id=0x05, is-reentrant=true, is-synchronous=true, call-type=REGULAR, execution-context=UNSPECIFIED
    Spi_SyncTransmit: service-id=0x0a, is-reentrant=true, is-synchronous=true, call-type=REGULAR, execution-context=UNSPECIFIED
    Spi_WriteIB: service-id=0x02, is-reentrant=true, is-synchronous=true, call-type=REGULAR, execution-context=UNSPECIFIED
    Lpspi_Ip_LPSPI_{0..5}_IRQHandler: service-id=0, is-reentrant=false, is-synchronous=true, call-type=INTERRUPT, execution-context=INTERRUPT-CAT-2
package /Spi_TS_T40D34M30I0R0/Implementations
  bsw implementation BswImplementation_Spi: programming-language=C, sw-version=3.0.0, vendor-id=43, ar-release-version=4.7.0, behavior=InternalBehavior_Spi, vendor-specific-module-def=Spi
    code-descriptors:
      code Files
        artifact-descriptors:
          short-label=config::Spi.xdm, category=SWCFG
          short-label=doc::RTD_SPI_IM.pdf, category=SWDOC
          short-label=doc::RTD_SPI_UM.pdf, category=SWDOC
          short-label=examples::EBT::S32K358::Spi_HalfDuplexTransfer_S32K358::generate::epc::BaseNXP.xdm, category=SWCFG
          short-label=examples::EBT::S32K358::Spi_HalfDuplexTransfer_S32K358::generate::epc::Dem.xdm, category=SWCFG
          short-label=examples::EBT::S32K358::Spi_HalfDuplexTransfer_S32K358::generate::epc::EcuC.xdm, category=SWCFG
          short-label=examples::EBT::S32K358::Spi_HalfDuplexTransfer_S32K358::generate::epc::Mcu.xdm, category=SWCFG
          short-label=examples::EBT::S32K358::Spi_HalfDuplexTransfer_S32K358::generate::epc::Platform.xdm, category=SWCFG
          short-label=examples::EBT::S32K358::Spi_HalfDuplexTransfer_S32K358::generate::epc::Port.xdm, category=SWCFG
          short-label=examples::EBT::S32K358::Spi_HalfDuplexTransfer_S32K358::generate::epc::Resource.xdm, category=SWCFG
          short-label=examples::EBT::S32K358::Spi_HalfDuplexTransfer_S32K358::generate::epc::Spi.xdm, category=SWCFG
          short-label=examples::EBT::S32K358::Spi_HalfDuplexTransfer_S32K358::include::check_example.h, category=SWHDR
          short-label=examples::EBT::S32K358::Spi_HalfDuplexTransfer_S32K358::src::main.c, category=SWSRC
          short-label=examples::EBT::S32K358::Spi_HalfDuplexTransfer_S32K358::TresosProject::Spi_HalfDuplexTransfer_S32K358::.prefs::preferences.xdm, category=SWCFG
          short-label=examples::EBT::S32K358::Spi_HalfDuplexTransfer_S32K358::TresosProject::Spi_HalfDuplexTransfer_S32K358::config::BaseNXP.xdm, category=SWCFG
          short-label=examples::EBT::S32K358::Spi_HalfDuplexTransfer_S32K358::TresosProject::Spi_HalfDuplexTransfer_S32K358::config::Dem.xdm, category=SWCFG
          short-label=examples::EBT::S32K358::Spi_HalfDuplexTransfer_S32K358::TresosProject::Spi_HalfDuplexTransfer_S32K358::config::EcuC.xdm, category=SWCFG
          short-label=examples::EBT::S32K358::Spi_HalfDuplexTransfer_S32K358::TresosProject::Spi_HalfDuplexTransfer_S32K358::config::Mcu.xdm, category=SWCFG
          short-label=examples::EBT::S32K358::Spi_HalfDuplexTransfer_S32K358::TresosProject::Spi_HalfDuplexTransfer_S32K358::config::Platform.xdm, category=SWCFG
          short-label=examples::EBT::S32K358::Spi_HalfDuplexTransfer_S32K358::TresosProject::Spi_HalfDuplexTransfer_S32K358::config::Port.xdm, category=SWCFG
          short-label=examples::EBT::S32K358::Spi_HalfDuplexTransfer_S32K358::TresosProject::Spi_HalfDuplexTransfer_S32K358::config::Resource.xdm, category=SWCFG
          short-label=examples::EBT::S32K358::Spi_HalfDuplexTransfer_S32K358::TresosProject::Spi_HalfDuplexTransfer_S32K358::config::Spi.xdm, category=SWCFG
          short-label=examples::EBT::S32K358::Spi_Transfer_S32K358::generate::epc::BaseNXP.xdm, category=SWCFG
          short-label=examples::EBT::S32K358::Spi_Transfer_S32K358::generate::epc::Dem.xdm, category=SWCFG
          short-label=examples::EBT::S32K358::Spi_Transfer_S32K358::generate::epc::EcuC.xdm, category=SWCFG
          short-label=examples::EBT::S32K358::Spi_Transfer_S32K358::generate::epc::Mcl.xdm, category=SWCFG
          short-label=examples::EBT::S32K358::Spi_Transfer_S32K358::generate::epc::Mcu.xdm, category=SWCFG
          short-label=examples::EBT::S32K358::Spi_Transfer_S32K358::generate::epc::Platform.xdm, category=SWCFG
          short-label=examples::EBT::S32K358::Spi_Transfer_S32K358::generate::epc::Port.xdm, category=SWCFG
          short-label=examples::EBT::S32K358::Spi_Transfer_S32K358::generate::epc::Resource.xdm, category=SWCFG
          short-label=examples::EBT::S32K358::Spi_Transfer_S32K358::generate::epc::Rm.xdm, category=SWCFG
          short-label=examples::EBT::S32K358::Spi_Transfer_S32K358::generate::epc::Spi.xdm, category=SWCFG
          short-label=examples::EBT::S32K358::Spi_Transfer_S32K358::include::check_example.h, category=SWHDR
          short-label=examples::EBT::S32K358::Spi_Transfer_S32K358::src::main.c, category=SWSRC
          short-label=examples::EBT::S32K358::Spi_Transfer_S32K358::TresosProject::Spi_Transfer_S32K358::.prefs::preferences.xdm, category=SWCFG
          short-label=examples::EBT::S32K358::Spi_Transfer_S32K358::TresosProject::Spi_Transfer_S32K358::config::BaseNXP.xdm, category=SWCFG
          short-label=examples::EBT::S32K358::Spi_Transfer_S32K358::TresosProject::Spi_Transfer_S32K358::config::Dem.xdm, category=SWCFG
          short-label=examples::EBT::S32K358::Spi_Transfer_S32K358::TresosProject::Spi_Transfer_S32K358::config::EcuC.xdm, category=SWCFG
          short-label=examples::EBT::S32K358::Spi_Transfer_S32K358::TresosProject::Spi_Transfer_S32K358::config::Mcl.xdm, category=SWCFG
          short-label=examples::EBT::S32K358::Spi_Transfer_S32K358::TresosProject::Spi_Transfer_S32K358::config::Mcu.xdm, category=SWCFG
          short-label=examples::EBT::S32K358::Spi_Transfer_S32K358::TresosProject::Spi_Transfer_S32K358::config::Platform.xdm, category=SWCFG
          short-label=examples::EBT::S32K358::Spi_Transfer_S32K358::TresosProject::Spi_Transfer_S32K358::config::Port.xdm, category=SWCFG
          short-label=examples::EBT::S32K358::Spi_Transfer_S32K358::TresosProject::Spi_Transfer_S32K358::config::Resource.xdm, category=SWCFG
          short-label=examples::EBT::S32K358::Spi_Transfer_S32K358::TresosProject::Spi_Transfer_S32K358::config::Rm.xdm, category=SWCFG
          short-label=examples::EBT::S32K358::Spi_Transfer_S32K358::TresosProject::Spi_Transfer_S32K358::config::Spi.xdm, category=SWCFG
          short-label=examples::EBT::S32K396::Spi_HalfDuplexTransfer_S32K396::generate::epc::BaseNXP.xdm, category=SWCFG
          short-label=examples::EBT::S32K396::Spi_HalfDuplexTransfer_S32K396::generate::epc::Dem.xdm, category=SWCFG
          short-label=examples::EBT::S32K396::Spi_HalfDuplexTransfer_S32K396::generate::epc::EcuC.xdm, category=SWCFG
          short-label=examples::EBT::S32K396::Spi_HalfDuplexTransfer_S32K396::generate::epc::Mcu.xdm, category=SWCFG
          short-label=examples::EBT::S32K396::Spi_HalfDuplexTransfer_S32K396::generate::epc::Platform.xdm, category=SWCFG
          short-label=examples::EBT::S32K396::Spi_HalfDuplexTransfer_S32K396::generate::epc::Port.xdm, category=SWCFG
          short-label=examples::EBT::S32K396::Spi_HalfDuplexTransfer_S32K396::generate::epc::Resource.xdm, category=SWCFG
          short-label=examples::EBT::S32K396::Spi_HalfDuplexTransfer_S32K396::generate::epc::Spi.xdm, category=SWCFG
          short-label=examples::EBT::S32K396::Spi_HalfDuplexTransfer_S32K396::include::check_example.h, category=SWHDR
          short-label=examples::EBT::S32K396::Spi_HalfDuplexTransfer_S32K396::src::main.c, category=SWSRC
          short-label=examples::EBT::S32K396::Spi_HalfDuplexTransfer_S32K396::TresosProject::Spi_HalfDuplexTransfer_S32K396::.prefs::preferences.xdm, category=SWCFG
          short-label=examples::EBT::S32K396::Spi_HalfDuplexTransfer_S32K396::TresosProject::Spi_HalfDuplexTransfer_S32K396::config::BaseNXP.xdm, category=SWCFG
          short-label=examples::EBT::S32K396::Spi_HalfDuplexTransfer_S32K396::TresosProject::Spi_HalfDuplexTransfer_S32K396::config::Dem.xdm, category=SWCFG
          short-label=examples::EBT::S32K396::Spi_HalfDuplexTransfer_S32K396::TresosProject::Spi_HalfDuplexTransfer_S32K396::config::EcuC.xdm, category=SWCFG
          short-label=examples::EBT::S32K396::Spi_HalfDuplexTransfer_S32K396::TresosProject::Spi_HalfDuplexTransfer_S32K396::config::Mcu.xdm, category=SWCFG
          short-label=examples::EBT::S32K396::Spi_HalfDuplexTransfer_S32K396::TresosProject::Spi_HalfDuplexTransfer_S32K396::config::Platform.xdm, category=SWCFG
          short-label=examples::EBT::S32K396::Spi_HalfDuplexTransfer_S32K396::TresosProject::Spi_HalfDuplexTransfer_S32K396::config::Port.xdm, category=SWCFG
          short-label=examples::EBT::S32K396::Spi_HalfDuplexTransfer_S32K396::TresosProject::Spi_HalfDuplexTransfer_S32K396::config::Resource.xdm, category=SWCFG
          short-label=examples::EBT::S32K396::Spi_HalfDuplexTransfer_S32K396::TresosProject::Spi_HalfDuplexTransfer_S32K396::config::Spi.xdm, category=SWCFG
          short-label=examples::EBT::S32K396::Spi_Transfer_S32K396::generate::epc::BaseNXP.xdm, category=SWCFG
          short-label=examples::EBT::S32K396::Spi_Transfer_S32K396::generate::epc::Dem.xdm, category=SWCFG
          short-label=examples::EBT::S32K396::Spi_Transfer_S32K396::generate::epc::EcuC.xdm, category=SWCFG
          short-label=examples::EBT::S32K396::Spi_Transfer_S32K396::generate::epc::Mcl.xdm, category=SWCFG
          short-label=examples::EBT::S32K396::Spi_Transfer_S32K396::generate::epc::Mcu.xdm, category=SWCFG
          short-label=examples::EBT::S32K396::Spi_Transfer_S32K396::generate::epc::Platform.xdm, category=SWCFG
          short-label=examples::EBT::S32K396::Spi_Transfer_S32K396::generate::epc::Port.xdm, category=SWCFG
          short-label=examples::EBT::S32K396::Spi_Transfer_S32K396::generate::epc::Resource.xdm, category=SWCFG
          short-label=examples::EBT::S32K396::Spi_Transfer_S32K396::generate::epc::Rm.xdm, category=SWCFG
          short-label=examples::EBT::S32K396::Spi_Transfer_S32K396::generate::epc::Spi.xdm, category=SWCFG
          short-label=examples::EBT::S32K396::Spi_Transfer_S32K396::include::check_example.h, category=SWHDR
          short-label=examples::EBT::S32K396::Spi_Transfer_S32K396::src::main.c, category=SWSRC
          short-label=examples::EBT::S32K396::Spi_Transfer_S32K396::TresosProject::Spi_Transfer_S32K396::.prefs::preferences.xdm, category=SWCFG
          short-label=examples::EBT::S32K396::Spi_Transfer_S32K396::TresosProject::Spi_Transfer_S32K396::config::BaseNXP.xdm, category=SWCFG
          short-label=examples::EBT::S32K396::Spi_Transfer_S32K396::TresosProject::Spi_Transfer_S32K396::config::Dem.xdm, category=SWCFG
          short-label=examples::EBT::S32K396::Spi_Transfer_S32K396::TresosProject::Spi_Transfer_S32K396::config::EcuC.xdm, category=SWCFG
          short-label=examples::EBT::S32K396::Spi_Transfer_S32K396::TresosProject::Spi_Transfer_S32K396::config::Mcl.xdm, category=SWCFG
          short-label=examples::EBT::S32K396::Spi_Transfer_S32K396::TresosProject::Spi_Transfer_S32K396::config::Mcu.xdm, category=SWCFG
          short-label=examples::EBT::S32K396::Spi_Transfer_S32K396::TresosProject::Spi_Transfer_S32K396::config::Platform.xdm, category=SWCFG
          short-label=examples::EBT::S32K396::Spi_Transfer_S32K396::TresosProject::Spi_Transfer_S32K396::config::Port.xdm, category=SWCFG
          short-label=examples::EBT::S32K396::Spi_Transfer_S32K396::TresosProject::Spi_Transfer_S32K396::config::Resource.xdm, category=SWCFG
          short-label=examples::EBT::S32K396::Spi_Transfer_S32K396::TresosProject::Spi_Transfer_S32K396::config::Rm.xdm, category=SWCFG
          short-label=examples::EBT::S32K396::Spi_Transfer_S32K396::TresosProject::Spi_Transfer_S32K396::config::Spi.xdm, category=SWCFG
          short-label=examples::EBT::S32K3XX::Spi_HalfDuplexTransfer_S32K344::generate::epc::BaseNXP.xdm, category=SWCFG
          short-label=examples::EBT::S32K3XX::Spi_HalfDuplexTransfer_S32K344::generate::epc::Dem.xdm, category=SWCFG
          short-label=examples::EBT::S32K3XX::Spi_HalfDuplexTransfer_S32K344::generate::epc::EcuC.xdm, category=SWCFG
          short-label=examples::EBT::S32K3XX::Spi_HalfDuplexTransfer_S32K344::generate::epc::Mcu.xdm, category=SWCFG
          short-label=examples::EBT::S32K3XX::Spi_HalfDuplexTransfer_S32K344::generate::epc::Platform.xdm, category=SWCFG
          short-label=examples::EBT::S32K3XX::Spi_HalfDuplexTransfer_S32K344::generate::epc::Port.xdm, category=SWCFG
          short-label=examples::EBT::S32K3XX::Spi_HalfDuplexTransfer_S32K344::generate::epc::Resource.xdm, category=SWCFG
          short-label=examples::EBT::S32K3XX::Spi_HalfDuplexTransfer_S32K344::generate::epc::Spi.xdm, category=SWCFG
          short-label=examples::EBT::S32K3XX::Spi_HalfDuplexTransfer_S32K344::include::check_example.h, category=SWHDR
          short-label=examples::EBT::S32K3XX::Spi_HalfDuplexTransfer_S32K344::src::main.c, category=SWSRC
          short-label=examples::EBT::S32K3XX::Spi_HalfDuplexTransfer_S32K344::TresosProject::Spi_HalfDuplexTransfer_S32K344::.prefs::preferences.xdm, category=SWCFG
          short-label=examples::EBT::S32K3XX::Spi_HalfDuplexTransfer_S32K344::TresosProject::Spi_HalfDuplexTransfer_S32K344::config::BaseNXP.xdm, category=SWCFG
          short-label=examples::EBT::S32K3XX::Spi_HalfDuplexTransfer_S32K344::TresosProject::Spi_HalfDuplexTransfer_S32K344::config::Dem.xdm, category=SWCFG
          short-label=examples::EBT::S32K3XX::Spi_HalfDuplexTransfer_S32K344::TresosProject::Spi_HalfDuplexTransfer_S32K344::config::EcuC.xdm, category=SWCFG
          short-label=examples::EBT::S32K3XX::Spi_HalfDuplexTransfer_S32K344::TresosProject::Spi_HalfDuplexTransfer_S32K344::config::Mcu.xdm, category=SWCFG
          short-label=examples::EBT::S32K3XX::Spi_HalfDuplexTransfer_S32K344::TresosProject::Spi_HalfDuplexTransfer_S32K344::config::Platform.xdm, category=SWCFG
          short-label=examples::EBT::S32K3XX::Spi_HalfDuplexTransfer_S32K344::TresosProject::Spi_HalfDuplexTransfer_S32K344::config::Port.xdm, category=SWCFG
          short-label=examples::EBT::S32K3XX::Spi_HalfDuplexTransfer_S32K344::TresosProject::Spi_HalfDuplexTransfer_S32K344::config::Resource.xdm, category=SWCFG
          short-label=examples::EBT::S32K3XX::Spi_HalfDuplexTransfer_S32K344::TresosProject::Spi_HalfDuplexTransfer_S32K344::config::Spi.xdm, category=SWCFG
          short-label=examples::EBT::S32K3XX::Spi_Transfer_S32K344::generate::epc::BaseNXP.xdm, category=SWCFG
          short-label=examples::EBT::S32K3XX::Spi_Transfer_S32K344::generate::epc::Dem.xdm, category=SWCFG
          short-label=examples::EBT::S32K3XX::Spi_Transfer_S32K344::generate::epc::EcuC.xdm, category=SWCFG
          short-label=examples::EBT::S32K3XX::Spi_Transfer_S32K344::generate::epc::Mcl.xdm, category=SWCFG
          short-label=examples::EBT::S32K3XX::Spi_Transfer_S32K344::generate::epc::Mcu.xdm, category=SWCFG
          short-label=examples::EBT::S32K3XX::Spi_Transfer_S32K344::generate::epc::Platform.xdm, category=SWCFG
          short-label=examples::EBT::S32K3XX::Spi_Transfer_S32K344::generate::epc::Port.xdm, category=SWCFG
          short-label=examples::EBT::S32K3XX::Spi_Transfer_S32K344::generate::epc::Resource.xdm, category=SWCFG
          short-label=examples::EBT::S32K3XX::Spi_Transfer_S32K344::generate::epc::Rm.xdm, category=SWCFG
          short-label=examples::EBT::S32K3XX::Spi_Transfer_S32K344::generate::epc::Spi.xdm, category=SWCFG
          short-label=examples::EBT::S32K3XX::Spi_Transfer_S32K344::include::check_example.h, category=SWHDR
          short-label=examples::EBT::S32K3XX::Spi_Transfer_S32K344::src::main.c, category=SWSRC
          short-label=examples::EBT::S32K3XX::Spi_Transfer_S32K344::TresosProject::Spi_Transfer_S32K344::.prefs::preferences.xdm, category=SWCFG
          short-label=examples::EBT::S32K3XX::Spi_Transfer_S32K344::TresosProject::Spi_Transfer_S32K344::config::BaseNXP.xdm, category=SWCFG
          short-label=examples::EBT::S32K3XX::Spi_Transfer_S32K344::TresosProject::Spi_Transfer_S32K344::config::Dem.xdm, category=SWCFG
          short-label=examples::EBT::S32K3XX::Spi_Transfer_S32K344::TresosProject::Spi_Transfer_S32K344::config::EcuC.xdm, category=SWCFG
          short-label=examples::EBT::S32K3XX::Spi_Transfer_S32K344::TresosProject::Spi_Transfer_S32K344::config::Mcl.xdm, category=SWCFG
          short-label=examples::EBT::S32K3XX::Spi_Transfer_S32K344::TresosProject::Spi_Transfer_S32K344::config::Mcu.xdm, category=SWCFG
          short-label=examples::EBT::S32K3XX::Spi_Transfer_S32K344::TresosProject::Spi_Transfer_S32K344::config::Platform.xdm, category=SWCFG
          short-label=examples::EBT::S32K3XX::Spi_Transfer_S32K344::TresosProject::Spi_Transfer_S32K344::config::Port.xdm, category=SWCFG
          short-label=examples::EBT::S32K3XX::Spi_Transfer_S32K344::TresosProject::Spi_Transfer_S32K344::config::Resource.xdm, category=SWCFG
          short-label=examples::EBT::S32K3XX::Spi_Transfer_S32K344::TresosProject::Spi_Transfer_S32K344::config::Rm.xdm, category=SWCFG
          short-label=examples::EBT::S32K3XX::Spi_Transfer_S32K344::TresosProject::Spi_Transfer_S32K344::config::Spi.xdm, category=SWCFG
          short-label=examples::S32DS::S32K358::Lpspi_Flexio_Ip_Transfer_S32K358::include::check_example.h, category=SWHDR
          short-label=examples::S32DS::S32K358::Lpspi_Flexio_Ip_Transfer_S32K358::Project_Settings::Startup_Code::exceptions.c, category=SWSRC
          short-label=examples::S32DS::S32K358::Lpspi_Flexio_Ip_Transfer_S32K358::Project_Settings::Startup_Code::nvic.c, category=SWSRC
          short-label=examples::S32DS::S32K358::Lpspi_Flexio_Ip_Transfer_S32K358::Project_Settings::Startup_Code::startup.c, category=SWSRC
          short-label=examples::S32DS::S32K358::Lpspi_Flexio_Ip_Transfer_S32K358::Project_Settings::Startup_Code::system.c, category=SWSRC
          short-label=examples::S32DS::S32K358::Lpspi_Flexio_Ip_Transfer_S32K358::src::main.c, category=SWSRC
          short-label=examples::S32DS::S32K358::Lpspi_Ip_HalfDuplexTransfer_S32K358::include::check_example.h, category=SWHDR
          short-label=examples::S32DS::S32K358::Lpspi_Ip_HalfDuplexTransfer_S32K358::Project_Settings::Startup_Code::exceptions.c, category=SWSRC
          short-label=examples::S32DS::S32K358::Lpspi_Ip_HalfDuplexTransfer_S32K358::Project_Settings::Startup_Code::nvic.c, category=SWSRC
          short-label=examples::S32DS::S32K358::Lpspi_Ip_HalfDuplexTransfer_S32K358::Project_Settings::Startup_Code::startup.c, category=SWSRC
          short-label=examples::S32DS::S32K358::Lpspi_Ip_HalfDuplexTransfer_S32K358::Project_Settings::Startup_Code::system.c, category=SWSRC
          short-label=examples::S32DS::S32K358::Lpspi_Ip_HalfDuplexTransfer_S32K358::src::main.c, category=SWSRC
          short-label=examples::S32DS::S32K358::Spi_HalfDuplexTransfer_S32K358::include::check_example.h, category=SWHDR
          short-label=examples::S32DS::S32K358::Spi_HalfDuplexTransfer_S32K358::Project_Settings::Startup_Code::exceptions.c, category=SWSRC
          short-label=examples::S32DS::S32K358::Spi_HalfDuplexTransfer_S32K358::Project_Settings::Startup_Code::nvic.c, category=SWSRC
          short-label=examples::S32DS::S32K358::Spi_HalfDuplexTransfer_S32K358::Project_Settings::Startup_Code::startup.c, category=SWSRC
          short-label=examples::S32DS::S32K358::Spi_HalfDuplexTransfer_S32K358::Project_Settings::Startup_Code::system.c, category=SWSRC
          short-label=examples::S32DS::S32K358::Spi_HalfDuplexTransfer_S32K358::src::main.c, category=SWSRC
          short-label=examples::S32DS::S32K358::Spi_Transfer_S32K358::include::check_example.h, category=SWHDR
          short-label=examples::S32DS::S32K358::Spi_Transfer_S32K358::Project_Settings::Startup_Code::exceptions.c, category=SWSRC
          short-label=examples::S32DS::S32K358::Spi_Transfer_S32K358::Project_Settings::Startup_Code::nvic.c, category=SWSRC
          short-label=examples::S32DS::S32K358::Spi_Transfer_S32K358::Project_Settings::Startup_Code::startup.c, category=SWSRC
          short-label=examples::S32DS::S32K358::Spi_Transfer_S32K358::Project_Settings::Startup_Code::system.c, category=SWSRC
          short-label=examples::S32DS::S32K358::Spi_Transfer_S32K358::src::main.c, category=SWSRC
          short-label=examples::S32DS::S32K396::Lpspi_Flexio_Ip_Transfer_S32K396::include::check_example.h, category=SWHDR
          short-label=examples::S32DS::S32K396::Lpspi_Flexio_Ip_Transfer_S32K396::Project_Settings::Startup_Code::exceptions.c, category=SWSRC
          short-label=examples::S32DS::S32K396::Lpspi_Flexio_Ip_Transfer_S32K396::Project_Settings::Startup_Code::nvic.c, category=SWSRC
          short-label=examples::S32DS::S32K396::Lpspi_Flexio_Ip_Transfer_S32K396::Project_Settings::Startup_Code::startup.c, category=SWSRC
          short-label=examples::S32DS::S32K396::Lpspi_Flexio_Ip_Transfer_S32K396::Project_Settings::Startup_Code::system.c, category=SWSRC
          short-label=examples::S32DS::S32K396::Lpspi_Flexio_Ip_Transfer_S32K396::src::main.c, category=SWSRC
          short-label=examples::S32DS::S32K396::Lpspi_Ip_HalfDuplexTransfer_S32K396::include::check_example.h, category=SWHDR
          short-label=examples::S32DS::S32K396::Lpspi_Ip_HalfDuplexTransfer_S32K396::Project_Settings::Startup_Code::exceptions.c, category=SWSRC
          short-label=examples::S32DS::S32K396::Lpspi_Ip_HalfDuplexTransfer_S32K396::Project_Settings::Startup_Code::nvic.c, category=SWSRC
          short-label=examples::S32DS::S32K396::Lpspi_Ip_HalfDuplexTransfer_S32K396::Project_Settings::Startup_Code::startup.c, category=SWSRC
          short-label=examples::S32DS::S32K396::Lpspi_Ip_HalfDuplexTransfer_S32K396::Project_Settings::Startup_Code::system.c, category=SWSRC
          short-label=examples::S32DS::S32K396::Lpspi_Ip_HalfDuplexTransfer_S32K396::src::main.c, category=SWSRC
          short-label=examples::S32DS::S32K396::Spi_HalfDuplexTransfer_S32K396::include::check_example.h, category=SWHDR
          short-label=examples::S32DS::S32K396::Spi_HalfDuplexTransfer_S32K396::Project_Settings::Startup_Code::exceptions.c, category=SWSRC
          short-label=examples::S32DS::S32K396::Spi_HalfDuplexTransfer_S32K396::Project_Settings::Startup_Code::nvic.c, category=SWSRC
          short-label=examples::S32DS::S32K396::Spi_HalfDuplexTransfer_S32K396::Project_Settings::Startup_Code::startup.c, category=SWSRC
          short-label=examples::S32DS::S32K396::Spi_HalfDuplexTransfer_S32K396::Project_Settings::Startup_Code::system.c, category=SWSRC
          short-label=examples::S32DS::S32K396::Spi_HalfDuplexTransfer_S32K396::src::main.c, category=SWSRC
          short-label=examples::S32DS::S32K396::Spi_Transfer_S32K396::include::check_example.h, category=SWHDR
          short-label=examples::S32DS::S32K396::Spi_Transfer_S32K396::Project_Settings::Startup_Code::exceptions.c, category=SWSRC
          short-label=examples::S32DS::S32K396::Spi_Transfer_S32K396::Project_Settings::Startup_Code::nvic.c, category=SWSRC
          short-label=examples::S32DS::S32K396::Spi_Transfer_S32K396::Project_Settings::Startup_Code::startup.c, category=SWSRC
          short-label=examples::S32DS::S32K396::Spi_Transfer_S32K396::Project_Settings::Startup_Code::system.c, category=SWSRC
          short-label=examples::S32DS::S32K396::Spi_Transfer_S32K396::src::main.c, category=SWSRC
          short-label=examples::S32DS::S32K3XX::Lpspi_Flexio_Ip_Transfer_S32K344::include::check_example.h, category=SWHDR
          short-label=examples::S32DS::S32K3XX::Lpspi_Flexio_Ip_Transfer_S32K344::Project_Settings::Startup_Code::exceptions.c, category=SWSRC
          short-label=examples::S32DS::S32K3XX::Lpspi_Flexio_Ip_Transfer_S32K344::Project_Settings::Startup_Code::nvic.c, category=SWSRC
          short-label=examples::S32DS::S32K3XX::Lpspi_Flexio_Ip_Transfer_S32K344::Project_Settings::Startup_Code::startup.c, category=SWSRC
          short-label=examples::S32DS::S32K3XX::Lpspi_Flexio_Ip_Transfer_S32K344::Project_Settings::Startup_Code::system.c, category=SWSRC
          short-label=examples::S32DS::S32K3XX::Lpspi_Flexio_Ip_Transfer_S32K344::src::main.c, category=SWSRC
          short-label=examples::S32DS::S32K3XX::Lpspi_Ip_HalfDuplexTransfer_S32K344::include::check_example.h, category=SWHDR
          short-label=examples::S32DS::S32K3XX::Lpspi_Ip_HalfDuplexTransfer_S32K344::Project_Settings::Startup_Code::exceptions.c, category=SWSRC
          short-label=examples::S32DS::S32K3XX::Lpspi_Ip_HalfDuplexTransfer_S32K344::Project_Settings::Startup_Code::nvic.c, category=SWSRC
          short-label=examples::S32DS::S32K3XX::Lpspi_Ip_HalfDuplexTransfer_S32K344::Project_Settings::Startup_Code::startup.c, category=SWSRC
          short-label=examples::S32DS::S32K3XX::Lpspi_Ip_HalfDuplexTransfer_S32K344::Project_Settings::Startup_Code::system.c, category=SWSRC
          short-label=examples::S32DS::S32K3XX::Lpspi_Ip_HalfDuplexTransfer_S32K344::src::main.c, category=SWSRC
          short-label=examples::S32DS::S32K3XX::Spi_HalfDuplexTransfer_S32K344::include::check_example.h, category=SWHDR
          short-label=examples::S32DS::S32K3XX::Spi_HalfDuplexTransfer_S32K344::Project_Settings::Startup_Code::exceptions.c, category=SWSRC
          short-label=examples::S32DS::S32K3XX::Spi_HalfDuplexTransfer_S32K344::Project_Settings::Startup_Code::nvic.c, category=SWSRC
          short-label=examples::S32DS::S32K3XX::Spi_HalfDuplexTransfer_S32K344::Project_Settings::Startup_Code::startup.c, category=SWSRC
          short-label=examples::S32DS::S32K3XX::Spi_HalfDuplexTransfer_S32K344::Project_Settings::Startup_Code::system.c, category=SWSRC
          short-label=examples::S32DS::S32K3XX::Spi_HalfDuplexTransfer_S32K344::src::main.c, category=SWSRC
          short-label=examples::S32DS::S32K3XX::Spi_Transfer_S32K344::include::check_example.h, category=SWHDR
          short-label=examples::S32DS::S32K3XX::Spi_Transfer_S32K344::Project_Settings::Startup_Code::exceptions.c, category=SWSRC
          short-label=examples::S32DS::S32K3XX::Spi_Transfer_S32K344::Project_Settings::Startup_Code::nvic.c, category=SWSRC
          short-label=examples::S32DS::S32K3XX::Spi_Transfer_S32K344::Project_Settings::Startup_Code::startup.c, category=SWSRC
          short-label=examples::S32DS::S32K3XX::Spi_Transfer_S32K344::Project_Settings::Startup_Code::system.c, category=SWSRC
          short-label=examples::S32DS::S32K3XX::Spi_Transfer_S32K344::src::main.c, category=SWSRC
          short-label=include::Flexio_Spi_Ip.h, category=SWHDR
          short-label=include::Flexio_Spi_Ip_Irq.h, category=SWHDR
          short-label=include::Flexio_Spi_Ip_TrustedFunctions.h, category=SWHDR
          short-label=include::Flexio_Spi_Ip_Types.h, category=SWHDR
          short-label=include::Lpspi_Ip.h, category=SWHDR
          short-label=include::Lpspi_Ip_TrustedFunctions.h, category=SWHDR
          short-label=include::Lpspi_Ip_Types.h, category=SWHDR
          short-label=include::Spi.h, category=SWHDR
          short-label=include::Spi_Ipw.h, category=SWHDR
          short-label=include::Spi_Ipw_Types.h, category=SWHDR
          short-label=src::Flexio_Spi_Ip.c, category=SWSRC
          short-label=src::Flexio_Spi_Ip_Irq.c, category=SWSRC
          short-label=src::Lpspi_Ip.c, category=SWSRC
          short-label=src::Lpspi_Ip_Irq.c, category=SWSRC
          short-label=src::Spi.c, category=SWSRC
          short-label=src::Spi_Ipw.c, category=SWSRC
    4 x compiler:
      DIAB_Compiler:
        name=Windriver Diab
        options=-tARMCORTEXM7MG:simple -mthumb -std=c99 -Oz -g -fstandalone-debug -Wstrict-prototypes -Wsign-compare -Wdouble-promotion -Wunknown-pragmas -Wundef -Wextra -Wall -pedantic -Werror=implicit-function-declaration -fno-common -fno-signed-char -fno-trigraphs -V -c -DS32K3XX -D $ (DERIVATIVE) -DDIAB -DUSE_SW_VECTOR_MODE -DD_CACHE_ENABLE -DI_CACHE_ENABLE -DENABLE_FPU -DMCAL_ENABLE_USER_MODE_SUPPORT
        vendor=Windriver
        version=Wind River Diab Compiler v7.0.4
      GCC_Compiler:
        name=GCC Compiler
        options=-mcpu=cortex-m7 -mthumb -mlittle-endian -mfpu=fpv5-sp-d16 -mfloat-abi=hard -std=c99 -Os -ggdb3 -Wall -Wextra -pedantic -Wstrict-prototypes -Wundef -Wunused -Werror=implicit-function-declaration -Wsign-compare -Wdouble-promotion -fno-short-enums -funsigned-char -funsigned-bitfields -fno-common -fstack-usage -fdump-ipa-all -c -DS32K3XX -D $ (DERIVATIVE) -DGCC -DUSE_SW_VECTOR_MODE -DD_CACHE_ENABLE -DI_CACHE_ENABLE -DENABLE_FPU -DMCAL_ENABLE_USER_MODE_SUPPORT --sysroot=$(NEWLIB_DIR) -specs=nano.specs -specs=nosys.specs
        vendor=GCC Systems
        version=NXP GCC 10.2.0 20200723
      GHS_Compiler:
        name=Green Hills
        options=-cpu=cortexm7 -thumb -fpu=vfpv5_d16 -fsingle -C99 --ghstd=last -Osize --gnu_asm -dual_debug -G -keeptempfiles -Wimplicit-int -Wshadow -Wtrigraphs -Wundef --unsigned_chars --unsigned_fields --no_commons --no_exceptions --no_slash_comment --prototype_errors --incorrect_pragma_warnings -c -DS32K3XX -D $ (DERIVATIVE) -DGHS -DUSE_SW_VECTOR_MODE -DD_CACHE_ENABLE -DI_CACHE_ENABLE -DENABLE_FPU -DMCAL_ENABLE_USER_MODE_SUPPORT
        vendor=Green Hills
        version=Green Hills Multi 7.1.6d / Compiler 2021.1.4
      IAR_Compiler:
        name=IAR Compiler
        options=--cpu Cortex-M7 --cpu_mode thumb --endian little --fpu VFPv5-SP -e -Ohz --debug --no_clustering --no_mem_idioms --do_explicit_zero_opt_in_named_sections --require_prototypes --no_wrap_diagnostics --diag_suppress Pa050 -DS32K3XX -D $ (DERIVATIVE) -DIAR -DUSE_SW_VECTOR_MODE -DD_CACHE_ENABLE -DI_CACHE_ENABLE -DENABLE_FPU -DMCAL_ENABLE_USER_MODE_SUPPORT
        vendor=IAR Systems
        version=IAR ANSI C/C++ Compiler v.8.50.10 (safety version)
    generated-artifacts:
      13 x dependency on artifact:
        Flexio_Spi_Ip_PBcfg_h: artifact-descriptor={short-label=generate_PB::include::Flexio_Spi_Ip_PBcfg.h, category=SWHDR}, usages=EXECUTE
        Lpspi_Ip_PBcfg_h: artifact-descriptor={short-label=generate_PB::include::Lpspi_Ip_PBcfg.h, category=SWHDR}, usages=EXECUTE
        Spi_Ipw_PBcfg_h: artifact-descriptor={short-label=generate_PB::include::Spi_Ipw_PBcfg.h, category=SWHDR}, usages=EXECUTE
        Spi_PBcfg_h: artifact-descriptor={short-label=generate_PB::include::Spi_PBcfg.h, category=SWHDR}, usages=EXECUTE
        Flexio_Spi_Ip_PBcfg_c: artifact-descriptor={short-label=generate_PB::src::Flexio_Spi_Ip_PBcfg.c, category=SWSRC}, usages=EXECUTE
        Lpspi_Ip_PBcfg_c: artifact-descriptor={short-label=generate_PB::src::Lpspi_Ip_PBcfg.c, category=SWSRC}, usages=EXECUTE
        Spi_Ipw_PBcfg_c: artifact-descriptor={short-label=generate_PB::src::Spi_Ipw_PBcfg.c, category=SWSRC}, usages=EXECUTE
        Spi_PBcfg_c: artifact-descriptor={short-label=generate_PB::src::Spi_PBcfg.c, category=SWSRC}, usages=EXECUTE
        Flexio_Spi_Ip_Cfg_h: artifact-descriptor={short-label=generate_PC::include::Flexio_Spi_Ip_Cfg.h, category=SWHDR}, usages=COMPILE
        Flexio_Spi_Ip_CfgDefines_h: artifact-descriptor={short-label=generate_PC::include::Flexio_Spi_Ip_CfgDefines.h, category=SWHDR}, usages=COMPILE
        Lpspi_Ip_Cfg_h: artifact-descriptor={short-label=generate_PC::include::Lpspi_Ip_Cfg.h, category=SWHDR}, usages=COMPILE
        Spi_Cfg_h: artifact-descriptor={short-label=generate_PC::include::Spi_Cfg.h, category=SWHDR}, usages=COMPILE
        Spi_Ipw_Cfg_h: artifact-descriptor={short-label=generate_PC::include::Spi_Ipw_Cfg.h, category=SWHDR}, usages=COMPILE
    4 x linker:
      DIAB_Linker: name=Windriver Diab, options=-e Reset_Handler linker_script_file.dld -m30 -Xstack-usage -Xpreprocess-lecl -Llibrary_path -lc -lm -tARMCORTEXM7MG:simple, vendor=Windriver, version=Wind River Diab Compiler v7.0.4
      GCC_Linker: name=GCC Compiler, options=-Wl,-Map,filename -T linkerfile --entry=Reset_Handler -nostartfiles -mcpu=cortexm7 -mthumb -mfpu=fpv5-sp-d16 -mfloat-abi=hard -mlittle-endian -ggdb3 -lc -lm -lgcc -specs=nano.specs -specs=nosys.specs, vendor=GCC Systems, version=NXP GCC 10.2.0 20200723
      GHS_Linker: name=Green Hills, options=-e Reset_Handler -T linker_script_file.ld -map -keepmap -Mn -delete -ignore_debug_references -Llibrary_path -larch -lstartup -lind_sd -v -keep=C40_Ip_AccessCode -nostartfiles, vendor=Green Hills, version=Green Hills Multi 7.1.6d / Compiler 2021.1.4
      IAR_Linker: name=IAR Compiler, options=--map filename --config linkerfile --cpu=Cortex-M7 --fpu VFPv5-SP --entry _start --enable_stack_usage --skip_dynamic_initialization --no_wrap_diagnostics, vendor=IAR Systems, version=IAR ANSI C/C++ Compiler v.8.50.10 (safety version)
    resource consumption ResourceConsumption
      11 x memory section:
        SPI_CODE: alignment=UNSPECIFIED, sw-addrmethod=CODE, symbol=CODE
        SPI_CONFIG_DATA_UNSPECIFIED: alignment=UNSPECIFIED, sw-addrmethod=CONFIG_DATA, symbol=CONFIG_DATA_UNSPECIFIED
        SPI_CONST_UNSPECIFIED: alignment=UNSPECIFIED, sw-addrmethod=CONST, symbol=CONST_UNSPECIFIED
        SPI_VAR_CLEARED_32: alignment=32, sw-addrmethod=VAR_CLEARED, symbol=VAR_CLEARED_32
        SPI_VAR_CLEARED_32_NO_CACHEABLE: alignment=32, sw-addrmethod=VAR_CLEARED_NO_CACHEABLE, symbol=VAR_CLEARED_32_NO_CACHEABLE
        SPI_VAR_CLEARED_8_NO_CACHEABLE: alignment=8, sw-addrmethod=VAR_CLEARED_NO_CACHEABLE, symbol=VAR_CLEARED_8_NO_CACHEABLE
        SPI_VAR_CLEARED_UNSPECIFIED: alignment=UNSPECIFIED, sw-addrmethod=VAR_CLEARED, symbol=VAR_CLEARED_UNSPECIFIED
        SPI_VAR_CLEARED_UNSPECIFIED_NO_CACHEABLE: alignment=UNSPECIFIED, sw-addrmethod=VAR_CLEARED_NO_CACHEABLE, symbol=VAR_CLEARED_UNSPECIFIED_NO_CACHEABLE
        SPI_VAR_INIT_8_NO_CACHEABLE: alignment=8, sw-addrmethod=VAR_INIT_NO_CACHEABLE, symbol=VAR_INIT_8_NO_CACHEABLE
        SPI_VAR_INIT_UNSPECIFIED: alignment=UNSPECIFIED, sw-addrmethod=VAR_INIT, symbol=VAR_INIT_UNSPECIFIED
        SPI_VAR_INIT_UNSPECIFIED_NO_CACHEABLE: alignment=UNSPECIFIED, sw-addrmethod=VAR_INIT_NO_CACHEABLE, symbol=VAR_INIT_UNSPECIFIED_NO_CACHEABLE
