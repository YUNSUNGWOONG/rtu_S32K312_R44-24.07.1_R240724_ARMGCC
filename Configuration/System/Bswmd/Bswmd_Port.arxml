AUTOSAR XML (schema 00047)
package /AUTOSAR_Port/BswModuleDescriptions
  bsw module description Port: module-id=124
    provided-entrys:
      Igf_Port_Ip_Init
      Port_GetVersionInfo
      Port_Init
      Port_RefreshPortDirection
      Port_ResetPinMode
      Port_SetAsUnusedPin
      Port_SetAsUsedPin
      Port_SetPinDirection
      Port_SetPinMode
      Siul2_Port_Ip_SetInputBuffer
      Siul2_Port_Ip_SetOutputBuffer
      Siul2_Port_Ip_SetPinDirection
      Siul2_Port_Ip_SetPullSel
      Tspc_Port_Ip_ConfigureObeGroup
      Tspc_Port_Ip_EnableObeGroup
    bsw internal behavior InternalBehavior_Port
      12 x exclusive area:
        PORT_EXCLUSIVE_AREA_{00..11}
      15 x bsw called entity:
        Igf_Port_Ip_Init: can-enter-exclusive-area=PORT_EXCLUSIVE_AREA_11, implemented-entry=Igf_Port_Ip_Init
        Port_GetVersionInfo: implemented-entry=Port_GetVersionInfo
        Port_Init: implemented-entry=Port_Init
        Port_RefreshPortDirection: can-enter-exclusive-area=PORT_EXCLUSIVE_AREA_07, implemented-entry=Port_RefreshPortDirection
        Port_ResetPinMode: can-enter-exclusive-area=PORT_EXCLUSIVE_AREA_08, implemented-entry=Port_ResetPinMode
        Port_SetAsUnusedPin: implemented-entry=Port_SetAsUnusedPin
        Port_SetAsUsedPin: implemented-entry=Port_SetAsUsedPin
        Port_SetPinDirection: can-enter-exclusive-area=PORT_EXCLUSIVE_AREA_05, implemented-entry=Port_SetPinDirection
        Port_SetPinMode: can-enter-exclusive-area=[PORT_EXCLUSIVE_AREA_00, PORT_EXCLUSIVE_AREA_06], implemented-entry=Port_SetPinMode
        Siul2_Port_Ip_SetInputBuffer: can-enter-exclusive-area=PORT_EXCLUSIVE_AREA_03, implemented-entry=Siul2_Port_Ip_SetInputBuffer
        Siul2_Port_Ip_SetOutputBuffer: can-enter-exclusive-area=PORT_EXCLUSIVE_AREA_02, implemented-entry=Siul2_Port_Ip_SetOutputBuffer
        Siul2_Port_Ip_SetPinDirection: can-enter-exclusive-area=PORT_EXCLUSIVE_AREA_04, implemented-entry=Siul2_Port_Ip_SetPinDirection
        Siul2_Port_Ip_SetPullSel: can-enter-exclusive-area=PORT_EXCLUSIVE_AREA_01, implemented-entry=Siul2_Port_Ip_SetPullSel
        Tspc_Port_Ip_ConfigureObeGroup: can-enter-exclusive-area=PORT_EXCLUSIVE_AREA_10, implemented-entry=Tspc_Port_Ip_ConfigureObeGroup
        Tspc_Port_Ip_EnableObeGroup: can-enter-exclusive-area=PORT_EXCLUSIVE_AREA_09, implemented-entry=Tspc_Port_Ip_EnableObeGroup
package /AUTOSAR_Port/BswModuleEntrys
  15 x bsw module entry, all with is-synchronous=true, call-type=REGULAR, execution-context=UNSPECIFIED, sw-service-impl-policy=STANDARD:
    Igf_Port_Ip_Init: service-id=0xfa, is-reentrant=false
    Port_GetVersionInfo: service-id=0x03, is-reentrant=true
    Port_Init: service-id=0x00, is-reentrant=false
    Port_RefreshPortDirection: service-id=0x02, is-reentrant=false
    Port_ResetPinMode: service-id=0x07, is-reentrant=false
    Port_SetAsUnusedPin: service-id=0x05, is-reentrant=false
    Port_SetAsUsedPin: service-id=0x06, is-reentrant=false
    Port_SetPinDirection: service-id=0x01, is-reentrant=true
    Port_SetPinMode: service-id=0x04, is-reentrant=true
    Siul2_Port_Ip_SetInputBuffer: service-id=0xf2, is-reentrant=false
    Siul2_Port_Ip_SetOutputBuffer: service-id=0xf1, is-reentrant=false
    Siul2_Port_Ip_SetPinDirection: service-id=0xf3, is-reentrant=false
    Siul2_Port_Ip_SetPullSel: service-id=0xf0, is-reentrant=false
    Tspc_Port_Ip_ConfigureObeGroup: service-id=0xf9, is-reentrant=false
    Tspc_Port_Ip_EnableObeGroup: service-id=0xf8, is-reentrant=false
package /Port_TS_T40D34M30I0R0/Implementations
  bsw implementation BswImplementation_Port: programming-language=C, sw-version=3.0.0, vendor-id=43, ar-release-version=4.7.0, behavior=InternalBehavior_Port, recommended-configuration=Port, vendor-specific-module-def=Port
    code-descriptors:
      code Files
        artifact-descriptors:
          short-label=config::Port.xdm, category=SWCFG
          short-label=config_ext::PortRecConfiguration_JtagPins.xdm, category=SWCFG
          short-label=doc::RTD_PORT_IM.pdf, category=SWDOC
          short-label=doc::RTD_PORT_UM.pdf, category=SWDOC
          short-label=examples::EBT::S32K358::Port_Example_S32K358::generate::epc::BaseNXP.xdm, category=SWCFG
          short-label=examples::EBT::S32K358::Port_Example_S32K358::generate::epc::Dem.xdm, category=SWCFG
          short-label=examples::EBT::S32K358::Port_Example_S32K358::generate::epc::Dio.xdm, category=SWCFG
          short-label=examples::EBT::S32K358::Port_Example_S32K358::generate::epc::Mcu.xdm, category=SWCFG
          short-label=examples::EBT::S32K358::Port_Example_S32K358::generate::epc::Platform.xdm, category=SWCFG
          short-label=examples::EBT::S32K358::Port_Example_S32K358::generate::epc::Port.xdm, category=SWCFG
          short-label=examples::EBT::S32K358::Port_Example_S32K358::generate::epc::Resource.xdm, category=SWCFG
          short-label=examples::EBT::S32K358::Port_Example_S32K358::include::check_example.h, category=SWHDR
          short-label=examples::EBT::S32K358::Port_Example_S32K358::src::main.c, category=SWSRC
          short-label=examples::EBT::S32K358::Port_Example_S32K358::TresosProject::Port_Example_S32K358::.prefs::preferences.xdm, category=SWCFG
          short-label=examples::EBT::S32K358::Port_Example_S32K358::TresosProject::Port_Example_S32K358::config::BaseNXP.xdm, category=SWCFG
          short-label=examples::EBT::S32K358::Port_Example_S32K358::TresosProject::Port_Example_S32K358::config::Dem.xdm, category=SWCFG
          short-label=examples::EBT::S32K358::Port_Example_S32K358::TresosProject::Port_Example_S32K358::config::Dio.xdm, category=SWCFG
          short-label=examples::EBT::S32K358::Port_Example_S32K358::TresosProject::Port_Example_S32K358::config::EcuC.xdm, category=SWCFG
          short-label=examples::EBT::S32K358::Port_Example_S32K358::TresosProject::Port_Example_S32K358::config::Mcu.xdm, category=SWCFG
          short-label=examples::EBT::S32K358::Port_Example_S32K358::TresosProject::Port_Example_S32K358::config::Platform.xdm, category=SWCFG
          short-label=examples::EBT::S32K358::Port_Example_S32K358::TresosProject::Port_Example_S32K358::config::Port.xdm, category=SWCFG
          short-label=examples::EBT::S32K358::Port_Example_S32K358::TresosProject::Port_Example_S32K358::config::Resource.xdm, category=SWCFG
          short-label=examples::EBT::S32K396::Port_Example_S32K396::generate::epc::BaseNXP.xdm, category=SWCFG
          short-label=examples::EBT::S32K396::Port_Example_S32K396::generate::epc::Dem.xdm, category=SWCFG
          short-label=examples::EBT::S32K396::Port_Example_S32K396::generate::epc::Dio.xdm, category=SWCFG
          short-label=examples::EBT::S32K396::Port_Example_S32K396::generate::epc::Mcu.xdm, category=SWCFG
          short-label=examples::EBT::S32K396::Port_Example_S32K396::generate::epc::Platform.xdm, category=SWCFG
          short-label=examples::EBT::S32K396::Port_Example_S32K396::generate::epc::Port.xdm, category=SWCFG
          short-label=examples::EBT::S32K396::Port_Example_S32K396::generate::epc::Resource.xdm, category=SWCFG
          short-label=examples::EBT::S32K396::Port_Example_S32K396::include::check_example.h, category=SWHDR
          short-label=examples::EBT::S32K396::Port_Example_S32K396::src::main.c, category=SWSRC
          short-label=examples::EBT::S32K396::Port_Example_S32K396::TresosProject::Port_Example_S32K396::.prefs::preferences.xdm, category=SWCFG
          short-label=examples::EBT::S32K396::Port_Example_S32K396::TresosProject::Port_Example_S32K396::config::BaseNXP.xdm, category=SWCFG
          short-label=examples::EBT::S32K396::Port_Example_S32K396::TresosProject::Port_Example_S32K396::config::Dem.xdm, category=SWCFG
          short-label=examples::EBT::S32K396::Port_Example_S32K396::TresosProject::Port_Example_S32K396::config::Dio.xdm, category=SWCFG
          short-label=examples::EBT::S32K396::Port_Example_S32K396::TresosProject::Port_Example_S32K396::config::EcuC.xdm, category=SWCFG
          short-label=examples::EBT::S32K396::Port_Example_S32K396::TresosProject::Port_Example_S32K396::config::Mcu.xdm, category=SWCFG
          short-label=examples::EBT::S32K396::Port_Example_S32K396::TresosProject::Port_Example_S32K396::config::Platform.xdm, category=SWCFG
          short-label=examples::EBT::S32K396::Port_Example_S32K396::TresosProject::Port_Example_S32K396::config::Port.xdm, category=SWCFG
          short-label=examples::EBT::S32K396::Port_Example_S32K396::TresosProject::Port_Example_S32K396::config::Resource.xdm, category=SWCFG
          short-label=examples::EBT::S32K3XX::Port_Example_S32K344::generate::epc::BaseNXP.xdm, category=SWCFG
          short-label=examples::EBT::S32K3XX::Port_Example_S32K344::generate::epc::Dem.xdm, category=SWCFG
          short-label=examples::EBT::S32K3XX::Port_Example_S32K344::generate::epc::Dio.xdm, category=SWCFG
          short-label=examples::EBT::S32K3XX::Port_Example_S32K344::generate::epc::Mcu.xdm, category=SWCFG
          short-label=examples::EBT::S32K3XX::Port_Example_S32K344::generate::epc::Platform.xdm, category=SWCFG
          short-label=examples::EBT::S32K3XX::Port_Example_S32K344::generate::epc::Port.xdm, category=SWCFG
          short-label=examples::EBT::S32K3XX::Port_Example_S32K344::generate::epc::Resource.xdm, category=SWCFG
          short-label=examples::EBT::S32K3XX::Port_Example_S32K344::include::check_example.h, category=SWHDR
          short-label=examples::EBT::S32K3XX::Port_Example_S32K344::src::main.c, category=SWSRC
          short-label=examples::EBT::S32K3XX::Port_Example_S32K344::TresosProject::Port_Example_S32K344::.prefs::preferences.xdm, category=SWCFG
          short-label=examples::EBT::S32K3XX::Port_Example_S32K344::TresosProject::Port_Example_S32K344::config::BaseNXP.xdm, category=SWCFG
          short-label=examples::EBT::S32K3XX::Port_Example_S32K344::TresosProject::Port_Example_S32K344::config::Dem.xdm, category=SWCFG
          short-label=examples::EBT::S32K3XX::Port_Example_S32K344::TresosProject::Port_Example_S32K344::config::Dio.xdm, category=SWCFG
          short-label=examples::EBT::S32K3XX::Port_Example_S32K344::TresosProject::Port_Example_S32K344::config::EcuC.xdm, category=SWCFG
          short-label=examples::EBT::S32K3XX::Port_Example_S32K344::TresosProject::Port_Example_S32K344::config::Mcu.xdm, category=SWCFG
          short-label=examples::EBT::S32K3XX::Port_Example_S32K344::TresosProject::Port_Example_S32K344::config::Platform.xdm, category=SWCFG
          short-label=examples::EBT::S32K3XX::Port_Example_S32K344::TresosProject::Port_Example_S32K344::config::Port.xdm, category=SWCFG
          short-label=examples::EBT::S32K3XX::Port_Example_S32K344::TresosProject::Port_Example_S32K344::config::Resource.xdm, category=SWCFG
          short-label=examples::EBT::S32M276::Port_Example_S32M276::generate::epc::BaseNXP.xdm, category=SWCFG
          short-label=examples::EBT::S32M276::Port_Example_S32M276::generate::epc::Dem.xdm, category=SWCFG
          short-label=examples::EBT::S32M276::Port_Example_S32M276::generate::epc::Dio.xdm, category=SWCFG
          short-label=examples::EBT::S32M276::Port_Example_S32M276::generate::epc::Mcu.xdm, category=SWCFG
          short-label=examples::EBT::S32M276::Port_Example_S32M276::generate::epc::Port.xdm, category=SWCFG
          short-label=examples::EBT::S32M276::Port_Example_S32M276::generate::epc::Resource.xdm, category=SWCFG
          short-label=examples::EBT::S32M276::Port_Example_S32M276::include::check_example.h, category=SWHDR
          short-label=examples::EBT::S32M276::Port_Example_S32M276::src::main.c, category=SWSRC
          short-label=examples::EBT::S32M276::Port_Example_S32M276::TresosProject::Port_Example_S32M276::.prefs::preferences.xdm, category=SWCFG
          short-label=examples::EBT::S32M276::Port_Example_S32M276::TresosProject::Port_Example_S32M276::config::BaseNXP.xdm, category=SWCFG
          short-label=examples::EBT::S32M276::Port_Example_S32M276::TresosProject::Port_Example_S32M276::config::Dem.xdm, category=SWCFG
          short-label=examples::EBT::S32M276::Port_Example_S32M276::TresosProject::Port_Example_S32M276::config::Dio.xdm, category=SWCFG
          short-label=examples::EBT::S32M276::Port_Example_S32M276::TresosProject::Port_Example_S32M276::config::EcuC.xdm, category=SWCFG
          short-label=examples::EBT::S32M276::Port_Example_S32M276::TresosProject::Port_Example_S32M276::config::Mcu.xdm, category=SWCFG
          short-label=examples::EBT::S32M276::Port_Example_S32M276::TresosProject::Port_Example_S32M276::config::Port.xdm, category=SWCFG
          short-label=examples::EBT::S32M276::Port_Example_S32M276::TresosProject::Port_Example_S32M276::config::Resource.xdm, category=SWCFG
          short-label=examples::S32DS::S32K358::Port_Example_S32K358::include::check_example.h, category=SWHDR
          short-label=examples::S32DS::S32K358::Port_Example_S32K358::Project_Settings::Startup_Code::exceptions.c, category=SWSRC
          short-label=examples::S32DS::S32K358::Port_Example_S32K358::Project_Settings::Startup_Code::nvic.c, category=SWSRC
          short-label=examples::S32DS::S32K358::Port_Example_S32K358::Project_Settings::Startup_Code::startup.c, category=SWSRC
          short-label=examples::S32DS::S32K358::Port_Example_S32K358::Project_Settings::Startup_Code::system.c, category=SWSRC
          short-label=examples::S32DS::S32K358::Port_Example_S32K358::src::main.c, category=SWSRC
          short-label=examples::S32DS::S32K358::Siul2_Port_Ip_Example_S32K358::include::check_example.h, category=SWHDR
          short-label=examples::S32DS::S32K358::Siul2_Port_Ip_Example_S32K358::Project_Settings::Startup_Code::exceptions.c, category=SWSRC
          short-label=examples::S32DS::S32K358::Siul2_Port_Ip_Example_S32K358::Project_Settings::Startup_Code::nvic.c, category=SWSRC
          short-label=examples::S32DS::S32K358::Siul2_Port_Ip_Example_S32K358::Project_Settings::Startup_Code::startup.c, category=SWSRC
          short-label=examples::S32DS::S32K358::Siul2_Port_Ip_Example_S32K358::Project_Settings::Startup_Code::system.c, category=SWSRC
          short-label=examples::S32DS::S32K358::Siul2_Port_Ip_Example_S32K358::src::main.c, category=SWSRC
          short-label=examples::S32DS::S32K396::Port_Example_S32K396::include::check_example.h, category=SWHDR
          short-label=examples::S32DS::S32K396::Port_Example_S32K396::Project_Settings::Startup_Code::exceptions.c, category=SWSRC
          short-label=examples::S32DS::S32K396::Port_Example_S32K396::Project_Settings::Startup_Code::nvic.c, category=SWSRC
          short-label=examples::S32DS::S32K396::Port_Example_S32K396::Project_Settings::Startup_Code::startup.c, category=SWSRC
          short-label=examples::S32DS::S32K396::Port_Example_S32K396::Project_Settings::Startup_Code::system.c, category=SWSRC
          short-label=examples::S32DS::S32K396::Port_Example_S32K396::src::main.c, category=SWSRC
          short-label=examples::S32DS::S32K396::Siul2_Port_Ip_Example_S32K396::include::check_example.h, category=SWHDR
          short-label=examples::S32DS::S32K396::Siul2_Port_Ip_Example_S32K396::Project_Settings::Startup_Code::exceptions.c, category=SWSRC
          short-label=examples::S32DS::S32K396::Siul2_Port_Ip_Example_S32K396::Project_Settings::Startup_Code::nvic.c, category=SWSRC
          short-label=examples::S32DS::S32K396::Siul2_Port_Ip_Example_S32K396::Project_Settings::Startup_Code::startup.c, category=SWSRC
          short-label=examples::S32DS::S32K396::Siul2_Port_Ip_Example_S32K396::Project_Settings::Startup_Code::system.c, category=SWSRC
          short-label=examples::S32DS::S32K396::Siul2_Port_Ip_Example_S32K396::src::main.c, category=SWSRC
          short-label=examples::S32DS::S32K3XX::Port_Example_S32K344::include::check_example.h, category=SWHDR
          short-label=examples::S32DS::S32K3XX::Port_Example_S32K344::Project_Settings::Startup_Code::exceptions.c, category=SWSRC
          short-label=examples::S32DS::S32K3XX::Port_Example_S32K344::Project_Settings::Startup_Code::nvic.c, category=SWSRC
          short-label=examples::S32DS::S32K3XX::Port_Example_S32K344::Project_Settings::Startup_Code::startup.c, category=SWSRC
          short-label=examples::S32DS::S32K3XX::Port_Example_S32K344::Project_Settings::Startup_Code::system.c, category=SWSRC
          short-label=examples::S32DS::S32K3XX::Port_Example_S32K344::src::main.c, category=SWSRC
          short-label=examples::S32DS::S32K3XX::Siul2_Port_Ip_Example_S32K344::include::check_example.h, category=SWHDR
          short-label=examples::S32DS::S32K3XX::Siul2_Port_Ip_Example_S32K344::Project_Settings::Startup_Code::exceptions.c, category=SWSRC
          short-label=examples::S32DS::S32K3XX::Siul2_Port_Ip_Example_S32K344::Project_Settings::Startup_Code::nvic.c, category=SWSRC
          short-label=examples::S32DS::S32K3XX::Siul2_Port_Ip_Example_S32K344::Project_Settings::Startup_Code::startup.c, category=SWSRC
          short-label=examples::S32DS::S32K3XX::Siul2_Port_Ip_Example_S32K344::Project_Settings::Startup_Code::system.c, category=SWSRC
          short-label=examples::S32DS::S32K3XX::Siul2_Port_Ip_Example_S32K344::src::main.c, category=SWSRC
          short-label=examples::S32DS::S32M276::Port_Example_S32M276::include::check_example.h, category=SWHDR
          short-label=examples::S32DS::S32M276::Port_Example_S32M276::Project_Settings::Startup_Code::exceptions.c, category=SWSRC
          short-label=examples::S32DS::S32M276::Port_Example_S32M276::Project_Settings::Startup_Code::nvic.c, category=SWSRC
          short-label=examples::S32DS::S32M276::Port_Example_S32M276::Project_Settings::Startup_Code::startup.c, category=SWSRC
          short-label=examples::S32DS::S32M276::Port_Example_S32M276::Project_Settings::Startup_Code::system.c, category=SWSRC
          short-label=examples::S32DS::S32M276::Port_Example_S32M276::src::main.c, category=SWSRC
          short-label=examples::S32DS::S32M276::Siul2_Port_Ip_Example_S32M276::include::check_example.h, category=SWHDR
          short-label=examples::S32DS::S32M276::Siul2_Port_Ip_Example_S32M276::Project_Settings::Startup_Code::exceptions.c, category=SWSRC
          short-label=examples::S32DS::S32M276::Siul2_Port_Ip_Example_S32M276::Project_Settings::Startup_Code::nvic.c, category=SWSRC
          short-label=examples::S32DS::S32M276::Siul2_Port_Ip_Example_S32M276::Project_Settings::Startup_Code::startup.c, category=SWSRC
          short-label=examples::S32DS::S32M276::Siul2_Port_Ip_Example_S32M276::Project_Settings::Startup_Code::system.c, category=SWSRC
          short-label=examples::S32DS::S32M276::Siul2_Port_Ip_Example_S32M276::src::main.c, category=SWSRC
          short-label=include::Igf_Port_Ip.h, category=SWHDR
          short-label=include::Igf_Port_Ip_Types.h, category=SWHDR
          short-label=include::Port.h, category=SWHDR
          short-label=include::Port_Ipw.h, category=SWHDR
          short-label=include::Siul2_Port_Ip.h, category=SWHDR
          short-label=include::Siul2_Port_Ip_TrustedFunctions.h, category=SWHDR
          short-label=include::Siul2_Port_Ip_Types.h, category=SWHDR
          short-label=include::Tspc_Port_Ip.h, category=SWHDR
          short-label=include::Tspc_Port_Ip_Types.h, category=SWHDR
          short-label=src::Igf_Port_Ip.c, category=SWSRC
          short-label=src::Port.c, category=SWSRC
          short-label=src::Port_Ipw.c, category=SWSRC
          short-label=src::Siul2_Port_Ip.c, category=SWSRC
          short-label=src::Tspc_Port_Ip.c, category=SWSRC
    4 x compiler:
      DIAB_Compiler:
        name=Windriver Diab
        options=-tARMCORTEXM7MG:simple -mthumb -std=c99 -Oz -g -fstandalone-debug -Wstrict-prototypes -Wsign-compare -Wdouble-promotion -Wunknown-pragmas -Wundef -Wextra -Wall -pedantic -Werror=implicit-function-declaration -fno-common -fno-signed-char -fno-trigraphs -V -c -DS32K3XX -D $ (DERIVATIVE) -DDIAB -DUSE_SW_VECTOR_MODE -DD_CACHE_ENABLE -DI_CACHE_ENABLE -DENABLE_FPU -DMCAL_ENABLE_USER_MODE_SUPPORT
        vendor=Windriver
        version=Wind River Diab Compiler v7.0.4
      GCC_Compiler:
        name=GCC Compiler
        options=-mcpu=cortex-m7 -mthumb -mlittle-endian -mfpu=fpv5-sp-d16 -mfloat-abi=hard -std=c99 -Os -ggdb3 -Wall -Wextra -pedantic -Wstrict-prototypes -Wundef -Wunused -Werror=implicit-function-declaration -Wsign-compare -Wdouble-promotion -fno-short-enums -funsigned-char -funsigned-bitfields -fno-common -fstack-usage -fdump-ipa-all -c -DS32K3XX -D $ (DERIVATIVE) -DGCC -DUSE_SW_VECTOR_MODE -DD_CACHE_ENABLE -DI_CACHE_ENABLE -DENABLE_FPU -DMCAL_ENABLE_USER_MODE_SUPPORT --sysroot=$(NEWLIB_DIR) -specs=nano.specs -specs=nosys.specs
        vendor=GCC Systems
        version=NXP GCC 10.2.0 20200723
      GHS_Compiler:
        name=Green Hills
        options=-cpu=cortexm7 -thumb -fpu=vfpv5_d16 -fsingle -C99 --ghstd=last -Osize --gnu_asm -dual_debug -G -keeptempfiles -Wimplicit-int -Wshadow -Wtrigraphs -Wundef --unsigned_chars --unsigned_fields --no_commons --no_exceptions --no_slash_comment --prototype_errors --incorrect_pragma_warnings -c -DS32K3XX -D $ (DERIVATIVE) -DGHS -DUSE_SW_VECTOR_MODE -DD_CACHE_ENABLE -DI_CACHE_ENABLE -DENABLE_FPU -DMCAL_ENABLE_USER_MODE_SUPPORT
        vendor=Green Hills
        version=Green Hills Multi 7.1.6d / Compiler 2021.1.4
      IAR_Compiler:
        name=IAR Compiler
        options=--cpu Cortex-M7 --cpu_mode thumb --endian little --fpu VFPv5-SP -e -Ohz --debug --no_clustering --no_mem_idioms --do_explicit_zero_opt_in_named_sections --require_prototypes --no_wrap_diagnostics --diag_suppress Pa050 -DS32K3XX -D $ (DERIVATIVE) -DIAR -DUSE_SW_VECTOR_MODE -DD_CACHE_ENABLE -DI_CACHE_ENABLE -DENABLE_FPU -DMCAL_ENABLE_USER_MODE_SUPPORT
        vendor=IAR Systems
        version=IAR ANSI C/C++ Compiler v.8.50.10 (safety version)
    generated-artifacts:
      14 x dependency on artifact:
        Igf_Port_Ip_PBcfg_h: artifact-descriptor={short-label=generate_PB::include::Igf_Port_Ip_PBcfg.h, category=SWHDR}, usages=EXECUTE
        Port_PBcfg_h: artifact-descriptor={short-label=generate_PB::include::Port_PBcfg.h, category=SWHDR}, usages=EXECUTE
        Siul2_Port_Ip_PBcfg_h: artifact-descriptor={short-label=generate_PB::include::Siul2_Port_Ip_PBcfg.h, category=SWHDR}, usages=EXECUTE
        Tspc_Port_Ip_PBcfg_h: artifact-descriptor={short-label=generate_PB::include::Tspc_Port_Ip_PBcfg.h, category=SWHDR}, usages=EXECUTE
        Igf_Port_Ip_PBcfg_c: artifact-descriptor={short-label=generate_PB::src::Igf_Port_Ip_PBcfg.c, category=SWSRC}, usages=EXECUTE
        Port_PBcfg_c: artifact-descriptor={short-label=generate_PB::src::Port_PBcfg.c, category=SWSRC}, usages=EXECUTE
        Siul2_Port_Ip_PBcfg_c: artifact-descriptor={short-label=generate_PB::src::Siul2_Port_Ip_PBcfg.c, category=SWSRC}, usages=EXECUTE
        Tspc_Port_Ip_PBcfg_c: artifact-descriptor={short-label=generate_PB::src::Tspc_Port_Ip_PBcfg.c, category=SWSRC}, usages=EXECUTE
        Igf_Port_Ip_Cfg_h: artifact-descriptor={short-label=generate_PC::include::Igf_Port_Ip_Cfg.h, category=SWHDR}, usages=COMPILE
        Port_Cfg_h: artifact-descriptor={short-label=generate_PC::include::Port_Cfg.h, category=SWHDR}, usages=COMPILE
        Siul2_Port_Ip_Cfg_h: artifact-descriptor={short-label=generate_PC::include::Siul2_Port_Ip_Cfg.h, category=SWHDR}, usages=COMPILE
        Siul2_Port_Ip_Defines_h: artifact-descriptor={short-label=generate_PC::include::Siul2_Port_Ip_Defines.h, category=SWHDR}, usages=COMPILE
        Tspc_Port_Ip_Cfg_h: artifact-descriptor={short-label=generate_PC::include::Tspc_Port_Ip_Cfg.h, category=SWHDR}, usages=COMPILE
        Port_Cfg_c: artifact-descriptor={short-label=generate_PC::src::Port_Cfg.c, category=SWSRC}, usages=COMPILE
    4 x linker:
      DIAB_Linker: name=Windriver Diab, options=-e Reset_Handler linker_script_file.dld -m30 -Xstack-usage -Xpreprocess-lecl -Llibrary_path -lc -lm -tARMCORTEXM7MG:simple, vendor=Windriver, version=Wind River Diab Compiler v7.0.4
      GCC_Linker: name=GCC Compiler, options=-Wl,-Map,filename -T linkerfile --entry=Reset_Handler -nostartfiles -mcpu=cortexm7 -mthumb -mfpu=fpv5-sp-d16 -mfloat-abi=hard -mlittle-endian -ggdb3 -lc -lm -lgcc -specs=nano.specs -specs=nosys.specs, vendor=GCC Systems, version=NXP GCC 10.2.0 20200723
      GHS_Linker: name=Green Hills, options=-e Reset_Handler -T linker_script_file.ld -map -keepmap -Mn -delete -ignore_debug_references -Llibrary_path -larch -lstartup -lind_sd -v -keep=C40_Ip_AccessCode -nostartfiles, vendor=Green Hills, version=Green Hills Multi 7.1.6d / Compiler 2021.1.4
      IAR_Linker: name=IAR Compiler, options=--map filename --config linkerfile --cpu=Cortex-M7 --fpu VFPv5-SP --entry _start --enable_stack_usage --skip_dynamic_initialization --no_wrap_diagnostics, vendor=IAR Systems, version=IAR ANSI C/C++ Compiler v.8.50.10 (safety version)
    resource consumption ResourceConsumption
      12 x memory section:
        PORT_CODE: alignment=UNSPECIFIED, sw-addrmethod=CODE, symbol=CODE
        PORT_CONFIG_DATA_16: alignment=16, sw-addrmethod=CONFIG_DATA, symbol=CONFIG_DATA_16
        PORT_CONFIG_DATA_32: alignment=32, sw-addrmethod=CONFIG_DATA, symbol=CONFIG_DATA_32
        PORT_CONFIG_DATA_8: alignment=8, sw-addrmethod=CONFIG_DATA, symbol=CONFIG_DATA_8
        PORT_CONFIG_DATA_UNSPECIFIED: alignment=UNSPECIFIED, sw-addrmethod=CONFIG_DATA, symbol=CONFIG_DATA_UNSPECIFIED
        PORT_CONST_16: alignment=16, sw-addrmethod=CONST, symbol=CONST_16
        PORT_CONST_32: alignment=32, sw-addrmethod=CONST, symbol=CONST_32
        PORT_CONST_UNSPECIFIED: alignment=UNSPECIFIED, sw-addrmethod=CONST, symbol=CONST_UNSPECIFIED
        PORT_VAR_CLEARED_16_NO_CACHEABLE: alignment=16, sw-addrmethod=VAR_CLEARED_NO_CACHEABLE, symbol=VAR_CLEARED_16_NO_CACHEABLE
        PORT_VAR_CLEARED_32: alignment=32, sw-addrmethod=VAR_CLEARED, symbol=VAR_CLEARED_32
        PORT_VAR_CLEARED_UNSPECIFIED: alignment=UNSPECIFIED, sw-addrmethod=VAR_CLEARED, symbol=VAR_CLEARED_UNSPECIFIED
        PORT_VAR_CLEARED_UNSPECIFIED_NO_CACHEABLE: alignment=UNSPECIFIED, sw-addrmethod=VAR_CLEARED_NO_CACHEABLE, symbol=VAR_CLEARED_UNSPECIFIED_NO_CACHEABLE
