AUTOSAR XML (schema 00047)
package /ArPackage_E2EXf
  bsw implementation BswImplementation_E2EXf: sw-version=1.1.0, vendor-id=76, ar-release-version=4.4.0, behavior=BswInternalBehavior_E2EXf
  bsw module description E2EXf: module-id=176
    bsw internal behavior BswInternalBehavior_E2EXf
      bsw called entity BswCalledEntity_1: implemented-entry=E2EXf_Inv_Com_ComISignalGroup_MsgGr_E2E_FD_CAN1_BSD_01_50ms_P11
      bsw called entity BswCalledEntity_2: implemented-entry=E2EXf_Com_ComISignalGroup_MsgGr_E2E_FD_CAN1_TCU_01_10ms_P11
  bsw module entry E2EXf_Inv_Com_ComISignalGroup_MsgGr_E2E_FD_CAN1_BSD_01_50ms_P11: service-id=4, is-reentrant=true, is-synchronous=true, call-type=REGULAR, execution-context=TASK, sw-service-impl-policy=STANDARD
  bsw module entry E2EXf_Com_ComISignalGroup_MsgGr_E2E_FD_CAN1_TCU_01_10ms_P11: service-id=3, is-reentrant=true, is-synchronous=true, call-type=REGULAR, execution-context=TASK, sw-service-impl-policy=STANDARD
