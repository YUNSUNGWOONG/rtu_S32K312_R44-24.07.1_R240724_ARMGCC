AUTOSAR XML (schema 00047)
package /AUTOSAR_Lin_43_LPUART_FLEXIO/BswModuleDescriptions
  bsw module description Lin: module-id=82
    provided-entrys:
      Flexio_Lin_Ip_Deinit
      Lin_CheckWakeup
      Lin_GetStatus
      Lin_GetVersionInfo
      Lin_GoToSleep
      Lin_GoToSleepInternal
      Lin_Init
      Lin_SendFrame
      Lin_SetClockMode
      Lin_Wakeup
      Lin_WakeupInternal
      LPUART0_LIN_IP_ERR_IRQHandler
      LPUART0_LIN_IP_RxTx_IRQHandler
      LPUART10_LIN_IP_ERR_IRQHandler
      LPUART10_LIN_IP_RxTx_IRQHandler
      LPUART11_LIN_IP_ERR_IRQHandler
      LPUART11_LIN_IP_RxTx_IRQHandler
      LPUART12_LIN_IP_ERR_IRQHandler
      LPUART12_LIN_IP_RxTx_IRQHandler
      LPUART13_LIN_IP_ERR_IRQHandler
      LPUART13_LIN_IP_RxTx_IRQHandler
      LPUART14_LIN_IP_ERR_IRQHandler
      LPUART14_LIN_IP_RxTx_IRQHandler
      LPUART15_LIN_IP_ERR_IRQHandler
      LPUART15_LIN_IP_RxTx_IRQHandler
      LPUART1_LIN_IP_ERR_IRQHandler
      LPUART1_LIN_IP_RxTx_IRQHandler
      LPUART2_LIN_IP_ERR_IRQHandler
      LPUART2_LIN_IP_RxTx_IRQHandler
      LPUART3_LIN_IP_ERR_IRQHandler
      LPUART3_LIN_IP_RxTx_IRQHandler
      LPUART4_LIN_IP_ERR_IRQHandler
      LPUART4_LIN_IP_RxTx_IRQHandler
      LPUART5_LIN_IP_ERR_IRQHandler
      LPUART5_LIN_IP_RxTx_IRQHandler
      LPUART6_LIN_IP_ERR_IRQHandler
      LPUART6_LIN_IP_RxTx_IRQHandler
      LPUART7_LIN_IP_ERR_IRQHandler
      LPUART7_LIN_IP_RxTx_IRQHandler
      LPUART8_LIN_IP_ERR_IRQHandler
      LPUART8_LIN_IP_RxTx_IRQHandler
      LPUART9_LIN_IP_ERR_IRQHandler
      LPUART9_LIN_IP_RxTx_IRQHandler
      LPUARTMSC_LIN_IP_ERR_IRQHandler
      LPUARTMSC_LIN_IP_RxTx_IRQHandler
    bsw internal behavior InternalBehavior_Lin
      18 x exclusive area:
        LIN_EXCLUSIVE_AREA_{08..11}
        LIN_EXCLUSIVE_AREA_13
        LIN_EXCLUSIVE_AREA_{15..27}
      11 x bsw called entity:
        Flexio_Lin_Ip_Deinit: can-enter-exclusive-area=LIN_EXCLUSIVE_AREA_19, implemented-entry=Flexio_Lin_Ip_Deinit
        Lin_43_LPUART_FLEXIO_CheckWakeup: implemented-entry=Lin_CheckWakeup
        Lin_43_LPUART_FLEXIO_GetStatus: implemented-entry=Lin_GetStatus
        Lin_43_LPUART_FLEXIO_GetVersionInfo: implemented-entry=Lin_GetVersionInfo
        Lin_43_LPUART_FLEXIO_GoToSleep: can-enter-exclusive-area=[LIN_EXCLUSIVE_AREA_09, LIN_EXCLUSIVE_AREA_10, LIN_EXCLUSIVE_AREA_11, LIN_EXCLUSIVE_AREA_15], implemented-entry=Lin_GoToSleep
        Lin_43_LPUART_FLEXIO_GoToSleepInternal: can-enter-exclusive-area=[LIN_EXCLUSIVE_AREA_09, LIN_EXCLUSIVE_AREA_10, LIN_EXCLUSIVE_AREA_11, LIN_EXCLUSIVE_AREA_15, LIN_EXCLUSIVE_AREA_17, LIN_EXCLUSIVE_AREA_18, LIN_EXCLUSIVE_AREA_24, LIN_EXCLUSIVE_AREA_25], implemented-entry=Lin_GoToSleepInternal
        Lin_43_LPUART_FLEXIO_Init: can-enter-exclusive-area=[LIN_EXCLUSIVE_AREA_08, LIN_EXCLUSIVE_AREA_09, LIN_EXCLUSIVE_AREA_10, LIN_EXCLUSIVE_AREA_13, LIN_EXCLUSIVE_AREA_17, LIN_EXCLUSIVE_AREA_18, LIN_EXCLUSIVE_AREA_20, LIN_EXCLUSIVE_AREA_21, LIN_EXCLUSIVE_AREA_26, LIN_EXCLUSIVE_AREA_27, LIN_EXCLUSIVE_AREA_23, LIN_EXCLUSIVE_AREA_24, LIN_EXCLUSIVE_AREA_25], implemented-entry=Lin_Init
        Lin_43_LPUART_FLEXIO_SendFrame: can-enter-exclusive-area=[LIN_EXCLUSIVE_AREA_09, LIN_EXCLUSIVE_AREA_10, LIN_EXCLUSIVE_AREA_11, LIN_EXCLUSIVE_AREA_15, LIN_EXCLUSIVE_AREA_16, LIN_EXCLUSIVE_AREA_24, LIN_EXCLUSIVE_AREA_25], implemented-entry=Lin_SendFrame
        Lin_43_LPUART_FLEXIO_SetClockMode: can-enter-exclusive-area=LIN_EXCLUSIVE_AREA_22, implemented-entry=Lin_SetClockMode
        Lin_43_LPUART_FLEXIO_Wakeup: implemented-entry=Lin_Wakeup
        Lin_43_LPUART_FLEXIO_WakeupInternal: can-enter-exclusive-area=[LIN_EXCLUSIVE_AREA_24, LIN_EXCLUSIVE_AREA_25], implemented-entry=Lin_WakeupInternal
      34 x bsw interrupt entity, all with interrupt-category=CAT-2, interrupt-source=Hardware:
        LPUART0_LIN_IP_ERR_IRQHandler: implemented-entry=LPUART0_LIN_IP_ERR_IRQHandler
        LPUART0_LIN_IP_RxTx_IRQHandler: implemented-entry=LPUART0_LIN_IP_RxTx_IRQHandler
        LPUART10_LIN_IP_ERR_IRQHandler: implemented-entry=LPUART10_LIN_IP_ERR_IRQHandler
        LPUART10_LIN_IP_RxTx_IRQHandler: implemented-entry=LPUART10_LIN_IP_RxTx_IRQHandler
        LPUART11_LIN_IP_ERR_IRQHandler: implemented-entry=LPUART11_LIN_IP_ERR_IRQHandler
        LPUART11_LIN_IP_RxTx_IRQHandler: implemented-entry=LPUART11_LIN_IP_RxTx_IRQHandler
        LPUART12_LIN_IP_ERR_IRQHandler: implemented-entry=LPUART12_LIN_IP_ERR_IRQHandler
        LPUART12_LIN_IP_RxTx_IRQHandler: implemented-entry=LPUART12_LIN_IP_RxTx_IRQHandler
        LPUART13_LIN_IP_ERR_IRQHandler: implemented-entry=LPUART13_LIN_IP_ERR_IRQHandler
        LPUART13_LIN_IP_RxTx_IRQHandler: implemented-entry=LPUART13_LIN_IP_RxTx_IRQHandler
        LPUART14_LIN_IP_ERR_IRQHandler: implemented-entry=LPUART14_LIN_IP_ERR_IRQHandler
        LPUART14_LIN_IP_RxTx_IRQHandler: implemented-entry=LPUART14_LIN_IP_RxTx_IRQHandler
        LPUART15_LIN_IP_ERR_IRQHandler: implemented-entry=LPUART15_LIN_IP_ERR_IRQHandler
        LPUART15_LIN_IP_RxTx_IRQHandler: implemented-entry=LPUART15_LIN_IP_RxTx_IRQHandler
        LPUART1_LIN_IP_ERR_IRQHandler: implemented-entry=LPUART1_LIN_IP_ERR_IRQHandler
        LPUART1_LIN_IP_RxTx_IRQHandler: implemented-entry=LPUART1_LIN_IP_RxTx_IRQHandler
        LPUART2_LIN_IP_ERR_IRQHandler: implemented-entry=LPUART2_LIN_IP_ERR_IRQHandler
        LPUART2_LIN_IP_RxTx_IRQHandler: implemented-entry=LPUART2_LIN_IP_RxTx_IRQHandler
        LPUART3_LIN_IP_ERR_IRQHandler: implemented-entry=LPUART3_LIN_IP_ERR_IRQHandler
        LPUART3_LIN_IP_RxTx_IRQHandler: implemented-entry=LPUART3_LIN_IP_RxTx_IRQHandler
        LPUART4_LIN_IP_ERR_IRQHandler: implemented-entry=LPUART4_LIN_IP_ERR_IRQHandler
        LPUART4_LIN_IP_RxTx_IRQHandler: implemented-entry=LPUART4_LIN_IP_RxTx_IRQHandler
        LPUART5_LIN_IP_ERR_IRQHandler: implemented-entry=LPUART5_LIN_IP_ERR_IRQHandler
        LPUART5_LIN_IP_RxTx_IRQHandler: implemented-entry=LPUART5_LIN_IP_RxTx_IRQHandler
        LPUART6_LIN_IP_ERR_IRQHandler: implemented-entry=LPUART6_LIN_IP_ERR_IRQHandler
        LPUART6_LIN_IP_RxTx_IRQHandler: implemented-entry=LPUART6_LIN_IP_RxTx_IRQHandler
        LPUART7_LIN_IP_ERR_IRQHandler: implemented-entry=LPUART7_LIN_IP_ERR_IRQHandler
        LPUART7_LIN_IP_RxTx_IRQHandler: implemented-entry=LPUART7_LIN_IP_RxTx_IRQHandler
        LPUART8_LIN_IP_ERR_IRQHandler: implemented-entry=LPUART8_LIN_IP_ERR_IRQHandler
        LPUART8_LIN_IP_RxTx_IRQHandler: implemented-entry=LPUART8_LIN_IP_RxTx_IRQHandler
        LPUART9_LIN_IP_ERR_IRQHandler: implemented-entry=LPUART9_LIN_IP_ERR_IRQHandler
        LPUART9_LIN_IP_RxTx_IRQHandler: implemented-entry=LPUART9_LIN_IP_RxTx_IRQHandler
        LPUARTMSC_LIN_IP_ERR_IRQHandler: implemented-entry=LPUARTMSC_LIN_IP_ERR_IRQHandler
        LPUARTMSC_LIN_IP_RxTx_IRQHandler: implemented-entry=LPUARTMSC_LIN_IP_RxTx_IRQHandler
package /AUTOSAR_Lin_43_LPUART_FLEXIO/BswModuleEntrys
  45 x bsw module entry, all with sw-service-impl-policy=STANDARD:
    Flexio_Lin_Ip_Deinit: service-id=0x100, is-reentrant=false, is-synchronous=true, call-type=REGULAR, execution-context=UNSPECIFIED
    Lin_CheckWakeup: service-id=0x0a, is-reentrant=false, is-synchronous=true, call-type=REGULAR, execution-context=UNSPECIFIED
    Lin_GetStatus: service-id=0x08, is-reentrant=false, is-synchronous=true, call-type=REGULAR, execution-context=UNSPECIFIED
    Lin_GetVersionInfo: service-id=0x01, is-reentrant=true, is-synchronous=true, call-type=REGULAR, execution-context=UNSPECIFIED
    Lin_GoToSleep: service-id=0x06, is-reentrant=false, is-synchronous=false, call-type=REGULAR, execution-context=UNSPECIFIED
    Lin_GoToSleepInternal: service-id=0x09, is-reentrant=false, is-synchronous=true, call-type=REGULAR, execution-context=UNSPECIFIED
    Lin_Init: service-id=0x00, is-reentrant=false, is-synchronous=true, call-type=REGULAR, execution-context=UNSPECIFIED
    Lin_SendFrame: service-id=0x04, is-reentrant=false, is-synchronous=false, call-type=REGULAR, execution-context=UNSPECIFIED
    Lin_SetClockMode: service-id=0x0c, is-reentrant=false, is-synchronous=true, call-type=REGULAR, execution-context=UNSPECIFIED
    Lin_Wakeup: service-id=0x07, is-reentrant=false, is-synchronous=false, call-type=REGULAR, execution-context=UNSPECIFIED
    Lin_WakeupInternal: service-id=0x0b, is-reentrant=false, is-synchronous=false, call-type=REGULAR, execution-context=UNSPECIFIED
    LPUART0_LIN_IP_ERR_IRQHandler: service-id=0, is-reentrant=false, is-synchronous=true, call-type=INTERRUPT, execution-context=INTERRUPT-CAT-2
    LPUART0_LIN_IP_RxTx_IRQHandler: service-id=0, is-reentrant=false, is-synchronous=true, call-type=INTERRUPT, execution-context=INTERRUPT-CAT-2
    LPUART10_LIN_IP_ERR_IRQHandler: service-id=0, is-reentrant=false, is-synchronous=true, call-type=INTERRUPT, execution-context=INTERRUPT-CAT-2
    LPUART10_LIN_IP_RxTx_IRQHandler: service-id=0, is-reentrant=false, is-synchronous=true, call-type=INTERRUPT, execution-context=INTERRUPT-CAT-2
    LPUART11_LIN_IP_ERR_IRQHandler: service-id=0, is-reentrant=false, is-synchronous=true, call-type=INTERRUPT, execution-context=INTERRUPT-CAT-2
    LPUART11_LIN_IP_RxTx_IRQHandler: service-id=0, is-reentrant=false, is-synchronous=true, call-type=INTERRUPT, execution-context=INTERRUPT-CAT-2
    LPUART12_LIN_IP_ERR_IRQHandler: service-id=0, is-reentrant=false, is-synchronous=true, call-type=INTERRUPT, execution-context=INTERRUPT-CAT-2
    LPUART12_LIN_IP_RxTx_IRQHandler: service-id=0, is-reentrant=false, is-synchronous=true, call-type=INTERRUPT, execution-context=INTERRUPT-CAT-2
    LPUART13_LIN_IP_ERR_IRQHandler: service-id=0, is-reentrant=false, is-synchronous=true, call-type=INTERRUPT, execution-context=INTERRUPT-CAT-2
    LPUART13_LIN_IP_RxTx_IRQHandler: service-id=0, is-reentrant=false, is-synchronous=true, call-type=INTERRUPT, execution-context=INTERRUPT-CAT-2
    LPUART14_LIN_IP_ERR_IRQHandler: service-id=0, is-reentrant=false, is-synchronous=true, call-type=INTERRUPT, execution-context=INTERRUPT-CAT-2
    LPUART14_LIN_IP_RxTx_IRQHandler: service-id=0, is-reentrant=false, is-synchronous=true, call-type=INTERRUPT, execution-context=INTERRUPT-CAT-2
    LPUART15_LIN_IP_ERR_IRQHandler: service-id=0, is-reentrant=false, is-synchronous=true, call-type=INTERRUPT, execution-context=INTERRUPT-CAT-2
    LPUART15_LIN_IP_RxTx_IRQHandler: service-id=0, is-reentrant=false, is-synchronous=true, call-type=INTERRUPT, execution-context=INTERRUPT-CAT-2
    LPUART1_LIN_IP_ERR_IRQHandler: service-id=0, is-reentrant=false, is-synchronous=true, call-type=INTERRUPT, execution-context=INTERRUPT-CAT-2
    LPUART1_LIN_IP_RxTx_IRQHandler: service-id=0, is-reentrant=false, is-synchronous=true, call-type=INTERRUPT, execution-context=INTERRUPT-CAT-2
    LPUART2_LIN_IP_ERR_IRQHandler: service-id=0, is-reentrant=false, is-synchronous=true, call-type=INTERRUPT, execution-context=INTERRUPT-CAT-2
    LPUART2_LIN_IP_RxTx_IRQHandler: service-id=0, is-reentrant=false, is-synchronous=true, call-type=INTERRUPT, execution-context=INTERRUPT-CAT-2
    LPUART3_LIN_IP_ERR_IRQHandler: service-id=0, is-reentrant=false, is-synchronous=true, call-type=INTERRUPT, execution-context=INTERRUPT-CAT-2
    LPUART3_LIN_IP_RxTx_IRQHandler: service-id=0, is-reentrant=false, is-synchronous=true, call-type=INTERRUPT, execution-context=INTERRUPT-CAT-2
    LPUART4_LIN_IP_ERR_IRQHandler: service-id=0, is-reentrant=false, is-synchronous=true, call-type=INTERRUPT, execution-context=INTERRUPT-CAT-2
    LPUART4_LIN_IP_RxTx_IRQHandler: service-id=0, is-reentrant=false, is-synchronous=true, call-type=INTERRUPT, execution-context=INTERRUPT-CAT-2
    LPUART5_LIN_IP_ERR_IRQHandler: service-id=0, is-reentrant=false, is-synchronous=true, call-type=INTERRUPT, execution-context=INTERRUPT-CAT-2
    LPUART5_LIN_IP_RxTx_IRQHandler: service-id=0, is-reentrant=false, is-synchronous=true, call-type=INTERRUPT, execution-context=INTERRUPT-CAT-2
    LPUART6_LIN_IP_ERR_IRQHandler: service-id=0, is-reentrant=false, is-synchronous=true, call-type=INTERRUPT, execution-context=INTERRUPT-CAT-2
    LPUART6_LIN_IP_RxTx_IRQHandler: service-id=0, is-reentrant=false, is-synchronous=true, call-type=INTERRUPT, execution-context=INTERRUPT-CAT-2
    LPUART7_LIN_IP_ERR_IRQHandler: service-id=0, is-reentrant=false, is-synchronous=true, call-type=INTERRUPT, execution-context=INTERRUPT-CAT-2
    LPUART7_LIN_IP_RxTx_IRQHandler: service-id=0, is-reentrant=false, is-synchronous=true, call-type=INTERRUPT, execution-context=INTERRUPT-CAT-2
    LPUART8_LIN_IP_ERR_IRQHandler: service-id=0, is-reentrant=false, is-synchronous=true, call-type=INTERRUPT, execution-context=INTERRUPT-CAT-2
    LPUART8_LIN_IP_RxTx_IRQHandler: service-id=0, is-reentrant=false, is-synchronous=true, call-type=INTERRUPT, execution-context=INTERRUPT-CAT-2
    LPUART9_LIN_IP_ERR_IRQHandler: service-id=0, is-reentrant=false, is-synchronous=true, call-type=INTERRUPT, execution-context=INTERRUPT-CAT-2
    LPUART9_LIN_IP_RxTx_IRQHandler: service-id=0, is-reentrant=false, is-synchronous=true, call-type=INTERRUPT, execution-context=INTERRUPT-CAT-2
    LPUARTMSC_LIN_IP_ERR_IRQHandler: service-id=0, is-reentrant=false, is-synchronous=true, call-type=INTERRUPT, execution-context=INTERRUPT-CAT-2
    LPUARTMSC_LIN_IP_RxTx_IRQHandler: service-id=0, is-reentrant=false, is-synchronous=true, call-type=INTERRUPT, execution-context=INTERRUPT-CAT-2
package /Lin_43_LPUART_FLEXIO_TS_T40D34M30I0R0/Implementations
  bsw implementation BswImplementation_Lin: programming-language=C, sw-version=3.0.0, vendor-id=43, ar-release-version=4.7.0, behavior=InternalBehavior_Lin, vendor-api-infix=LPUART_FLEXIO, vendor-specific-module-def=Lin
    code-descriptors:
      code Files
        artifact-descriptors:
          short-label=config::Lin_43_LPUART_FLEXIO.xdm, category=SWCFG
          short-label=doc::RTD_LIN_43_LPUART_FLEXIO_IM.pdf, category=SWDOC
          short-label=doc::RTD_LIN_43_LPUART_FLEXIO_UM.pdf, category=SWDOC
          short-label=examples::EBT::S32K358::Lin_MasterFrameTransfer_S32K358::generate::epc::BaseNXP.xdm, category=SWCFG
          short-label=examples::EBT::S32K358::Lin_MasterFrameTransfer_S32K358::generate::epc::Dem.xdm, category=SWCFG
          short-label=examples::EBT::S32K358::Lin_MasterFrameTransfer_S32K358::generate::epc::EcuC.xdm, category=SWCFG
          short-label=examples::EBT::S32K358::Lin_MasterFrameTransfer_S32K358::generate::epc::EcuM.xdm, category=SWCFG
          short-label=examples::EBT::S32K358::Lin_MasterFrameTransfer_S32K358::generate::epc::Lin_43_LPUART_FLEXIO.xdm, category=SWCFG
          short-label=examples::EBT::S32K358::Lin_MasterFrameTransfer_S32K358::generate::epc::Mcl.xdm, category=SWCFG
          short-label=examples::EBT::S32K358::Lin_MasterFrameTransfer_S32K358::generate::epc::Mcu.xdm, category=SWCFG
          short-label=examples::EBT::S32K358::Lin_MasterFrameTransfer_S32K358::generate::epc::Platform.xdm, category=SWCFG
          short-label=examples::EBT::S32K358::Lin_MasterFrameTransfer_S32K358::generate::epc::Port.xdm, category=SWCFG
          short-label=examples::EBT::S32K358::Lin_MasterFrameTransfer_S32K358::generate::epc::Resource.xdm, category=SWCFG
          short-label=examples::EBT::S32K358::Lin_MasterFrameTransfer_S32K358::include::check_example.h, category=SWHDR
          short-label=examples::EBT::S32K358::Lin_MasterFrameTransfer_S32K358::src::main.c, category=SWSRC
          short-label=examples::EBT::S32K358::Lin_MasterFrameTransfer_S32K358::TresosProject::Lin_MasterFrameTransfer_S32K358::.prefs::preferences.xdm, category=SWCFG
          short-label=examples::EBT::S32K358::Lin_MasterFrameTransfer_S32K358::TresosProject::Lin_MasterFrameTransfer_S32K358::config::BaseNXP.xdm, category=SWCFG
          short-label=examples::EBT::S32K358::Lin_MasterFrameTransfer_S32K358::TresosProject::Lin_MasterFrameTransfer_S32K358::config::Dem.xdm, category=SWCFG
          short-label=examples::EBT::S32K358::Lin_MasterFrameTransfer_S32K358::TresosProject::Lin_MasterFrameTransfer_S32K358::config::EcuC.xdm, category=SWCFG
          short-label=examples::EBT::S32K358::Lin_MasterFrameTransfer_S32K358::TresosProject::Lin_MasterFrameTransfer_S32K358::config::EcuM.xdm, category=SWCFG
          short-label=examples::EBT::S32K358::Lin_MasterFrameTransfer_S32K358::TresosProject::Lin_MasterFrameTransfer_S32K358::config::Lin_43_LPUART_FLEXIO.xdm, category=SWCFG
          short-label=examples::EBT::S32K358::Lin_MasterFrameTransfer_S32K358::TresosProject::Lin_MasterFrameTransfer_S32K358::config::Mcl.xdm, category=SWCFG
          short-label=examples::EBT::S32K358::Lin_MasterFrameTransfer_S32K358::TresosProject::Lin_MasterFrameTransfer_S32K358::config::Mcu.xdm, category=SWCFG
          short-label=examples::EBT::S32K358::Lin_MasterFrameTransfer_S32K358::TresosProject::Lin_MasterFrameTransfer_S32K358::config::Platform.xdm, category=SWCFG
          short-label=examples::EBT::S32K358::Lin_MasterFrameTransfer_S32K358::TresosProject::Lin_MasterFrameTransfer_S32K358::config::Port.xdm, category=SWCFG
          short-label=examples::EBT::S32K358::Lin_MasterFrameTransfer_S32K358::TresosProject::Lin_MasterFrameTransfer_S32K358::config::Resource.xdm, category=SWCFG
          short-label=examples::EBT::S32K396::Lin_Flexio_MasterFrameTransfer_S32K396::generate::epc::BaseNXP.xdm, category=SWCFG
          short-label=examples::EBT::S32K396::Lin_Flexio_MasterFrameTransfer_S32K396::generate::epc::Dem.xdm, category=SWCFG
          short-label=examples::EBT::S32K396::Lin_Flexio_MasterFrameTransfer_S32K396::generate::epc::EcuC.xdm, category=SWCFG
          short-label=examples::EBT::S32K396::Lin_Flexio_MasterFrameTransfer_S32K396::generate::epc::EcuM.xdm, category=SWCFG
          short-label=examples::EBT::S32K396::Lin_Flexio_MasterFrameTransfer_S32K396::generate::epc::Lin_43_LPUART_FLEXIO.xdm, category=SWCFG
          short-label=examples::EBT::S32K396::Lin_Flexio_MasterFrameTransfer_S32K396::generate::epc::Mcl.xdm, category=SWCFG
          short-label=examples::EBT::S32K396::Lin_Flexio_MasterFrameTransfer_S32K396::generate::epc::Mcu.xdm, category=SWCFG
          short-label=examples::EBT::S32K396::Lin_Flexio_MasterFrameTransfer_S32K396::generate::epc::Platform.xdm, category=SWCFG
          short-label=examples::EBT::S32K396::Lin_Flexio_MasterFrameTransfer_S32K396::generate::epc::Port.xdm, category=SWCFG
          short-label=examples::EBT::S32K396::Lin_Flexio_MasterFrameTransfer_S32K396::generate::epc::Resource.xdm, category=SWCFG
          short-label=examples::EBT::S32K396::Lin_Flexio_MasterFrameTransfer_S32K396::include::check_example.h, category=SWHDR
          short-label=examples::EBT::S32K396::Lin_Flexio_MasterFrameTransfer_S32K396::src::main.c, category=SWSRC
          short-label=examples::EBT::S32K396::Lin_Flexio_MasterFrameTransfer_S32K396::TresosProject::Lin_Flexio_MasterFrameTransfer_S32K396::.prefs::preferences.xdm, category=SWCFG
          short-label=examples::EBT::S32K396::Lin_Flexio_MasterFrameTransfer_S32K396::TresosProject::Lin_Flexio_MasterFrameTransfer_S32K396::config::BaseNXP.xdm, category=SWCFG
          short-label=examples::EBT::S32K396::Lin_Flexio_MasterFrameTransfer_S32K396::TresosProject::Lin_Flexio_MasterFrameTransfer_S32K396::config::Dem.xdm, category=SWCFG
          short-label=examples::EBT::S32K396::Lin_Flexio_MasterFrameTransfer_S32K396::TresosProject::Lin_Flexio_MasterFrameTransfer_S32K396::config::EcuC.xdm, category=SWCFG
          short-label=examples::EBT::S32K396::Lin_Flexio_MasterFrameTransfer_S32K396::TresosProject::Lin_Flexio_MasterFrameTransfer_S32K396::config::EcuM.xdm, category=SWCFG
          short-label=examples::EBT::S32K396::Lin_Flexio_MasterFrameTransfer_S32K396::TresosProject::Lin_Flexio_MasterFrameTransfer_S32K396::config::Lin_43_LPUART_FLEXIO.xdm, category=SWCFG
          short-label=examples::EBT::S32K396::Lin_Flexio_MasterFrameTransfer_S32K396::TresosProject::Lin_Flexio_MasterFrameTransfer_S32K396::config::Mcl.xdm, category=SWCFG
          short-label=examples::EBT::S32K396::Lin_Flexio_MasterFrameTransfer_S32K396::TresosProject::Lin_Flexio_MasterFrameTransfer_S32K396::config::Mcu.xdm, category=SWCFG
          short-label=examples::EBT::S32K396::Lin_Flexio_MasterFrameTransfer_S32K396::TresosProject::Lin_Flexio_MasterFrameTransfer_S32K396::config::Platform.xdm, category=SWCFG
          short-label=examples::EBT::S32K396::Lin_Flexio_MasterFrameTransfer_S32K396::TresosProject::Lin_Flexio_MasterFrameTransfer_S32K396::config::Port.xdm, category=SWCFG
          short-label=examples::EBT::S32K396::Lin_Flexio_MasterFrameTransfer_S32K396::TresosProject::Lin_Flexio_MasterFrameTransfer_S32K396::config::Resource.xdm, category=SWCFG
          short-label=examples::EBT::S32K396::Lin_Lpuart_MasterFrameTransfer_S32K396::generate::epc::BaseNXP.xdm, category=SWCFG
          short-label=examples::EBT::S32K396::Lin_Lpuart_MasterFrameTransfer_S32K396::generate::epc::Dem.xdm, category=SWCFG
          short-label=examples::EBT::S32K396::Lin_Lpuart_MasterFrameTransfer_S32K396::generate::epc::EcuC.xdm, category=SWCFG
          short-label=examples::EBT::S32K396::Lin_Lpuart_MasterFrameTransfer_S32K396::generate::epc::EcuM.xdm, category=SWCFG
          short-label=examples::EBT::S32K396::Lin_Lpuart_MasterFrameTransfer_S32K396::generate::epc::Lin_43_LPUART_FLEXIO.xdm, category=SWCFG
          short-label=examples::EBT::S32K396::Lin_Lpuart_MasterFrameTransfer_S32K396::generate::epc::Mcu.xdm, category=SWCFG
          short-label=examples::EBT::S32K396::Lin_Lpuart_MasterFrameTransfer_S32K396::generate::epc::Platform.xdm, category=SWCFG
          short-label=examples::EBT::S32K396::Lin_Lpuart_MasterFrameTransfer_S32K396::generate::epc::Port.xdm, category=SWCFG
          short-label=examples::EBT::S32K396::Lin_Lpuart_MasterFrameTransfer_S32K396::generate::epc::Resource.xdm, category=SWCFG
          short-label=examples::EBT::S32K396::Lin_Lpuart_MasterFrameTransfer_S32K396::include::check_example.h, category=SWHDR
          short-label=examples::EBT::S32K396::Lin_Lpuart_MasterFrameTransfer_S32K396::src::main.c, category=SWSRC
          short-label=examples::EBT::S32K396::Lin_Lpuart_MasterFrameTransfer_S32K396::TresosProject::Lin_Lpuart_MasterFrameTransfer_S32K396::.prefs::preferences.xdm, category=SWCFG
          short-label=examples::EBT::S32K396::Lin_Lpuart_MasterFrameTransfer_S32K396::TresosProject::Lin_Lpuart_MasterFrameTransfer_S32K396::config::BaseNXP.xdm, category=SWCFG
          short-label=examples::EBT::S32K396::Lin_Lpuart_MasterFrameTransfer_S32K396::TresosProject::Lin_Lpuart_MasterFrameTransfer_S32K396::config::Dem.xdm, category=SWCFG
          short-label=examples::EBT::S32K396::Lin_Lpuart_MasterFrameTransfer_S32K396::TresosProject::Lin_Lpuart_MasterFrameTransfer_S32K396::config::EcuC.xdm, category=SWCFG
          short-label=examples::EBT::S32K396::Lin_Lpuart_MasterFrameTransfer_S32K396::TresosProject::Lin_Lpuart_MasterFrameTransfer_S32K396::config::EcuM.xdm, category=SWCFG
          short-label=examples::EBT::S32K396::Lin_Lpuart_MasterFrameTransfer_S32K396::TresosProject::Lin_Lpuart_MasterFrameTransfer_S32K396::config::Lin_43_LPUART_FLEXIO.xdm, category=SWCFG
          short-label=examples::EBT::S32K396::Lin_Lpuart_MasterFrameTransfer_S32K396::TresosProject::Lin_Lpuart_MasterFrameTransfer_S32K396::config::Mcu.xdm, category=SWCFG
          short-label=examples::EBT::S32K396::Lin_Lpuart_MasterFrameTransfer_S32K396::TresosProject::Lin_Lpuart_MasterFrameTransfer_S32K396::config::Platform.xdm, category=SWCFG
          short-label=examples::EBT::S32K396::Lin_Lpuart_MasterFrameTransfer_S32K396::TresosProject::Lin_Lpuart_MasterFrameTransfer_S32K396::config::Port.xdm, category=SWCFG
          short-label=examples::EBT::S32K396::Lin_Lpuart_MasterFrameTransfer_S32K396::TresosProject::Lin_Lpuart_MasterFrameTransfer_S32K396::config::Resource.xdm, category=SWCFG
          short-label=examples::EBT::S32K3XX::Lin_MasterFrameTransfer_S32K344::generate::epc::BaseNXP.xdm, category=SWCFG
          short-label=examples::EBT::S32K3XX::Lin_MasterFrameTransfer_S32K344::generate::epc::Dem.xdm, category=SWCFG
          short-label=examples::EBT::S32K3XX::Lin_MasterFrameTransfer_S32K344::generate::epc::EcuC.xdm, category=SWCFG
          short-label=examples::EBT::S32K3XX::Lin_MasterFrameTransfer_S32K344::generate::epc::EcuM.xdm, category=SWCFG
          short-label=examples::EBT::S32K3XX::Lin_MasterFrameTransfer_S32K344::generate::epc::Lin_43_LPUART_FLEXIO.xdm, category=SWCFG
          short-label=examples::EBT::S32K3XX::Lin_MasterFrameTransfer_S32K344::generate::epc::Mcl.xdm, category=SWCFG
          short-label=examples::EBT::S32K3XX::Lin_MasterFrameTransfer_S32K344::generate::epc::Mcu.xdm, category=SWCFG
          short-label=examples::EBT::S32K3XX::Lin_MasterFrameTransfer_S32K344::generate::epc::Platform.xdm, category=SWCFG
          short-label=examples::EBT::S32K3XX::Lin_MasterFrameTransfer_S32K344::generate::epc::Port.xdm, category=SWCFG
          short-label=examples::EBT::S32K3XX::Lin_MasterFrameTransfer_S32K344::generate::epc::Resource.xdm, category=SWCFG
          short-label=examples::EBT::S32K3XX::Lin_MasterFrameTransfer_S32K344::include::check_example.h, category=SWHDR
          short-label=examples::EBT::S32K3XX::Lin_MasterFrameTransfer_S32K344::src::main.c, category=SWSRC
          short-label=examples::EBT::S32K3XX::Lin_MasterFrameTransfer_S32K344::TresosProject::Lin_MasterFrameTransfer_S32K344::.prefs::preferences.xdm, category=SWCFG
          short-label=examples::EBT::S32K3XX::Lin_MasterFrameTransfer_S32K344::TresosProject::Lin_MasterFrameTransfer_S32K344::config::BaseNXP.xdm, category=SWCFG
          short-label=examples::EBT::S32K3XX::Lin_MasterFrameTransfer_S32K344::TresosProject::Lin_MasterFrameTransfer_S32K344::config::Dem.xdm, category=SWCFG
          short-label=examples::EBT::S32K3XX::Lin_MasterFrameTransfer_S32K344::TresosProject::Lin_MasterFrameTransfer_S32K344::config::EcuC.xdm, category=SWCFG
          short-label=examples::EBT::S32K3XX::Lin_MasterFrameTransfer_S32K344::TresosProject::Lin_MasterFrameTransfer_S32K344::config::EcuM.xdm, category=SWCFG
          short-label=examples::EBT::S32K3XX::Lin_MasterFrameTransfer_S32K344::TresosProject::Lin_MasterFrameTransfer_S32K344::config::Lin_43_LPUART_FLEXIO.xdm, category=SWCFG
          short-label=examples::EBT::S32K3XX::Lin_MasterFrameTransfer_S32K344::TresosProject::Lin_MasterFrameTransfer_S32K344::config::Mcl.xdm, category=SWCFG
          short-label=examples::EBT::S32K3XX::Lin_MasterFrameTransfer_S32K344::TresosProject::Lin_MasterFrameTransfer_S32K344::config::Mcu.xdm, category=SWCFG
          short-label=examples::EBT::S32K3XX::Lin_MasterFrameTransfer_S32K344::TresosProject::Lin_MasterFrameTransfer_S32K344::config::Platform.xdm, category=SWCFG
          short-label=examples::EBT::S32K3XX::Lin_MasterFrameTransfer_S32K344::TresosProject::Lin_MasterFrameTransfer_S32K344::config::Port.xdm, category=SWCFG
          short-label=examples::EBT::S32K3XX::Lin_MasterFrameTransfer_S32K344::TresosProject::Lin_MasterFrameTransfer_S32K344::config::Resource.xdm, category=SWCFG
          short-label=examples::EBT::S32M276::Lin_LinTrcv_Flexio_MasterFrameTransfer_S32M276::generate::epc::Ae.xdm, category=SWCFG
          short-label=examples::EBT::S32M276::Lin_LinTrcv_Flexio_MasterFrameTransfer_S32M276::generate::epc::BaseNXP.xdm, category=SWCFG
          short-label=examples::EBT::S32M276::Lin_LinTrcv_Flexio_MasterFrameTransfer_S32M276::generate::epc::Dem.xdm, category=SWCFG
          short-label=examples::EBT::S32M276::Lin_LinTrcv_Flexio_MasterFrameTransfer_S32M276::generate::epc::EcuC.xdm, category=SWCFG
          short-label=examples::EBT::S32M276::Lin_LinTrcv_Flexio_MasterFrameTransfer_S32M276::generate::epc::EcuM.xdm, category=SWCFG
          short-label=examples::EBT::S32M276::Lin_LinTrcv_Flexio_MasterFrameTransfer_S32M276::generate::epc::LinTrcv_43_AE.xdm, category=SWCFG
          short-label=examples::EBT::S32M276::Lin_LinTrcv_Flexio_MasterFrameTransfer_S32M276::generate::epc::Lin_43_LPUART_FLEXIO.xdm, category=SWCFG
          short-label=examples::EBT::S32M276::Lin_LinTrcv_Flexio_MasterFrameTransfer_S32M276::generate::epc::Mcl.xdm, category=SWCFG
          short-label=examples::EBT::S32M276::Lin_LinTrcv_Flexio_MasterFrameTransfer_S32M276::generate::epc::Mcu.xdm, category=SWCFG
          short-label=examples::EBT::S32M276::Lin_LinTrcv_Flexio_MasterFrameTransfer_S32M276::generate::epc::Platform.xdm, category=SWCFG
          short-label=examples::EBT::S32M276::Lin_LinTrcv_Flexio_MasterFrameTransfer_S32M276::generate::epc::Port.xdm, category=SWCFG
          short-label=examples::EBT::S32M276::Lin_LinTrcv_Flexio_MasterFrameTransfer_S32M276::generate::epc::Resource.xdm, category=SWCFG
          short-label=examples::EBT::S32M276::Lin_LinTrcv_Flexio_MasterFrameTransfer_S32M276::generate::epc::Spi.xdm, category=SWCFG
          short-label=examples::EBT::S32M276::Lin_LinTrcv_Flexio_MasterFrameTransfer_S32M276::include::check_example.h, category=SWHDR
          short-label=examples::EBT::S32M276::Lin_LinTrcv_Flexio_MasterFrameTransfer_S32M276::src::main.c, category=SWSRC
          short-label=examples::EBT::S32M276::Lin_LinTrcv_Flexio_MasterFrameTransfer_S32M276::TresosProject::Lin_LinTrcv_Flexio_MasterFrameTransfer_S32M276::.prefs::preferences.xdm, category=SWCFG
          short-label=examples::EBT::S32M276::Lin_LinTrcv_Flexio_MasterFrameTransfer_S32M276::TresosProject::Lin_LinTrcv_Flexio_MasterFrameTransfer_S32M276::config::Ae.xdm, category=SWCFG
          short-label=examples::EBT::S32M276::Lin_LinTrcv_Flexio_MasterFrameTransfer_S32M276::TresosProject::Lin_LinTrcv_Flexio_MasterFrameTransfer_S32M276::config::BaseNXP.xdm, category=SWCFG
          short-label=examples::EBT::S32M276::Lin_LinTrcv_Flexio_MasterFrameTransfer_S32M276::TresosProject::Lin_LinTrcv_Flexio_MasterFrameTransfer_S32M276::config::Dem.xdm, category=SWCFG
          short-label=examples::EBT::S32M276::Lin_LinTrcv_Flexio_MasterFrameTransfer_S32M276::TresosProject::Lin_LinTrcv_Flexio_MasterFrameTransfer_S32M276::config::EcuC.xdm, category=SWCFG
          short-label=examples::EBT::S32M276::Lin_LinTrcv_Flexio_MasterFrameTransfer_S32M276::TresosProject::Lin_LinTrcv_Flexio_MasterFrameTransfer_S32M276::config::EcuM.xdm, category=SWCFG
          short-label=examples::EBT::S32M276::Lin_LinTrcv_Flexio_MasterFrameTransfer_S32M276::TresosProject::Lin_LinTrcv_Flexio_MasterFrameTransfer_S32M276::config::LinTrcv_43_AE.xdm, category=SWCFG
          short-label=examples::EBT::S32M276::Lin_LinTrcv_Flexio_MasterFrameTransfer_S32M276::TresosProject::Lin_LinTrcv_Flexio_MasterFrameTransfer_S32M276::config::Lin_43_LPUART_FLEXIO.xdm, category=SWCFG
          short-label=examples::EBT::S32M276::Lin_LinTrcv_Flexio_MasterFrameTransfer_S32M276::TresosProject::Lin_LinTrcv_Flexio_MasterFrameTransfer_S32M276::config::Mcl.xdm, category=SWCFG
          short-label=examples::EBT::S32M276::Lin_LinTrcv_Flexio_MasterFrameTransfer_S32M276::TresosProject::Lin_LinTrcv_Flexio_MasterFrameTransfer_S32M276::config::Mcu.xdm, category=SWCFG
          short-label=examples::EBT::S32M276::Lin_LinTrcv_Flexio_MasterFrameTransfer_S32M276::TresosProject::Lin_LinTrcv_Flexio_MasterFrameTransfer_S32M276::config::Platform.xdm, category=SWCFG
          short-label=examples::EBT::S32M276::Lin_LinTrcv_Flexio_MasterFrameTransfer_S32M276::TresosProject::Lin_LinTrcv_Flexio_MasterFrameTransfer_S32M276::config::Port.xdm, category=SWCFG
          short-label=examples::EBT::S32M276::Lin_LinTrcv_Flexio_MasterFrameTransfer_S32M276::TresosProject::Lin_LinTrcv_Flexio_MasterFrameTransfer_S32M276::config::Resource.xdm, category=SWCFG
          short-label=examples::EBT::S32M276::Lin_LinTrcv_Flexio_MasterFrameTransfer_S32M276::TresosProject::Lin_LinTrcv_Flexio_MasterFrameTransfer_S32M276::config::Spi.xdm, category=SWCFG
          short-label=examples::EBT::S32M276::Lin_LinTrcv_Lpuart_MasterFrameTransfer_S32M276::generate::epc::Ae.xdm, category=SWCFG
          short-label=examples::EBT::S32M276::Lin_LinTrcv_Lpuart_MasterFrameTransfer_S32M276::generate::epc::BaseNXP.xdm, category=SWCFG
          short-label=examples::EBT::S32M276::Lin_LinTrcv_Lpuart_MasterFrameTransfer_S32M276::generate::epc::Dem.xdm, category=SWCFG
          short-label=examples::EBT::S32M276::Lin_LinTrcv_Lpuart_MasterFrameTransfer_S32M276::generate::epc::EcuC.xdm, category=SWCFG
          short-label=examples::EBT::S32M276::Lin_LinTrcv_Lpuart_MasterFrameTransfer_S32M276::generate::epc::EcuM.xdm, category=SWCFG
          short-label=examples::EBT::S32M276::Lin_LinTrcv_Lpuart_MasterFrameTransfer_S32M276::generate::epc::LinTrcv_43_AE.xdm, category=SWCFG
          short-label=examples::EBT::S32M276::Lin_LinTrcv_Lpuart_MasterFrameTransfer_S32M276::generate::epc::Lin_43_LPUART_FLEXIO.xdm, category=SWCFG
          short-label=examples::EBT::S32M276::Lin_LinTrcv_Lpuart_MasterFrameTransfer_S32M276::generate::epc::Mcu.xdm, category=SWCFG
          short-label=examples::EBT::S32M276::Lin_LinTrcv_Lpuart_MasterFrameTransfer_S32M276::generate::epc::Platform.xdm, category=SWCFG
          short-label=examples::EBT::S32M276::Lin_LinTrcv_Lpuart_MasterFrameTransfer_S32M276::generate::epc::Port.xdm, category=SWCFG
          short-label=examples::EBT::S32M276::Lin_LinTrcv_Lpuart_MasterFrameTransfer_S32M276::generate::epc::Resource.xdm, category=SWCFG
          short-label=examples::EBT::S32M276::Lin_LinTrcv_Lpuart_MasterFrameTransfer_S32M276::generate::epc::Spi.xdm, category=SWCFG
          short-label=examples::EBT::S32M276::Lin_LinTrcv_Lpuart_MasterFrameTransfer_S32M276::include::check_example.h, category=SWHDR
          short-label=examples::EBT::S32M276::Lin_LinTrcv_Lpuart_MasterFrameTransfer_S32M276::src::main.c, category=SWSRC
          short-label=examples::EBT::S32M276::Lin_LinTrcv_Lpuart_MasterFrameTransfer_S32M276::TresosProject::Lin_LinTrcv_Lpuart_MasterFrameTransfer_S32M276::.prefs::preferences.xdm, category=SWCFG
          short-label=examples::EBT::S32M276::Lin_LinTrcv_Lpuart_MasterFrameTransfer_S32M276::TresosProject::Lin_LinTrcv_Lpuart_MasterFrameTransfer_S32M276::config::Ae.xdm, category=SWCFG
          short-label=examples::EBT::S32M276::Lin_LinTrcv_Lpuart_MasterFrameTransfer_S32M276::TresosProject::Lin_LinTrcv_Lpuart_MasterFrameTransfer_S32M276::config::BaseNXP.xdm, category=SWCFG
          short-label=examples::EBT::S32M276::Lin_LinTrcv_Lpuart_MasterFrameTransfer_S32M276::TresosProject::Lin_LinTrcv_Lpuart_MasterFrameTransfer_S32M276::config::Dem.xdm, category=SWCFG
          short-label=examples::EBT::S32M276::Lin_LinTrcv_Lpuart_MasterFrameTransfer_S32M276::TresosProject::Lin_LinTrcv_Lpuart_MasterFrameTransfer_S32M276::config::EcuC.xdm, category=SWCFG
          short-label=examples::EBT::S32M276::Lin_LinTrcv_Lpuart_MasterFrameTransfer_S32M276::TresosProject::Lin_LinTrcv_Lpuart_MasterFrameTransfer_S32M276::config::EcuM.xdm, category=SWCFG
          short-label=examples::EBT::S32M276::Lin_LinTrcv_Lpuart_MasterFrameTransfer_S32M276::TresosProject::Lin_LinTrcv_Lpuart_MasterFrameTransfer_S32M276::config::LinTrcv_43_AE.xdm, category=SWCFG
          short-label=examples::EBT::S32M276::Lin_LinTrcv_Lpuart_MasterFrameTransfer_S32M276::TresosProject::Lin_LinTrcv_Lpuart_MasterFrameTransfer_S32M276::config::Lin_43_LPUART_FLEXIO.xdm, category=SWCFG
          short-label=examples::EBT::S32M276::Lin_LinTrcv_Lpuart_MasterFrameTransfer_S32M276::TresosProject::Lin_LinTrcv_Lpuart_MasterFrameTransfer_S32M276::config::Mcu.xdm, category=SWCFG
          short-label=examples::EBT::S32M276::Lin_LinTrcv_Lpuart_MasterFrameTransfer_S32M276::TresosProject::Lin_LinTrcv_Lpuart_MasterFrameTransfer_S32M276::config::Platform.xdm, category=SWCFG
          short-label=examples::EBT::S32M276::Lin_LinTrcv_Lpuart_MasterFrameTransfer_S32M276::TresosProject::Lin_LinTrcv_Lpuart_MasterFrameTransfer_S32M276::config::Port.xdm, category=SWCFG
          short-label=examples::EBT::S32M276::Lin_LinTrcv_Lpuart_MasterFrameTransfer_S32M276::TresosProject::Lin_LinTrcv_Lpuart_MasterFrameTransfer_S32M276::config::Resource.xdm, category=SWCFG
          short-label=examples::EBT::S32M276::Lin_LinTrcv_Lpuart_MasterFrameTransfer_S32M276::TresosProject::Lin_LinTrcv_Lpuart_MasterFrameTransfer_S32M276::config::Spi.xdm, category=SWCFG
          short-label=examples::S32DS::S32K358::Lin_Ip_FrameTransfer_S32K358::include::check_example.h, category=SWHDR
          short-label=examples::S32DS::S32K358::Lin_Ip_FrameTransfer_S32K358::Project_Settings::Startup_Code::exceptions.c, category=SWSRC
          short-label=examples::S32DS::S32K358::Lin_Ip_FrameTransfer_S32K358::Project_Settings::Startup_Code::nvic.c, category=SWSRC
          short-label=examples::S32DS::S32K358::Lin_Ip_FrameTransfer_S32K358::Project_Settings::Startup_Code::startup.c, category=SWSRC
          short-label=examples::S32DS::S32K358::Lin_Ip_FrameTransfer_S32K358::Project_Settings::Startup_Code::system.c, category=SWSRC
          short-label=examples::S32DS::S32K358::Lin_Ip_FrameTransfer_S32K358::src::main.c, category=SWSRC
          short-label=examples::S32DS::S32K358::Lin_MasterFrameTransfer_S32K358::include::check_example.h, category=SWHDR
          short-label=examples::S32DS::S32K358::Lin_MasterFrameTransfer_S32K358::Project_Settings::Startup_Code::exceptions.c, category=SWSRC
          short-label=examples::S32DS::S32K358::Lin_MasterFrameTransfer_S32K358::Project_Settings::Startup_Code::nvic.c, category=SWSRC
          short-label=examples::S32DS::S32K358::Lin_MasterFrameTransfer_S32K358::Project_Settings::Startup_Code::startup.c, category=SWSRC
          short-label=examples::S32DS::S32K358::Lin_MasterFrameTransfer_S32K358::Project_Settings::Startup_Code::system.c, category=SWSRC
          short-label=examples::S32DS::S32K358::Lin_MasterFrameTransfer_S32K358::src::main.c, category=SWSRC
          short-label=examples::S32DS::S32K396::Lin_Ip_FrameTransfer_S32K396::include::check_example.h, category=SWHDR
          short-label=examples::S32DS::S32K396::Lin_Ip_FrameTransfer_S32K396::Project_Settings::Startup_Code::exceptions.c, category=SWSRC
          short-label=examples::S32DS::S32K396::Lin_Ip_FrameTransfer_S32K396::Project_Settings::Startup_Code::nvic.c, category=SWSRC
          short-label=examples::S32DS::S32K396::Lin_Ip_FrameTransfer_S32K396::Project_Settings::Startup_Code::startup.c, category=SWSRC
          short-label=examples::S32DS::S32K396::Lin_Ip_FrameTransfer_S32K396::Project_Settings::Startup_Code::system.c, category=SWSRC
          short-label=examples::S32DS::S32K396::Lin_Ip_FrameTransfer_S32K396::src::main.c, category=SWSRC
          short-label=examples::S32DS::S32K396::Lin_MasterFrameTransfer_S32K396::include::check_example.h, category=SWHDR
          short-label=examples::S32DS::S32K396::Lin_MasterFrameTransfer_S32K396::Project_Settings::Startup_Code::exceptions.c, category=SWSRC
          short-label=examples::S32DS::S32K396::Lin_MasterFrameTransfer_S32K396::Project_Settings::Startup_Code::nvic.c, category=SWSRC
          short-label=examples::S32DS::S32K396::Lin_MasterFrameTransfer_S32K396::Project_Settings::Startup_Code::startup.c, category=SWSRC
          short-label=examples::S32DS::S32K396::Lin_MasterFrameTransfer_S32K396::Project_Settings::Startup_Code::system.c, category=SWSRC
          short-label=examples::S32DS::S32K396::Lin_MasterFrameTransfer_S32K396::src::main.c, category=SWSRC
          short-label=examples::S32DS::S32K3XX::Lin_Ip_FrameTransfer_S32K344::include::check_example.h, category=SWHDR
          short-label=examples::S32DS::S32K3XX::Lin_Ip_FrameTransfer_S32K344::Project_Settings::Startup_Code::exceptions.c, category=SWSRC
          short-label=examples::S32DS::S32K3XX::Lin_Ip_FrameTransfer_S32K344::Project_Settings::Startup_Code::nvic.c, category=SWSRC
          short-label=examples::S32DS::S32K3XX::Lin_Ip_FrameTransfer_S32K344::Project_Settings::Startup_Code::startup.c, category=SWSRC
          short-label=examples::S32DS::S32K3XX::Lin_Ip_FrameTransfer_S32K344::Project_Settings::Startup_Code::system.c, category=SWSRC
          short-label=examples::S32DS::S32K3XX::Lin_Ip_FrameTransfer_S32K344::src::main.c, category=SWSRC
          short-label=examples::S32DS::S32K3XX::Lin_MasterFrameTransfer_S32K344::include::check_example.h, category=SWHDR
          short-label=examples::S32DS::S32K3XX::Lin_MasterFrameTransfer_S32K344::Project_Settings::Startup_Code::exceptions.c, category=SWSRC
          short-label=examples::S32DS::S32K3XX::Lin_MasterFrameTransfer_S32K344::Project_Settings::Startup_Code::nvic.c, category=SWSRC
          short-label=examples::S32DS::S32K3XX::Lin_MasterFrameTransfer_S32K344::Project_Settings::Startup_Code::startup.c, category=SWSRC
          short-label=examples::S32DS::S32K3XX::Lin_MasterFrameTransfer_S32K344::Project_Settings::Startup_Code::system.c, category=SWSRC
          short-label=examples::S32DS::S32K3XX::Lin_MasterFrameTransfer_S32K344::src::main.c, category=SWSRC
          short-label=examples::S32DS::S32M276::Lin_LinTrcv_Flexio_MasterFrameTransfer_S32M276::include::check_example.h, category=SWHDR
          short-label=examples::S32DS::S32M276::Lin_LinTrcv_Flexio_MasterFrameTransfer_S32M276::Project_Settings::Startup_Code::exceptions.c, category=SWSRC
          short-label=examples::S32DS::S32M276::Lin_LinTrcv_Flexio_MasterFrameTransfer_S32M276::Project_Settings::Startup_Code::nvic.c, category=SWSRC
          short-label=examples::S32DS::S32M276::Lin_LinTrcv_Flexio_MasterFrameTransfer_S32M276::Project_Settings::Startup_Code::startup.c, category=SWSRC
          short-label=examples::S32DS::S32M276::Lin_LinTrcv_Flexio_MasterFrameTransfer_S32M276::Project_Settings::Startup_Code::system.c, category=SWSRC
          short-label=examples::S32DS::S32M276::Lin_LinTrcv_Flexio_MasterFrameTransfer_S32M276::src::main.c, category=SWSRC
          short-label=examples::S32DS::S32M276::Lin_LinTrcv_Lpuart_MasterFrameTransfer_S32M276::include::check_example.h, category=SWHDR
          short-label=examples::S32DS::S32M276::Lin_LinTrcv_Lpuart_MasterFrameTransfer_S32M276::Project_Settings::Startup_Code::exceptions.c, category=SWSRC
          short-label=examples::S32DS::S32M276::Lin_LinTrcv_Lpuart_MasterFrameTransfer_S32M276::Project_Settings::Startup_Code::nvic.c, category=SWSRC
          short-label=examples::S32DS::S32M276::Lin_LinTrcv_Lpuart_MasterFrameTransfer_S32M276::Project_Settings::Startup_Code::startup.c, category=SWSRC
          short-label=examples::S32DS::S32M276::Lin_LinTrcv_Lpuart_MasterFrameTransfer_S32M276::Project_Settings::Startup_Code::system.c, category=SWSRC
          short-label=examples::S32DS::S32M276::Lin_LinTrcv_Lpuart_MasterFrameTransfer_S32M276::src::main.c, category=SWSRC
          short-label=include::Flexio_Lin_Ip.h, category=SWHDR
          short-label=include::Flexio_Lin_Ip_Irq.h, category=SWHDR
          short-label=include::Flexio_Lin_Ip_Types.h, category=SWHDR
          short-label=include::Lin_43_LPUART_FLEXIO.h, category=SWHDR
          short-label=include::Lin_43_LPUART_FLEXIO_ASRExt.h, category=SWHDR
          short-label=include::Lin_43_LPUART_FLEXIO_Ipw.h, category=SWHDR
          short-label=include::Lin_43_LPUART_FLEXIO_Ipw_Types.h, category=SWHDR
          short-label=include::Lin_43_LPUART_FLEXIO_Types.h, category=SWHDR
          short-label=include::Lin_Ip_Common.h, category=SWHDR
          short-label=include::Lpuart_Lin_Ip.h, category=SWHDR
          short-label=include::Lpuart_Lin_Ip_Hw_Access.h, category=SWHDR
          short-label=include::Lpuart_Lin_Ip_Types.h, category=SWHDR
          short-label=src::Flexio_Lin_Ip.c, category=SWSRC
          short-label=src::Lin_43_LPUART_FLEXIO.c, category=SWSRC
          short-label=src::Lin_43_LPUART_FLEXIO_ASRExt.c, category=SWSRC
          short-label=src::Lin_43_LPUART_FLEXIO_Ipw.c, category=SWSRC
          short-label=src::Lin_Ip_Common.c, category=SWSRC
          short-label=src::Lpuart_Lin_Ip.c, category=SWSRC
          short-label=src::Lpuart_Lin_Ip_Hw_Access.c, category=SWSRC
          short-label=src::Lpuart_Lin_Ip_Irq.c, category=SWSRC
    4 x compiler:
      DIAB_Compiler:
        name=Windriver Diab
        options=-tARMCORTEXM7MG:simple -mthumb -std=c99 -Oz -g -fstandalone-debug -Wstrict-prototypes -Wsign-compare -Wdouble-promotion -Wunknown-pragmas -Wundef -Wextra -Wall -pedantic -Werror=implicit-function-declaration -fno-common -fno-signed-char -fno-trigraphs -V -c -DS32K3XX -D $ (DERIVATIVE) -DDIAB -DUSE_SW_VECTOR_MODE -DD_CACHE_ENABLE -DI_CACHE_ENABLE -DENABLE_FPU -DMCAL_ENABLE_USER_MODE_SUPPORT
        vendor=Windriver
        version=Wind River Diab Compiler v7.0.4
      GCC_Compiler:
        name=GCC Compiler
        options=-mcpu=cortex-m7 -mthumb -mlittle-endian -mfpu=fpv5-sp-d16 -mfloat-abi=hard -std=c99 -Os -ggdb3 -Wall -Wextra -pedantic -Wstrict-prototypes -Wundef -Wunused -Werror=implicit-function-declaration -Wsign-compare -Wdouble-promotion -fno-short-enums -funsigned-char -funsigned-bitfields -fno-common -fstack-usage -fdump-ipa-all -c -DS32K3XX -D $ (DERIVATIVE) -DGCC -DUSE_SW_VECTOR_MODE -DD_CACHE_ENABLE -DI_CACHE_ENABLE -DENABLE_FPU -DMCAL_ENABLE_USER_MODE_SUPPORT --sysroot=$(NEWLIB_DIR) -specs=nano.specs -specs=nosys.specs
        vendor=GCC Systems
        version=NXP GCC 10.2.0 20200723
      GHS_Compiler:
        name=Green Hills
        options=-cpu=cortexm7 -thumb -fpu=vfpv5_d16 -fsingle -C99 --ghstd=last -Osize --gnu_asm -dual_debug -G -keeptempfiles -Wimplicit-int -Wshadow -Wtrigraphs -Wundef --unsigned_chars --unsigned_fields --no_commons --no_exceptions --no_slash_comment --prototype_errors --incorrect_pragma_warnings -c -DS32K3XX -D $ (DERIVATIVE) -DGHS -DUSE_SW_VECTOR_MODE -DD_CACHE_ENABLE -DI_CACHE_ENABLE -DENABLE_FPU -DMCAL_ENABLE_USER_MODE_SUPPORT
        vendor=Green Hills
        version=Green Hills Multi 7.1.6d / Compiler 2021.1.4
      IAR_Compiler:
        name=IAR Compiler
        options=--cpu Cortex-M7 --cpu_mode thumb --endian little --fpu VFPv5-SP -e -Ohz --debug --no_clustering --no_mem_idioms --do_explicit_zero_opt_in_named_sections --require_prototypes --no_wrap_diagnostics --diag_suppress Pa050 -DS32K3XX -D $ (DERIVATIVE) -DIAR -DUSE_SW_VECTOR_MODE -DD_CACHE_ENABLE -DI_CACHE_ENABLE -DENABLE_FPU -DMCAL_ENABLE_USER_MODE_SUPPORT
        vendor=IAR Systems
        version=IAR ANSI C/C++ Compiler v.8.50.10 (safety version)
    generated-artifacts:
      17 x dependency on artifact:
        Flexio_Lin_Ip_PBcfg_h: artifact-descriptor={short-label=generate_PB::include::Flexio_Lin_Ip_PBcfg.h, category=SWHDR}, usages=EXECUTE
        Lin_43_LPUART_FLEXIO_Ipw_PBcfg_h: artifact-descriptor={short-label=generate_PB::include::Lin_43_LPUART_FLEXIO_Ipw_PBcfg.h, category=SWHDR}, usages=EXECUTE
        Lin_43_LPUART_FLEXIO_PBcfg_h: artifact-descriptor={short-label=generate_PB::include::Lin_43_LPUART_FLEXIO_PBcfg.h, category=SWHDR}, usages=EXECUTE
        Lpuart_Lin_Ip_PBcfg_h: artifact-descriptor={short-label=generate_PB::include::Lpuart_Lin_Ip_PBcfg.h, category=SWHDR}, usages=EXECUTE
        Flexio_Lin_Ip_PBcfg_c: artifact-descriptor={short-label=generate_PB::src::Flexio_Lin_Ip_PBcfg.c, category=SWSRC}, usages=EXECUTE
        Lin_43_LPUART_FLEXIO_Ipw_PBcfg_c: artifact-descriptor={short-label=generate_PB::src::Lin_43_LPUART_FLEXIO_Ipw_PBcfg.c, category=SWSRC}, usages=EXECUTE
        Lin_43_LPUART_FLEXIO_PBcfg_c: artifact-descriptor={short-label=generate_PB::src::Lin_43_LPUART_FLEXIO_PBcfg.c, category=SWSRC}, usages=EXECUTE
        Lpuart_Lin_Ip_PBcfg_c: artifact-descriptor={short-label=generate_PB::src::Lpuart_Lin_Ip_PBcfg.c, category=SWSRC}, usages=EXECUTE
        Flexio_Lin_Ip_Cfg_h: artifact-descriptor={short-label=generate_PC::include::Flexio_Lin_Ip_Cfg.h, category=SWHDR}, usages=COMPILE
        Flexio_Lin_Ip_CfgDefines_h: artifact-descriptor={short-label=generate_PC::include::Flexio_Lin_Ip_CfgDefines.h, category=SWHDR}, usages=COMPILE
        Flexio_Lin_Ip_Defines_h: artifact-descriptor={short-label=generate_PC::include::Flexio_Lin_Ip_Defines.h, category=SWHDR}, usages=COMPILE
        Lin_43_LPUART_FLEXIO_Cfg_h: artifact-descriptor={short-label=generate_PC::include::Lin_43_LPUART_FLEXIO_Cfg.h, category=SWHDR}, usages=COMPILE
        Lin_43_LPUART_FLEXIO_Defines_h: artifact-descriptor={short-label=generate_PC::include::Lin_43_LPUART_FLEXIO_Defines.h, category=SWHDR}, usages=COMPILE
        Lin_43_LPUART_FLEXIO_Ipw_Cfg_h: artifact-descriptor={short-label=generate_PC::include::Lin_43_LPUART_FLEXIO_Ipw_Cfg.h, category=SWHDR}, usages=COMPILE
        Lpuart_Lin_Ip_Cfg_h: artifact-descriptor={short-label=generate_PC::include::Lpuart_Lin_Ip_Cfg.h, category=SWHDR}, usages=COMPILE
        Lpuart_Lin_Ip_Defines_h: artifact-descriptor={short-label=generate_PC::include::Lpuart_Lin_Ip_Defines.h, category=SWHDR}, usages=COMPILE
        Lin_43_LPUART_FLEXIO_Cfg_c: artifact-descriptor={short-label=generate_PC::src::Lin_43_LPUART_FLEXIO_Cfg.c, category=SWSRC}, usages=COMPILE
    4 x linker:
      DIAB_Linker: name=Windriver Diab, options=-e Reset_Handler linker_script_file.dld -m30 -Xstack-usage -Xpreprocess-lecl -Llibrary_path -lc -lm -tARMCORTEXM7MG:simple, vendor=Windriver, version=Wind River Diab Compiler v7.0.4
      GCC_Linker: name=GCC Compiler, options=-Wl,-Map,filename -T linkerfile --entry=Reset_Handler -nostartfiles -mcpu=cortexm7 -mthumb -mfpu=fpv5-sp-d16 -mfloat-abi=hard -mlittle-endian -ggdb3 -lc -lm -lgcc -specs=nano.specs -specs=nosys.specs, vendor=GCC Systems, version=NXP GCC 10.2.0 20200723
      GHS_Linker: name=Green Hills, options=-e Reset_Handler -T linker_script_file.ld -map -keepmap -Mn -delete -ignore_debug_references -Llibrary_path -larch -lstartup -lind_sd -v -keep=C40_Ip_AccessCode -nostartfiles, vendor=Green Hills, version=Green Hills Multi 7.1.6d / Compiler 2021.1.4
      IAR_Linker: name=IAR Compiler, options=--map filename --config linkerfile --cpu=Cortex-M7 --fpu VFPv5-SP --entry _start --enable_stack_usage --skip_dynamic_initialization --no_wrap_diagnostics, vendor=IAR Systems, version=IAR ANSI C/C++ Compiler v.8.50.10 (safety version)
    resource consumption ResourceConsumption
      8 x memory section:
        LIN_43_LPUART_FLEXIO_CODE: alignment=UNSPECIFIED, sw-addrmethod=CODE, symbol=CODE
        LIN_43_LPUART_FLEXIO_CONFIG_DATA_UNSPECIFIED: alignment=UNSPECIFIED, sw-addrmethod=CONFIG_DATA, symbol=CONFIG_DATA_UNSPECIFIED
        LIN_43_LPUART_FLEXIO_CONST_UNSPECIFIED: alignment=UNSPECIFIED, sw-addrmethod=CONST, symbol=CONST_UNSPECIFIED
        LIN_43_LPUART_FLEXIO_VAR_CLEARED_32: alignment=32, sw-addrmethod=VAR_CLEARED, symbol=VAR_CLEARED_32
        LIN_43_LPUART_FLEXIO_VAR_CLEARED_8: alignment=8, sw-addrmethod=VAR_CLEARED, symbol=VAR_CLEARED_8
        LIN_43_LPUART_FLEXIO_VAR_CLEARED_BOOLEAN: alignment=BOOLEAN, sw-addrmethod=VAR_CLEARED, symbol=VAR_CLEARED_BOOLEAN
        LIN_43_LPUART_FLEXIO_VAR_CLEARED_UNSPECIFIED: alignment=UNSPECIFIED, sw-addrmethod=VAR_CLEARED, symbol=VAR_CLEARED_UNSPECIFIED
        LIN_43_LPUART_FLEXIO_VAR_INIT_8: alignment=8, sw-addrmethod=VAR_INIT, symbol=VAR_INIT_8
