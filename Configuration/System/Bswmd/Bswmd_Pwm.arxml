AUTOSAR XML (schema 00047)
package /AUTOSAR_Pwm/BswModuleDescriptions
  bsw module description Pwm: module-id=121
    provided-entrys:
      Emios_Pwm_Ip_ChannelEnterDebugMode
      Emios_Pwm_Ip_ChannelStopDebugMode
      Emios_Pwm_Ip_DeInitChannel
      Emios_Pwm_Ip_ForceMatchLeadingEdge
      Emios_Pwm_Ip_ForceMatchTrailingEdge
      Emios_Pwm_Ip_GetDeadTime
      Emios_Pwm_Ip_GetDutyCycle
      Emios_Pwm_Ip_GetFlagRequest
      Emios_Pwm_Ip_GetPeriod
      Emios_Pwm_Ip_GetPhaseShift
      Emios_Pwm_Ip_GetTriggerPlacement
      Emios_Pwm_Ip_InitChannel
      Emios_Pwm_Ip_SetDeadTime
      Emios_Pwm_Ip_SetDutyCycle
      Emios_Pwm_Ip_SetFlagRequest
      Emios_Pwm_Ip_SetPeriod
      Emios_Pwm_Ip_SetPhaseShift
      Emios_Pwm_Ip_SetTriggerPlacement
      Flexio_Pwm_Ip_DeInitChannel
      Flexio_Pwm_Ip_ForceOuputLevel
      Flexio_Pwm_Ip_GetOutputState
      Flexio_Pwm_Ip_GetPeriod
      Flexio_Pwm_Ip_InitChannel
      Flexio_Pwm_Ip_UpdateClockPrescaler
      Flexio_Pwm_Ip_UpdateInterruptMode
      Flexio_Pwm_Ip_UpdatePeriodDuty
      Pwm_DeInit
      Pwm_DisableNotification
      Pwm_EnableNotification
      Pwm_GetChannelState
      Pwm_GetCurrentPowerState
      Pwm_GetOutputState
      Pwm_GetTargetPowerState
      Pwm_GetVersionInfo
      Pwm_Init
      Pwm_Notification
      Pwm_PreparePowerState
      Pwm_SetChannelDeadTime
      Pwm_SetChannelOutput
      Pwm_SetClockMode
      Pwm_SetCounterBus
      Pwm_SetDutyCycle
      Pwm_SetDutyCycle_NoUpdate
      Pwm_SetDutyPhaseShift
      Pwm_SetOutputToIdle
      Pwm_SetPeriodAndDuty
      Pwm_SetPeriodAndDuty_NoUpdate
      Pwm_SetPhaseShift
      Pwm_SetPhaseShift_NoUpdate
      Pwm_SetPowerState
      Pwm_SetTriggerDelay
      Pwm_SyncUpdate
      FLEXPWM_IP_FAULT_ISR
      FLEXPWM_IP_INS_0_SUBMOD_{0..3}_CMP_ISR
      FLEXPWM_IP_INS_1_SUBMOD_{0..3}_CMP_ISR
      FLEXPWM_IP_INS_2_SUBMOD_{0..3}_CMP_ISR
    bsw internal behavior InternalBehavior_Pwm
      21 x exclusive area:
        PWM_EXCLUSIVE_AREA_{14..34}
      52 x bsw called entity:
        Emios_Pwm_Ip_ChannelEnterDebugMode: can-enter-exclusive-area=PWM_EXCLUSIVE_AREA_21, implemented-entry=Emios_Pwm_Ip_ChannelEnterDebugMode
        Emios_Pwm_Ip_ChannelStopDebugMode: can-enter-exclusive-area=[PWM_EXCLUSIVE_AREA_22, PWM_EXCLUSIVE_AREA_23], implemented-entry=Emios_Pwm_Ip_ChannelStopDebugMode
        Emios_Pwm_Ip_DeInitChannel: implemented-entry=Emios_Pwm_Ip_DeInitChannel
        Emios_Pwm_Ip_ForceMatchLeadingEdge: can-enter-exclusive-area=PWM_EXCLUSIVE_AREA_14, implemented-entry=Emios_Pwm_Ip_ForceMatchLeadingEdge
        Emios_Pwm_Ip_ForceMatchTrailingEdge: can-enter-exclusive-area=PWM_EXCLUSIVE_AREA_15, implemented-entry=Emios_Pwm_Ip_ForceMatchTrailingEdge
        Emios_Pwm_Ip_GetDeadTime: implemented-entry=Emios_Pwm_Ip_GetDeadTime
        Emios_Pwm_Ip_GetDutyCycle: implemented-entry=Emios_Pwm_Ip_GetDutyCycle
        Emios_Pwm_Ip_GetFlagRequest: implemented-entry=Emios_Pwm_Ip_GetFlagRequest
        Emios_Pwm_Ip_GetPeriod: implemented-entry=Emios_Pwm_Ip_GetPeriod
        Emios_Pwm_Ip_GetPhaseShift: implemented-entry=Emios_Pwm_Ip_GetPhaseShift
        Emios_Pwm_Ip_GetTriggerPlacement: implemented-entry=Emios_Pwm_Ip_GetTriggerPlacement
        Emios_Pwm_Ip_InitChannel: implemented-entry=Emios_Pwm_Ip_InitChannel
        Emios_Pwm_Ip_SetDeadTime: can-enter-exclusive-area=PWM_EXCLUSIVE_AREA_19, implemented-entry=Emios_Pwm_Ip_SetDeadTime
        Emios_Pwm_Ip_SetDutyCycle: can-enter-exclusive-area=PWM_EXCLUSIVE_AREA_17, implemented-entry=Emios_Pwm_Ip_SetDutyCycle
        Emios_Pwm_Ip_SetFlagRequest: implemented-entry=Emios_Pwm_Ip_SetFlagRequest
        Emios_Pwm_Ip_SetPeriod: can-enter-exclusive-area=PWM_EXCLUSIVE_AREA_16, implemented-entry=Emios_Pwm_Ip_SetPeriod
        Emios_Pwm_Ip_SetPhaseShift: can-enter-exclusive-area=PWM_EXCLUSIVE_AREA_18, implemented-entry=Emios_Pwm_Ip_SetPhaseShift
        Emios_Pwm_Ip_SetTriggerPlacement: can-enter-exclusive-area=PWM_EXCLUSIVE_AREA_20, implemented-entry=Emios_Pwm_Ip_SetTriggerPlacement
        Flexio_Pwm_Ip_DeInitChannel: implemented-entry=Flexio_Pwm_Ip_DeInitChannel
        Flexio_Pwm_Ip_ForceOuputLevel: can-enter-exclusive-area=PWM_EXCLUSIVE_AREA_32, implemented-entry=Flexio_Pwm_Ip_ForceOuputLevel
        Flexio_Pwm_Ip_GetOutputState: implemented-entry=Flexio_Pwm_Ip_GetOutputState
        Flexio_Pwm_Ip_GetPeriod: implemented-entry=Flexio_Pwm_Ip_GetPeriod
        Flexio_Pwm_Ip_InitChannel: can-enter-exclusive-area=PWM_EXCLUSIVE_AREA_32, implemented-entry=Flexio_Pwm_Ip_InitChannel
        Flexio_Pwm_Ip_UpdateClockPrescaler: can-enter-exclusive-area=PWM_EXCLUSIVE_AREA_31, implemented-entry=Flexio_Pwm_Ip_UpdateClockPrescaler
        Flexio_Pwm_Ip_UpdateInterruptMode: can-enter-exclusive-area=PWM_EXCLUSIVE_AREA_34, implemented-entry=Flexio_Pwm_Ip_UpdateInterruptMode
        Flexio_Pwm_Ip_UpdatePeriodDuty: can-enter-exclusive-area=PWM_EXCLUSIVE_AREA_33, implemented-entry=Flexio_Pwm_Ip_UpdatePeriodDuty
        Pwm_DeInit: implemented-entry=Pwm_DeInit
        Pwm_DisableNotification: can-enter-exclusive-area=[PWM_EXCLUSIVE_AREA_23, PWM_EXCLUSIVE_AREA_34], implemented-entry=Pwm_DisableNotification
        Pwm_EnableNotification: can-enter-exclusive-area=[PWM_EXCLUSIVE_AREA_23, PWM_EXCLUSIVE_AREA_34], implemented-entry=Pwm_EnableNotification
        Pwm_GetChannelState: implemented-entry=Pwm_GetChannelState
        Pwm_GetCurrentPowerState: implemented-entry=Pwm_GetCurrentPowerState
        Pwm_GetOutputState: implemented-entry=Pwm_GetOutputState
        Pwm_GetTargetPowerState: implemented-entry=Pwm_GetTargetPowerState
        Pwm_GetVersionInfo: implemented-entry=Pwm_GetVersionInfo
        Pwm_Init: implemented-entry=Pwm_Init
        Pwm_Notification: implemented-entry=Pwm_Notification
        Pwm_PreparePowerState: implemented-entry=Pwm_PreparePowerState
        Pwm_SetChannelDeadTime: can-enter-exclusive-area=PWM_EXCLUSIVE_AREA_19, implemented-entry=Pwm_SetChannelDeadTime
        Pwm_SetChannelOutput: can-enter-exclusive-area=[PWM_EXCLUSIVE_AREA_14, PWM_EXCLUSIVE_AREA_15], implemented-entry=Pwm_SetChannelOutput
        Pwm_SetClockMode: can-enter-exclusive-area=[PWM_EXCLUSIVE_AREA_28, PWM_EXCLUSIVE_AREA_31], implemented-entry=Pwm_SetClockMode
        Pwm_SetCounterBus: can-enter-exclusive-area=PWM_EXCLUSIVE_AREA_27, implemented-entry=Pwm_SetCounterBus
        Pwm_SetDutyCycle: can-enter-exclusive-area=[PWM_EXCLUSIVE_AREA_17, PWM_EXCLUSIVE_AREA_25, PWM_EXCLUSIVE_AREA_33], implemented-entry=Pwm_SetDutyCycle
        Pwm_SetDutyCycle_NoUpdate: can-enter-exclusive-area=[PWM_EXCLUSIVE_AREA_17, PWM_EXCLUSIVE_AREA_25, PWM_EXCLUSIVE_AREA_30], implemented-entry=Pwm_SetDutyCycle_NoUpdate
        Pwm_SetDutyPhaseShift: can-enter-exclusive-area=[PWM_EXCLUSIVE_AREA_17, PWM_EXCLUSIVE_AREA_18, PWM_EXCLUSIVE_AREA_29, PWM_EXCLUSIVE_AREA_30], implemented-entry=Pwm_SetDutyPhaseShift
        Pwm_SetOutputToIdle: can-enter-exclusive-area=[PWM_EXCLUSIVE_AREA_24, PWM_EXCLUSIVE_AREA_32], implemented-entry=Pwm_SetOutputToIdle
        Pwm_SetPeriodAndDuty: can-enter-exclusive-area=[PWM_EXCLUSIVE_AREA_16, PWM_EXCLUSIVE_AREA_17, PWM_EXCLUSIVE_AREA_25, PWM_EXCLUSIVE_AREA_33], implemented-entry=Pwm_SetPeriodAndDuty
        Pwm_SetPeriodAndDuty_NoUpdate: can-enter-exclusive-area=[PWM_EXCLUSIVE_AREA_16, PWM_EXCLUSIVE_AREA_17, PWM_EXCLUSIVE_AREA_25, PWM_EXCLUSIVE_AREA_30], implemented-entry=Pwm_SetPeriodAndDuty_NoUpdate
        Pwm_SetPhaseShift: implemented-entry=Pwm_SetPhaseShift
        Pwm_SetPhaseShift_NoUpdate: implemented-entry=Pwm_SetPhaseShift_NoUpdate
        Pwm_SetPowerState: can-enter-exclusive-area=PWM_EXCLUSIVE_AREA_26, implemented-entry=Pwm_SetPowerState
        Pwm_SetTriggerDelay: can-enter-exclusive-area=PWM_EXCLUSIVE_AREA_20, implemented-entry=Pwm_SetTriggerDelay
        Pwm_SyncUpdate: implemented-entry=Pwm_SyncUpdate
      13 x bsw interrupt entity, all with interrupt-category=CAT-2, interrupt-source=Hardware:
        FLEXPWM_IP_FAULT_ISR: implemented-entry=FLEXPWM_IP_FAULT_ISR
        FLEXPWM_IP_INS_0_SUBMOD_{0..3}_CMP_ISR: implemented-entry=FLEXPWM_IP_INS_0_SUBMOD_{0..3}_CMP_ISR
        FLEXPWM_IP_INS_1_SUBMOD_{0..3}_CMP_ISR: implemented-entry=FLEXPWM_IP_INS_1_SUBMOD_{0..3}_CMP_ISR
        FLEXPWM_IP_INS_2_SUBMOD_{0..3}_CMP_ISR: implemented-entry=FLEXPWM_IP_INS_2_SUBMOD_{0..3}_CMP_ISR
package /AUTOSAR_Pwm/BswModuleEntrys
  65 x bsw module entry, all with sw-service-impl-policy=STANDARD:
    Emios_Pwm_Ip_ChannelEnterDebugMode: service-id=0x50, is-reentrant=true, is-synchronous=true, call-type=REGULAR, execution-context=UNSPECIFIED
    Emios_Pwm_Ip_ChannelStopDebugMode: service-id=0x51, is-reentrant=true, is-synchronous=true, call-type=REGULAR, execution-context=UNSPECIFIED
    Emios_Pwm_Ip_DeInitChannel: service-id=0x4f, is-reentrant=true, is-synchronous=true, call-type=REGULAR, execution-context=UNSPECIFIED
    Emios_Pwm_Ip_ForceMatchLeadingEdge: service-id=0x41, is-reentrant=true, is-synchronous=true, call-type=REGULAR, execution-context=UNSPECIFIED
    Emios_Pwm_Ip_ForceMatchTrailingEdge: service-id=0x42, is-reentrant=true, is-synchronous=true, call-type=REGULAR, execution-context=UNSPECIFIED
    Emios_Pwm_Ip_GetDeadTime: service-id=0x4e, is-reentrant=true, is-synchronous=true, call-type=REGULAR, execution-context=UNSPECIFIED
    Emios_Pwm_Ip_GetDutyCycle: service-id=0x44, is-reentrant=true, is-synchronous=true, call-type=REGULAR, execution-context=UNSPECIFIED
    Emios_Pwm_Ip_GetFlagRequest: service-id=0x53, is-reentrant=true, is-synchronous=true, call-type=REGULAR, execution-context=UNSPECIFIED
    Emios_Pwm_Ip_GetPeriod: service-id=0x46, is-reentrant=true, is-synchronous=true, call-type=REGULAR, execution-context=UNSPECIFIED
    Emios_Pwm_Ip_GetPhaseShift: service-id=0x48, is-reentrant=true, is-synchronous=true, call-type=REGULAR, execution-context=UNSPECIFIED
    Emios_Pwm_Ip_GetTriggerPlacement: service-id=0x4c, is-reentrant=true, is-synchronous=true, call-type=REGULAR, execution-context=UNSPECIFIED
    Emios_Pwm_Ip_InitChannel: service-id=0x40, is-reentrant=true, is-synchronous=true, call-type=REGULAR, execution-context=UNSPECIFIED
    Emios_Pwm_Ip_SetDeadTime: service-id=0x4d, is-reentrant=true, is-synchronous=true, call-type=REGULAR, execution-context=UNSPECIFIED
    Emios_Pwm_Ip_SetDutyCycle: service-id=0x43, is-reentrant=true, is-synchronous=true, call-type=REGULAR, execution-context=UNSPECIFIED
    Emios_Pwm_Ip_SetFlagRequest: service-id=0x52, is-reentrant=true, is-synchronous=true, call-type=REGULAR, execution-context=UNSPECIFIED
    Emios_Pwm_Ip_SetPeriod: service-id=0x45, is-reentrant=true, is-synchronous=true, call-type=REGULAR, execution-context=UNSPECIFIED
    Emios_Pwm_Ip_SetPhaseShift: service-id=0x47, is-reentrant=true, is-synchronous=true, call-type=REGULAR, execution-context=UNSPECIFIED
    Emios_Pwm_Ip_SetTriggerPlacement: service-id=0x4b, is-reentrant=true, is-synchronous=true, call-type=REGULAR, execution-context=UNSPECIFIED
    Flexio_Pwm_Ip_DeInitChannel: service-id=0x61, is-reentrant=true, is-synchronous=true, call-type=REGULAR, execution-context=UNSPECIFIED
    Flexio_Pwm_Ip_ForceOuputLevel: service-id=0x63, is-reentrant=true, is-synchronous=true, call-type=REGULAR, execution-context=UNSPECIFIED
    Flexio_Pwm_Ip_GetOutputState: service-id=0x65, is-reentrant=true, is-synchronous=true, call-type=REGULAR, execution-context=UNSPECIFIED
    Flexio_Pwm_Ip_GetPeriod: service-id=0x67, is-reentrant=true, is-synchronous=true, call-type=REGULAR, execution-context=UNSPECIFIED
    Flexio_Pwm_Ip_InitChannel: service-id=0x60, is-reentrant=true, is-synchronous=true, call-type=REGULAR, execution-context=UNSPECIFIED
    Flexio_Pwm_Ip_UpdateClockPrescaler: service-id=0x62, is-reentrant=true, is-synchronous=true, call-type=REGULAR, execution-context=UNSPECIFIED
    Flexio_Pwm_Ip_UpdateInterruptMode: service-id=0x66, is-reentrant=true, is-synchronous=true, call-type=REGULAR, execution-context=UNSPECIFIED
    Flexio_Pwm_Ip_UpdatePeriodDuty: service-id=0x64, is-reentrant=true, is-synchronous=true, call-type=REGULAR, execution-context=UNSPECIFIED
    Pwm_DeInit: service-id=0x01, is-reentrant=false, is-synchronous=true, call-type=REGULAR, execution-context=UNSPECIFIED
    Pwm_DisableNotification: service-id=0x06, is-reentrant=false, is-synchronous=false, call-type=REGULAR, execution-context=UNSPECIFIED
    Pwm_EnableNotification: service-id=0x07, is-reentrant=false, is-synchronous=false, call-type=REGULAR, execution-context=UNSPECIFIED
    Pwm_GetChannelState: service-id=0x20, is-reentrant=true, is-synchronous=true, call-type=REGULAR, execution-context=UNSPECIFIED
    Pwm_GetCurrentPowerState: service-id=0x0a, is-reentrant=false, is-synchronous=true, call-type=REGULAR, execution-context=UNSPECIFIED
    Pwm_GetOutputState: service-id=0x05, is-reentrant=false, is-synchronous=true, call-type=REGULAR, execution-context=UNSPECIFIED
    Pwm_GetTargetPowerState: service-id=0x0b, is-reentrant=false, is-synchronous=true, call-type=REGULAR, execution-context=UNSPECIFIED
    Pwm_GetVersionInfo: service-id=0x08, is-reentrant=true, is-synchronous=true, call-type=REGULAR, execution-context=UNSPECIFIED
    Pwm_Init: service-id=0x00, is-reentrant=false, is-synchronous=true, call-type=REGULAR, execution-context=UNSPECIFIED
    Pwm_Notification: service-id=0x00, is-reentrant=false, is-synchronous=true, call-type=REGULAR, execution-context=UNSPECIFIED
    Pwm_PreparePowerState: service-id=0x0c, is-reentrant=false, is-synchronous=true, call-type=REGULAR, execution-context=UNSPECIFIED
    Pwm_SetChannelDeadTime: service-id=0x2b, is-reentrant=true, is-synchronous=true, call-type=REGULAR, execution-context=UNSPECIFIED
    Pwm_SetChannelOutput: service-id=0x23, is-reentrant=true, is-synchronous=true, call-type=REGULAR, execution-context=UNSPECIFIED
    Pwm_SetClockMode: service-id=0x27, is-reentrant=true, is-synchronous=true, call-type=REGULAR, execution-context=UNSPECIFIED
    Pwm_SetCounterBus: service-id=0x22, is-reentrant=true, is-synchronous=true, call-type=REGULAR, execution-context=UNSPECIFIED
    Pwm_SetDutyCycle: service-id=0x02, is-reentrant=false, is-synchronous=false, call-type=REGULAR, execution-context=UNSPECIFIED
    Pwm_SetDutyCycle_NoUpdate: service-id=0x2a, is-reentrant=true, is-synchronous=true, call-type=REGULAR, execution-context=UNSPECIFIED
    Pwm_SetDutyPhaseShift: service-id=0x37, is-reentrant=true, is-synchronous=true, call-type=REGULAR, execution-context=UNSPECIFIED
    Pwm_SetOutputToIdle: service-id=0x04, is-reentrant=false, is-synchronous=false, call-type=REGULAR, execution-context=UNSPECIFIED
    Pwm_SetPeriodAndDuty: service-id=0x03, is-reentrant=false, is-synchronous=false, call-type=REGULAR, execution-context=UNSPECIFIED
    Pwm_SetPeriodAndDuty_NoUpdate: service-id=0x29, is-reentrant=true, is-synchronous=true, call-type=REGULAR, execution-context=UNSPECIFIED
    Pwm_SetPhaseShift: service-id=0x2c, is-reentrant=true, is-synchronous=true, call-type=REGULAR, execution-context=UNSPECIFIED
    Pwm_SetPhaseShift_NoUpdate: service-id=0x2d, is-reentrant=true, is-synchronous=true, call-type=REGULAR, execution-context=UNSPECIFIED
    Pwm_SetPowerState: service-id=0x09, is-reentrant=false, is-synchronous=true, call-type=REGULAR, execution-context=UNSPECIFIED
    Pwm_SetTriggerDelay: service-id=0x24, is-reentrant=true, is-synchronous=true, call-type=REGULAR, execution-context=UNSPECIFIED
    Pwm_SyncUpdate: service-id=0x28, is-reentrant=true, is-synchronous=true, call-type=REGULAR, execution-context=UNSPECIFIED
    FLEXPWM_IP_FAULT_ISR: service-id=0, is-reentrant=false, is-synchronous=true, call-type=INTERRUPT, execution-context=INTERRUPT-CAT-2
    FLEXPWM_IP_INS_0_SUBMOD_{0..3}_CMP_ISR: service-id=0, is-reentrant=false, is-synchronous=true, call-type=INTERRUPT, execution-context=INTERRUPT-CAT-2
    FLEXPWM_IP_INS_1_SUBMOD_{0..3}_CMP_ISR: service-id=0, is-reentrant=false, is-synchronous=true, call-type=INTERRUPT, execution-context=INTERRUPT-CAT-2
    FLEXPWM_IP_INS_2_SUBMOD_{0..3}_CMP_ISR: service-id=0, is-reentrant=false, is-synchronous=true, call-type=INTERRUPT, execution-context=INTERRUPT-CAT-2
package /Pwm_TS_T40D34M30I0R0/Implementations
  bsw implementation BswImplementation_Pwm: programming-language=C, sw-version=3.0.0, vendor-id=43, ar-release-version=4.7.0, behavior=InternalBehavior_Pwm, vendor-specific-module-def=Pwm
    code-descriptors:
      code Files
        artifact-descriptors:
          short-label=config::Pwm.xdm, category=SWCFG
          short-label=doc::RTD_PWM_IM.pdf, category=SWDOC
          short-label=doc::RTD_PWM_UM.pdf, category=SWDOC
          short-label=examples::EBT::S32K358::Pwm_example_S32K358::generate::epc::BaseNXP.xdm, category=SWCFG
          short-label=examples::EBT::S32K358::Pwm_example_S32K358::generate::epc::Dem.xdm, category=SWCFG
          short-label=examples::EBT::S32K358::Pwm_example_S32K358::generate::epc::Dio.xdm, category=SWCFG
          short-label=examples::EBT::S32K358::Pwm_example_S32K358::generate::epc::Ecuc.xdm, category=SWCFG
          short-label=examples::EBT::S32K358::Pwm_example_S32K358::generate::epc::Mcl.xdm, category=SWCFG
          short-label=examples::EBT::S32K358::Pwm_example_S32K358::generate::epc::Mcu.xdm, category=SWCFG
          short-label=examples::EBT::S32K358::Pwm_example_S32K358::generate::epc::Platform.xdm, category=SWCFG
          short-label=examples::EBT::S32K358::Pwm_example_S32K358::generate::epc::Port.xdm, category=SWCFG
          short-label=examples::EBT::S32K358::Pwm_example_S32K358::generate::epc::Pwm.xdm, category=SWCFG
          short-label=examples::EBT::S32K358::Pwm_example_S32K358::generate::epc::Resource.xdm, category=SWCFG
          short-label=examples::EBT::S32K358::Pwm_example_S32K358::include::check_example.h, category=SWHDR
          short-label=examples::EBT::S32K358::Pwm_example_S32K358::src::main.c, category=SWSRC
          short-label=examples::EBT::S32K358::Pwm_example_S32K358::TresosProject::Pwm_example_S32K358::.prefs::preferences.xdm, category=SWCFG
          short-label=examples::EBT::S32K358::Pwm_example_S32K358::TresosProject::Pwm_example_S32K358::config::BaseNXP.xdm, category=SWCFG
          short-label=examples::EBT::S32K358::Pwm_example_S32K358::TresosProject::Pwm_example_S32K358::config::Dem.xdm, category=SWCFG
          short-label=examples::EBT::S32K358::Pwm_example_S32K358::TresosProject::Pwm_example_S32K358::config::Dio.xdm, category=SWCFG
          short-label=examples::EBT::S32K358::Pwm_example_S32K358::TresosProject::Pwm_example_S32K358::config::Ecuc.xdm, category=SWCFG
          short-label=examples::EBT::S32K358::Pwm_example_S32K358::TresosProject::Pwm_example_S32K358::config::Mcl.xdm, category=SWCFG
          short-label=examples::EBT::S32K358::Pwm_example_S32K358::TresosProject::Pwm_example_S32K358::config::Mcu.xdm, category=SWCFG
          short-label=examples::EBT::S32K358::Pwm_example_S32K358::TresosProject::Pwm_example_S32K358::config::Platform.xdm, category=SWCFG
          short-label=examples::EBT::S32K358::Pwm_example_S32K358::TresosProject::Pwm_example_S32K358::config::Port.xdm, category=SWCFG
          short-label=examples::EBT::S32K358::Pwm_example_S32K358::TresosProject::Pwm_example_S32K358::config::Pwm.xdm, category=SWCFG
          short-label=examples::EBT::S32K358::Pwm_example_S32K358::TresosProject::Pwm_example_S32K358::config::Resource.xdm, category=SWCFG
          short-label=examples::EBT::S32K396::Pwm_example_S32K396::generate::epc::BaseNXP.xdm, category=SWCFG
          short-label=examples::EBT::S32K396::Pwm_example_S32K396::generate::epc::Dem.xdm, category=SWCFG
          short-label=examples::EBT::S32K396::Pwm_example_S32K396::generate::epc::Dio.xdm, category=SWCFG
          short-label=examples::EBT::S32K396::Pwm_example_S32K396::generate::epc::Ecuc.xdm, category=SWCFG
          short-label=examples::EBT::S32K396::Pwm_example_S32K396::generate::epc::Mcl.xdm, category=SWCFG
          short-label=examples::EBT::S32K396::Pwm_example_S32K396::generate::epc::Mcu.xdm, category=SWCFG
          short-label=examples::EBT::S32K396::Pwm_example_S32K396::generate::epc::Port.xdm, category=SWCFG
          short-label=examples::EBT::S32K396::Pwm_example_S32K396::generate::epc::Pwm.xdm, category=SWCFG
          short-label=examples::EBT::S32K396::Pwm_example_S32K396::generate::epc::Resource.xdm, category=SWCFG
          short-label=examples::EBT::S32K396::Pwm_example_S32K396::include::check_example.h, category=SWHDR
          short-label=examples::EBT::S32K396::Pwm_example_S32K396::src::main.c, category=SWSRC
          short-label=examples::EBT::S32K396::Pwm_example_S32K396::TresosProject::Pwm_example_S32K396::.prefs::preferences.xdm, category=SWCFG
          short-label=examples::EBT::S32K396::Pwm_example_S32K396::TresosProject::Pwm_example_S32K396::config::BaseNXP.xdm, category=SWCFG
          short-label=examples::EBT::S32K396::Pwm_example_S32K396::TresosProject::Pwm_example_S32K396::config::Dem.xdm, category=SWCFG
          short-label=examples::EBT::S32K396::Pwm_example_S32K396::TresosProject::Pwm_example_S32K396::config::Dio.xdm, category=SWCFG
          short-label=examples::EBT::S32K396::Pwm_example_S32K396::TresosProject::Pwm_example_S32K396::config::Ecuc.xdm, category=SWCFG
          short-label=examples::EBT::S32K396::Pwm_example_S32K396::TresosProject::Pwm_example_S32K396::config::Mcl.xdm, category=SWCFG
          short-label=examples::EBT::S32K396::Pwm_example_S32K396::TresosProject::Pwm_example_S32K396::config::Mcu.xdm, category=SWCFG
          short-label=examples::EBT::S32K396::Pwm_example_S32K396::TresosProject::Pwm_example_S32K396::config::Port.xdm, category=SWCFG
          short-label=examples::EBT::S32K396::Pwm_example_S32K396::TresosProject::Pwm_example_S32K396::config::Pwm.xdm, category=SWCFG
          short-label=examples::EBT::S32K396::Pwm_example_S32K396::TresosProject::Pwm_example_S32K396::config::Resource.xdm, category=SWCFG
          short-label=examples::EBT::S32K3XX::Pwm_example_S32K344::generate::epc::BaseNXP.xdm, category=SWCFG
          short-label=examples::EBT::S32K3XX::Pwm_example_S32K344::generate::epc::Dem.xdm, category=SWCFG
          short-label=examples::EBT::S32K3XX::Pwm_example_S32K344::generate::epc::Dio.xdm, category=SWCFG
          short-label=examples::EBT::S32K3XX::Pwm_example_S32K344::generate::epc::Ecuc.xdm, category=SWCFG
          short-label=examples::EBT::S32K3XX::Pwm_example_S32K344::generate::epc::Mcl.xdm, category=SWCFG
          short-label=examples::EBT::S32K3XX::Pwm_example_S32K344::generate::epc::Mcu.xdm, category=SWCFG
          short-label=examples::EBT::S32K3XX::Pwm_example_S32K344::generate::epc::Platform.xdm, category=SWCFG
          short-label=examples::EBT::S32K3XX::Pwm_example_S32K344::generate::epc::Port.xdm, category=SWCFG
          short-label=examples::EBT::S32K3XX::Pwm_example_S32K344::generate::epc::Pwm.xdm, category=SWCFG
          short-label=examples::EBT::S32K3XX::Pwm_example_S32K344::generate::epc::Resource.xdm, category=SWCFG
          short-label=examples::EBT::S32K3XX::Pwm_example_S32K344::include::check_example.h, category=SWHDR
          short-label=examples::EBT::S32K3XX::Pwm_example_S32K344::src::main.c, category=SWSRC
          short-label=examples::EBT::S32K3XX::Pwm_example_S32K344::TresosProject::Pwm_example_S32K344::.prefs::preferences.xdm, category=SWCFG
          short-label=examples::EBT::S32K3XX::Pwm_example_S32K344::TresosProject::Pwm_example_S32K344::config::BaseNXP.xdm, category=SWCFG
          short-label=examples::EBT::S32K3XX::Pwm_example_S32K344::TresosProject::Pwm_example_S32K344::config::Dem.xdm, category=SWCFG
          short-label=examples::EBT::S32K3XX::Pwm_example_S32K344::TresosProject::Pwm_example_S32K344::config::Dio.xdm, category=SWCFG
          short-label=examples::EBT::S32K3XX::Pwm_example_S32K344::TresosProject::Pwm_example_S32K344::config::Ecuc.xdm, category=SWCFG
          short-label=examples::EBT::S32K3XX::Pwm_example_S32K344::TresosProject::Pwm_example_S32K344::config::Mcl.xdm, category=SWCFG
          short-label=examples::EBT::S32K3XX::Pwm_example_S32K344::TresosProject::Pwm_example_S32K344::config::Mcu.xdm, category=SWCFG
          short-label=examples::EBT::S32K3XX::Pwm_example_S32K344::TresosProject::Pwm_example_S32K344::config::Platform.xdm, category=SWCFG
          short-label=examples::EBT::S32K3XX::Pwm_example_S32K344::TresosProject::Pwm_example_S32K344::config::Port.xdm, category=SWCFG
          short-label=examples::EBT::S32K3XX::Pwm_example_S32K344::TresosProject::Pwm_example_S32K344::config::Pwm.xdm, category=SWCFG
          short-label=examples::EBT::S32K3XX::Pwm_example_S32K344::TresosProject::Pwm_example_S32K344::config::Resource.xdm, category=SWCFG
          short-label=examples::S32DS::S32K358::Emios_Pwm_Ip_Example_S32K358::include::check_example.h, category=SWHDR
          short-label=examples::S32DS::S32K358::Emios_Pwm_Ip_Example_S32K358::Project_Settings::Startup_Code::exceptions.c, category=SWSRC
          short-label=examples::S32DS::S32K358::Emios_Pwm_Ip_Example_S32K358::Project_Settings::Startup_Code::nvic.c, category=SWSRC
          short-label=examples::S32DS::S32K358::Emios_Pwm_Ip_Example_S32K358::Project_Settings::Startup_Code::startup.c, category=SWSRC
          short-label=examples::S32DS::S32K358::Emios_Pwm_Ip_Example_S32K358::Project_Settings::Startup_Code::system.c, category=SWSRC
          short-label=examples::S32DS::S32K358::Emios_Pwm_Ip_Example_S32K358::src::main.c, category=SWSRC
          short-label=examples::S32DS::S32K358::Flexio_Pwm_Ip_Example_S32K358::include::check_example.h, category=SWHDR
          short-label=examples::S32DS::S32K358::Flexio_Pwm_Ip_Example_S32K358::Project_Settings::Startup_Code::exceptions.c, category=SWSRC
          short-label=examples::S32DS::S32K358::Flexio_Pwm_Ip_Example_S32K358::Project_Settings::Startup_Code::nvic.c, category=SWSRC
          short-label=examples::S32DS::S32K358::Flexio_Pwm_Ip_Example_S32K358::Project_Settings::Startup_Code::startup.c, category=SWSRC
          short-label=examples::S32DS::S32K358::Flexio_Pwm_Ip_Example_S32K358::Project_Settings::Startup_Code::system.c, category=SWSRC
          short-label=examples::S32DS::S32K358::Flexio_Pwm_Ip_Example_S32K358::src::main.c, category=SWSRC
          short-label=examples::S32DS::S32K358::Pwm_example_S32K358::include::check_example.h, category=SWHDR
          short-label=examples::S32DS::S32K358::Pwm_example_S32K358::Project_Settings::Startup_Code::exceptions.c, category=SWSRC
          short-label=examples::S32DS::S32K358::Pwm_example_S32K358::Project_Settings::Startup_Code::nvic.c, category=SWSRC
          short-label=examples::S32DS::S32K358::Pwm_example_S32K358::Project_Settings::Startup_Code::startup.c, category=SWSRC
          short-label=examples::S32DS::S32K358::Pwm_example_S32K358::Project_Settings::Startup_Code::system.c, category=SWSRC
          short-label=examples::S32DS::S32K358::Pwm_example_S32K358::src::main.c, category=SWSRC
          short-label=examples::S32DS::S32K396::Emios_Pwm_Ip_Example_S32K396::include::check_example.h, category=SWHDR
          short-label=examples::S32DS::S32K396::Emios_Pwm_Ip_Example_S32K396::Project_Settings::Startup_Code::exceptions.c, category=SWSRC
          short-label=examples::S32DS::S32K396::Emios_Pwm_Ip_Example_S32K396::Project_Settings::Startup_Code::nvic.c, category=SWSRC
          short-label=examples::S32DS::S32K396::Emios_Pwm_Ip_Example_S32K396::Project_Settings::Startup_Code::startup.c, category=SWSRC
          short-label=examples::S32DS::S32K396::Emios_Pwm_Ip_Example_S32K396::Project_Settings::Startup_Code::system.c, category=SWSRC
          short-label=examples::S32DS::S32K396::Emios_Pwm_Ip_Example_S32K396::src::main.c, category=SWSRC
          short-label=examples::S32DS::S32K396::Flexio_Pwm_Ip_Example_S32K396::include::check_example.h, category=SWHDR
          short-label=examples::S32DS::S32K396::Flexio_Pwm_Ip_Example_S32K396::Project_Settings::Startup_Code::exceptions.c, category=SWSRC
          short-label=examples::S32DS::S32K396::Flexio_Pwm_Ip_Example_S32K396::Project_Settings::Startup_Code::nvic.c, category=SWSRC
          short-label=examples::S32DS::S32K396::Flexio_Pwm_Ip_Example_S32K396::Project_Settings::Startup_Code::startup.c, category=SWSRC
          short-label=examples::S32DS::S32K396::Flexio_Pwm_Ip_Example_S32K396::Project_Settings::Startup_Code::system.c, category=SWSRC
          short-label=examples::S32DS::S32K396::Flexio_Pwm_Ip_Example_S32K396::src::main.c, category=SWSRC
          short-label=examples::S32DS::S32K396::Pwm_example_S32K396::include::check_example.h, category=SWHDR
          short-label=examples::S32DS::S32K396::Pwm_example_S32K396::Project_Settings::Startup_Code::exceptions.c, category=SWSRC
          short-label=examples::S32DS::S32K396::Pwm_example_S32K396::Project_Settings::Startup_Code::nvic.c, category=SWSRC
          short-label=examples::S32DS::S32K396::Pwm_example_S32K396::Project_Settings::Startup_Code::startup.c, category=SWSRC
          short-label=examples::S32DS::S32K396::Pwm_example_S32K396::Project_Settings::Startup_Code::system.c, category=SWSRC
          short-label=examples::S32DS::S32K396::Pwm_example_S32K396::src::main.c, category=SWSRC
          short-label=examples::S32DS::S32K3XX::Emios_Pwm_Ip_Example_S32K344::include::check_example.h, category=SWHDR
          short-label=examples::S32DS::S32K3XX::Emios_Pwm_Ip_Example_S32K344::Project_Settings::Startup_Code::exceptions.c, category=SWSRC
          short-label=examples::S32DS::S32K3XX::Emios_Pwm_Ip_Example_S32K344::Project_Settings::Startup_Code::nvic.c, category=SWSRC
          short-label=examples::S32DS::S32K3XX::Emios_Pwm_Ip_Example_S32K344::Project_Settings::Startup_Code::startup.c, category=SWSRC
          short-label=examples::S32DS::S32K3XX::Emios_Pwm_Ip_Example_S32K344::Project_Settings::Startup_Code::system.c, category=SWSRC
          short-label=examples::S32DS::S32K3XX::Emios_Pwm_Ip_Example_S32K344::src::main.c, category=SWSRC
          short-label=examples::S32DS::S32K3XX::Flexio_Pwm_Ip_Example_S32K344::include::check_example.h, category=SWHDR
          short-label=examples::S32DS::S32K3XX::Flexio_Pwm_Ip_Example_S32K344::Project_Settings::Startup_Code::exceptions.c, category=SWSRC
          short-label=examples::S32DS::S32K3XX::Flexio_Pwm_Ip_Example_S32K344::Project_Settings::Startup_Code::nvic.c, category=SWSRC
          short-label=examples::S32DS::S32K3XX::Flexio_Pwm_Ip_Example_S32K344::Project_Settings::Startup_Code::startup.c, category=SWSRC
          short-label=examples::S32DS::S32K3XX::Flexio_Pwm_Ip_Example_S32K344::Project_Settings::Startup_Code::system.c, category=SWSRC
          short-label=examples::S32DS::S32K3XX::Flexio_Pwm_Ip_Example_S32K344::src::main.c, category=SWSRC
          short-label=examples::S32DS::S32K3XX::Pwm_example_S32K344::include::check_example.h, category=SWHDR
          short-label=examples::S32DS::S32K3XX::Pwm_example_S32K344::Project_Settings::Startup_Code::exceptions.c, category=SWSRC
          short-label=examples::S32DS::S32K3XX::Pwm_example_S32K344::Project_Settings::Startup_Code::nvic.c, category=SWSRC
          short-label=examples::S32DS::S32K3XX::Pwm_example_S32K344::Project_Settings::Startup_Code::startup.c, category=SWSRC
          short-label=examples::S32DS::S32K3XX::Pwm_example_S32K344::Project_Settings::Startup_Code::system.c, category=SWSRC
          short-label=examples::S32DS::S32K3XX::Pwm_example_S32K344::src::main.c, category=SWSRC
          short-label=include::Emios_Pwm_Ip.h, category=SWHDR
          short-label=include::Emios_Pwm_Ip_HwAccess.h, category=SWHDR
          short-label=include::Emios_Pwm_Ip_Irq.h, category=SWHDR
          short-label=include::Emios_Pwm_Ip_Types.h, category=SWHDR
          short-label=include::Flexio_Pwm_Ip.h, category=SWHDR
          short-label=include::Flexio_Pwm_Ip_HwAccess.h, category=SWHDR
          short-label=include::Flexio_Pwm_Ip_Irq.h, category=SWHDR
          short-label=include::Flexio_Pwm_Ip_Types.h, category=SWHDR
          short-label=include::FlexPwm_Ip.h, category=SWHDR
          short-label=include::FlexPwm_Ip_HwAccess.h, category=SWHDR
          short-label=include::FlexPwm_Ip_Irq.h, category=SWHDR
          short-label=include::FlexPwm_Ip_TrustedFunctions.h, category=SWHDR
          short-label=include::FlexPwm_Ip_Types.h, category=SWHDR
          short-label=include::Pwm.h, category=SWHDR
          short-label=include::Pwm_EnvCfg.h, category=SWHDR
          short-label=include::Pwm_Ipw.h, category=SWHDR
          short-label=include::Pwm_Ipw_Irq.h, category=SWHDR
          short-label=include::Pwm_Ipw_Types.h, category=SWHDR
          short-label=include::Pwm_Notif.h, category=SWHDR
          short-label=src::Emios_Pwm_Ip.c, category=SWSRC
          short-label=src::Emios_Pwm_Ip_Irq.c, category=SWSRC
          short-label=src::Flexio_Pwm_Ip.c, category=SWSRC
          short-label=src::Flexio_Pwm_Ip_Irq.c, category=SWSRC
          short-label=src::FlexPwm_Ip.c, category=SWSRC
          short-label=src::FlexPwm_Ip_Irq.c, category=SWSRC
          short-label=src::Pwm.c, category=SWSRC
          short-label=src::Pwm_Ipw.c, category=SWSRC
          short-label=src::Pwm_Ipw_Irq.c, category=SWSRC
    4 x compiler:
      DIAB_Compiler:
        name=Windriver Diab
        options=-tARMCORTEXM7MG:simple -mthumb -std=c99 -Oz -g -fstandalone-debug -Wstrict-prototypes -Wsign-compare -Wdouble-promotion -Wunknown-pragmas -Wundef -Wextra -Wall -pedantic -Werror=implicit-function-declaration -fno-common -fno-signed-char -fno-trigraphs -V -c -DS32K3XX -D $ (DERIVATIVE) -DDIAB -DUSE_SW_VECTOR_MODE -DD_CACHE_ENABLE -DI_CACHE_ENABLE -DENABLE_FPU -DMCAL_ENABLE_USER_MODE_SUPPORT
        vendor=Windriver
        version=Wind River Diab Compiler v7.0.4
      GCC_Compiler:
        name=GCC Compiler
        options=-mcpu=cortex-m7 -mthumb -mlittle-endian -mfpu=fpv5-sp-d16 -mfloat-abi=hard -std=c99 -Os -ggdb3 -Wall -Wextra -pedantic -Wstrict-prototypes -Wundef -Wunused -Werror=implicit-function-declaration -Wsign-compare -Wdouble-promotion -fno-short-enums -funsigned-char -funsigned-bitfields -fno-common -fstack-usage -fdump-ipa-all -c -DS32K3XX -D $ (DERIVATIVE) -DGCC -DUSE_SW_VECTOR_MODE -DD_CACHE_ENABLE -DI_CACHE_ENABLE -DENABLE_FPU -DMCAL_ENABLE_USER_MODE_SUPPORT --sysroot=$(NEWLIB_DIR) -specs=nano.specs -specs=nosys.specs
        vendor=GCC Systems
        version=NXP GCC 10.2.0 20200723
      GHS_Compiler:
        name=Green Hills
        options=-cpu=cortexm7 -thumb -fpu=vfpv5_d16 -fsingle -C99 --ghstd=last -Osize --gnu_asm -dual_debug -G -keeptempfiles -Wimplicit-int -Wshadow -Wtrigraphs -Wundef --unsigned_chars --unsigned_fields --no_commons --no_exceptions --no_slash_comment --prototype_errors --incorrect_pragma_warnings -c -DS32K3XX -D $ (DERIVATIVE) -DGHS -DUSE_SW_VECTOR_MODE -DD_CACHE_ENABLE -DI_CACHE_ENABLE -DENABLE_FPU -DMCAL_ENABLE_USER_MODE_SUPPORT
        vendor=Green Hills
        version=Green Hills Multi 7.1.6d / Compiler 2021.1.4
      IAR_Compiler:
        name=IAR Compiler
        options=--cpu Cortex-M7 --cpu_mode thumb --endian little --fpu VFPv5-SP -e -Ohz --debug --no_clustering --no_mem_idioms --do_explicit_zero_opt_in_named_sections --require_prototypes --no_wrap_diagnostics --diag_suppress Pa050 -DS32K3XX -D $ (DERIVATIVE) -DIAR -DUSE_SW_VECTOR_MODE -DD_CACHE_ENABLE -DI_CACHE_ENABLE -DENABLE_FPU -DMCAL_ENABLE_USER_MODE_SUPPORT
        vendor=IAR Systems
        version=IAR ANSI C/C++ Compiler v.8.50.10 (safety version)
    generated-artifacts:
      16 x dependency on artifact:
        Emios_Pwm_Ip_PBcfg_h: artifact-descriptor={short-label=generate_PB::include::Emios_Pwm_Ip_PBcfg.h, category=SWHDR}, usages=EXECUTE
        Flexio_Pwm_Ip_PBcfg_h: artifact-descriptor={short-label=generate_PB::include::Flexio_Pwm_Ip_PBcfg.h, category=SWHDR}, usages=EXECUTE
        FlexPwm_Ip_PBcfg_h: artifact-descriptor={short-label=generate_PB::include::FlexPwm_Ip_PBcfg.h, category=SWHDR}, usages=EXECUTE
        Pwm_PBcfg_h: artifact-descriptor={short-label=generate_PB::include::Pwm_PBcfg.h, category=SWHDR}, usages=EXECUTE
        Emios_Pwm_Ip_PBcfg_c: artifact-descriptor={short-label=generate_PB::src::Emios_Pwm_Ip_PBcfg.c, category=SWSRC}, usages=EXECUTE
        Flexio_Pwm_Ip_PBcfg_c: artifact-descriptor={short-label=generate_PB::src::Flexio_Pwm_Ip_PBcfg.c, category=SWSRC}, usages=EXECUTE
        FlexPwm_Ip_PBcfg_c: artifact-descriptor={short-label=generate_PB::src::FlexPwm_Ip_PBcfg.c, category=SWSRC}, usages=EXECUTE
        Pwm_PBcfg_c: artifact-descriptor={short-label=generate_PB::src::Pwm_PBcfg.c, category=SWSRC}, usages=EXECUTE
        Emios_Pwm_Ip_Cfg_h: artifact-descriptor={short-label=generate_PC::include::Emios_Pwm_Ip_Cfg.h, category=SWHDR}, usages=COMPILE
        Emios_Pwm_Ip_CfgDefines_h: artifact-descriptor={short-label=generate_PC::include::Emios_Pwm_Ip_CfgDefines.h, category=SWHDR}, usages=COMPILE
        Flexio_Pwm_Ip_Cfg_h: artifact-descriptor={short-label=generate_PC::include::Flexio_Pwm_Ip_Cfg.h, category=SWHDR}, usages=COMPILE
        Flexio_Pwm_Ip_CfgDefines_h: artifact-descriptor={short-label=generate_PC::include::Flexio_Pwm_Ip_CfgDefines.h, category=SWHDR}, usages=COMPILE
        FlexPwm_Ip_Cfg_h: artifact-descriptor={short-label=generate_PC::include::FlexPwm_Ip_Cfg.h, category=SWHDR}, usages=COMPILE
        FlexPwm_Ip_CfgDefines_h: artifact-descriptor={short-label=generate_PC::include::FlexPwm_Ip_CfgDefines.h, category=SWHDR}, usages=COMPILE
        Pwm_Cfg_h: artifact-descriptor={short-label=generate_PC::include::Pwm_Cfg.h, category=SWHDR}, usages=COMPILE
        Pwm_Ipw_Cfg_h: artifact-descriptor={short-label=generate_PC::include::Pwm_Ipw_Cfg.h, category=SWHDR}, usages=COMPILE
    4 x linker:
      DIAB_Linker: name=Windriver Diab, options=-e Reset_Handler linker_script_file.dld -m30 -Xstack-usage -Xpreprocess-lecl -Llibrary_path -lc -lm -tARMCORTEXM7MG:simple, vendor=Windriver, version=Wind River Diab Compiler v7.0.4
      GCC_Linker: name=GCC Compiler, options=-Wl,-Map,filename -T linkerfile --entry=Reset_Handler -nostartfiles -mcpu=cortexm7 -mthumb -mfpu=fpv5-sp-d16 -mfloat-abi=hard -mlittle-endian -ggdb3 -lc -lm -lgcc -specs=nano.specs -specs=nosys.specs, vendor=GCC Systems, version=NXP GCC 10.2.0 20200723
      GHS_Linker: name=Green Hills, options=-e Reset_Handler -T linker_script_file.ld -map -keepmap -Mn -delete -ignore_debug_references -Llibrary_path -larch -lstartup -lind_sd -v -keep=C40_Ip_AccessCode -nostartfiles, vendor=Green Hills, version=Green Hills Multi 7.1.6d / Compiler 2021.1.4
      IAR_Linker: name=IAR Compiler, options=--map filename --config linkerfile --cpu=Cortex-M7 --fpu VFPv5-SP --entry _start --enable_stack_usage --skip_dynamic_initialization --no_wrap_diagnostics, vendor=IAR Systems, version=IAR ANSI C/C++ Compiler v.8.50.10 (safety version)
    resource consumption ResourceConsumption
      10 x memory section:
        PWM_CODE: alignment=UNSPECIFIED, sw-addrmethod=CODE, symbol=CODE
        PWM_CONFIG_DATA_UNSPECIFIED: alignment=UNSPECIFIED, sw-addrmethod=CONFIG_DATA, symbol=CONFIG_DATA_UNSPECIFIED
        PWM_CONST_UNSPECIFIED: alignment=UNSPECIFIED, sw-addrmethod=CONST, symbol=CONST_UNSPECIFIED
        PWM_VAR_CLEARED_16: alignment=16, sw-addrmethod=VAR_CLEARED, symbol=VAR_CLEARED_16
        PWM_VAR_CLEARED_32: alignment=32, sw-addrmethod=VAR_CLEARED, symbol=VAR_CLEARED_32
        PWM_VAR_CLEARED_8: alignment=8, sw-addrmethod=VAR_CLEARED, symbol=VAR_CLEARED_8
        PWM_VAR_CLEARED_UNSPECIFIED: alignment=UNSPECIFIED, sw-addrmethod=VAR_CLEARED, symbol=VAR_CLEARED_UNSPECIFIED
        PWM_VAR_INIT_32: alignment=32, sw-addrmethod=VAR_INIT, symbol=VAR_INIT_32
        PWM_VAR_INIT_8: alignment=8, sw-addrmethod=VAR_INIT, symbol=VAR_INIT_8
        PWM_VAR_INIT_UNSPECIFIED: alignment=UNSPECIFIED, sw-addrmethod=VAR_INIT, symbol=VAR_INIT_UNSPECIFIED
