AUTOSAR XML (schema 00047)
package /ArPackage_Xfrm
  bsw implementation BswImplementation_ComXf: programming-language=C, sw-version=1.0.11, vendor-id=76, ar-release-version=4.4.0, behavior=BswInternalBehavior_ComXf
  bsw module description ComXf: module-id=175
    bsw internal behavior BswInternalBehavior_ComXf
      bsw called entity BswCalledEntity_1: implemented-entry=ComXf_Inv_Com_ComISignalGroup_MsgGr_E2E_FD_CAN1_BSD_01_50ms_P11
      bsw called entity BswCalledEntity_2: implemented-entry=ComXf_Com_ComISignalGroup_MsgGr_E2E_FD_CAN1_TCU_01_10ms_P11
  bsw module entry ComXf_Inv_Com_ComISignalGroup_MsgGr_E2E_FD_CAN1_BSD_01_50ms_P11: service-id=4, is-reentrant=true, is-synchronous=true, call-type=REGULAR, execution-context=TASK, sw-service-impl-policy=STANDARD
  bsw module entry ComXf_Com_ComISignalGroup_MsgGr_E2E_FD_CAN1_TCU_01_10ms_P11: service-id=3, is-reentrant=true, is-synchronous=true, call-type=REGULAR, execution-context=TASK, sw-service-impl-policy=STANDARD
