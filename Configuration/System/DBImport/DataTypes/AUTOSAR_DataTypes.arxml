AUTOSAR XML (schema 00047)
standard types defined: void, sint8, sint16, sint32, uint8, uint16, uint32, sint8_least, sint16_least, sint32_least, uint8_least, uint16_least, uint32_least, float32, float64, boolean, uint64, sint64, Std_ReturnType
package /AUTOSAR_DataTypes/ImplementationDataTypes
  16 x impl type, all with category=VALUE, type-emitter=RTE:
    AUTOSAR_boolean: base-type=boolean, range raw 0..1
    AUTOSAR_float32: base-type=float32
    AUTOSAR_float64: base-type=float64
    AUTOSAR_sint16: base-type=sint16, range raw -32768..32767
    AUTOSAR_sint16_least: base-type=sint16_least, range raw -32768..32767
    AUTOSAR_sint32: base-type=sint32, range raw -2147483648..2147483647
    AUTOSAR_sint32_least: base-type=sint32_least, range raw -2147483648..2147483647
    AUTOSAR_sint8: base-type=sint8, range raw -128..127
    AUTOSAR_sint8_least: base-type=sint8_least, range raw -128..127
    AUTOSAR_uint16: base-type=uint16, range raw 0..65535
    AUTOSAR_uint16_least: base-type=uint16_least, range raw 0..65535
    AUTOSAR_uint32: base-type=uint32, range raw 0..4294967295
    AUTOSAR_uint32_least: base-type=uint32_least, range raw 0..4294967295
    AUTOSAR_uint8: base-type=uint8, range raw 0..255
    AUTOSAR_uint8_least: base-type=uint8_least, range raw 0..255
    AUTOSAR_sint64: base-type=sint64, range raw -9223372036854775808..2147483647
package /AUTOSAR_DataTypes/CompuMethods
  compu method boolean_Literals: 0=FALSE, 1=TRUE
package /AUTOSAR_DataTypes/Std/ImplementationDataTypes
  impl type Std_VersionInfoType: category=STRUCTURE, type-emitter=Std_Types.h  # Standard Version Info Type | This type shall be used to request the version of a BSW module using the <Module name>_GetVersionInfo() function.
    5 x element, all with category=TYPE_REFERENCE:
      vendorID: implementation-data-type=uint16
      moduleID: implementation-data-type=uint16
      sw_major_version: implementation-data-type=uint8
      sw_minor_version: implementation-data-type=uint8
      sw_patch_version: implementation-data-type=uint8
