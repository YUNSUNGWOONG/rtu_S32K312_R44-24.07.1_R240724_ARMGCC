AUTOSAR XML (schema 00047)
package /AUTOSAR/Can_GeneralTypes/DataConstrs
  range CanTrcv_TrcvModeType: raw 0x00..2
  range CanTrcv_TrcvWakeupModeType: raw 0x00..0x02
  range CanTrcv_TrcvWakeupReasonType: raw 0x00..0x07
  range Can_ControllerStateType: raw 0x00..0x03
package /AUTOSAR/Can_GeneralTypes/CompuMethods
  compu method CanTrcv_TrcvModeType: 0x00=CANTRCV_TRCVMODE_NORMAL, 1=CANTRCV_TRCVMODE_SLEEP, 2=CANTRCV_TRCVMODE_STANDBY
  compu method CanTrcv_TrcvWakeupModeType: 0x00=CANTRCV_WUMODE_ENABLE, 0x01=CANTRCV_WUMODE_DISABLE, 0x02=CANTRCV_WUMODE_CLEAR
  compu method CanTrcv_TrcvWakeupReasonType: 0x00=CANTRCV_WU_ERROR, 0x01=CANTRCV_WU_NOT_SUPPORTED, 0x02=CANTRCV_WU_BY_BUS, 0x03=CANTRCV_WU_INTERNALLY, 0x04=CANTRCV_WU_RESET, 0x05=CANTRCV_WU_POWER_ON, 0x06=CANTRCV_WU_BY_PIN, 0x07=CANTRCV_WU_BY_SYSERR
  compu method Can_ControllerStateType: 0x00=CAN_CS_UNINIT, 0x01=CAN_CS_STARTED, 0x02=CAN_CS_STOPPED, 0x03=CAN_CS_SLEEP
package /AUTOSAR/Can_GeneralTypes/ImplementationDataTypes
  9 x impl type, all with type-emitter=Can_GeneralTypes.h:
    CanTrcv_TrcvModeType: implementation-data-type=uint8
    CanTrcv_TrcvWakeupModeType: implementation-data-type=uint8
    CanTrcv_TrcvWakeupReasonType: implementation-data-type=uint8
    Can_ControllerStateType: implementation-data-type=uint8
    Can_ErrorStateType: compu {0=CAN_ERRORSTATE_ACTIVE, 1=CAN_ERRORSTATE_PASSIVE, 2=CAN_ERRORSTATE_BUSOFF}, range raw 0..2, implementation-data-type=uint8
    Can_HwHandleType: implementation-data-type=uint16, implementation-data-type=uint8
    Can_HwType: category=STRUCTURE
      element CanId: implementation-data-type=Can_IdType
      element Hoh: implementation-data-type=Can_HwHandleType
      element ControllerId: implementation-data-type=uint8
    Can_IdType: implementation-data-type=uint32
    Can_PduType: category=STRUCTURE
      4 x element:
        swPduHandle: implementation-data-type=PduIdType
        length: implementation-data-type=uint8
        id: implementation-data-type=Can_IdType
        sdu: category=DATA_REFERENCE, sw-pointer-target-props={target-category=TYPE_REFERENCE, implementation-data-type=uint8}
package /Bsw_CanIf/ImplementationDataTypes
  13 x impl type:
    CanIf_ConfigType: category=STRUCTURE, type-emitter=CanIf.h
      element Dummy: category=VALUE, base-type=uint8
    CanIf_NotifStatusType: compu {0x00=CANIF_NO_NOTIFICATION, 1=CANIF_TX_RX_NOTIFICATION}, range raw 0x00..1, implementation-data-type=uint8, type-emitter=CanIf.h
    CanIf_PduModeType: compu {0x00=CANIF_OFFLINE, 0x01=CANIF_TX_OFFLINE, 0x02=CANIF_TX_OFFLINE_ACTIVE, 0x03=CANIF_ONLINE}, range raw 0x00..0x03, implementation-data-type=uint8, type-emitter=CanIf.h
    CanIf_TTErrorLevelEnumType: compu {0..3=CANIF_TT_ERROR_S0..CANIF_TT_ERROR_S3}, range raw 0..3, implementation-data-type=uint8, type-emitter=TTCanIf.h
    CanIf_TTErrorLevelType: category=STRUCTURE, type-emitter=TTCanIf.h
      element errorLevel: implementation-data-type=CanIf_TTErrorLevelEnumType
      element maxMessageStatusCount: implementation-data-type=uint8
      element minMessageStatusCount: implementation-data-type=uint8
    CanIf_TTEventEnumType: compu {0=CANIF_TT_ERROR_LEVEL_CHANGED, 1=CANIF_TT_INIT_WATCH_TRIGGER, 2=CANIF_TT_NO_ERROR, 3=CANIF_TT_SYNC_FAILED, 4=CANIF_TT_TX_OVERFLOW, 5=CANIF_TT_TX_UNDERFLOW}, range raw 0..5, implementation-data-type=uint8, type-emitter=TTCanIf.h
    CanIf_TTMasterSlaveModeType: compu {0=CANIF_TT_BACKUP_MASTER, 1=CANIF_TT_CURRENT_MASTER, 2=CANIF_TT_MASTER_OFF, 3=CANIF_TT_SLAVE}, range raw 0..3, implementation-data-type=uint8, type-emitter=TTCanIf.h
    CanIf_TTMasterStateType: category=STRUCTURE, type-emitter=TTCanIf.h
      element masterSlaveMode: implementation-data-type=CanIf_TTMasterSlaveModeType
      element refTriggerOffset: implementation-data-type=uint8
      element syncMode: implementation-data-type=CanIf_TTSyncModeEnumType
    CanIf_TTSevereErrorEnumType: compu {0=CANIF_TT_CONFIG_ERROR, 1=CANIF_TT_WATCH_TRIGGER_REACHED, 2=CANIF_TT_APPL_WATCHDOG}, range raw 0..2, implementation-data-type=uint8, type-emitter=TTCanIf.h
    CanIf_TTSyncModeEnumType: compu {0=CANIF_TT_IN_GAP, 1=CANIF_TT_IN_SCHEDULE, 2=CANIF_TT_SYNC_OFF, 3=CANIF_TT_SYNCHRONIZING}, range raw 0..3, implementation-data-type=uint8, type-emitter=TTCanIf.h
    CanIf_TTTimeSourceType: compu {0=CANIF_TT_CYCLE_TIME, 1=CANIF_TT_GLOBAL_TIME, 2=CANIF_TT_LOCAL_TIME, 3=CANIF_TT_UNDEFINED}, range raw 0..3, implementation-data-type=uint8, type-emitter=TTCanIf.h
    CanIf_TTTimeType: implementation-data-type=uint16, type-emitter=TTCanIf.h
    CanIf_TTTimingErrorIRQType: category=STRUCTURE, type-emitter=TTCanIf.h
      element errorLevel: implementation-data-type=CanIf_TTErrorLevelType
      element event: implementation-data-type=CanIf_TTEventEnumType
package /Bsw_CanNm/ImplementationDataTypes
  impl type CanNm_ConfigType: category=STRUCTURE, type-emitter=CanNm.h
    element Dummy: category=VALUE, base-type=uint8
package /Bsw_CanSM/ImplementationDataTypes
  impl type CanSM_BswMCurrentStateType: compu {0=CANSM_BSWM_NO_COMMUNICATION, 1=CANSM_BSWM_SILENT_COMMUNICATION, 2=CANSM_BSWM_FULL_COMMUNICATION, 3=CANSM_BSWM_BUS_OFF, 4=CANSM_BSWM_CHANGE_BAUDRATE}, range raw 0..4, implementation-data-type=uint8, type-emitter=CanSM.h
  impl type CanSM_ConfigType: category=STRUCTURE, type-emitter=CanSM.h
    element Dummy: category=VALUE, base-type=uint8
  impl type CanSM_StateType: compu {0=CANSM_INITED, 1=CANSM_UNINITED}, range raw 0..1, implementation-data-type=uint8, type-emitter=CanSM.h
package /Bsw_CanTp/ImplementationDataTypes
  impl type CanTp_ConfigType: category=STRUCTURE, type-emitter=CanTp.h
    element Dummy: category=VALUE, base-type=uint8
package /Bsw_CanTrcv/ImplementationDataTypes
  impl type CanTrcv_ConfigType: category=STRUCTURE, type-emitter=CanTrcv.h
    element Dummy: category=VALUE, base-type=uint8
  impl type CanTrcv_PNActivationType: compu {0=PN_ENABLED, 1=PN_DISABLED}, range raw 0..1, implementation-data-type=uint8, type-emitter=CanTrcv.h
  impl type CanTrcv_TrcvFlagStateType: compu {0=CANTRCV_FLAG_SET, 1=CANTRCV_FLAG_CLEARED}, range raw 0..1, implementation-data-type=uint8, type-emitter=CanTrcv.h
package /Bsw_CanCM/ImplementationDataTypes
  impl type CanCM_ChannelType: implementation-data-type=uint8, type-emitter=CanCM_InitTypes.h
  impl type CanCM_VolModType: compu {0=CANCM_VOL_MODE_NORMAL, 1=CANCM_VOL_MODE_ABNORMAL, 2=CANCM_VOL_MODE_CRITICAL, 3=CANCM_VOL_MODE_UNDEFINED}, range raw 0..3, implementation-data-type=uint8, type-emitter=CanCM_InitTypes.h
  impl type CanCM_CommStatType: compu {0=CANCM_COMM_STAT_INACTIVE, 1=CANCM_COMM_STAT_START, 2=CANCM_COMM_STAT_ACTIVE, 3=CANCM_COMM_STAT_SHUTDOWN, 4=CANCM_COMM_STAT_UNDEFINED}, range raw 0..4, implementation-data-type=uint8, type-emitter=CanCM_InitTypes.h
