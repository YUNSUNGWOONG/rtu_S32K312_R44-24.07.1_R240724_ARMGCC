AUTOSAR XML (schema 00047)
package /AUTOSAR/ComStack_Types/DataConstrs
  range IcomSwitch_ErrorType: raw 0x00..0x01
package /AUTOSAR/ComStack_Types/ImplementationDataTypes
  11 x impl type, all with type-emitter=ComStack_Types.h:
    BufReq_ReturnType: compu {0x00=BUFREQ_OK, 0x01=BUFREQ_E_NOT_OK, 0x02=BUFREQ_E_BUSY, 0x03=BUFREQ_E_OVFL}, range raw 0x00..0x03, implementation-data-type=uint8
    IcomConfigIdType: range raw 0..255, implementation-data-type=uint8
    IcomSwitch_ErrorType: compu {0x00=ICOM_SWITCH_E_OK, 0x01=ICOM_SWITCH_E_FAILED}, range raw 0..255, implementation-data-type=uint8
    PNCHandleType: range raw 0..255, implementation-data-type=uint8
    PduIdType: range raw 0..65535, implementation-data-type=uint8, range raw 0..65535, implementation-data-type=uint16
    PduInfoType: category=STRUCTURE
      element SduDataPtr: category=DATA_REFERENCE, sw-pointer-target-props={target-category=TYPE_REFERENCE, implementation-data-type=uint8}
      element MetaDataPtr: category=DATA_REFERENCE, sw-pointer-target-props={target-category=TYPE_REFERENCE, implementation-data-type=uint8}
      element SduLength: implementation-data-type=PduLengthType
    PduLengthType: range raw 0..65535, implementation-data-type=uint8, range raw 0..65535, implementation-data-type=uint16, range raw 0..65535, implementation-data-type=uint32
    RetryInfoType: category=STRUCTURE
      element TpDataState: implementation-data-type=TpDataStateType
      element TxTpDataCnt: implementation-data-type=PduLengthType
    TPParameterType: compu {0x00=TP_STMIN, 0x01=TP_BS, 0x02=TP_BC}, range raw 0x00..0x02, implementation-data-type=uint8
    TpDataStateType: compu {0x00=TP_DATACONF, 0x01=TP_DATARETRY, 0x02=TP_CONFPENDING}, range raw 0x00..0x02, implementation-data-type=uint8
    NetworkHandleType: range raw 0..255, implementation-data-type=uint8
