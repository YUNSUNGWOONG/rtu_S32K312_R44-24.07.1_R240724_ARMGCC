AUTOSAR XML (schema 00047)
package /ECU_EXTRACT
  system EcuExtract: category=ECU_EXTRACT, pnc-vector-length=12, pnc-vector-offset=4
    system mapping DataMappings
      data-mappings:
        {communication-direction=IN, data-element=App_Lin_LIN1.RootSwCompositionPrototype.Gr_MsgGr_LIN1_RCR_Sensor_Status.MsgGr_LIN1_RCR_Sensor_Status, signal-group=MsgGr_LIN1_RCR_Sensor_Status, type-mapping=sender-rec-record-type-mapping=record-element-mappings=[{implementation-record-element=RCR_TOF, system-signal=SystemSignal_LIN1_RCR_Sensor_Status_RCR_TOF}, {implementation-record-element=RCR_Sensor_Status_0, system-signal=SystemSignal_LIN1_RCR_Sensor_Status_RCR_Sensor_Status_0}, {implementation-record-element=RCR_Sensor_Status_1, system-signal=SystemSignal_LIN1_RCR_Sensor_Status_RCR_Sensor_Status_1}, {implementation-record-element=RCR_Sensor_Status_2, system-signal=SystemSignal_LIN1_RCR_Sensor_Status_RCR_Sensor_Status_2}, {implementation-record-element=RCR_Sensor_Status_3, system-signal=SystemSignal_LIN1_RCR_Sensor_Status_RCR_Sensor_Status_3}, {implementation-record-element=RCR_Sensor_Status_4, system-signal=SystemSignal_LIN1_RCR_Sensor_Status_RCR_Sensor_Status_4}, {implementation-record-element=RCR_Sensor_Status_5, system-signal=SystemSignal_LIN1_RCR_Sensor_Status_RCR_Sensor_Status_5}, {implementation-record-element=RCR_Sensor_Status_6, system-signal=SystemSignal_LIN1_RCR_Sensor_Status_RCR_Sensor_Status_6}, {implementation-record-element=RCR_Sensor_Status_7, system-signal=SystemSignal_LIN1_RCR_Sensor_Status_RCR_Sensor_Status_7}, {implementation-record-element=RCR_CRC, system-signal=SystemSignal_LIN1_RCR_Sensor_Status_RCR_CRC}, {implementation-record-element=RCR_Ringtime, system-signal=SystemSignal_LIN1_RCR_Sensor_Status_RCR_Ringtime}]}
        {communication-direction=IN, data-element=App_Lin_LIN1.RootSwCompositionPrototype.Gr_MsgGr_LIN1_FCR_Sensor_Status.MsgGr_LIN1_FCR_Sensor_Status, signal-group=MsgGr_LIN1_FCR_Sensor_Status, type-mapping=sender-rec-record-type-mapping=record-element-mappings=[{implementation-record-element=FCR_TOF, system-signal=SystemSignal_LIN1_FCR_Sensor_Status_FCR_TOF}, {implementation-record-element=FCR_Sensor_Status_0, system-signal=SystemSignal_LIN1_FCR_Sensor_Status_FCR_Sensor_Status_0}, {implementation-record-element=FCR_Sensor_Status_1, system-signal=SystemSignal_LIN1_FCR_Sensor_Status_FCR_Sensor_Status_1}, {implementation-record-element=FCR_Sensor_Status_2, system-signal=SystemSignal_LIN1_FCR_Sensor_Status_FCR_Sensor_Status_2}, {implementation-record-element=FCR_Sensor_Status_3, system-signal=SystemSignal_LIN1_FCR_Sensor_Status_FCR_Sensor_Status_3}, {implementation-record-element=FCR_Sensor_Status_4, system-signal=SystemSignal_LIN1_FCR_Sensor_Status_FCR_Sensor_Status_4}, {implementation-record-element=FCR_Sensor_Status_5, system-signal=SystemSignal_LIN1_FCR_Sensor_Status_FCR_Sensor_Status_5}, {implementation-record-element=FCR_Sensor_Status_6, system-signal=SystemSignal_LIN1_FCR_Sensor_Status_FCR_Sensor_Status_6}, {implementation-record-element=FCR_Sensor_Status_7, system-signal=SystemSignal_LIN1_FCR_Sensor_Status_FCR_Sensor_Status_7}, {implementation-record-element=FCR_CRC, system-signal=SystemSignal_LIN1_FCR_Sensor_Status_FCR_CRC}, {implementation-record-element=FCR_Ringtime, system-signal=SystemSignal_LIN1_FCR_Sensor_Status_FCR_Ringtime}]}
        {communication-direction=IN, data-element=App_Lin_LIN1.RootSwCompositionPrototype.Gr_MsgGr_LIN1_RL_Sensor_Status.MsgGr_LIN1_RL_Sensor_Status, signal-group=MsgGr_LIN1_RL_Sensor_Status, type-mapping=sender-rec-record-type-mapping=record-element-mappings=[{implementation-record-element=RL_TOF, system-signal=SystemSignal_LIN1_RL_Sensor_Status_RL_TOF}, {implementation-record-element=RL_Sensor_Status_0, system-signal=SystemSignal_LIN1_RL_Sensor_Status_RL_Sensor_Status_0}, {implementation-record-element=RL_Sensor_Status_1, system-signal=SystemSignal_LIN1_RL_Sensor_Status_RL_Sensor_Status_1}, {implementation-record-element=RL_Sensor_Status_2, system-signal=SystemSignal_LIN1_RL_Sensor_Status_RL_Sensor_Status_2}, {implementation-record-element=RL_Sensor_Status_3, system-signal=SystemSignal_LIN1_RL_Sensor_Status_RL_Sensor_Status_3}, {implementation-record-element=RL_Sensor_Status_4, system-signal=SystemSignal_LIN1_RL_Sensor_Status_RL_Sensor_Status_4}, {implementation-record-element=RL_Sensor_Status_5, system-signal=SystemSignal_LIN1_RL_Sensor_Status_RL_Sensor_Status_5}, {implementation-record-element=RL_Sensor_Status_6, system-signal=SystemSignal_LIN1_RL_Sensor_Status_RL_Sensor_Status_6}, {implementation-record-element=RL_Sensor_Status_7, system-signal=SystemSignal_LIN1_RL_Sensor_Status_RL_Sensor_Status_7}, {implementation-record-element=RL_CRC, system-signal=SystemSignal_LIN1_RL_Sensor_Status_RL_CRC}, {implementation-record-element=RL_Ringtime, system-signal=SystemSignal_LIN1_RL_Sensor_Status_RL_Ringtime}]}
        {communication-direction=IN, data-element=App_Lin_LIN1.RootSwCompositionPrototype.Gr_MsgGr_LIN1_SlaveResp.MsgGr_LIN1_SlaveResp, signal-group=MsgGr_LIN1_SlaveResp, type-mapping=sender-rec-record-type-mapping=record-element-mappings=[{implementation-record-element=SlaveRespB0, system-signal=SystemSignal_LIN1_SlaveResp_SlaveRespB0}, {implementation-record-element=SlaveRespB1, system-signal=SystemSignal_LIN1_SlaveResp_SlaveRespB1}, {implementation-record-element=SlaveRespB2, system-signal=SystemSignal_LIN1_SlaveResp_SlaveRespB2}, {implementation-record-element=SlaveRespB3, system-signal=SystemSignal_LIN1_SlaveResp_SlaveRespB3}, {implementation-record-element=SlaveRespB4, system-signal=SystemSignal_LIN1_SlaveResp_SlaveRespB4}, {implementation-record-element=SlaveRespB5, system-signal=SystemSignal_LIN1_SlaveResp_SlaveRespB5}, {implementation-record-element=SlaveRespB6, system-signal=SystemSignal_LIN1_SlaveResp_SlaveRespB6}, {implementation-record-element=SlaveRespB7, system-signal=SystemSignal_LIN1_SlaveResp_SlaveRespB7}]}
        {communication-direction=OUT, data-element=App_Lin_LIN1.RootSwCompositionPrototype.Gr_MsgGr_LIN1_Master_Cmd.MsgGr_LIN1_Master_Cmd, signal-group=MsgGr_LIN1_Master_Cmd, type-mapping=sender-rec-record-type-mapping=record-element-mappings=[{implementation-record-element=NAD, system-signal=SystemSignal_LIN1_Master_Cmd_NAD}, {implementation-record-element=PCI_Type, system-signal=SystemSignal_LIN1_Master_Cmd_PCI_Type}, {implementation-record-element=SID, system-signal=SystemSignal_LIN1_Master_Cmd_SID}, {implementation-record-element=RL_Sensor_Tx, system-signal=SystemSignal_LIN1_Master_Cmd_RL_Sensor_Tx}, {implementation-record-element=RCL_Sensor_Tx, system-signal=SystemSignal_LIN1_Master_Cmd_RCL_Sensor_Tx}, {implementation-record-element=RCR_Sensor_Tx, system-signal=SystemSignal_LIN1_Master_Cmd_RCR_Sensor_Tx}, {implementation-record-element=RR_Sensor_Tx, system-signal=SystemSignal_LIN1_Master_Cmd_RR_Sensor_Tx}, {implementation-record-element=FL_Sensor_Tx, system-signal=SystemSignal_LIN1_Master_Cmd_FL_Sensor_Tx}, {implementation-record-element=FCL_Sensor_Tx, system-signal=SystemSignal_LIN1_Master_Cmd_FCL_Sensor_Tx}, {implementation-record-element=FCR_Sensor_Tx, system-signal=SystemSignal_LIN1_Master_Cmd_FCR_Sensor_Tx}, {implementation-record-element=FR_Sensor_Tx, system-signal=SystemSignal_LIN1_Master_Cmd_FR_Sensor_Tx}, {implementation-record-element=RL_Sensor_Rx, system-signal=SystemSignal_LIN1_Master_Cmd_RL_Sensor_Rx}, {implementation-record-element=RCL_Sensor_Rx, system-signal=SystemSignal_LIN1_Master_Cmd_RCL_Sensor_Rx}, {implementation-record-element=RCR_Sensor_Rx, system-signal=SystemSignal_LIN1_Master_Cmd_RCR_Sensor_Rx}, {implementation-record-element=RR_Sensor_Rx, system-signal=SystemSignal_LIN1_Master_Cmd_RR_Sensor_Rx}, {implementation-record-element=FL_Sensor_Rx, system-signal=SystemSignal_LIN1_Master_Cmd_FL_Sensor_Rx}, {implementation-record-element=FCL_Sensor_Rx, system-signal=SystemSignal_LIN1_Master_Cmd_FCL_Sensor_Rx}, {implementation-record-element=FCR_Sensor_Rx, system-signal=SystemSignal_LIN1_Master_Cmd_FCR_Sensor_Rx}, {implementation-record-element=FR_Sensor_Rx, system-signal=SystemSignal_LIN1_Master_Cmd_FR_Sensor_Rx}]}
        {communication-direction=IN, data-element=App_Lin_LIN1.RootSwCompositionPrototype.Gr_MsgGr_LIN1_RCL_Sensor_Status.MsgGr_LIN1_RCL_Sensor_Status, signal-group=MsgGr_LIN1_RCL_Sensor_Status, type-mapping=sender-rec-record-type-mapping=record-element-mappings=[{implementation-record-element=RCL_TOF, system-signal=SystemSignal_LIN1_RCL_Sensor_Status_RCL_TOF}, {implementation-record-element=RCL_Sensor_Status_0, system-signal=SystemSignal_LIN1_RCL_Sensor_Status_RCL_Sensor_Status_0}, {implementation-record-element=RCL_Sensor_Status_1, system-signal=SystemSignal_LIN1_RCL_Sensor_Status_RCL_Sensor_Status_1}, {implementation-record-element=RCL_Sensor_Status_2, system-signal=SystemSignal_LIN1_RCL_Sensor_Status_RCL_Sensor_Status_2}, {implementation-record-element=RCL_Sensor_Status_3, system-signal=SystemSignal_LIN1_RCL_Sensor_Status_RCL_Sensor_Status_3}, {implementation-record-element=RCL_Sensor_Status_4, system-signal=SystemSignal_LIN1_RCL_Sensor_Status_RCL_Sensor_Status_4}, {implementation-record-element=RCL_Sensor_Status_5, system-signal=SystemSignal_LIN1_RCL_Sensor_Status_RCL_Sensor_Status_5}, {implementation-record-element=RCL_Sensor_Status_6, system-signal=SystemSignal_LIN1_RCL_Sensor_Status_RCL_Sensor_Status_6}, {implementation-record-element=RCL_Sensor_Status_7, system-signal=SystemSignal_LIN1_RCL_Sensor_Status_RCL_Sensor_Status_7}, {implementation-record-element=RCL_CRC, system-signal=SystemSignal_LIN1_RCL_Sensor_Status_RCL_CRC}, {implementation-record-element=RCL_Ringtime, system-signal=SystemSignal_LIN1_RCL_Sensor_Status_RCL_Ringtime}]}
        {communication-direction=IN, data-element=App_Lin_LIN1.RootSwCompositionPrototype.Gr_MsgGr_LIN1_FR_Sensor_Status.MsgGr_LIN1_FR_Sensor_Status, signal-group=MsgGr_LIN1_FR_Sensor_Status, type-mapping=sender-rec-record-type-mapping=record-element-mappings=[{implementation-record-element=FR_TOF, system-signal=SystemSignal_LIN1_FR_Sensor_Status_FR_TOF}, {implementation-record-element=FR_Sensor_Status_0, system-signal=SystemSignal_LIN1_FR_Sensor_Status_FR_Sensor_Status_0}, {implementation-record-element=FR_Sensor_Status_1, system-signal=SystemSignal_LIN1_FR_Sensor_Status_FR_Sensor_Status_1}, {implementation-record-element=FR_Sensor_Status_2, system-signal=SystemSignal_LIN1_FR_Sensor_Status_FR_Sensor_Status_2}, {implementation-record-element=FR_Sensor_Status_3, system-signal=SystemSignal_LIN1_FR_Sensor_Status_FR_Sensor_Status_3}, {implementation-record-element=FR_Sensor_Status_4, system-signal=SystemSignal_LIN1_FR_Sensor_Status_FR_Sensor_Status_4}, {implementation-record-element=FR_Sensor_Status_5, system-signal=SystemSignal_LIN1_FR_Sensor_Status_FR_Sensor_Status_5}, {implementation-record-element=FR_Sensor_Status_6, system-signal=SystemSignal_LIN1_FR_Sensor_Status_FR_Sensor_Status_6}, {implementation-record-element=FR_Sensor_Status_7, system-signal=SystemSignal_LIN1_FR_Sensor_Status_FR_Sensor_Status_7}, {implementation-record-element=FR_CRC, system-signal=SystemSignal_LIN1_FR_Sensor_Status_FR_CRC}, {implementation-record-element=FR_Ringtime, system-signal=SystemSignal_LIN1_FR_Sensor_Status_FR_Ringtime}]}
        {communication-direction=IN, data-element=App_Lin_LIN1.RootSwCompositionPrototype.Gr_MsgGr_LIN1_RR_Sensor_Status.MsgGr_LIN1_RR_Sensor_Status, signal-group=MsgGr_LIN1_RR_Sensor_Status, type-mapping=sender-rec-record-type-mapping=record-element-mappings=[{implementation-record-element=RR_TOF, system-signal=SystemSignal_LIN1_RR_Sensor_Status_RR_TOF}, {implementation-record-element=RR_Sensor_Status_0, system-signal=SystemSignal_LIN1_RR_Sensor_Status_RR_Sensor_Status_0}, {implementation-record-element=RR_Sensor_Status_1, system-signal=SystemSignal_LIN1_RR_Sensor_Status_RR_Sensor_Status_1}, {implementation-record-element=RR_Sensor_Status_2, system-signal=SystemSignal_LIN1_RR_Sensor_Status_RR_Sensor_Status_2}, {implementation-record-element=RR_Sensor_Status_3, system-signal=SystemSignal_LIN1_RR_Sensor_Status_RR_Sensor_Status_3}, {implementation-record-element=RR_Sensor_Status_4, system-signal=SystemSignal_LIN1_RR_Sensor_Status_RR_Sensor_Status_4}, {implementation-record-element=RR_Sensor_Status_5, system-signal=SystemSignal_LIN1_RR_Sensor_Status_RR_Sensor_Status_5}, {implementation-record-element=RR_Sensor_Status_6, system-signal=SystemSignal_LIN1_RR_Sensor_Status_RR_Sensor_Status_6}, {implementation-record-element=RR_Sensor_Status_7, system-signal=SystemSignal_LIN1_RR_Sensor_Status_RR_Sensor_Status_7}, {implementation-record-element=RR_CRC, system-signal=SystemSignal_LIN1_RR_Sensor_Status_RR_CRC}, {implementation-record-element=RR_Ringtime, system-signal=SystemSignal_LIN1_RR_Sensor_Status_RR_Ringtime}]}
        {communication-direction=IN, data-element=App_Lin_LIN1.RootSwCompositionPrototype.Gr_MsgGr_LIN1_FCL_Sensor_Status.MsgGr_LIN1_FCL_Sensor_Status, signal-group=MsgGr_LIN1_FCL_Sensor_Status, type-mapping=sender-rec-record-type-mapping=record-element-mappings=[{implementation-record-element=FCL_TOF, system-signal=SystemSignal_LIN1_FCL_Sensor_Status_FCL_TOF}, {implementation-record-element=FCL_Sensor_Status_0, system-signal=SystemSignal_LIN1_FCL_Sensor_Status_FCL_Sensor_Status_0}, {implementation-record-element=FCL_Sensor_Status_1, system-signal=SystemSignal_LIN1_FCL_Sensor_Status_FCL_Sensor_Status_1}, {implementation-record-element=FCL_Sensor_Status_2, system-signal=SystemSignal_LIN1_FCL_Sensor_Status_FCL_Sensor_Status_2}, {implementation-record-element=FCL_Sensor_Status_3, system-signal=SystemSignal_LIN1_FCL_Sensor_Status_FCL_Sensor_Status_3}, {implementation-record-element=FCL_Sensor_Status_4, system-signal=SystemSignal_LIN1_FCL_Sensor_Status_FCL_Sensor_Status_4}, {implementation-record-element=FCL_Sensor_Status_5, system-signal=SystemSignal_LIN1_FCL_Sensor_Status_FCL_Sensor_Status_5}, {implementation-record-element=FCL_Sensor_Status_6, system-signal=SystemSignal_LIN1_FCL_Sensor_Status_FCL_Sensor_Status_6}, {implementation-record-element=FCL_Sensor_Status_7, system-signal=SystemSignal_LIN1_FCL_Sensor_Status_FCL_Sensor_Status_7}, {implementation-record-element=FCL_CRC, system-signal=SystemSignal_LIN1_FCL_Sensor_Status_FCL_CRC}, {implementation-record-element=FCL_Ringtime, system-signal=SystemSignal_LIN1_FCL_Sensor_Status_FCL_Ringtime}]}
        {communication-direction=IN, data-element=App_Lin_LIN1.RootSwCompositionPrototype.Gr_MsgGr_LIN1_FL_Sensor_Status.MsgGr_LIN1_FL_Sensor_Status, signal-group=MsgGr_LIN1_FL_Sensor_Status, type-mapping=sender-rec-record-type-mapping=record-element-mappings=[{implementation-record-element=FL_TOF, system-signal=SystemSignal_LIN1_FL_Sensor_Status_FL_TOF}, {implementation-record-element=FL_Sensor_Status_0, system-signal=SystemSignal_LIN1_FL_Sensor_Status_FL_Sensor_Status_0}, {implementation-record-element=FL_Sensor_Status_1, system-signal=SystemSignal_LIN1_FL_Sensor_Status_FL_Sensor_Status_1}, {implementation-record-element=FL_Sensor_Status_2, system-signal=SystemSignal_LIN1_FL_Sensor_Status_FL_Sensor_Status_2}, {implementation-record-element=FL_Sensor_Status_3, system-signal=SystemSignal_LIN1_FL_Sensor_Status_FL_Sensor_Status_3}, {implementation-record-element=FL_Sensor_Status_4, system-signal=SystemSignal_LIN1_FL_Sensor_Status_FL_Sensor_Status_4}, {implementation-record-element=FL_Sensor_Status_5, system-signal=SystemSignal_LIN1_FL_Sensor_Status_FL_Sensor_Status_5}, {implementation-record-element=FL_Sensor_Status_6, system-signal=SystemSignal_LIN1_FL_Sensor_Status_FL_Sensor_Status_6}, {implementation-record-element=FL_Sensor_Status_7, system-signal=SystemSignal_LIN1_FL_Sensor_Status_FL_Sensor_Status_7}, {implementation-record-element=FL_CRC, system-signal=SystemSignal_LIN1_FL_Sensor_Status_FL_CRC}, {implementation-record-element=FL_Ringtime, system-signal=SystemSignal_LIN1_FL_Sensor_Status_FL_Ringtime}]}
        {communication-direction=OUT, data-element=App_Lin_LIN1.RootSwCompositionPrototype.Gr_MsgGr_LIN1_MasterReq.MsgGr_LIN1_MasterReq, signal-group=MsgGr_LIN1_MasterReq, type-mapping=sender-rec-record-type-mapping=record-element-mappings=[{implementation-record-element=MasterReqB0, system-signal=SystemSignal_LIN1_MasterReq_MasterReqB0}, {implementation-record-element=MasterReqB1, system-signal=SystemSignal_LIN1_MasterReq_MasterReqB1}, {implementation-record-element=MasterReqB2, system-signal=SystemSignal_LIN1_MasterReq_MasterReqB2}, {implementation-record-element=MasterReqB3, system-signal=SystemSignal_LIN1_MasterReq_MasterReqB3}, {implementation-record-element=MasterReqB4, system-signal=SystemSignal_LIN1_MasterReq_MasterReqB4}, {implementation-record-element=MasterReqB5, system-signal=SystemSignal_LIN1_MasterReq_MasterReqB5}, {implementation-record-element=MasterReqB6, system-signal=SystemSignal_LIN1_MasterReq_MasterReqB6}, {implementation-record-element=MasterReqB7, system-signal=SystemSignal_LIN1_MasterReq_MasterReqB7}]}
        {communication-direction=OUT, data-element=SWC_E2EXf.RootSwCompositionPrototype.P_tx11_FD.MsgGr_E2E_FD_CAN1_TCU_01_10ms_P11, signal-group=MsgGr_E2E_FD_CAN1_TCU_01_10ms_P11, type-mapping=sender-rec-record-type-mapping=sender-rec-record-element-mapping{implementation-record-element=TCU_EngRpmDisSta_Tx_P11, system-signal=SystemSignal_FD_CAN1_TCU_01_10ms_P11_TCU_EngRpmDisSta_Tx_P11}}
        {communication-direction=IN, data-element=SWC_E2EXf.RootSwCompositionPrototype.R_rx11_FD.MsgGr_E2E_FD_CAN1_BSD_01_50ms_P11, signal-group=MsgGr_E2E_FD_CAN1_BSD_01_50ms_P11, type-mapping=sender-rec-record-type-mapping=sender-rec-record-element-mapping{implementation-record-element=TCU_EngRpmDisSta_Rx_P11, system-signal=SystemSignal_FD_CAN1_BSD_01_50ms_P11_TCU_EngRpmDisSta_Rx_P11}}
    system mapping SwMappings
      sw-mappings:
        swc to ecu mapping SwMapping0: ecu-instance=ECU1
          component:
            RootSwCompositionPrototype.App_Lin_LIN1
            RootSwCompositionPrototype.SWC_AppMode
            RootSwCompositionPrototype.SWC_DiagnosticMonitor
            RootSwCompositionPrototype.SWC_DiagnosticService
            RootSwCompositionPrototype.SWC_E2EXf
            RootSwCompositionPrototype.SWC_WdgMTest
            RootSwCompositionPrototype.CDD_LIN
            RootSwCompositionPrototype.IoHwAb
            RootSwCompositionPrototype.BswM
            RootSwCompositionPrototype.ComM
            RootSwCompositionPrototype.Csm
            RootSwCompositionPrototype.DET
            RootSwCompositionPrototype.Dcm
            RootSwCompositionPrototype.Dem
            RootSwCompositionPrototype.EcuM
            RootSwCompositionPrototype.FiM
            RootSwCompositionPrototype.KeyM
            RootSwCompositionPrototype.NvM
            RootSwCompositionPrototype.Os_Master
            RootSwCompositionPrototype.StbM
            RootSwCompositionPrototype.WdgM
    system mapping PncMappings: pnc-mapping{pnc-group=[ISignalIPduGroupRx_ECU1_FD_CAN1_PNC32, ISignalIPduGroupTx_ECU1_FD_CAN1_PNC32], pnc-identifier=32}
    root-software-compositions:
      root sw composition prototype RootSwCompositionPrototype: software-composition=EcuComposition
  ecu instance ECU1: associated-com-i-pdu-group=[ISignalIPduGroupRx_ECU1_LIN1, ISignalIPduGroupTx_ECU1_LIN1, ISignalIPduGroupRx_ECU1_LIN2, ISignalIPduGroupTx_ECU1_LIN2, ISignalIPduGroupTx_ECU1_FD_CAN1_PNC32, ISignalIPduGroupRx_ECU1_FD_CAN1_PNC32], sleep-mode-supported=false, wake-up-over-bus-supported=false
    can communication controller ECU1_HS_CAN1
    lin master LinMaster_ECU1_LIN1: time-base=0.005, time-base-jitter=0.0
    lin master LinMaster_ECU1_LIN1: time-base=0.005, time-base-jitter=0.0
    lin master LinMaster_ECU1_LIN2: time-base=0.005, time-base-jitter=0.0
    can communication controller ECU1_FD_CAN1
    can communication connector Conn_ECU1_HS_CAN1: comm-controller=ECU1_HS_CAN1
    lin communication connector Conn_ECU1_LIN1: comm-controller=ECU1/LinMaster_ECU1_LIN1
    lin communication connector Conn_ECU1_LIN1: comm-controller=ECU1/LinMaster_ECU1_LIN1
    lin communication connector Conn_ECU1_LIN2: comm-controller=LinMaster_ECU1_LIN2
    can communication connector Conn_ECU1_FD_CAN1: comm-controller=ECU1_FD_CAN1, pnc-wakeup-data-mask=4294967296
  composition sw component type EcuComposition
    22 x component:
      App_Lin_LIN1: type=App_Lin_LIN1
      SWC_AppMode: type=SWC_AppMode
      SWC_DiagnosticMonitor: type=SWC_DiagnosticMonitor
      SWC_DiagnosticService: type=SWC_DiagnosticService
      SWC_E2EXf: type=SWC_E2EXf
      SWC_WdgMTest: type=SWC_WdgMTest
      CDD_LIN: type=CDD_LIN
      IoHwAb: type=IoHwAb
      BswM: type=BswM_Partition_Main
      ComM: type=ComM
      Csm: type=Csm
      DET: type=DET
      Dcm: type=Dcm
      Dem: type=Dem
      EcuM: type=EcuM
      FiM: type=FiM
      KeyM: type=KeyM
      NvM: type=NvM
      Os_Master: type=Os_Master
      StbM: type=StbM
      WdgM: type=WdgM
      Fota: type=Fota
    connect ComM.CL_ComMChannel_LIN1 -> SWC_AppMode.R_CL_ComMChannel_LIN1
    connect App_Lin_LIN1.P_SR_LIN1_SCHEDULE_CHANGE -> BswM.modeRequestPort_LinSchedule_LIN1
    connect SWC_DiagnosticService.ServiceRequestManufacturerNotification_DcmDsdServiceRequestManufacturerNotification0 -> Dcm.ServiceRequestManufacturerNotification_DcmDsdServiceRequestManufacturerNotification0
    connect SWC_DiagnosticService.ServiceRequestSupplierNotification_DcmDsdServiceRequestSupplierNotification0 -> Dcm.ServiceRequestSupplierNotification_DcmDsdServiceRequestSupplierNotification0
    connect EcuM.bootTarget -> SWC_AppMode.requirePort_BootTarget
    connect EcuM.currentMode -> SWC_AppMode.modeNotificationPort_currentMode
    connect WdgM.globalMode -> SWC_WdgMTest.globalMode
    connect WdgM.globalSupervision -> SWC_WdgMTest.WdgM_GlobalSupervision
    connect WdgM.localSupervision_SE_Init_CP_Init_AS0 -> SWC_WdgMTest.SE_Init_CP_AS0
    connect ComM.modeLimitation -> SWC_AppMode.R_modeLimitation
    connect SWC_AppMode.modeRequestPort_ComMMode_LIN1 -> BswM.modeRequestPort_ComMMode_LIN1
    connect BswM.modeSwitchPort_CanSMBORState_FD_CAN1 -> SWC_AppMode.modeNotificationPort_CanSMBORState_FD_CAN1
    connect BswM.modeSwitchPort_CanSMState_FD_CAN1 -> SWC_AppMode.modeNotificationPort_CanSMState_FD_CAN1
    connect BswM.modeSwitchPort_ComMMode_LIN1 -> SWC_AppMode.modeNotificationPort_ComMMode_LIN1
    connect BswM.modeSwitchPort_InitState -> SWC_AppMode.modeNotificationPort_InitState
    connect BswM.modeSwitchPort_LinSMState_LIN1 -> SWC_AppMode.modeNotificationPort_LinSMState_LIN1
    connect BswM.modeSwitchPort_PduGroupRx_LIN1 -> SWC_AppMode.modeNotificationPort_PduGroupRx_LIN1
    connect BswM.modeSwitchPort_PduGroupTx_LIN1 -> SWC_AppMode.modeNotificationPort_PduGroupTx_LIN1
    connect BswM.modeSwitchPort_WakeupEvent -> SWC_AppMode.modeNotificationPort_WakeupEvent
    connect EcuM.shutdownTarget -> SWC_AppMode.requirePort_ShutdownTarget
    connect EcuM.staterequest -> SWC_AppMode.clientPort_StateRequest
    connect EcuM.time -> SWC_AppMode.requirePort_EcuMTime
    connect BswM.modeSwitchPort_PduGroupRx_FD_CAN1_PNC32 -> SWC_AppMode.modeNotificationPort_PduGroupRx_FD_CAN1_PNC32
    connect BswM.modeSwitchPort_PduGroupTx_FD_CAN1_PNC32 -> SWC_AppMode.modeNotificationPort_PduGroupTx_FD_CAN1_PNC32
    connect SWC_AppMode.modeRequestPort_ComMMode_PNC32 -> BswM.modeRequestPort_ComMMode_PNC32
    connect BswM.modeSwitchPort_ComMMode_PNC32 -> SWC_AppMode.modeNotificationPort_ComMMode_PNC32
    connect ComM.CL_ComMChannel_FD_CAN1 -> SWC_AppMode.R_CL_ComMChannel_FD_CAN1_PNC32
    connect EcuM.staterequest -> Fota.Fota_StateRequest
    connect BswM.modeSwitchPort_ComMMode_LIN2 -> SWC_AppMode.modeNotificationPort_ComMMode_LIN2
    connect BswM.modeSwitchPort_LinSMState_LIN2 -> SWC_AppMode.modeNotificationPort_LinSMState_LIN2
    connect BswM.modeSwitchPort_PduGroupRx_LIN2 -> SWC_AppMode.modeNotificationPort_PduGroupRx_LIN2
    connect BswM.modeSwitchPort_PduGroupTx_LIN2 -> SWC_AppMode.modeNotificationPort_PduGroupTx_LIN2
    connect SWC_AppMode.modeRequestPort_ComMMode_LIN2 -> BswM.modeRequestPort_ComMMode_LIN2
    connect App_Lin_LIN1.P_SR_LIN2_SCHEDULE_CHANGE -> BswM.modeRequestPort_LinSchedule_LIN2
    connect ComM.CL_ComMChannel_LIN2 -> SWC_AppMode.R_CL_ComMChannel_LIN2
