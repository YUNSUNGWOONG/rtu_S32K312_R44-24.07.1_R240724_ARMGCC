AUTOSAR XML (schema 00047)
package /AUTOSAR
  composition sw component type CSWC_RootComposition
    6 x component:
      SWC_AppMode: type=SWC_AppMode
      SWC_E2EXf: type=SWC_E2EXf
      App_Lin_LIN1: type=App_Lin_LIN1
      SWC_WdgMTest: type=SWC_WdgMTest
      SWC_DiagnosticMonitor: type=SWC_DiagnosticMonitor
      SWC_DiagnosticService: type=SWC_DiagnosticService
