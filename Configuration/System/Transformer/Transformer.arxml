AUTOSAR XML (schema 00047)
package /DataTransformation/XF_FD_CAN1
  data transformation set XfSetTx_FD_CAN1_P11_8
    data transformation XfTx_FD_CAN1_P11_8: execute-despite-data-unavailability=true, transformer-chain=[XfTechTx_ComXf_P11_8, XfTechTx_E2EXf_P11_8]
    transformation technology XfTechTx_ComXf_P11_8: buffer-properties={buffer-computation=compu-rational-coeffs={compu-numerator=[8, 0], compu-denominator=1}, header-length=0}, has-internal-state=true, needs-original-data=false, protocol=COMBased, transformer-class=SERIALIZER, version=1.0.0
    transformation technology XfTechTx_E2EXf_P11_8:
      buffer-properties={buffer-computation=compu-rational-coeffs={compu-numerator=[0, 1], compu-denominator=1}, header-length=0, in-place=false}
      has-internal-state=true
      needs-original-data=false
      protocol=E2E
      end-to-end-transformation-description{counter-offset=12, crc-offset=0, data-id-mode=ALL-16-BIT, max-delta-counter=10, max-error-state-init=0, max-error-state-invalid=0, max-error-state-valid=0, min-ok-state-init=1, min-ok-state-invalid=1, min-ok-state-valid=1, profile-name=PROFILE_11, upper-header-bits-to-shift=0, window-size=1}
      transformer-class=SAFETY
      version=1.0.0
  data transformation set XfSetRx_FD_CAN1_P11_8
    data transformation XfRx_FD_CAN1_P11_8: execute-despite-data-unavailability=true, transformer-chain=[XfTechRx_E2EXf_P11_8, XfTechRx_ComXf_P11_8]
    transformation technology XfTechRx_ComXf_P11_8: buffer-properties={buffer-computation=compu-rational-coeffs={compu-numerator=[8, 0], compu-denominator=1}, header-length=0}, has-internal-state=true, needs-original-data=false, protocol=COMBased, transformer-class=SERIALIZER, version=1.0.0
    transformation technology XfTechRx_E2EXf_P11_8:
      buffer-properties={buffer-computation=compu-rational-coeffs={compu-numerator=[0, 1], compu-denominator=1}, header-length=0, in-place=false}
      has-internal-state=true
      needs-original-data=false
      protocol=E2E
      end-to-end-transformation-description{counter-offset=12, crc-offset=0, data-id-mode=ALL-16-BIT, max-delta-counter=10, max-error-state-init=0, max-error-state-invalid=0, max-error-state-valid=0, min-ok-state-init=1, min-ok-state-invalid=1, min-ok-state-valid=1, profile-name=PROFILE_11, upper-header-bits-to-shift=0, window-size=1}
      transformer-class=SAFETY
      version=1.0.0
