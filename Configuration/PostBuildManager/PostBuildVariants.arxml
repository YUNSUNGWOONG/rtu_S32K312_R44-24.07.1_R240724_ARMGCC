AUTOSAR XML (schema 00047)
package /AUTRON/PostBuildSelectable
  post build variant criterion PostBuildSelectableCriterion: compu {}
  4 x post build variant criterion value set:
    PostBuildCriterionValueSet_FL: post-build-variant-criterion-value{variant-criterion=PostBuildSelectableCriterion, value=0}
    PostBuildCriterionValueSet_FR: post-build-variant-criterion-value{variant-criterion=PostBuildSelectableCriterion, value=1}
    PostBuildCriterionValueSet_RL: post-build-variant-criterion-value{variant-criterion=PostBuildSelectableCriterion, value=2}
    PostBuildCriterionValueSet_RR: post-build-variant-criterion-value{variant-criterion=PostBuildSelectableCriterion, value=3}
  4 x predefined variant:
    Variant_FL: post-build-variant-criterion-value-set=PostBuildCriterionValueSet_FL
    Variant_FR: post-build-variant-criterion-value-set=PostBuildCriterionValueSet_FR
    Variant_RL: post-build-variant-criterion-value-set=PostBuildCriterionValueSet_RL
    Variant_RR: post-build-variant-criterion-value-set=PostBuildCriterionValueSet_RR
