AUTOSAR XML (schema 4-3-0)
# (C) 2021 HYUNDAI AUTRON Co., Ltd.
package /AUTOSAR
  ecuc definition collection ParameterDefinition_Os: module=Os
  module definition Os: refined-module-def=Os, variants pre-compile  # Configuration of the Os (Operating System) module.
    container OsAlarm [0..*]  # An OsAlarm may be used to asynchronously inform or activate a specific task. It is possible to start alarms automatically at system start-up depending on the application mode.
      reference OsAlarmAccessingApplication [0..*]: set at pre-compile, destination=OsApplication  # Reference to applications which have an access to this object.
      reference OsAlarmCounterRef: set at pre-compile, destination=OsCounter  # Reference to the assigned counter for that alarm
      choice container OsAlarmAction  # This container defines which type of notification is used when the alarm expires.
        container OsAlarmActivateTask [0..1]  # This container specifies the parameters to activate a task.
          reference OsAlarmActivateTaskRef: set at pre-compile, destination=OsTask  # Reference to the task that will be activated by that alarm action
        container OsAlarmCallback [0..1]  # This container specifies the parameters to call a callback OS alarm action.
          function name OsAlarmCallbackName: set at pre-compile  # Name of the function that is called when this alarm callback is triggered.
        container OsAlarmIncrementCounter [0..1]  # This container specifies the parameters to increment a counter.
          reference OsAlarmIncrementCounterRef: set at pre-compile, destination=OsCounter  # Reference to the counter that will be incremented by that alarm action
        container OsAlarmSetEvent [0..1]  # This container specifies the parameters to set an event
          reference OsAlarmSetEventRef: set at pre-compile, destination=OsEvent  # Reference to the event that will be set by that alarm action
          reference OsAlarmSetEventTaskRef: set at pre-compile, destination=OsTask  # Reference to the task that will be activated by that event
      container OsAlarmAutostart [0..1]  # If present this container defines if an alarm is started automatically at system start-up depending on the application mode.
        integer OsAlarmAlarmTime: 0..4294967295, set at pre-compile, default-value=1  # The relative or absolute tick value when the alarm expires for the first time. Note that for an alarm which is RELATIVE the value must be at bigger than 0.
        enumeration OsAlarmAutostartType: {ABSOLUTE, RELATIVE}, set at pre-compile, default-value=RELATIVE  # This specifies the type of autostart for the alarm. | ABSOLUTE : The alarm is started on startup via SetAbsAlarm(). RELATIVE : The alarm is started on startup via SetRelAlarm().
        integer OsAlarmCycleTime: 0..4294967295, set at pre-compile, default-value=1  # Cycle time of a cyclic alarm in ticks. If the value is 0 than the alarm is not cyclic.
        reference OsAlarmAppModeRef [1..*]: set at pre-compile, destination=OsAppMode  # Reference to the application modes for which the AUTOSTART shall be performed
    container OsAppMode [1..*]  # OsAppMode is the object used to define OSEK OS properties for an OSEK OS application mode. | No standard attributes are defined for AppMode. In a CPU, at least one AppMode object has to be defined. [source: OSEK OIL Spec. 2.5] An OsAppMode called OSDEFAULTAPPMODE must always be there for OSEK compatilbility.
    container OsApplication [0..*]  # An AUTOSAR OS must be capable of supporting a collection of OS objects (tasks, interrupts, alarms, hooks etc.) that form a cohesive functional unit. This collection of objects is termed an OS-Application. | All objects which belong to the same OS-Application have access to each other. Access means to allow to use these objects within API services. Access by other applications can be granted separately.
      integer OsApplicationCoreAssignment [0..1]: 0..65534, set at pre-compile, default-value=0  # ID of the core onto which the OsApplication is bound.
      boolean OsTrusted: scope=ECU, set at pre-compile, default-value=false  # Parameter to specify if an OS-Application is trusted or not. | true: OS-Application is trusted false: OS-Application is not trusted (default)
      integer OsApplicationStackSize: 4..2147483644, set at pre-compile, origin=AUTRON, default-value=1024  # The stack size in OS-Application is designated.
      boolean OsTrustedApplicationWithProtection: scope=ECU, set at pre-compile, default-value=false  # Parameter to specify if a trusted OS-Application is executed with memory protection or not. | true: OS-Application runs within a protected environment. This means that write access is limited. false: OS-Application has full write access (default)
      boolean OsTrustedApplicationDelayTimingViolationCall: scope=ECU, set at pre-compile, default-value=true  # Parameter to specify if a timing violation which occurs within an trusted OS-Application is raised immediately of if it is delayed until the current task returns to the calling OS-Application (return of CallTrustedFunction) | true: violation / call to ProtectionHook() is delayed false: timing violation cause an immediate call to the ProtectionHook().
      reference OsAppAlarmRef [0..*]: scope=ECU, set at pre-compile, destination=OsAlarm  # Specifies the OsAlarms that belong to the OsApplication.
      reference OsAppCounterRef [0..*]: scope=ECU, set at pre-compile, destination=OsCounter  # References the OsCounters that belong to the OsApplication.
      reference OsAppEcucPartitionRef [0..1]: set at pre-compile, destination=EcucPartition  # Denotes which "EcucPartition" is implemented by this "OSApplication".
      reference OsAppIsrRef [0..*]: scope=ECU, set at pre-compile, destination=OsIsr  # references which OsIsrs belong to the OsApplication
      reference OsAppScheduleTableRef [0..*]: scope=ECU, set at pre-compile, destination=OsScheduleTable  # References the OsScheduleTables that belong to the OsApplication.
      reference OsAppTaskRef [0..*]: scope=ECU, set at pre-compile, destination=OsTask  # references which OsTasks belong to the OsApplication
      reference OsRestartTask [0..1]: scope=ECU, set at pre-compile, destination=OsTask  # Optionally one task of an OS-Application may be defined as Restart Task. | Multiplicity = 1: Restart Task is activated by the Operating System if the protection hook requests it. Multiplicity = 0: No task is automatically started after a protection error happened.
      reference OsAppResourceRef [0..*]: scope=ECU, set at pre-compile, destination=OsResource  # References the OsResources that belong to the OsApplication.
      reference OsApplicationCoreRef [0..1]: multiplicity set at pre-compile, set at pre-compile, destination=EcucCoreDefinition  # Reference to the Core Definition in the Ecuc Module where the CoreId is defined. This reference is used to describe to which Core the OsApplication is bound.
      container OsApplicationHooks  # Container to structure the OS-Application-specific hooks
        boolean OsAppErrorHook: set at pre-compile, default-value=false  # Select the OS-Application error hook. | true: Hook is called false: Hook is not called
        boolean OsAppShutdownHook: set at pre-compile, default-value=false  # Select the OS-Application specific shutdown hook for the OS-Application. | true: Hook is called false: Hook is not called
        boolean OsAppStartupHook: set at pre-compile, default-value=false  # Select the OS-Application specific startup hook for the OS-Application. | true: Hook is called false: Hook is not called
      container OsApplicationTrustedFunction [0..*]  # Container to structure the configration parameters of trusted functions
        function name OsTrustedFunctionName: set at pre-compile  # Trusted function (as part of a trusted OS-Application) available to other OS-Applications. This also supersedes the OSEK OIL attribute TRUSTED in APPLICATION because the optionality of this parameter is describing that already.
    container OsCounter [0..*]  # Configuration information for the counters that belong to the OsApplication.
      integer OsCounterMaxAllowedValue: 1..4294967295, set at pre-compile, default-value=1  # Maximum possible allowed value of the system counter in ticks.
      integer OsCounterMinCycle: 1..4294967295, set at pre-compile, default-value=1  # The MINCYCLE attribute specifies the minimum allowed number of counter ticks for a cyclic alarm linked to the counter.
      integer OsCounterTicksPerBase: 1..4294967295, set at pre-compile, default-value=1  # The TICKSPERBASE attribute specifies the number of ticks required to reach a counterspecific unit. The interpretation is implementation-specific.
      enumeration OsCounterType: {HARDWARE, SOFTWARE}, set at pre-compile, default-value=SOFTWARE  # This parameter contains the natural type or unit of the counter. | HARDWARE : This counter is driven by some hardware e.g. a hardware timer unit. SOFTWARE : The counter is driven by some software which calls the IncrementCounter service.
      enumeration OsDrivingInterrupt [0..1]: {SYSTICK(0xE000ED23)}, category=FIXED, set at pre-compile, origin=AUTRON  # Port Specific interrupt which drives the HARDWARE counter. On occurance of this interrupt the counter is incremented by 1.
      float OsSecondsPerTick [0..1]: 0..0.067, set at pre-compile, default-value=0.0000001  # Time of one counter tick in seconds.
      reference OsCounterAccessingApplication [0..*]: set at pre-compile, destination=OsApplication  # Reference to applications which have an access to this object.
      container OsDriver [0..1]  # This Container contains the information who will drive the counter. | This configuration is only valid if the counter has OsCounterType set to HARDWARE. If the container does not exist (multiplicity=0) the timer is managed by the OS internally (OSINTERNAL). If the container exists the OS can use the GPT interface to manage the timer. The user have to supply the GPT channel. If the counter is driven by some other (external to the OS) source (like a TPU for example) this must be described as a vendor specific extension.
        reference OsGptChannelRef [0..1]: set at pre-compile, destination=GptChannelConfiguration  # Reference to the GPT channel.
      container OsTimeConstant [0..*]  # Allows the user to define constants which can be e.g. used to compare time values with timer tick values. | A time value will be converted to a timer tick value during generation and can later on accessed via the OsConstName. The conversation is done by rounding time values to the nearest fitting tick value.
        float OsTimeValue: 0..4294967296, set at pre-compile, default-value=0.001  # This parameter contains the value of the constant in seconds.
        string OsConstName: set at pre-compile, origin=AUTRON  # The name which is accessed by the application to get the above OsTimeValue.
    container OsEvent [0..*]  # Representation of OS events in the configuration context. Adopted from the OSEK OIL specification.
      integer OsEventMask [0..1]: 0..4294967295, set at pre-compile, default-value=0  # If event mask would be set to AUTO in OIL, this parameter should be omitted here. This paramter will not be used by the OS and event mask will be provided by the Os generator.
    container OsIoc [0..1]  # Configuration of the IOC (Inter OS Application Communicator).
      container OsIocCommunication [0..*]  # Representation of a 1:1 or N:1 communication between software parts located in different OS-Applications that are bound to the same or to different cores. | The name shall begin with the name of the sending software service and be followed by a unique identifier delivered by the sending software service. In the case of RTE as user attention shall be paid on the fact that uniqueness for identifier names has to be reached over ports, data elements, object instances and maybe additional identification properties (E.g. Case 1:N mapping to 1:1). Example: - <NameSpace>_UniqueID
        integer OsIocBufferLength [0..1]: 0..4294967295, set at pre-compile, default-value=1  # This attribute defines the size of the IOC internal queue to be allocated for a queued communication. | This configuration information shall allow the optimization of the needed memory for communications requiring buffers within the RTE and within the IOC.
        container OsIocDataProperties [1..*]  # Data properties of the data to be transferred on the IOC communication channel.
          integer OsIocDataPropertyIndex [0..1]: 0..255, set at pre-compile, default-value=0  # This parameter is used to define in which order the data is send, e.g. whether IocSendGroup(A,B) or IocSendGroup(B,A) shall be used.
          string OsIocInitValue [0..1]: set at pre-compile  # Initial Value for the data to be transferred on the IOC communication channel.
          foreign reference OsIocDataTypeRef: set at pre-compile, destination-type=IMPLEMENTATION-DATA-TYPE  # This is the type of the data to be transferred on the IOC communication channel. This attribute is necessary to generate the parameter type of the Ioc functions. Additionally this information should be used to compute the data size for necessary data copy operations within the Ioc module. | If more than one attribute is defined, the IOC generator should generate an IocXxxGroup function (Xxx= CHOICE [Send, Receive, Write, Read]). N:1 communication (Multiplicity of OsIocSenderProperties > 1) is only allowed for multiplicity of OsIocDataRef = 1
        container OsIocReceiverProperties  # Representation of receiver properties for one communication. For each OsIocCommunication (1:1 or N:1) one receiver has to be defined. This container should be instanciated within an OsIocCommunication.
          enumeration OsIocFunctionImplementationKind [0..1]: {DO_NOT_CARE, FUNCTION, MACRO}, set at pre-compile, default-value=DO_NOT_CARE  # This parameter is used to select whether this communication is implemented as a macro or as a function. | DO_NOT_CARE : It is not defined whether a macro or a function is used. FUNCTION : Communication is implemented as a function. MACRO : Communication is implemented as a macro.
          function name OsIocReceiverPullCB [0..1]: set at pre-compile  # This attribute defines the name of a callback function that the IOC shall call on the receiving core for each data reception. | In case of non existence of this attribute no ReceiverPullCB notification shall be applied by the IOC. The name of the function shall begin with the name of the receiving module, followed with a callback name and followed by the IocId. Example: void RTE_ReceiverPullCB_RTE25 (void). If this attribute does not exist, it means that no ReceiverPullCB shall be called (No notification from IOC is required). If this attribute exists the IOC shall call the callback function on the receiving core.
          reference OsIocReceivingOsApplicationRef: set at pre-compile, destination=OsApplication  # This attribute is a reference to the receiving OsApplication instance defined in the configuration file of the OS. | This information allows for the generator to get additional information necessary for the code generation like: * The protection properties of the communicating OsApplications to find out which protections have to be crossed * The core identifiers to find out if an intra or an inter core communication has to be realized * Interrupt details in case of cross core notification to realize over IRQs
        container OsIocSenderProperties [1..*]  # Representation of sender properties for one communication. For each OsIocCommunication one (1:1) or many senders (N:1) have to be defined. Multiplicity > 1 (N:1 communication) is only allowed for Multiplicity of OsIocDataTypeRef = 1. | This container should be instanciated within an OsIocCommunication.
          enumeration OsIocFunctionImplementationKind [0..1]: {DO_NOT_CARE, FUNCTION, MACRO}, set at pre-compile, default-value=DO_NOT_CARE  # This parameter is used to select whether this communication is implemented as a macro or as a function. | DO_NOT_CARE : It is not defined whether a macro or a function is used. FUNCTION : Communication is implemented as a function. MACRO : Communication is implemented as a macro.
          integer OsIocSenderId [0..1]: 0..255, set at pre-compile, default-value=0  # Representation of a sender in a N:1 communication to distinguish between senders. | This parameter does not exist in 1:1 communication.
          reference OsIocSendingOsApplicationRef: set at pre-compile, destination=OsApplication  # This attribute is a reference to the sending OS-Application instance defined in the configuration file of the OS. | This information shall allows the generator to get additional information necessary for the code generation like: * The protection properties of the communicating OS-Applications to find out which protection boundaries have to be crossed. * The core identifiers to find out if an intra or an inter core communication has to be realized * Interrupt details in case of cross core notification to realize over IRQs
    container OsIsr [0..*]  # The OsIsr container represents an OSEK interrupt service routine.
      enumeration OsIsrCategory: {CATEGORY_1, CATEGORY_2}, set at pre-compile, default-value=CATEGORY_2  # This attribute specifies the category of this ISR. | CATEGORY_1 : Interrupt is of category 1 CATEGORY_2 : Interrupt is of category 2 .
      enumeration OsIsrName: {DMATCD0_IRQn(0xE000E404), DMATCD1_IRQn(0xE000E405), DMATCD2_IRQn(0xE000E406), DMATCD3_IRQn(0xE000E407), DMATCD4_IRQn(0xE000E408), DMATCD5_IRQn(0xE000E409), DMATCD6_IRQn(0xE000E40A), DMATCD7_IRQn(0xE000E40B), DMATCD8_IRQn(0xE000E40C), DMATCD9_IRQn(0xE000E40D), DMATCD10_IRQn(0xE000E40E), DMATCD11_IRQn(0xE000E40F), ERM_0_IRQn(0xE000E424), ERM_1_IRQn(0xE000E425), MCM_IRQn(0xE000E426), STM0_IRQn(0xE000E427), SWT0_IRQn(0xE000E42A), CTI0_IRQn(0xE000E42D), CTI1_IRQn(0xE000E42E), FLASH_0_IRQn(0xE000E430), FLASH_1_IRQn(0xE000E431), FLASH_2_IRQn(0xE000E432), RGM_IRQn(0xE000E433), PMC_IRQn(0xE000E434), SIUL_0_IRQn(0xE000E435), SIUL_1_IRQn(0xE000E436), SIUL_2_IRQn(0xE000E437), SIUL_3_IRQn(0xE000E438), EMIOS0_0_IRQn(0xE000E43D), EMIOS0_1_IRQn(0xE000E43E), EMIOS0_2_IRQn(0xE000E43F), EMIOS0_3_IRQn(0xE000E440), EMIOS0_4_IRQn(0xE000E441), EMIOS0_5_IRQn(0xE000E442), EMIOS1_0_IRQn(0xE000E445), EMIOS1_1_IRQn(0xE000E446), EMIOS1_2_IRQn(0xE000E447), EMIOS1_3_IRQn(0xE000E448), EMIOS1_4_IRQn(0xE000E449), EMIOS1_5_IRQn(0xE000E44A), WKPU_IRQn(0xE000E453), CMU0_IRQn(0xE000E454), CMU1_IRQn(0xE000E455), CMU2_IRQn(0xE000E456), BCTU_IRQn(0xE000E457), LCU0_IRQn(0xE000E45C), LCU1_IRQn(0xE000E45D), PIT0_IRQn(0xE000E460), PIT1_IRQn(0xE000E461), RTC_IRQn(0xE000E466), FlexCAN0_0_IRQn(0xE000E46D), FlexCAN0_1_IRQn(0xE000E46E), FlexCAN0_2_IRQn(0xE000E46F), FlexCAN1_0_IRQn(0xE000E471), FlexCAN1_1_IRQn(0xE000E472), FlexCAN1_2_IRQn(0xE000E473), FlexCAN2_0_IRQn(0xE000E474), FlexCAN2_1_IRQn(0xE000E475), FlexCAN2_2_IRQn(0xE000E476), FlexCAN3_0_IRQn(0xE000E477), FlexCAN3_1_IRQn(0xE000E478), FlexCAN4_0_IRQn(0xE000E479), FlexCAN4_1_IRQn(0xE000E47A), FlexCAN5_0_IRQn(0xE000E47B), FlexCAN5_1_IRQn(0xE000E47C), FLEXIO_IRQn(0xE000E48B), LPUART0_IRQn(0xE000E48D), LPUART1_IRQn(0xE000E48E), LPUART2_IRQn(0xE000E48F), LPUART3_IRQn(0xE000E490), LPUART4_IRQn(0xE000E491), LPUART5_IRQn(0xE000E492), LPUART6_IRQn(0xE000E493), LPUART7_IRQn(0xE000E494), I3C_IRQn(0xE000E4A0), LPI2C0_IRQn(0xE000E4A1), LPI2C1_IRQn(0xE000E4A2), LPSPI0_IRQn(0xE000E4A5), LPSPI1_IRQn(0xE000E4A6), LPSPI2_IRQn(0xE000E4A7), LPSPI3_IRQn(0xE000E4A8), JDC_IRQn(0xE000E4B2), ADC0_IRQn(0xE000E4B4), ADC1_IRQn(0xE000E4B5), LPCMP0_IRQn(0xE000E4B7), LPCMP1_IRQn(0xE000E4B8), FCCU_0_IRQn(0xE000E4BD), FCCU_1_IRQn(0xE000E4BE), HSE_MU0_TX_IRQn(0xE000E4C0), HSE_MU0_RX_IRQn(0xE000E4C1), HSE_MU0_ORED_IRQn(0xE000E4C2), HSE_MU1_TX_IRQn(0xE000E4C3), HSE_MU1_RX_IRQn(0xE000E4C4), HSE_MU1_ORED_IRQn(0xE000E4C5), SoC_PLL_IRQn(0xE000E4D4)}, set at pre-compile, origin=AUTRON  # M7 interrupt source for this Interrupt | M7 interrupt source for this Interrupt.
      integer OsIsrHardwarePriority: 1..15, set at pre-compile, origin=AUTRON, default-value=1  # The hardware priority of the ISR.
      integer OsIsrStackSize: 4..2147483644, set at pre-compile, origin=AUTRON, default-value=800  # Amount of stack allocated in bytes.
      reference OsIsrResourceRef [0..*]: set at pre-compile, destination=OsResource  # This reference defines the resources accessed by this ISR.
      container OsIsrTimingProtection [0..1]  # This container contains all parameters which are related to timing protection | If the container exists, the timing protection is used for this interrupt. If the container does not exist, the interrupt is not supervised regarding timing violations.
        float OsIsrAllInterruptLockBudget [0..1]: 0..4294967296, set at pre-compile, default-value=0  # This parameter contains the maximum time for which the ISR is allowed to lock all interrupts (via SuspendAllInterrupts() or DisableAllInterrupts()) (in seconds).
        float OsIsrExecutionBudget [0..1]: 0..4294967296, set at pre-compile, default-value=0  # The parameter contains the maximum allowed execution time of the interrupt (in seconds).
        float OsIsrOsInterruptLockBudget [0..1]: 0..4294967296, set at pre-compile, default-value=0  # This parameter contains the maximum time for which the ISR is allowed to lock all Category 2 interrupts (via SuspendOSInterrupts()) (in seconds).
        float OsIsrTimeFrame [0..1]: 0..4294967296, set at pre-compile, default-value=0  # This parameter contains the minimum inter-arrival time between successive interrupts (in seconds).
        container OsIsrResourceLock [0..*]  # This container contains a list of times the interrupt uses resources.
          float OsIsrResourceLockBudget: 0..4294967296, set at pre-compile, default-value=0  # This parameter contains the maximum time the interrupt is allowed to hold the given resource (in seconds).
          reference OsIsrResourceLockResourceRef: set at pre-compile, destination=OsResource  # Reference to the resource the locking time is depending on
    container OsOS  # OS is the object used to define OSEK OS properties for an OSEK application. | Per CPU exactly one OS object has to be defined.
      integer OsNumberOfCores [0..1]: 1..65535, set at pre-compile, default-value=1  # Maximum number of cores that are controlled by the OS. | The OS uses the value internally. It depends on the ECU HW.
      enumeration OsScalabilityClass [0..1]: {SC1, SC2, SC3, SC4}, category=FIXED, scope=ECU, set at pre-compile, default-value=SC1  # A scalability class for each System Object "OS" has to be selected. In order to customize the operating system to the needs of the user and to take full advantage of the processor features the operating system can be scaled according to the scalability classes. | If the scalability class is omitted this translates to the OIL AUTO mechanism SC1 : Basic functionalities of OS SC2 : Functionality related to timing protection and synchronization SC3 : Functionality related to memory protection SC4 : Combination of SC1, SC2 and SC3 scalability classes.
      boolean OsStackMonitoring: category=FIXED, set at pre-compile, default-value=false  # Select stack monitoring of Tasks/Category 2 ISRs | true: Stacks are monitored false: Stacks are not monitored
      enumeration OsStatus: {EXTENDED, STANDARD}, category=FIXED, set at pre-compile, default-value=EXTENDED  # The Status attribute specifies whether a system with standard or extended status has to be used. Automatic assigment is not supported for this attribute. | STANDARD : The Standard status does the normal checks on calling operating system services. EXTENDED : The extended status allows for enhanced plausibility checks on calling operating system services.
      boolean OsUseGetServiceId: category=FIXED, set at pre-compile, default-value=true  # As defined by OSEK | true : provides the service identifier where the error has been risen. false : Does not provide the service identifier where the error has been risen.
      boolean OsUseParameterAccess: category=FIXED, set at pre-compile, default-value=true  # As defined by OSEK | true : Enables user parameter access. false : Disables user parameter access
      boolean OsUseResScheduler: category=FIXED, set at pre-compile, default-value=true  # The OsUseResScheduler attribute defines whether the resource RES_SCHEDULER is used within the application. | true : The task that takes this resource cannot be pre empted. false : The task that takes this resource can be pre empted.
      enumeration OsProcessorSeries: {S32K31x}, category=FIXED, scope=ECU, set at pre-compile, multiplicity set at pre-compile, origin=AUTRON, set at pre-compile, default-value=S32K31x  # Os Processor name is designated by this parameter.
      enumeration OsProcessor: {S32K311, S32K312, S32K314}, category=FIXED, set at pre-compile, multiplicity set at pre-compile, origin=AUTRON, set at pre-compile, default-value=S32K312  # Os Processor name is designated by this parameter.
      integer OsUserStackSize: 32..2147483644, set at pre-compile, origin=AUTRON, default-value=1024  # This parameter gives Idle task Stack size | The OS uses the value internally. It depends on the ECU HW.
      float OsTPSTimerClock [0..1]: 0..160, category=FIXED, scope=ECU, multiplicity set at pre-compile, origin=AUTRON, set at pre-compile, default-value=96  # This parameter is used to define clock for TPS (Timing Protection System) timer clock (MHz). This parameter is valid only when timing protection feature is used.
      integer OsSystemTimerClock: 4..160, set at pre-compile, origin=AUTRON_v1.0.0, default-value=80  # The timer clock (MHz) allows H/W timer clock to be used as a reference of counter.
      enumeration OsStackFrame: {StackFrame4, StackFrame8, StackFrame16, StackFrame32}, category=FIXED, scope=ECU, set at pre-compile, origin=AUTRON, default-value=StackFrame8  # This parameter gives frame size of the Stack in bytes. | The OS uses the value internally. It depends on the ECU HW.
      boolean OsFullReadAccess: category=FIXED, origin=AUTRON, set at pre-compile  # This parameter is used to allow non-trusted OS-application to have full read access to memory. True: Non-trusted OS-application have full read access for memory. False: Non-trusted OS-application doesn't have full read access for memory.
      boolean OsFpuSupport: set at pre-compile, default-value=false  # The OsFpuSupport attribute defines whether to support saving and restoring FPU registers during context switching. If OsFpuSupport is 'true', 132 bytes of memory per Task or CAT2 ISR will be used additionally.
      container OsHooks  # Container to structure all hooks belonging to the OS
        boolean OsErrorHook: set at pre-compile, default-value=true  # Error hook as defined by OSEK | true: Hook is called false: Hook is not called
        boolean OsPostTaskHook: set at pre-compile, default-value=false  # Post-task hook as defined by OSEK | true: Hook is called false: Hook is not called
        boolean OsPreTaskHook: set at pre-compile, default-value=false  # Pre-task hook as defined by OSEK | true: Hook is called false: Hook is not called
        boolean OsProtectionHook [0..1]: set at pre-compile, default-value=false  # Switch to enable/disable the call to the (user supplied) protection hook. | true: Protection hook is called on protection error false: Protection hook is not called
        boolean OsShutdownHook: set at pre-compile, default-value=false  # Shutdown hook as defined by OSEK | true: Hook is called false: Hook is not called
        boolean OsStartupHook: set at pre-compile, default-value=false  # Startup hook as defined by OSEK | true: Hook is called false: Hook is not called
        boolean OsProfilingHook: category=FIXED, set at pre-compile, origin=AUTRON, default-value=false  # Provide following hook functions for profiling Task and Category 2 ISR state information - Os_IsrEntryHook() - Os_IsrExitHook() - Os_IsrKillHook() - Os_TaskActivationHook() - Os_TaskTerminationHook() - Os_TaskPreemptionHook() - Os_TaskRunningHook() - Os_TaskWaitingHook() - Os_TaskReleaseHook() - Os_TaskKillHook() - Os_IdleEntryHook() - Os_IdleExitHook()
      container OsDebug
        boolean ORTI: origin=AUTRON, set at pre-compile, default-value=false  # ORTI file generation true: ORTI file is generated false: ORTI file is not generated
      container OsMpuRegion [0..*]  # Container with details about memory area accessible to the Application
        integer OsMpuRegionNumber: 0..14, set at pre-compile, origin=AUTRON  # Defines the number of MPU region to be accessed.
        boolean OsMpuRegionEnabledOnStart: set at pre-compile, origin=AUTOEVER  # Enables a memory region before OS starts
        integer OsMpuRegionBaseAddress: 0..4294967295, set at pre-compile, origin=AUTRON  # The base address defines the start of the memory region. You must align this to a region-sized boundary. For example, if a region size of 8KB is programmed for a given region, the base address must be a multiple of 8KB.
        enumeration OsMpuRegionSize: {Size32bytes, Size64bytes, Size128bytes, Size256bytes, Size512bytes, Size1KB, Size2KB, Size4KB, Size8KB, Size16KB, Size32KB, Size64KB, Size128KB, Size256KB, Size512KB, Size1MB, Size2MB, Size4MB, Size8MB, Size16MB, Size32MB, Size64MB, Size128MB, Size256MB, Size512MB, Size1GB, Size2GB, Size4GB}, set at pre-compile, origin=AUTRON  # Specifies the size of the region specified by the Memory Region Number Register.
        enumeration OsMpuRegionRwPermission: {NONE_NONE, RW_NONE, RW_RO, RW_RW, RO_NONE, RO_RO}, set at pre-compile, origin=AUTRON  # Access permission. Defines the data access permissions. Each region can be given no access, read-only access, or read/write access permissions for Privileged or all modes. PrivilegedPermission_UserPermission
        integer OsMpuRegionSubregionDisable: 0..255, set at pre-compile, origin=AUTRON  # Each bit position represents a sub-region, 0-7 The meaning of each bit is: 0 = address range is part of this region 1 = address range is not part of this region. Each region can be split into eight equal sized non-overlapping subregions. An access to a memory address in a disabled subregion does not use the attributes and permissions defined for that region. Instead, it uses the attributes and permissions of a lower priority region or generates a background fault if no other regions overlap at that address. This enables increased protection and memory attribute granularity. All region sizes between 256 bytes and 4GB support eight subregions. Region sizes below 256 bytes do not support subregions, and the subregion disable field is SBZ/UNP for regions of less than 256 bytes in size.
        boolean OsMpuRegionExecutionPermission: set at pre-compile, origin=AUTOEVER  # Determines if a region of memory is executable
        enumeration OsMpuRegionAttribute: {StronglyOrdered, Device_Shareable, Device_NonShareable, Normal_WT_NoWA_Shareable, Normal_WT_NoWA_NonShareable, Normal_WB_NoWA_Shareable, Normal_WB_NoWA_NonShareable, Normal_NonCacheable_Shareable, Normal_NonCacheable_NonShareable, Normal_WB_WA_Shareable, Normal_WB_WA_NonShareable}, set at pre-compile, origin=AUTRON  # Each region has a number of attributes associated with it. These control how a memory access is performed when the processor accesses an address that falls within a given region. The attributes are: • Memory type, see Memory types on page 7-7, one of: - Strongly Ordered - Device - Normal. • Shared or Non-shared • Non-cacheable • Write-through cacheable • Write-back cacheable • Read allocation • Write allocation.
        string OsMpuRegionLinkerSection [0..1]: origin=AUTRON  # Linker sections that should be located in MPU region. ex) Code section : ".text.ECUC_PARTITION_NAME*" Read only data section : ".rodata.ECUC_PARTITION_NAME*" Variable section : ".data.ECUC_PARTITION_NAME*" ".bss.ECUC_PARTITION_NAME*"
        reference OsMpuRegionAccessingApplication [0..1]: set at pre-compile, origin=AUTRON, destination=OsApplication  # Reference to applications which have an access to this object.
    container OsPeripheralArea [0..65534]: multiplicity set at pre-compile  # An OsResource object is used to co-ordinate the concurrent access by tasks and ISRs to a shared resource, e.g. the scheduler, any program sequence, memory or any hardware area.
      integer OsPeripheralAreaEndAddress: 0..18446744073709551615, set at pre-compile  # An OsResource object is used to co-ordinate the concurrent access by tasks and ISRs to a shared resource, e.g. the scheduler, any program sequence, memory or any hardware area.
      integer OsPeripheralAreaId: 0..18446744073709551615, symbolic-name-value=true  # An OsResource object is used to co-ordinate the concurrent access by tasks and ISRs to a shared resource, e.g. the scheduler, any program sequence, memory or any hardware area.
      integer OsPeripheralAreaStartAddress: 0..18446744073709551615, set at pre-compile  # An OsResource object is used to co-ordinate the concurrent access by tasks and ISRs to a shared resource, e.g. the scheduler, any program sequence, memory or any hardware area.
      reference OsPeripheralAreaAccessingApplication [0..*]: destination=OsApplication  # An OsResource object is used to co-ordinate the concurrent access by tasks and ISRs to a shared resource, e.g. the scheduler, any program sequence, memory or any hardware area.
    container OsResource [0..*]  # An OsResource object is used to co-ordinate the concurrent access by tasks and ISRs to a shared resource, e.g. the scheduler, any program sequence, memory or any hardware area.
      enumeration OsResourceProperty: {INTERNAL, LINKED, STANDARD}, set at pre-compile, default-value=STANDARD  # This specifies the type of the resource. | INTERNAL : The resource is an internal resource. LINKED : The resource is a linked resource (a second name for a existing resource). STANDARD : The resource is a standard resource.
      reference OsResourceAccessingApplication [0..*]: set at pre-compile, destination=OsApplication  # Reference to applications which have an access to this object.
      reference OsResourceLinkedResourceRef [0..1]: set at pre-compile, destination=OsResource  # The link to the resource. Must be valid if OsResourceProperty is LINKED. If OsResourceProperty is not LINKED the value is ignored.
    container OsScheduleTable [0..*]  # An OsScheduleTable addresses the synchronization issue by providing an encapsulation of a statically defined set of alarms that cannot be modified at runtime.
      integer OsScheduleTableDuration: 0..4294967295, set at pre-compile, default-value=1  # This parameter defines the modulus of the schedule table (in ticks).
      boolean OsScheduleTableRepeating: set at pre-compile, default-value=false  # This Paramter specifies the behaviour of the Schedule Table. | true: first expiry point on the schedule table shall be processed at final expiry point delay ticks after the final expiry point is processed. false: the schedule table processing stops when the final expiry point is processed.
      reference OsSchTblAccessingApplication [0..*]: set at pre-compile, destination=OsApplication  # Reference to applications which have an access to this object.
      reference OsScheduleTableCounterRef: set at pre-compile, destination=OsCounter  # This parameter contains a reference to the counter which drives the schedule table.
      container OsScheduleTableAutostart [0..1]  # This container specifies if and how the schedule table is started on startup of the Operating System. The options to start a schedule table correspond to the API calls to start schedule tables during runtime.
        enumeration OsScheduleTableAutostartType: {ABSOLUTE, RELATIVE, SYNCHRON}, set at pre-compile, default-value=RELATIVE  # This specifies the type of the autostart for the schedule table. | ABSOLUTE : The schedule table is started during startup with the StartScheduleTableAbs() service. RELATIVE : The schedule table is started during startup with the StartScheduleTableRel() service. SYNCHRON : The schedule table is started during startup with the StartScheduleTableSynchron() service.
        integer OsScheduleTableStartValue [0..1]: 0..4294967295, set at pre-compile, default-value=1  # Absolute autostart tick value when the schedule table starts. Only used if the OsScheduleTableAutostartType is ABSOLUTE. | Relative offset in ticks when the schedule table starts. Only used if the OsScheduleTableAutostartType is RELATIVE.
        reference OsScheduleTableAppModeRef [1..*]: set at pre-compile, destination=OsAppMode  # Reference in which application modes the schedule table should be started during startup
      container OsScheduleTableExpiryPoint [1..*]  # The point on a Schedule Table at which the OS activates tasks and/or sets events
        integer OsScheduleTblExpPointOffset: 0..4294967295, set at pre-compile, default-value=0  # The offset from zero (in ticks) at which the expiry point is to be processed.
        container OsScheduleTableEventSetting [0..*]  # Event that is triggered by that schedule table.
          reference OsScheduleTableSetEventRef: set at pre-compile, destination=OsEvent  # Reference to event that will be set by action
          reference OsScheduleTableSetEventTaskRef: set at pre-compile, destination=OsTask  # Reference to the task that will be activated by that event
        container OsScheduleTableTaskActivation [0..*]  # Task that is triggered by that schedule table.
          reference OsScheduleTableActivateTaskRef: set at pre-compile, destination=OsTask  # Reference to task that will be activated by action
        container OsScheduleTblAdjustableExpPoint [0..1]  # Adjustable expiry point
          integer OsScheduleTableMaxLengthen: 0..4294967295, set at pre-compile, default-value=0  # The maximum positive adjustment that can be made to the expiry point offset (in ticks).
          integer OsScheduleTableMaxShorten: 0..4294967295, set at pre-compile, default-value=0  # The maximum negative adjustment that can be made to the expiry point offset (in ticks).
      container OsScheduleTableSync [0..1]  # This container specifies the synchronization parameters of the schedule table.
        integer OsScheduleTblExplicitPrecision [0..1]: 0..4294967295, set at pre-compile, default-value=0  # This configuration is only valid if the explicit synchronisation is used.
        enumeration OsScheduleTblSyncStrategy: {EXPLICIT, IMPLICIT, NONE}, set at pre-compile, default-value=NONE  # AUTOSAR OS provides support for synchronisation in two ways: explicit and implicit. | EXPLICIT : The schedule table is driven by an OS counter but processing needs to be synchronized with a different counter which is not an OS counter object. IMPLICIT : The counter driving the schedule table is the counter with which synchronisation is required. NONE : No support for synchronisation(default).
    container OsSpinlock [0..*]  # An OsSpinlock object is used to co-ordinate concurrent access by TASKs/ISR2s on different cores to a shared resource.
      reference OsSpinlockAccessingApplication [1..*]: set at pre-compile, destination=OsApplication  # Reference to OsApplications that have an access to this object.
      reference OsSpinlockSuccessor [0..1]: set at pre-compile, destination=OsSpinlock  # Reference to OsApplications that have an access to this object. | To check whether a spinlock can be occupied (in a nested way) without any danger of deadlock, a linked list of spinlocks can be defined. A spinlock can only be occupied in the order of the linked list. It is allowed to skip a spinlock. If no linked list is specified, spinlocks cannot be nested.
    container OsTask [0..*]  # This container represents an OSEK task.
      integer OsTaskActivation: 1..4294967295, set at pre-compile, default-value=1  # This attribute defines the maximum number of queued activation requests for the task. A value equal to "1" means that at any time only a single activation is permitted for this task. Note that the value must be a natural number starting at 1.
      integer OsTaskPriority: 0..4294967295, set at pre-compile, default-value=0  # The priority of a task is defined by the value of this attribute. This value has to be understood as a relative value, i.e. the values show only the relative ordering of the tasks. | OSEK OS defines the lowest priority as zero (0); larger values correspond to higher priorities.
      enumeration OsTaskSchedule: {FULL, NON}, set at pre-compile, default-value=FULL  # The OsTaskSchedule attribute defines the preemptability of the task. | FULL : Task is preemptable. NON : Task is not preemptable.
      integer OsTaskStackSize [0..1]: 4..2147483644, set at pre-compile, origin=AUTRON, default-value=800  # The stack size in task is designated.
      reference OsTaskAccessingApplication [0..*]: set at pre-compile, destination=OsApplication  # Reference to applications which have an access to this object.
      reference OsTaskEventRef [0..*]: set at pre-compile, destination=OsEvent  # This reference defines the list of events the extended task may react on.
      reference OsTaskResourceRef [0..*]: set at pre-compile, destination=OsResource  # This reference defines a list of resources accessed by this task.
      container OsTaskAutostart [0..1]  # This container determines whether the task is activated during the system start-up procedure or not for some specific application modes. | If the task shall be activated during the system start-up, this container is present and holds the references to the application modes in which the task is auto-started.
        reference OsTaskAppModeRef [1..*]: set at pre-compile, destination=OsAppMode  # Reference to application modes in which that task is activated on startup of the OS
      container OsTaskTimingProtection [0..1]  # This container contains all parameters regarding timing protection of the task.
        float OsTaskAllInterruptLockBudget [0..1]: 0..4294967296, set at pre-compile, default-value=0  # This parameter contains the maximum time for which the task is allowed to lock all interrupts (via SuspendAllInterrupts() or DisableAllInterrupts()) (in seconds).
        float OsTaskExecutionBudget [0..1]: 0..4294967296, set at pre-compile, default-value=0  # This parameter contains the maximum allowed execution time of the task (in seconds).
        float OsTaskOsInterruptLockBudget [0..1]: 0..4294967296, set at pre-compile, default-value=0  # This parameter contains the maximum time for which the task is allowed to lock all Category 2 interrupts (via SuspendOSInterrupts()) (in seconds).
        float OsTaskTimeFrame [0..1]: 0..4294967296, set at pre-compile, default-value=0  # The minimum inter-arrival time between activations and/or releases of a task (in seconds).
        container OsTaskResourceLock [0..*]  # This container contains the worst case time between getting and releasing a given resource (in seconds).
          float OsTaskResourceLockBudget: 0..4294967296, set at pre-compile, default-value=0  # This parameter contains the maximum time the task is allowed to lock the resource (in seconds)
          reference OsTaskResourceLockResourceRef: set at pre-compile, destination=OsResource  # Reference to the resource used by the task
