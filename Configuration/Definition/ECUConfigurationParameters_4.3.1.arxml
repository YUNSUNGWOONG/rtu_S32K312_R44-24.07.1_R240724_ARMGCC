AUTOSAR XML (schema 4-0-3)
package /AUTOSAR/EcucDefs
  ecuc definition collection AUTOSARParameterDefinition_4_3_1: module=[Adc, BswM, Cal, Can, CanIf, CanNm, CanSM, CanTSyn, CanTp, CanTrcv, Cdd, Com, ComM, CorTst, Crc, CryIf, Crypto, Csm, Dbg, Dcm, Dem, Det, Dio, Dlt, DoIP, Ea, EcuC, EcuM, Eep, Eth, EthIf, EthSM, EthSwt, EthTSyn, EthTrcv, Fee, FiM, Fls, FlsTst, Fr, FrArTp, FrIf, FrNm, FrSM, FrTSyn, FrTp, FrTrcv, Gpt, Icu, IpduM, J1939Dcm, J1939Nm, J1939Rm, J1939Tp, LdCom, Lin, LinIf, LinNm, LinSM, LinTp, LinTrcv, Mcu, MemIf, MemMap, Nm, NvM, Ocu, Os, PduR, Port, Pwm, RamTst, Rte, Sd, SecOC, SoAd, SomeIpTp, Spi, StbM, TcpIp, Tm, UdpNm, V2xBtp, V2xFac, V2xGn, V2xM, WEth, WEthTrcv, Wdg, WdgIf, WdgM, Xcp, Xfrm]
  module definition Xfrm [0..*]: post-build-variant-support=true, variants link-time/post-build/pre-compile
    container XfrmGeneral  # Contains the general configuration parameters of the module.
      boolean XfrmDevErrorDetect: set at pre-compile, default-value=false  # Switches the development error detection and notification on or off. | * true: detection and notification is enabled. * false: detection and notification is disabled.
      integer XfrmInstanceId: 0..255, set at pre-compile  # Specifies the InstanceId of this module instance. If only one instance is present it shall have the Id 0.
      boolean XfrmVersionInfoApi: set at pre-compile, default-value=false  # Activate/Deactivate the version information API. | * true: version information API activated * false: version information API deactivated
    container XfrmImplementationMapping [1..*]  # For each transformer (TransformationTechnology) in a transformer chain (DataTransformation) which is applied to an ISignal it is necessary to specify the BswModuleEntry which implements it. This is the container to hold these mappings.
      foreign reference XfrmInvTransformerBswModuleEntryRef [0..1]: multiplicity set at pre-compile, set at pre-compile, destination-type=BSW-MODULE-ENTRY  # Reference to the BswModuleEntry which implements the referenced inverse transformer on the receiving/called side.
      foreign reference XfrmTransformationTechnologyRef: set at pre-compile, destination-type=TRANSFORMATION-TECHNOLOGY  # Reference to the TransformationTechnology in the DataTransformation of the system description for which the implementation (BswModuleEntry) shall be mapped.
      foreign reference XfrmTransformerBswModuleEntryRef [0..1]: multiplicity set at pre-compile, set at pre-compile, destination-type=BSW-MODULE-ENTRY  # Reference to the BswModuleEntry which implements the referenced transformer on the sending/calling side.
      instance reference XfrmVariableDataPrototypeInstanceRef [0..1]: multiplicity set at pre-compile, set at pre-compile, destination-context=SW-COMPONENT-PROTOTYPE PORT-PROTOTYPE, destination-type=VARIABLE-DATA-PROTOTYPE  # Instance Reference to a VariableDataPrototype in case a dedicated transformer BswModuleEntry is required per VariableDataPrototype access.
      container XfrmDemEventParameterRefs [0..1]  # Container for the references to DemEventParameter elements which shall be invoked using the API Dem_SetEventStatus in case the corresponding error occurs. The EventId is taken from the referenced DemEventParameter's DemEventId symbolic value. The standardized errors are provided in this container and can be extended by vendor-specific error references.
        symbolic name reference XFRM_E_MALFORMED_MESSAGE [0..1]: multiplicity set at pre-compile, set at pre-compile, destination=DemEventParameter  # Reference to configured DEM event to report if malformed messages were received by the transformer.
      container XfrmSignal [0..1]  # Reference to the signal in the system description that transports the transformed data.
        choice container XfrmSignalChoice  # Choice whether an ISignal or an ISignalGroup shall be referenced.
          container XfrmISignalGroupRefChoice [0..1]  # Reference to the ISignalGroup in the system description that transports the transformed data.
            foreign reference XfrmISignalGroupRef: set at pre-compile, destination-type=I-SIGNAL-GROUP  # Reference to the ISignalGroup in the system description that transports the transformed data.
          container XfrmISignalRefChoice [0..1]  # Reference to the ISignal in the system description that transports the transformed data.
            foreign reference XfrmISignalRef: set at pre-compile, destination-type=I-SIGNAL  # Reference to the ISignal in the system description that transports the transformed data.
package /AUTOSAR/LifeCycleInfoSets
  life cycle info set AUTOSARParameterDefinition_4_3_1
    life-cycle-infos:
      lc-object=BswMNmIfCarWakeUpIndication, lc-state=obsolete, period-begin=ar-release-version=4.3.1
      lc-object=CalAsymDecrypt, lc-state=obsolete
      lc-object=CalAsymDecryptMaxCtxBufByteSize, lc-state=obsolete
      lc-object=CalAsymDecryptMaxKeySize, lc-state=obsolete
      lc-object=CalAsymDecryptConfig, lc-state=obsolete
      lc-object=CalAsymDecryptInitConfiguration, lc-state=obsolete
      lc-object=CalAsymDecryptPrimitiveName, lc-state=obsolete
      lc-object=CalAsymEncrypt, lc-state=obsolete
      lc-object=CalAsymEncryptMaxCtxBufByteSize, lc-state=obsolete
      lc-object=CalAsymEncryptMaxKeySize, lc-state=obsolete
      lc-object=CalAsymEncryptConfig, lc-state=obsolete
      lc-object=CalAsymEncryptInitConfiguration, lc-state=obsolete
      lc-object=CalAsymEncryptPrimitiveName, lc-state=obsolete
      lc-object=CalAsymPrivateKeyExtract, lc-state=obsolete
      lc-object=CalAsymPrivateKeyExtractMaxCtxBufByteSize, lc-state=obsolete
      lc-object=CalAsymPrivateKeyExtractMaxKeySize, lc-state=obsolete
      lc-object=CalAsymPrivateKeyExtractConfig, lc-state=obsolete
      lc-object=CalAsymPrivateKeyExtractInitConfiguration, lc-state=obsolete
      lc-object=CalAsymPrivateKeyExtractPrimitiveName, lc-state=obsolete
      lc-object=CalAsymPrivateKeyWrapAsym, lc-state=obsolete
      lc-object=CalAsymPrivateKeyWrapAsymMaxCtxBufByteSize, lc-state=obsolete
      lc-object=CalAsymPrivateKeyWrapAsymMaxPrivKeySize, lc-state=obsolete
      lc-object=CalAsymPrivateKeyWrapAsymMaxPubKeySize, lc-state=obsolete
      lc-object=CalAsymPrivateKeyWrapAsymConfig, lc-state=obsolete
      lc-object=CalAsymPrivateKeyWrapAsymInitConfiguration, lc-state=obsolete
      lc-object=CalAsymPrivateKeyWrapAsymPrimitiveName, lc-state=obsolete
      lc-object=CalAsymPrivateKeyWrapSym, lc-state=obsolete
      lc-object=CalAsymPrivateKeyWrapSymMaxCtxBufByteSize, lc-state=obsolete
      lc-object=CalAsymPrivateKeyWrapSymMaxPrivKeySize, lc-state=obsolete
      lc-object=CalAsymPrivateKeyWrapSymMaxSymKeySize, lc-state=obsolete
      lc-object=CalAsymPrivateKeyWrapSymConfig, lc-state=obsolete
      lc-object=CalAsymPrivateKeyWrapSymInitConfiguration, lc-state=obsolete
      lc-object=CalAsymPrivateKeyWrapSymPrimitiveName, lc-state=obsolete
      lc-object=CalAsymPublicKeyExtract, lc-state=obsolete
      lc-object=CalAsymPublicKeyExtractMaxCtxBufByteSize, lc-state=obsolete
      lc-object=CalAsymPublicKeyExtractMaxKeySize, lc-state=obsolete
      lc-object=CalAsymPublicKeyExtractConfig, lc-state=obsolete
      lc-object=CalAsymPublicKeyExtractInitConfiguration, lc-state=obsolete
      lc-object=CalAsymPublicKeyExtractPrimitiveName, lc-state=obsolete
      lc-object=CalChecksum, lc-state=obsolete
      lc-object=CalChecksumMaxCtxBufByteSize, lc-state=obsolete
      lc-object=CalChecksumConfig, lc-state=obsolete
      lc-object=CalChecksumInitConfiguration, lc-state=obsolete
      lc-object=CalChecksumPrimitiveName, lc-state=obsolete
      lc-object=CalCompression, lc-state=obsolete
      lc-object=CalCompressMaxCtxBufByteSize, lc-state=obsolete
      lc-object=CalCompressionConfig, lc-state=obsolete
      lc-object=CalCompressInitConfiguration, lc-state=obsolete
      lc-object=CalCompressPrimitiveName, lc-state=obsolete
      lc-object=CalDecompression, lc-state=obsolete
      lc-object=CalDecompressMaxCtxBufByteSize, lc-state=obsolete
      lc-object=CalDecompressionConfig, lc-state=obsolete
      lc-object=CalDecompressInitConfiguration, lc-state=obsolete
      lc-object=CalDecompressPrimitiveName, lc-state=obsolete
      lc-object=CalGeneral, lc-state=obsolete
      lc-object=CalMaxAlignScalarType, lc-state=obsolete
      lc-object=CalVersionInfoApi, lc-state=obsolete
      lc-object=CalHash, lc-state=obsolete
      lc-object=CalHashMaxCtxBufByteSize, lc-state=obsolete
      lc-object=CalHashConfig, lc-state=obsolete
      lc-object=CalHashInitConfiguration, lc-state=obsolete
      lc-object=CalHashPrimitiveName, lc-state=obsolete
      lc-object=CalKeyDerive, lc-state=obsolete
      lc-object=CalKeyDeriveMaxCtxBufByteSize, lc-state=obsolete
      lc-object=CalKeyDeriveMaxKeySize, lc-state=obsolete
      lc-object=CalKeyDeriveConfig, lc-state=obsolete
      lc-object=CalKeyDeriveInitConfiguration, lc-state=obsolete
      lc-object=CalKeyDerivePrimitiveName, lc-state=obsolete
      lc-object=CalKeyExchangeCalcPubVal, lc-state=obsolete
      lc-object=CalKeyExchangeCalcPubValMaxBaseTypeSize, lc-state=obsolete
      lc-object=CalKeyExchangeCalcPubValMaxCtxBufByteSize, lc-state=obsolete
      lc-object=CalKeyExchangeCalcPubValMaxPrivateTypeSize, lc-state=obsolete
      lc-object=CalKeyExchangeCalcPubValConfig, lc-state=obsolete
      lc-object=CalKeyExchangeCalcPubValInitConfiguration, lc-state=obsolete
      lc-object=CalKeyExchangeCalcPubValPrimitiveName, lc-state=obsolete
      lc-object=CalKeyExchangeCalcSecret, lc-state=obsolete
      lc-object=CalKeyExchangeCalcSecretMaxBaseTypeSize, lc-state=obsolete
      lc-object=CalKeyExchangeCalcSecretMaxCtxBufByteSize, lc-state=obsolete
      lc-object=CalKeyExchangeCalcSecretMaxPrivateTypeSize, lc-state=obsolete
      lc-object=CalKeyExchangeCalcSecretConfig, lc-state=obsolete
      lc-object=CalKeyExchangeCalcSecretInitConfiguration, lc-state=obsolete
      lc-object=CalKeyExchangeCalcSecretPrimitiveName, lc-state=obsolete
      lc-object=CalMacGenerate, lc-state=obsolete
      lc-object=CalMacGenerateMaxCtxBufByteSize, lc-state=obsolete
      lc-object=CalMacGenerateMaxKeySize, lc-state=obsolete
      lc-object=CalMacGenerateConfig, lc-state=obsolete
      lc-object=CalMacGenerateInitConfiguration, lc-state=obsolete
      lc-object=CalMacGeneratePrimitiveName, lc-state=obsolete
      lc-object=CalMacVerify, lc-state=obsolete
      lc-object=CalMacVerifyMaxCtxBufByteSize, lc-state=obsolete
      lc-object=CalMacVerifyMaxKeySize, lc-state=obsolete
      lc-object=CalMacVerifyConfig, lc-state=obsolete
      lc-object=CalMacVerifyInitConfiguration, lc-state=obsolete
      lc-object=CalMacVerifyPrimitiveName, lc-state=obsolete
      lc-object=CalRandomGenerate, lc-state=obsolete
      lc-object=CalRandomGenerateConfig, lc-state=obsolete
      lc-object=CalRandomGenerateInitConfiguration, lc-state=obsolete
      lc-object=CalRandomGeneratePrimitiveName, lc-state=obsolete
      lc-object=CalRandomSeed, lc-state=obsolete
      lc-object=CalRandomMaxCtxBufByteSize, lc-state=obsolete
      lc-object=CalRandomSeedConfig, lc-state=obsolete
      lc-object=CalRandomSeedInitConfiguration, lc-state=obsolete
      lc-object=CalRandomSeedPrimitiveName, lc-state=obsolete
      lc-object=CalSignatureGenerate, lc-state=obsolete
      lc-object=CalSignatureGenerateMaxCtxBufByteSize, lc-state=obsolete
      lc-object=CalSignatureGenerateMaxKeySize, lc-state=obsolete
      lc-object=CalSignatureGenerateConfig, lc-state=obsolete
      lc-object=CalSignatureGenerateInitConfiguration, lc-state=obsolete
      lc-object=CalSignatureGeneratePrimitiveName, lc-state=obsolete
      lc-object=CalSignatureVerify, lc-state=obsolete
      lc-object=CalSignatureVerifyMaxCtxBufByteSize, lc-state=obsolete
      lc-object=CalSignatureVerifyMaxKeySize, lc-state=obsolete
      lc-object=CalSignatureVerifyConfig, lc-state=obsolete
      lc-object=CalSignatureVerifyInitConfiguration, lc-state=obsolete
      lc-object=CalSignatureVerifyPrimitiveName, lc-state=obsolete
      lc-object=CalSymBlockDecrypt, lc-state=obsolete
      lc-object=CalSymBlockDecryptMaxCtxBufByteSize, lc-state=obsolete
      lc-object=CalSymBlockDecryptMaxKeySize, lc-state=obsolete
      lc-object=CalSymBlockDecryptConfig, lc-state=obsolete
      lc-object=CalSymBlockDecryptInitConfiguration, lc-state=obsolete
      lc-object=CalSymBlockDecryptPrimitiveName, lc-state=obsolete
      lc-object=CalSymBlockEncrypt, lc-state=obsolete
      lc-object=CalSymBlockEncryptMaxCtxBufByteSize, lc-state=obsolete
      lc-object=CalSymBlockEncryptMaxKeySize, lc-state=obsolete
      lc-object=CalSymBlockEncryptConfig, lc-state=obsolete
      lc-object=CalSymBlockEncryptInitConfiguration, lc-state=obsolete
      lc-object=CalSymBlockEncryptPrimitiveName, lc-state=obsolete
      lc-object=CalSymDecrypt, lc-state=obsolete
      lc-object=CalSymDecryptMaxCtxBufByteSize, lc-state=obsolete
      lc-object=CalSymDecryptMaxKeySize, lc-state=obsolete
      lc-object=CalSymDecryptConfig, lc-state=obsolete
      lc-object=CalSymDecryptInitConfiguration, lc-state=obsolete
      lc-object=CalSymDecryptPrimitiveName, lc-state=obsolete
      lc-object=CalSymEncrypt, lc-state=obsolete
      lc-object=CalSymEncryptMaxCtxBufByteSize, lc-state=obsolete
      lc-object=CalSymEncryptMaxKeySize, lc-state=obsolete
      lc-object=CalSymEncryptConfig, lc-state=obsolete
      lc-object=CalSymEncryptInitConfiguration, lc-state=obsolete
      lc-object=CalSymEncryptPrimitiveName, lc-state=obsolete
      lc-object=CalSymKeyExtract, lc-state=obsolete
      lc-object=CalSymKeyExtractMaxCtxBufByteSize, lc-state=obsolete
      lc-object=CalSymKeyExtractMaxKeySize, lc-state=obsolete
      lc-object=CalSymKeyExtractConfig, lc-state=obsolete
      lc-object=CalSymKeyExtractInitConfiguration, lc-state=obsolete
      lc-object=CalSymKeyExtractPrimitiveName, lc-state=obsolete
      lc-object=CalSymKeyWrapAsym, lc-state=obsolete
      lc-object=CalSymKeyWrapAsymMaxCtxBufByteSize, lc-state=obsolete
      lc-object=CalSymKeyWrapAsymMaxPubKeySize, lc-state=obsolete
      lc-object=CalSymKeyWrapAsymMaxSymKeySize, lc-state=obsolete
      lc-object=CalSymKeyWrapAsymConfig, lc-state=obsolete
      lc-object=CalSymKeyWrapAsymInitConfiguration, lc-state=obsolete
      lc-object=CalSymKeyWrapAsymPrimitiveName, lc-state=obsolete
      lc-object=CalSymKeyWrapSym, lc-state=obsolete
      lc-object=CalSymKeyWrapSymMaxCtxBufByteSize, lc-state=obsolete
      lc-object=CalSymKeyWrapSymMaxSymKeySize, lc-state=obsolete
      lc-object=CalSymKeyWrapSymConfig, lc-state=obsolete
      lc-object=CalSymKeyWrapSymInitConfiguration, lc-state=obsolete
      lc-object=CalSymKeyWrapSymPrimitiveName, lc-state=obsolete
      lc-object=CanNmNodeDetectionEnabled, lc-state=obsolete
      lc-object=CanNmNodeIdEnabled, lc-state=obsolete
      lc-object=CanNmRepeatMsgIndEnabled, lc-state=obsolete
      lc-object=DcmDsdRequestManufacturerNotificationEnabled, lc-state=obsolete
      lc-object=DcmDsdRequestSupplierNotificationEnabled, lc-state=obsolete
      lc-object=DcmDslProtocolID, lc-state=obsolete
      lc-object=DcmDslProtocolPreemptTimeout, lc-state=obsolete, period-begin=ar-release-version=4.3.1
      lc-object=DcmSendRespPendOnTransToBoot, lc-state=obsolete
      lc-object=UINT8_DYN, lc-state=obsolete, period-begin=ar-release-version=4.3.1
      lc-object=DcmDspRoeStorageState, lc-state=obsolete, period-begin=ar-release-version=4.3.1
      lc-object=DemTriggerDcmReports, lc-state=obsolete
      lc-object=DoIPVehicleAnnouncementRepetition, lc-state=obsolete
      lc-object=EcuMFixedConfiguration, lc-state=obsolete
      lc-object=EcuMNvramReadallTimeout, lc-state=obsolete
      lc-object=EcuMNvramWriteallTimeout, lc-state=obsolete
      lc-object=EcuMRunMinimumDuration, lc-state=obsolete
      lc-object=EcuMComMCommunicationAllowedList, lc-state=obsolete
      lc-object=EcuMNormalMcuModeRef, lc-state=obsolete
      lc-object=EcuMDriverInitListThree, lc-state=obsolete
      lc-object=EcuMDriverInitListTwo, lc-state=obsolete
      lc-object=EcuMFixedUserConfig, lc-state=obsolete
      lc-object=EcuMFixedUser, lc-state=obsolete
      lc-object=EcuMTTII, lc-state=obsolete
      lc-object=EcuMDivisor, lc-state=obsolete
      lc-object=EcuMSleepModeRef, lc-state=obsolete
      lc-object=EcuMSuccessorRef, lc-state=obsolete
      lc-object=EcuMFixedGeneral, lc-state=obsolete
      lc-object=EcuMIncludeComM, lc-state=obsolete
      lc-object=EcuMTTIIEnabled, lc-state=obsolete
      lc-object=EcuMTTIIWakeupSourceRef, lc-state=obsolete
      lc-object=EthUpdatePhysAddrFilter, lc-state=obsolete
      lc-object=EthSwtPortEnableLinkDownCallback, lc-state=obsolete, period-begin=ar-release-version=4.3.1
      lc-object=EthSwtGetCfgHexDumpApi, lc-state=obsolete, period-begin=ar-release-version=4.3.1
      lc-object=EthSwtGetCfgHexDumpLengthApi, lc-state=obsolete, period-begin=ar-release-version=4.3.1
      lc-object=EthSwtLinkDownUser, lc-state=obsolete, period-begin=ar-release-version=4.3.1
      lc-object=EthSwtLinkUpUser, lc-state=obsolete, period-begin=ar-release-version=4.3.1
      lc-object=EthTSynIsSystemWideGlobalTimeMaster, lc-state=obsolete, period-begin=ar-release-version=4.3.1
      lc-object=FlsTstBlockBgndConfigSet, lc-state=obsolete, period-begin=ar-release-version=4.3.1
      lc-object=FlsTstBlockFgndConfigSet, lc-state=obsolete, period-begin=ar-release-version=4.3.1
      lc-object=FrNmNodeDetectionEnabled, lc-state=obsolete
      lc-object=FrNmSourceNodeIdentifierEnabled, lc-state=obsolete
      lc-object=IpduMContainedPduOffset, lc-state=draft
      lc-object=IpduMPduUpdateBitPosition, lc-state=draft
      lc-object=IpduMContainedPduOffset, lc-state=draft
      lc-object=IpduMPduUpdateBitPosition, lc-state=draft
      lc-object=IPDUM_HEADERTYPE_NONE, lc-state=draft
      lc-object=IPDUM_HEADERTYPE_NONE, lc-state=draft
      lc-object=IpduMUnusedAreasDefault, lc-state=draft
      lc-object=LinIfStartupState, lc-state=obsolete
      lc-object=NORMAL, lc-state=obsolete
      lc-object=SLEEP, lc-state=obsolete
      lc-object=LinNmNodeDetectionEnabled, lc-state=obsolete
      lc-object=LinNmNodeIdEnabled, lc-state=obsolete
      lc-object=LinTrcvInitState, lc-state=obsolete
      lc-object=LINTRCV_TRCV_MODE_NORMAL, lc-state=obsolete
      lc-object=LINTRCV_TRCV_MODE_SLEEP, lc-state=obsolete
      lc-object=LINTRCV_TRCV_MODE_STANDBY, lc-state=obsolete
      lc-object=NmNodeDetectionEnabled, lc-state=obsolete
      lc-object=NmNodeIdEnabled, lc-state=obsolete
      lc-object=NmRepeatMsgIndEnabled, lc-state=obsolete
      lc-object=OcuGroup, lc-state=obsolete, period-begin=ar-release-version=4.3.0
      lc-object=OcuGroupId, lc-state=obsolete, period-begin=ar-release-version=4.3.0
      lc-object=OcuGroupDefinition, lc-state=obsolete, period-begin=ar-release-version=4.3.0
      lc-object=PduRChangeParameterApi, lc-state=obsolete
      lc-object=RteUseComShadowSignalApi, lc-state=obsolete, period-begin=ar-release-version=4.3.1
      lc-object=SpiHwUnitSynchronous, lc-state=obsolete
      lc-object=UdpNmNodeDetectionEnabled, lc-state=obsolete
      lc-object=UdpNmNodeIdEnabled, lc-state=obsolete
      lc-object=UdpNmRepeatMsgIndEnabled, lc-state=obsolete
      lc-object=UdpNmMsgTimeoutTime, lc-state=obsolete, period-begin=ar-release-version=4.3.1
