AUTOSAR XML (schema 00047)
package /AUTRON
  module config Nm: implementation-config-variant=VARIANT-PRE-COMPILE, module-description=BswImplementation_Nm
    NmGlobalConfig
      NmGlobalConstants: category=TOOL_CONFIGURED, NmNumberOfChannels=1
      NmGlobalFeatures:
        category = TOOL_CONFIGURED
        NmBusSynchronizationEnabled = 0
        NmCarWakeUpRxEnabled = 0
        NmComControlEnabled = 1
        NmCoordinatorSupportEnabled = 0
        NmCoordinatorSyncSupport = 0
        NmPduRxIndicationEnabled = 0
        NmRemoteSleepIndEnabled = 0
        NmStateChangeIndEnabled = 0
        NmUserDataEnabled = 1
      NmGlobalProperties: category=TOOL_CONFIGURED, NmDevErrorDetect=1, NmVersionInfoApi=1, NmCycletimeMainFunction=0.005
    NmChannel_FD_CAN1 (NmChannelConfig):
      NmChannelSleepMaster = 0
      NmPassiveModeEnabled = 0
      NmStateReportEnabled = 0
      NmSynchronizingNetwork = 0
      NmCoordClusterIndex = 0
      NmActiveCoordinator = 1
      NmComUserDataSupport = 1
      NmComMChannelRef = ComMChannel_FD_CAN1
      NmBusType: category=TOOL_CONFIGURED
        NmStandardBusNmConfig: category=TOOL_CONFIGURED, NmStandardBusType=NM_BUSNM_CANNM
