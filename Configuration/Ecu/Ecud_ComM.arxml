AUTOSAR XML (schema 00047)
package /AUTRON
  module config ComM: implementation-config-variant=VARIANT-PRE-COMPILE, module-description=BswImplementation_ComM, post-build-variant-used=false
    ComMConfigSet: ComMPncEnabled=1
      ComMChannel_FD_CAN1 (ComMChannel):
        category = TOOL_CONFIGURED
        ComMBusType = COMM_BUS_TYPE_CAN
        ComMChannelId = 0
        ComMNoWakeUpInhibitionNvmStorage = 0
        ComMFullCommRequestNotificationEnabled = 0
        ComMMainFunctionPeriod = 0.005
        ComMNoWakeup = 0
        ComMNoCom = 1
        ComMNetworkManagement_FD_CAN1 (ComMNetworkManagement): category=TOOL_CONFIGURED, ComMNmLightTimeout=0, ComMNmVariant=FULL, ComMPncNmRequest=0
      ComMChannel_LIN1 (ComMChannel):
        category = TOOL_CONFIGURED
        ComMFullCommRequestNotificationEnabled = 0
        ComMMainFunctionPeriod = 0.005
        ComMNoWakeup = 0
        ComMChannelId = 1
        ComMBusType = COMM_BUS_TYPE_LIN
        ComMNoWakeUpInhibitionNvmStorage = 0
        ComMNoCom = 1
        ComMUserPerChannel_LIN1 (ComMUserPerChannel): category=TOOL_CONFIGURED, ComMUserChannel=ComMUser_LIN1
        ComMNetworkManagement_LIN1 (ComMNetworkManagement): category=TOOL_CONFIGURED, ComMNmLightTimeout=0, ComMNmVariant=LIGHT, ComMPncNmRequest=0
      ComMUser_LIN1 (ComMUser): category=TOOL_CONFIGURED, ComMUserIdentifier=0
      ComMUser_PNC32 (ComMUser): category=TOOL_CONFIGURED, ComMUserIdentifier=2
      ComMPnc_PNC32 (ComMPnc): category=TOOL_CONFIGURED, ComMPncId=32, ComMUserPerPnc=ComMUser_PNC32, ComMChannelPerPnc=ComMChannel_FD_CAN1
        ComMPnc_ComSignal_Tx_FD_CAN1_PNC_32 (ComMPncComSignal):
          category = TOOL_CONFIGURED
          ComMPncComSignalKind = EIRA
          ComMPncComSignalDirection = TX
          ComMPncComSignalChannelRef = ComMChannel_FD_CAN1
          ComMPncComSignalRef = ComISignal_Tx_PncVector_FD_CAN1
        ComMPnc_ComSignal_Rx_Can_PNC_32 (ComMPncComSignal): category=TOOL_CONFIGURED, ComMPncComSignalKind=EIRA, ComMPncComSignalDirection=RX, ComMPncComSignalRef=ComISignal_Rx_EIRA_CanNm
      ComMUser_LIN2 (ComMUser): category=TOOL_CONFIGURED, ComMUserIdentifier=1
      ComMChannel_LIN2 (ComMChannel):
        category = TOOL_CONFIGURED
        ComMNoWakeUpInhibitionNvmStorage = 0
        ComMBusType = COMM_BUS_TYPE_LIN
        ComMChannelId = 2
        ComMNoCom = 1
        ComMNoWakeup = 0
        ComMMainFunctionPeriod = 0.005
        ComMFullCommRequestNotificationEnabled = 0
        ComMNetworkManagement_LIN2 (ComMNetworkManagement): category=TOOL_CONFIGURED, ComMNmLightTimeout=0, ComMNmVariant=LIGHT, ComMPncNmRequest=0
        ComMUserPerChannel_LIN2 (ComMUserPerChannel): category=TOOL_CONFIGURED, ComMUserChannel=ComMUser_LIN2
    ComMGeneral:
      ComMEcuGroupClassification = 3
      ComMModeLimitationEnabled = 1
      ComMResetAfterForcingNoComm = 1
      ComMSynchronousWakeUp = 1
      ComMTMinFullComModeDuration = 5
      ComMVersionInfoApi = 1
      ComMWakeupInhibitionEnabled = 1
      ComMDirectUserMapping = 1
      ComMDevErrorDetect = 1
      ComMCanCMSupport = 1
      ComM0PncVectorAvoidance = 0
      ComMBusloadDetectingApi = 0
      ComMPncGatewayEnabled = 0
      ComMPncSupport = 1
      ComMPncPrepareSleepTimer = 0.5
