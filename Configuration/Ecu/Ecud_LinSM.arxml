AUTOSAR XML (schema 00047)
package /AUTRON
  module config LinSM: implementation-config-variant=VARIANT-PRE-COMPILE, module-description=BswImplementation_LinSM
    LinSMConfigSet: LinSMModeRequestRepetitionMax=0
      LinSMChannel_LIN1 (LinSMChannel):
        category = TOOL_CONFIGURED
        LinSMNodeType = MASTER
        LinSMConfirmationTimeout = 0
        LinSMTransceiverPassiveMode = 0
        LinSMComMNetworkHandleRef = ComMChannel_LIN1
        23 x LinSMSchedule, all with category=TOOL_CONFIGURED:
          LIN1_NULL: LinSMScheduleIndex=0, LinSMScheduleIndexRef=LinIfScheduleTable_LIN1_NULL
          LIN1_SCHEDULER_RPAS_NORMAL: LinSMScheduleIndex=1, LinSMScheduleIndexRef=LinIfScheduleTable_LIN1_SCHEDULER_RPAS_NORMAL
          LIN1_SCHEDULER_RPAS_CRC_COMPARE: LinSMScheduleIndex=2, LinSMScheduleIndexRef=LinIfScheduleTable_LIN1_SCHEDULER_RPAS_CRC_COMPARE
          LIN1_SCHEDULER_PAS_NORMAL: LinSMScheduleIndex=3, LinSMScheduleIndexRef=LinIfScheduleTable_LIN1_SCHEDULER_PAS_NORMAL
          LIN1_SCHEDULER_PAS_CRC_COMPARE: LinSMScheduleIndex=4, LinSMScheduleIndexRef=LinIfScheduleTable_LIN1_SCHEDULER_PAS_CRC_COMPARE
          LIN1_SCHEDULER_FRONT_PAS_NORMAL: LinSMScheduleIndex=5, LinSMScheduleIndexRef=LinIfScheduleTable_LIN1_SCHEDULER_FRONT_PAS_NORMAL
          LIN1_SCHEDULER_PAS_DIAG_IBU: LinSMScheduleIndex=6, LinSMScheduleIndexRef=LinIfScheduleTable_LIN1_SCHEDULER_PAS_DIAG_IBU
          LIN1_SCHEDULER_PAS_DIAG_FL: LinSMScheduleIndex=7, LinSMScheduleIndexRef=LinIfScheduleTable_LIN1_SCHEDULER_PAS_DIAG_FL
          LIN1_SCHEDULER_PAS_DIAG_FCL: LinSMScheduleIndex=8, LinSMScheduleIndexRef=LinIfScheduleTable_LIN1_SCHEDULER_PAS_DIAG_FCL
          LIN1_SCHEDULER_PAS_DIAG_FCR: LinSMScheduleIndex=9, LinSMScheduleIndexRef=LinIfScheduleTable_LIN1_SCHEDULER_PAS_DIAG_FCR
          LIN1_SCHEDULER_PAS_DIAG_FR: LinSMScheduleIndex=10, LinSMScheduleIndexRef=LinIfScheduleTable_LIN1_SCHEDULER_PAS_DIAG_FR
          LIN1_SCHEDULER_PAS_DIAG_RL: LinSMScheduleIndex=11, LinSMScheduleIndexRef=LinIfScheduleTable_LIN1_SCHEDULER_PAS_DIAG_RL
          LIN1_SCHEDULER_PAS_DIAG_RCL: LinSMScheduleIndex=12, LinSMScheduleIndexRef=LinIfScheduleTable_LIN1_SCHEDULER_PAS_DIAG_RCL
          LIN1_SCHEDULER_PAS_DIAG_RCR: LinSMScheduleIndex=13, LinSMScheduleIndexRef=LinIfScheduleTable_LIN1_SCHEDULER_PAS_DIAG_RCR
          LIN1_SCHEDULER_PAS_DIAG_RR: LinSMScheduleIndex=14, LinSMScheduleIndexRef=LinIfScheduleTable_LIN1_SCHEDULER_PAS_DIAG_RR
          LIN1_SCHEDULER_RPAS_VER_CHECK: LinSMScheduleIndex=15, LinSMScheduleIndexRef=LinIfScheduleTable_LIN1_SCHEDULER_RPAS_VER_CHECK
          LIN1_SCHEDULER_FPAS_VER_CHECK: LinSMScheduleIndex=16, LinSMScheduleIndexRef=LinIfScheduleTable_LIN1_SCHEDULER_FPAS_VER_CHECK
          LIN1_SCHEDULER_RPAS_TUNNING_WRITE: LinSMScheduleIndex=17, LinSMScheduleIndexRef=LinIfScheduleTable_LIN1_SCHEDULER_RPAS_TUNNING_WRITE
          LIN1_SCHEDULER_RPAS_TEMP_COMP: LinSMScheduleIndex=18, LinSMScheduleIndexRef=LinIfScheduleTable_LIN1_SCHEDULER_RPAS_TEMP_COMP
          LIN1_SCHEDULER_FPAS_TUNNING_WRITE: LinSMScheduleIndex=19, LinSMScheduleIndexRef=LinIfScheduleTable_LIN1_SCHEDULER_FPAS_TUNNING_WRITE
          LIN1_SCHEDULER_PAS_TEMP_COMP: LinSMScheduleIndex=20, LinSMScheduleIndexRef=LinIfScheduleTable_LIN1_SCHEDULER_PAS_TEMP_COMP
          LIN1_SCHEDULER_PAS_DIAG: LinSMScheduleIndex=21, LinSMScheduleIndexRef=LinIfScheduleTable_LIN1_SCHEDULER_PAS_DIAG
          LIN1_SCHEDULER_PAS_SENSOR_REQUEST: LinSMScheduleIndex=22, LinSMScheduleIndexRef=LinIfScheduleTable_LIN1_SCHEDULER_PAS_SENSOR_REQUEST
      LinSMChannel_LIN2 (LinSMChannel):
        category = TOOL_CONFIGURED
        LinSMNodeType = MASTER
        LinSMConfirmationTimeout = 0
        LinSMTransceiverPassiveMode = 0
        LinSMComMNetworkHandleRef = ComMChannel_LIN2
        23 x LinSMSchedule, all with category=TOOL_CONFIGURED:
          LIN2_NULL: LinSMScheduleIndex=0, LinSMScheduleIndexRef=LinIfScheduleTable_LIN2_NULL
          LIN2_SCHEDULER_RPAS_NORMAL: LinSMScheduleIndex=1, LinSMScheduleIndexRef=LinIfScheduleTable_LIN2_SCHEDULER_RPAS_NORMAL
          LIN2_SCHEDULER_RPAS_CRC_COMPARE: LinSMScheduleIndex=2, LinSMScheduleIndexRef=LinIfScheduleTable_LIN2_SCHEDULER_RPAS_CRC_COMPARE
          LIN2_SCHEDULER_PAS_NORMAL: LinSMScheduleIndex=3, LinSMScheduleIndexRef=LinIfScheduleTable_LIN2_SCHEDULER_PAS_NORMAL
          LIN2_SCHEDULER_PAS_CRC_COMPARE: LinSMScheduleIndex=4, LinSMScheduleIndexRef=LinIfScheduleTable_LIN2_SCHEDULER_PAS_CRC_COMPARE
          LIN2_SCHEDULER_FRONT_PAS_NORMAL: LinSMScheduleIndex=5, LinSMScheduleIndexRef=LinIfScheduleTable_LIN2_SCHEDULER_FRONT_PAS_NORMAL
          LIN2_SCHEDULER_PAS_DIAG_IBU: LinSMScheduleIndex=6, LinSMScheduleIndexRef=LinIfScheduleTable_LIN2_SCHEDULER_PAS_DIAG_IBU
          LIN2_SCHEDULER_PAS_DIAG_FL: LinSMScheduleIndex=7, LinSMScheduleIndexRef=LinIfScheduleTable_LIN2_SCHEDULER_PAS_DIAG_FL
          LIN2_SCHEDULER_PAS_DIAG_FCL: LinSMScheduleIndex=8, LinSMScheduleIndexRef=LinIfScheduleTable_LIN2_SCHEDULER_PAS_DIAG_FCL
          LIN2_SCHEDULER_PAS_DIAG_FCR: LinSMScheduleIndex=9, LinSMScheduleIndexRef=LinIfScheduleTable_LIN2_SCHEDULER_PAS_DIAG_FCR
          LIN2_SCHEDULER_PAS_DIAG_FR: LinSMScheduleIndex=10, LinSMScheduleIndexRef=LinIfScheduleTable_LIN2_SCHEDULER_PAS_DIAG_FR
          LIN2_SCHEDULER_PAS_DIAG_RL: LinSMScheduleIndex=11, LinSMScheduleIndexRef=LinIfScheduleTable_LIN2_SCHEDULER_PAS_DIAG_RL
          LIN2_SCHEDULER_PAS_DIAG_RCL: LinSMScheduleIndex=12, LinSMScheduleIndexRef=LinIfScheduleTable_LIN2_SCHEDULER_PAS_DIAG_RCL
          LIN2_SCHEDULER_PAS_DIAG_RCR: LinSMScheduleIndex=13, LinSMScheduleIndexRef=LinIfScheduleTable_LIN2_SCHEDULER_PAS_DIAG_RCR
          LIN2_SCHEDULER_PAS_DIAG_RR: LinSMScheduleIndex=14, LinSMScheduleIndexRef=LinIfScheduleTable_LIN2_SCHEDULER_PAS_DIAG_RR
          LIN2_SCHEDULER_RPAS_VER_CHECK: LinSMScheduleIndex=15, LinSMScheduleIndexRef=LinIfScheduleTable_LIN2_SCHEDULER_RPAS_VER_CHECK
          LIN2_SCHEDULER_FPAS_VER_CHECK: LinSMScheduleIndex=16, LinSMScheduleIndexRef=LinIfScheduleTable_LIN2_SCHEDULER_FPAS_VER_CHECK
          LIN2_SCHEDULER_RPAS_TUNNING_WRITE: LinSMScheduleIndex=17, LinSMScheduleIndexRef=LinIfScheduleTable_LIN2_SCHEDULER_RPAS_TUNNING_WRITE
          LIN2_SCHEDULER_RPAS_TEMP_COMP: LinSMScheduleIndex=18, LinSMScheduleIndexRef=LinIfScheduleTable_LIN2_SCHEDULER_RPAS_TEMP_COMP
          LIN2_SCHEDULER_FPAS_TUNNING_WRITE: LinSMScheduleIndex=19, LinSMScheduleIndexRef=LinIfScheduleTable_LIN2_SCHEDULER_FPAS_TUNNING_WRITE
          LIN2_SCHEDULER_PAS_TEMP_COMP: LinSMScheduleIndex=20, LinSMScheduleIndexRef=LinIfScheduleTable_LIN2_SCHEDULER_PAS_TEMP_COMP
          LIN2_SCHEDULER_PAS_DIAG: LinSMScheduleIndex=21, LinSMScheduleIndexRef=LinIfScheduleTable_LIN2_SCHEDULER_PAS_DIAG
          LIN2_SCHEDULER_PAS_SENSOR_REQUEST: LinSMScheduleIndex=22, LinSMScheduleIndexRef=LinIfScheduleTable_LIN2_SCHEDULER_PAS_SENSOR_REQUEST
    LinSMGeneral: LinSMDevErrorDetect=1, LinSMMainProcessingPeriod=0.01, LinSMVersionInfoApi=1
