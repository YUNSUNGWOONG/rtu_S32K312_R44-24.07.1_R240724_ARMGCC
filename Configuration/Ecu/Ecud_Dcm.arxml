AUTOSAR XML (schema 00047)
package /AUTRON
  module config Dcm: implementation-config-variant=VARIANT-PRE-COMPILE, module-description=BswImplementation_Dcm
    DcmConfigSet
      DcmDsl: category=TOOL_CONFIGURED
        4 x DcmDslBuffer, all with category=TOOL_CONFIGURED:
          UDS_RX_BUFFER: DcmDslBufferSize=255
          UDS_TX_BUFFER: DcmDslBufferSize=255
          PERIODIC_RX_BUFFER: DcmDslBufferSize=8
          PERIODIC_TX_BUFFER: DcmDslBufferSize=32
        ECU1 (DcmDslCallbackDCMRequestService)
        DcmDslDiagResp: category=TOOL_CONFIGURED, DcmDslDiagRespMaxNumRespPend=5, DcmDslDiagRespOnSecondDeclinedRequest=1
        Dcm_DiagCom_Protocol (DcmDslProtocol): category=TOOL_CONFIGURED
          3 x DcmDslProtocolRow, all with DcmDslProtocolRowUsed=1, DcmTimStrP2ServerAdjust=0.02, DcmTimStrP2StarServerAdjust=2.5, DcmDemClientRef=DemClient0, DcmDslProtocolSIDTable=ES95486_SERVICES:
            UDS_ON_CAN: category=TOOL_CONFIGURED, DcmDslProtocolType=DCM_UDS_ON_CAN, DcmSendRespPendOnRestart=1, DcmDslProtocolPriority=2, DcmDslProtocolRxBufferRef=UDS_RX_BUFFER, DcmDslProtocolTxBufferRef=UDS_TX_BUFFER
              UDS_ON_FD_CAN1 (DcmDslConnection): category=TOOL_CONFIGURED
                DcmDslMainConnection: category=TOOL_CONFIGURED, DcmDslProtocolRxTesterSourceAddr=0xf0, DcmDslProtocolRxConnectionId=0, DcmDslProtocolComMChannelRef=ComMChannel_FD_CAN1
                  PhysicalRequest (DcmDslProtocolRx):
                    category = TOOL_CONFIGURED
                    DcmDslProtocolRxAddrType = DCM_PHYSICAL_TYPE
                    DcmDslProtocolRxPduId = 0
                    DcmDslProtocolRxPduRef = Pdu_DcmIPdu_FD_CAN1_Diag_Msg_TP_Phys_Req_FD_CAN1
                  FunctionalRequest (DcmDslProtocolRx):
                    category = TOOL_CONFIGURED
                    DcmDslProtocolRxAddrType = DCM_FUNCTIONAL_TYPE
                    DcmDslProtocolRxPduId = 1
                    DcmDslProtocolRxPduRef = Pdu_DcmIPdu_FD_CAN1_Diag_Msg_TP_Func_FD_CAN1
                  Response (DcmDslProtocolTx): category=TOOL_CONFIGURED, DcmDslTxConfirmationPduId=0, DcmDslProtocolTxPduRef=Pdu_DcmIPdu_FD_CAN1_Diag_Msg_TP_Phys_Res_FD_CAN1
            PERIODIC_ON_CAN: DcmSendRespPendOnRestart=1, DcmDslProtocolPriority=3, DcmDslProtocolType=DCM_PERIODICTRANS_ON_CAN, DcmDslProtocolRxBufferRef=PERIODIC_RX_BUFFER, DcmDslProtocolTxBufferRef=PERIODIC_TX_BUFFER
              PERIODIC_ON_CAN_CONNECTION (DcmDslConnection)
                DcmDslPeriodicTransmission
                  DcmDslPeriodicConnection1 (DcmDslPeriodicConnection): DcmDslPeriodicTxConfirmationPduId=0, DcmDslPeriodicTxPduRef=Pdu_DcmIPdu_FD_CAN1_Diag_Msg_TP_Phys_Res_FD_CAN1
            UDS_ON_LIN: category=TOOL_CONFIGURED, DcmDslProtocolPriority=4, DcmDslProtocolType=DCM_UDS_ON_LIN, DcmSendRespPendOnRestart=0, DcmDslProtocolRxBufferRef=UDS_RX_BUFFER, DcmDslProtocolTxBufferRef=UDS_TX_BUFFER
              UDS_ON_LIN_CONNECTION (DcmDslConnection): category=TOOL_CONFIGURED
                UDS_ON_LIN_MAIN_CONNECTION (DcmDslMainConnection): category=TOOL_CONFIGURED, DcmDslProtocolRxConnectionId=0, DcmDslProtocolComMChannelRef=ComMChannel_LIN1
                  DcmDslProtocolRx_FuncReq_LIN_2 (DcmDslProtocolRx): category=TOOL_CONFIGURED, DcmDslProtocolRxAddrType=DCM_FUNCTIONAL_TYPE, DcmDslProtocolRxPduId=2, DcmDslProtocolRxPduRef=Pdu_DcmIPdu_LIN1_SlaveResp
                  DcmDslProtocolTx_LIN (DcmDslProtocolTx): category=TOOL_CONFIGURED, DcmDslTxConfirmationPduId=1, DcmDslProtocolTxPduRef=Pdu_DcmIPdu_LIN1_MasterReq
      DcmPageBufferCfg: DcmPagedBufferEnabled=1
      DcmDsp: DcmDspEnableObdMirror=0, DcmDspDataDefaultEndianness=LITTLE_ENDIAN, DcmDspPowerDownTime=0x02
        DcmDspClearDTC
        DcmDspComControl
          DcmDspComControlAllChannel_FD_CAN1 (DcmDspComControlAllChannel): DcmDspComControlAllChannelUsed=1, DcmDspAllComMChannelRef=ComMChannel_FD_CAN1
          DcmDspComControlSetting
          DcmDspComControlSpecificChannel_FD_CAN1 (DcmDspComControlSpecificChannel): DcmDspComControlSpecificChannelUsed=1, DcmDspSubnetNumber=1, DcmDspSpecificComMChannelRef=ComMChannel_FD_CAN1
        3 x DcmDspCommonAuthorization, all with DcmDspCommonAuthorizationSessionRef=DCM_EXTENDED_DIAGNOSTIC_SESSION, DcmDspCommonAuthorizationSessionRef=DCM_EXTENDED_DIAGNOSTIC_MODE:
          RID_0200h_Authorization: DcmDspCommonAuthorizationSecurityLevelRef=L9
          RID_FOTA_Authorization: DcmDspCommonAuthorizationSessionRef=DCM_ECU_PROGRAMMING_MODE, DcmDspCommonAuthorizationSessionRef=DCM_PROGRAMMING_SESSION, DcmDspCommonAuthorizationSecurityLevelRef=L9
          RID_0211_Authorization: DcmDspCommonAuthorizationSessionRef=DCM_DEFAULT_SESSION
        DcmDspControlDTCSetting
        9 x DcmDspData, all with DcmDspDataType=UINT8_N, DcmDspDataUsePort=USE_DATA_SYNCH_CLIENT_SERVER, DcmDspDataConditionCheckReadFncUsed=1:
          VehicleSpeed: DcmDspDataByteSize=1, DcmDspDataInfoRef=DataInfo_VehicleSpeed
          VehicleManufacturerECUSoftwareVersionNumber: DcmDspDataByteSize=17, DcmDspDataInfoRef=DataInfo_NoScaling
          SystemSupplierECUHardwareVersionNumber: DcmDspDataByteSize=4, DcmDspDataInfoRef=DataInfo_NoScaling
          SystemSupplierECUSoftwareNumber: DcmDspDataByteSize=4, DcmDspDataInfoRef=DataInfo_NoScaling
          ActuatorControl: DcmDspDataByteSize=1, DcmDspDataInfoRef=DataInfo_NoScaling
          VINDataIdentifier: DcmDspDataByteSize=17, DcmDspDataInfoRef=DataInfo_VIN
          BatVolt: DcmDspDataByteSize=1, DcmDspDataInfoRef=DataInfo_NoScaling
          RPM: DcmDspDataByteSize=2, DcmDspDataInfoRef=DataInfo_NoScaling
          ECT: DcmDspDataByteSize=1, DcmDspDataInfoRef=DataInfo_NoScaling
        3 x DcmDspDataInfo:
          DataInfo_VIN: DcmDspDataScalingInfoSize=2
          DataInfo_NoScaling
          DataInfo_VehicleSpeed: DcmDspDataScalingInfoSize=9
        12 x DcmDspDid, all with DcmDspDidUsePort=USE_DATA_ELEMENT_SPECIFIC_INTERFACES, DcmDspDidUsed=1:
          DID_0201h_VehicleSpeed: DcmDspDidIdentifier=0x0201, DcmDspDidInfoRef=DIDInfo_0201h_VehicleSpeed
            VehicleSpeed (DcmDspDidSignal): DcmDspDidByteOffset=0, DcmDspDidDataRef=DcmDsp/VehicleSpeed
          DID_F189h_VehicleManufacturerECUSoftwareVersionNumber: DcmDspDidIdentifier=0xF189, DcmDspDidInfoRef=DIDInfo_F189h_VehicleManufacturerECUSoftwareVersionNumber
            VehicleManufacturerECUSoftwareVersionNumber (DcmDspDidSignal): DcmDspDidByteOffset=0, DcmDspDidDataRef=DcmDsp/VehicleManufacturerECUSoftwareVersionNumber
          DID_F193h_SystemSupplierECUHardwareVersionNumber: DcmDspDidIdentifier=0xF193, DcmDspDidInfoRef=DIDInfo_F193h_SystemSupplierECUHardwareVersionNumber
            SystemSupplierECUHardwareVersionNumber (DcmDspDidSignal): DcmDspDidByteOffset=0, DcmDspDidDataRef=DcmDsp/SystemSupplierECUHardwareVersionNumber
          DID_F194h_SystemSupplierECUSoftwareNumber: DcmDspDidIdentifier=0xF194, DcmDspDidInfoRef=DIDInfo_F194h_SystemSupplierECUSoftwareNumber
            SystemSupplierECUSoftwareNumber (DcmDspDidSignal): DcmDspDidByteOffset=0, DcmDspDidDataRef=DcmDsp/SystemSupplierECUSoftwareNumber
          DID_F190h_VINDataIdentifier: DcmDspDidIdentifier=0xF190, DcmDspDidInfoRef=DIDInfo_F190h_VINDataIdentifier
            VINIdentifier (DcmDspDidSignal): DcmDspDidByteOffset=0, DcmDspDidDataRef=VINDataIdentifier
          DID_010Ah: DcmDspDidIdentifier=0x010A, DcmDspDidInfoRef=DIDInfo_010Ah
            3 x DcmDspDidSignal:
              BatVolt: DcmDspDidByteOffset=0, DcmDspDidDataRef=DcmDsp/BatVolt
              RPM: DcmDspDidByteOffset=1, DcmDspDidDataRef=DcmDsp/RPM
              ECT: DcmDspDidByteOffset=3, DcmDspDidDataRef=DcmDsp/ECT
          DID_F010h_ActuatorControl: DcmDspDidIdentifier=0xF010, DcmDspDidInfoRef=DIDInfo_F010h_ActuatorControl
            ActuatorControl (DcmDspDidSignal): DcmDspDidByteOffset=0, DcmDspDidDataRef=DcmDsp/ActuatorControl
          DID_F012h_MultipleActuatorControl: DcmDspDidIdentifier=0xF012, DcmDspDidInfoRef=DIDInfo_F012h_MultipleActuatorControl
            ActuatorControl (DcmDspDidSignal): DcmDspDidByteOffset=0, DcmDspDidDataRef=DcmDsp/ActuatorControl
            RPM (DcmDspDidSignal): DcmDspDidByteOffset=1, DcmDspDidDataRef=DcmDsp/RPM
          PDID_F2E3h: DcmDspDidIdentifier=0xF2E3, DcmDspDidInfoRef=PDIDInfo_F2E3h
            AC (DcmDspDidSignal): DcmDspDidByteOffset=0, DcmDspDidDataRef=DcmDsp/ActuatorControl
            BatVolt (DcmDspDidSignal): DcmDspDidByteOffset=1, DcmDspDidDataRef=DcmDsp/BatVolt
          PDID_F224h: DcmDspDidIdentifier=0xF224, DcmDspDidInfoRef=PDIDInfo_F224h
            RPM (DcmDspDidSignal): DcmDspDidByteOffset=0, DcmDspDidDataRef=DcmDsp/RPM
            ECT (DcmDspDidSignal): DcmDspDidByteOffset=2, DcmDspDidDataRef=DcmDsp/ECT
          PDID_F232h: DcmDspDidIdentifier=0xF232, DcmDspDidInfoRef=PDIDInfo_F232h
            3 x DcmDspDidSignal:
              BatVolt: DcmDspDidByteOffset=0, DcmDspDidDataRef=DcmDsp/BatVolt
              RPM: DcmDspDidByteOffset=1, DcmDspDidDataRef=DcmDsp/RPM
              ECT: DcmDspDidByteOffset=4, DcmDspDidDataRef=DcmDsp/ECT
          DDDID_F301h: DcmDspDidIdentifier=0xF301, DcmDspDidInfoRef=DDDIDInfo_F301h
        13 x DcmDspDidInfo:
          DIDInfo_0201h_VehicleSpeed: DcmDspDidDynamicallyDefined=0
            DcmDspDidRead
          DIDInfo_F189h_VehicleManufacturerECUSoftwareVersionNumber: DcmDspDidDynamicallyDefined=0
            DcmDspDidRead
          DIDInfo_F193h_SystemSupplierECUHardwareVersionNumber: DcmDspDidDynamicallyDefined=0
            DcmDspDidRead
          DIDInfo_0100h_0110h: DcmDspDidDynamicallyDefined=0
            DcmDspDidRead
            DcmDspDidWrite
          DIDInfo_F194h_SystemSupplierECUSoftwareNumber: DcmDspDidDynamicallyDefined=0
            DcmDspDidRead
          DIDInfo_F190h_VINDataIdentifier: DcmDspDidDynamicallyDefined=0
            DcmDspDidRead
            DcmDspDidWrite
          DIDInfo_010Ah: DcmDspDidDynamicallyDefined=0
            DcmDspDidRead
          DIDInfo_F010h_ActuatorControl: DcmDspDidDynamicallyDefined=0
            DcmDspDidControl:
              DcmDspDidControlMask = DCM_CONTROLMASK_INTERNAL
              DcmDspDidFreezeCurrentState = 1
              DcmDspDidResetToDefault = 1
              DcmDspDidShortTermAdjustment = 1
              DcmDspDidControlSessionRef = DCM_EXTENDED_DIAGNOSTIC_MODE
              DcmDspDidControlSecurityLevelRef = L9
              DcmDspDidControlSessionRef = DCM_EXTENDED_DIAGNOSTIC_SESSION
            DcmDspDidRead:
              DcmDspDidReadSessionRef = DCM_DEFAULT_SESSION
              DcmDspDidReadSessionRef = DCM_EXTENDED_DIAGNOSTIC_MODE
              DcmDspDidReadSessionRef = DCM_EXTENDED_DIAGNOSTIC_SESSION
            DcmDspDidWrite:
              DcmDspDidWriteSessionRef = DCM_DEFAULT_SESSION
              DcmDspDidWriteSessionRef = DCM_EXTENDED_DIAGNOSTIC_MODE
              DcmDspDidWriteSessionRef = DCM_EXTENDED_DIAGNOSTIC_SESSION
          DIDInfo_F012h_MultipleActuatorControl: DcmDspDidDynamicallyDefined=0
            DcmDspDidControl:
              DcmDspDidControlMask = DCM_CONTROLMASK_INTERNAL
              DcmDspDidFreezeCurrentState = 1
              DcmDspDidResetToDefault = 0
              DcmDspDidShortTermAdjustment = 1
              DcmDspDidControlSessionRef = DCM_DEFAULT_SESSION
              DcmDspDidControlSessionRef = DCM_EXTENDED_DIAGNOSTIC_MODE
              DcmDspDidControlSessionRef = DCM_EXTENDED_DIAGNOSTIC_SESSION
            DcmDspDidRead:
              DcmDspDidReadSessionRef = DCM_DEFAULT_SESSION
              DcmDspDidReadSessionRef = DCM_EXTENDED_DIAGNOSTIC_MODE
              DcmDspDidReadSessionRef = DCM_EXTENDED_DIAGNOSTIC_SESSION
          PDIDInfo_F2E3h: DcmDspDidDynamicallyDefined=0
            DcmDspDidRead:
              DcmDspDidReadSessionRef = DCM_DEFAULT_SESSION
              DcmDspDidReadSessionRef = DCM_EXTENDED_DIAGNOSTIC_MODE
              DcmDspDidReadSessionRef = DCM_EXTENDED_DIAGNOSTIC_SESSION
            DcmDspDidWrite:
              DcmDspDidWriteSessionRef = DCM_DEFAULT_SESSION
              DcmDspDidWriteSessionRef = DCM_EXTENDED_DIAGNOSTIC_MODE
              DcmDspDidWriteSessionRef = DCM_EXTENDED_DIAGNOSTIC_SESSION
          PDIDInfo_F232h: DcmDspDidDynamicallyDefined=0
            DcmDspDidRead:
              DcmDspDidReadSessionRef = DCM_DEFAULT_SESSION
              DcmDspDidReadSessionRef = DCM_EXTENDED_DIAGNOSTIC_MODE
              DcmDspDidReadSessionRef = DCM_EXTENDED_DIAGNOSTIC_SESSION
          PDIDInfo_F224h: DcmDspDidDynamicallyDefined=0
            DcmDspDidRead:
              DcmDspDidReadSessionRef = DCM_DEFAULT_SESSION
              DcmDspDidReadSessionRef = DCM_EXTENDED_DIAGNOSTIC_MODE
              DcmDspDidReadSessionRef = DCM_EXTENDED_DIAGNOSTIC_SESSION
            DcmDspDidWrite:
              DcmDspDidWriteSessionRef = DCM_DEFAULT_SESSION
              DcmDspDidWriteSessionRef = DCM_EXTENDED_DIAGNOSTIC_MODE
              DcmDspDidWriteSessionRef = DCM_EXTENDED_DIAGNOSTIC_SESSION
          DDDIDInfo_F301h: DcmDspDidDynamicallyDefined=1, DcmDspDDDIDMaxElements=0x03
            DcmDspDidRead
        DIDs_0100h_0110h (DcmDspDidRange):
          DcmDspDidRangeHasGaps = 1
          DcmDspDidRangeIdentifierLowerLimit = 0x0100
          DcmDspDidRangeIdentifierUpperLimit = 0x0110
          DcmDspDidRangeMaxDataLength = 30
          DcmDspDidRangeUsePort = 1
          DcmDspDidRangeInfoRef = DIDInfo_0100h_0110h
        DcmDspEcuReset
          5 x DcmDspEcuResetRow:
            HARD_RESET: DcmDspEcuResetId=0x01, DcmResponseToEcuReset=BEFORE_RESET
            KEY_ON_OFF_RESET: DcmDspEcuResetId=0x02, DcmResponseToEcuReset=AFTER_RESET
            SOFT_RESET: DcmDspEcuResetId=0x03, DcmResponseToEcuReset=BEFORE_RESET
            ENABLE_RAPID_POWER_SHUTDOWN: DcmDspEcuResetId=0x04, DcmResponseToEcuReset=BEFORE_RESET
            DISABLE_RAPID_POWER_SHUTDOWN: DcmDspEcuResetId=0x05, DcmResponseToEcuReset=AFTER_RESET
        DcmDspMemory
          DcmDspAddressAndLengthFormatIdentifier: DcmDspSupportedAddressAndLengthFormatIdentifier=0x14
          DcmDspMemoryIdInfo0 (DcmDspMemoryIdInfo)
            DcmDspReadMemoryRangeInfo0 (DcmDspReadMemoryRangeInfo): DcmDspReadMemoryRangeHigh=0x2109196C, DcmDspReadMemoryRangeLow=0x21091968
            DcmDspWriteMemoryRangeInfo0 (DcmDspWriteMemoryRangeInfo): DcmDspWriteMemoryRangeHigh=0x2048130E, DcmDspWriteMemoryRangeLow=0x20481309
        DcmDspMemoryTransfer: DcmDspMemoryTransferUsePort=1
          DcmDspAddressAndLengthFormatIdentifier:
            DcmDspSupportedAddressAndLengthFormatIdentifier = 0x14
            DcmDspSupportedAddressAndLengthFormatIdentifier = 0x34
            DcmDspSupportedAddressAndLengthFormatIdentifier = 0x44
          DcmDspMemoryTransferIdInfo0 (DcmDspMemoryTransferIdInfo): DcmDspMemoryIdValue=0x00
        DcmDspPeriodicTransmission:
          DcmDspMaxPeriodicDidScheduler = 0x06
          DcmDspPeriodicTransmissionFastRate = 0.15
          DcmDspPeriodicTransmissionMediumRate = 0.20
          DcmDspPeriodicTransmissionSlowRate = 0.25
        Tid1 (DcmDspRequestControl): DcmDspRequestControlInBufferSize=0, DcmDspRequestControlOutBufferSize=0, DcmDspRequestControlTestId=1
        DcmDspRequestFileTransfer:
          DcmRequestFileTransferFileSizeOrDirInfoParameterLength = 4
          DcmRequestFileTransferLengthFormatIdentifier = 4
          DcmRequestFileTransferUsePort = 1
          DcmRequestFileTransferMaxFileAndDirName = 4
        DcmDspRoe: DcmDspRoeInterMessageTime=2.0
          OnDTCStatusChange (DcmDspRoeEvent): DcmDspRoeInitialEventStatus=DCM_ROE_CLEARED, DcmDspRoeEventId=0x00
            DcmDspRoeEventProperties
              DcmDspRoeOnDTCStatusChange
          OnChangeOfDataIdentifier (DcmDspRoeEvent): DcmDspRoeInitialEventStatus=DCM_ROE_CLEARED, DcmDspRoeEventId=0x01
            DcmDspRoeEventProperties
              DcmDspRoeOnChangeOfDataIdentifier: DcmDspRoeDidRef=DID_F190h_VINDataIdentifier
          CURRENT_CYCLE (DcmDspRoeEventWindowTime): DcmDspRoeEventWindowTime=DCM_ROE_EVENT_WINDOW_CURRENT_CYCLE
          INFINITE (DcmDspRoeEventWindowTime): DcmDspRoeEventWindowTime=DCM_ROE_EVENT_WINDOW_INFINITE
        6 x DcmDspRoutine, all with DcmDspRoutineUsed=1:
          RID_0200h_CalibrationActuator: DcmDspRoutineIdentifier=0x0202, DcmDspRoutineUsePort=1
            DcmDspRequestRoutineResults: DcmDspRequestRoutineResultsCommonAuthorizationRef=RID_0200h_Authorization
              DcmDspRequestRoutineResultsOut
                RID_0200h_RequestOutSignal (DcmDspRequestRoutineResultsOutSignal): DcmDspRoutineSignalPos=0, DcmDspRoutineSignalType=UINT8
            DcmDspStartRoutine: DcmDspStartRoutineConfirmationEnabled=0, DcmDspStartRoutineCommonAuthorizationRef=RID_0200h_Authorization
              DcmDspStartRoutineIn
                RID_0200h_StartInSignal (DcmDspStartRoutineInSignal): DcmDspRoutineSignalPos=0, DcmDspRoutineSignalType=UINT8
              DcmDspStartRoutineOut
                RID_0200h_StartOutSignal (DcmDspStartRoutineOutSignal): DcmDspRoutineSignalPos=0, DcmDspRoutineSignalType=UINT8
            DcmDspStopRoutine: DcmDspStopRoutineCommonAuthorizationRef=RID_0200h_Authorization
              DcmDspStopRoutineIn
                RID_0200h_StopInSignal (DcmDspStopRoutineInSignal): DcmDspRoutineSignalPos=0, DcmDspRoutineSignalType=UINT8
              DcmDspStopRoutineOut
                RID_0200h_StopOutSignal (DcmDspStopRoutineOutSignal): DcmDspRoutineSignalPos=0, DcmDspRoutineSignalType=UINT8
          RID_FF01h_CheckProgrammingDependency: DcmDspRoutineIdentifier=0xFF01, DcmDspRoutineUsePort=0
            DcmDspStartRoutine: DcmDspStartRoutineFnc=Fota_Start_CheckProgrammingDependency, DcmDspStartRoutineCommonAuthorizationRef=RID_FOTA_Authorization
              DcmDspStartRoutineIn
                In_Block_Area (DcmDspStartRoutineInSignal): DcmDspRoutineParameterSize=3, DcmDspRoutineSignalEndianness=LITTLE_ENDIAN, DcmDspRoutineSignalPos=0, DcmDspRoutineSignalType=VARIABLE_LENGTH
              DcmDspStartRoutineOut
                Out_MemoryArea (DcmDspStartRoutineOutSignal): DcmDspRoutineParameterSize=1, DcmDspRoutineSignalEndianness=LITTLE_ENDIAN, DcmDspRoutineSignalPos=0, DcmDspRoutineSignalType=VARIABLE_LENGTH
          RID_0210h_ReadActiveArea: DcmDspRoutineIdentifier=0x0210, DcmDspRoutineUsePort=0
            DcmDspStartRoutine: DcmDspStartRoutineFnc=Fota_Start_ReadActiveArea, DcmDspStartRoutineCommonAuthorizationRef=RID_FOTA_Authorization
              DcmDspStartRoutineIn
                In__SWUnitMemoryArea (DcmDspStartRoutineInSignal): DcmDspRoutineParameterSize=2, DcmDspRoutineSignalEndianness=LITTLE_ENDIAN, DcmDspRoutineSignalPos=0, DcmDspRoutineSignalType=VARIABLE_LENGTH
              DcmDspStartRoutineOut
                StartOutSignal (DcmDspStartRoutineOutSignal): DcmDspRoutineParameterSize=1, DcmDspRoutineSignalEndianness=LITTLE_ENDIAN, DcmDspRoutineSignalPos=0, DcmDspRoutineSignalType=VARIABLE_LENGTH
          RID_0212h_EraseTargetArea: DcmDspRoutineIdentifier=0x0212, DcmDspRoutineUsePort=0
            DcmDspStartRoutine: DcmDspStartRoutineFnc=Fota_Start_EraseTargetArea, DcmDspStartRoutineCommonAuthorizationRef=RID_FOTA_Authorization
              DcmDspStartRoutineIn
                pRoutineDataIn (DcmDspStartRoutineInSignal): DcmDspRoutineParameterSize=4, DcmDspRoutineSignalEndianness=LITTLE_ENDIAN, DcmDspRoutineSignalPos=0, DcmDspRoutineSignalType=VARIABLE_LENGTH
              DcmDspStartRoutineOut
                Out_Block_Area (DcmDspStartRoutineOutSignal): DcmDspRoutineParameterSize=1, DcmDspRoutineSignalEndianness=LITTLE_ENDIAN, DcmDspRoutineSignalPos=0, DcmDspRoutineSignalType=VARIABLE_LENGTH
          RID_FF00_EraseMemory: DcmDspRoutineIdentifier=0xFF00, DcmDspRoutineUsePort=0
            DcmDspStartRoutine: DcmDspStartRoutineFnc=Fota_Start_EraseMemory, DcmDspStartRoutineCommonAuthorizationRef=RID_FOTA_Authorization
              DcmDspStartRoutineIn
                In_Block_Area (DcmDspStartRoutineInSignal): DcmDspRoutineParameterSize=2, DcmDspRoutineSignalEndianness=LITTLE_ENDIAN, DcmDspRoutineSignalPos=0, DcmDspRoutineSignalType=VARIABLE_LENGTH
              DcmDspStartRoutineOut
                Out_Block_Area (DcmDspStartRoutineOutSignal): DcmDspRoutineParameterSize=3, DcmDspRoutineSignalEndianness=LITTLE_ENDIAN, DcmDspRoutineSignalPos=0, DcmDspRoutineSignalType=VARIABLE_LENGTH
          RID_0213h_SwapActiveArea: DcmDspRoutineIdentifier=0x0213, DcmDspRoutineUsePort=0
            DcmDspStartRoutine: DcmDspStartRoutineFnc=Fota_Start_SwapActiveArea, DcmDspStartRoutineCommonAuthorizationRef=RID_FOTA_Authorization
              DcmDspStartRoutineIn
                pRoutineDataIn (DcmDspStartRoutineInSignal): DcmDspRoutineParameterSize=24, DcmDspRoutineSignalEndianness=LITTLE_ENDIAN, DcmDspRoutineSignalPos=0, DcmDspRoutineSignalType=VARIABLE_LENGTH
              DcmDspStartRoutineOut
                Out_Block_Area (DcmDspStartRoutineOutSignal): DcmDspRoutineParameterSize=40, DcmDspRoutineSignalEndianness=LITTLE_ENDIAN, DcmDspRoutineSignalPos=0, DcmDspRoutineSignalType=VARIABLE_LENGTH
        DcmDspSecurity: DcmDspSecurityMaxAttemptCounterReadoutTime=10.0
          L9 (DcmDspSecurityRow):
            DcmDspSecurityAttemptCounterEnabled = 0
            DcmDspSecurityDelayTime = 180
            DcmDspSecurityDelayTimeOnBoot = 0
            DcmDspSecurityKeySize = 8
            DcmDspSecurityLevel = 9
            DcmDspSecurityNumAttDelay = 3
            DcmDspSecuritySeedSize = 8
            DcmDspSecurityUsePort = USE_ASYNCH_CLIENT_SERVER
        DcmDspSession
          8 x DcmDspSessionRow, all with DcmDspSessionP2ServerMax=0.05, DcmDspSessionP2StarServerMax=5:
            DCM_DEFAULT_SESSION: DcmDspSessionForBoot=DCM_NO_BOOT, DcmDspSessionLevel=0x01
            DCM_PROGRAMMING_SESSION: DcmDspSessionForBoot=DCM_OEM_BOOT, DcmDspSessionLevel=0x02
            DCM_EXTENDED_DIAGNOSTIC_SESSION: DcmDspSessionLevel=0x03, DcmDspSessionForBoot=DCM_NO_BOOT
            DCM_SAFETY_SYSTEM_DIAGNOSTIC_SESSION: DcmDspSessionForBoot=DCM_NO_BOOT, DcmDspSessionLevel=0x04
            DCM_ECU_PROGRAMMING_MODE: DcmDspSessionForBoot=DCM_OEM_BOOT, DcmDspSessionLevel=0x05
            DCM_EXTENDED_DIAGNOSTIC_MODE: DcmDspSessionForBoot=DCM_NO_BOOT, DcmDspSessionLevel=0x10
            DCM_QUIESCENT_CURRENT_DIAGNOSTIC_MODE_START: DcmDspSessionForBoot=DCM_NO_BOOT, DcmDspSessionLevel=0x50
            DCM_SLEEP_MODE_START_REQUEST: DcmDspSessionForBoot=DCM_NO_BOOT, DcmDspSessionLevel=0x51
        VINInfoData (DcmDspVehInfo): DcmDspVehInfoInfoType=0x02, DcmDspVehInfoNODIProvResp=1
          VINInfoData (DcmDspVehInfoData): DcmDspVehInfoDataOrder=0, DcmDspVehInfoDataSize=17, DcmDspVehInfoDataUsePort=1
        PerformanceTrackingInfoData (DcmDspVehInfo): DcmDspVehInfoInfoType=0x08, DcmDspVehInfoNODIProvResp=1
          PerformanceTrackingInfoData (DcmDspVehInfoData): DcmDspVehInfoDataReadFnc=Dem_DcmGetInfoTypeValue08, DcmDspVehInfoDataUsePort=0, DcmDspVehInfoDataOrder=0, DcmDspVehInfoDataSize=32
      DcmDsd
        DcmDsdServiceRequestManufacturerNotification0 (DcmDsdServiceRequestManufacturerNotification)
        DcmDsdServiceRequestSupplierNotification0 (DcmDsdServiceRequestSupplierNotification)
        DcmDsdServiceRequestSupplierNotification1 (DcmDsdServiceRequestSupplierNotification)
        ES95486_SERVICES (DcmDsdServiceTable): DcmDsdSidTabId=0
          24 x DcmDsdService:
            SID10_DiagnosticSessionControl: DcmDsdServiceUsed=1, DcmDsdSidTabServiceId=0x10, DcmDsdSidTabSubfuncAvail=1
              8 x DcmDsdSubService:
                defaultSession: DcmDsdSubServiceUsed=1, DcmDsdSubServiceId=0x01
                programmingSession: DcmDsdSubServiceUsed=1, DcmDsdSubServiceId=0x02, DcmDsdSubServiceSessionLevelRef=DCM_DEFAULT_SESSION, DcmDsdSubServiceSessionLevelRef=DCM_ECU_PROGRAMMING_MODE, DcmDsdSubServiceSessionLevelRef=DCM_EXTENDED_DIAGNOSTIC_MODE, DcmDsdSubServiceSessionLevelRef=DCM_EXTENDED_DIAGNOSTIC_SESSION, DcmDsdSubServiceSessionLevelRef=DCM_PROGRAMMING_SESSION
                extendedDiagnosticSession: DcmDsdSubServiceUsed=1, DcmDsdSubServiceId=0x03, DcmDsdSubServiceSessionLevelRef=DCM_DEFAULT_SESSION, DcmDsdSubServiceSessionLevelRef=DCM_EXTENDED_DIAGNOSTIC_MODE, DcmDsdSubServiceSessionLevelRef=DCM_EXTENDED_DIAGNOSTIC_SESSION, DcmDsdSubServiceSessionLevelRef=DCM_SAFETY_SYSTEM_DIAGNOSTIC_SESSION
                safetySystemDiagnosticSession: DcmDsdSubServiceUsed=1, DcmDsdSubServiceId=0x04, DcmDsdSubServiceSessionLevelRef=DCM_DEFAULT_SESSION, DcmDsdSubServiceSessionLevelRef=DCM_EXTENDED_DIAGNOSTIC_MODE, DcmDsdSubServiceSessionLevelRef=DCM_EXTENDED_DIAGNOSTIC_SESSION, DcmDsdSubServiceSessionLevelRef=DCM_SAFETY_SYSTEM_DIAGNOSTIC_SESSION
                ecuProgrammingMode: DcmDsdSubServiceUsed=0, DcmDsdSubServiceId=0x05, DcmDsdSubServiceSessionLevelRef=DCM_DEFAULT_SESSION, DcmDsdSubServiceSessionLevelRef=DCM_ECU_PROGRAMMING_MODE, DcmDsdSubServiceSessionLevelRef=DCM_EXTENDED_DIAGNOSTIC_MODE, DcmDsdSubServiceSessionLevelRef=DCM_EXTENDED_DIAGNOSTIC_SESSION, DcmDsdSubServiceSessionLevelRef=DCM_PROGRAMMING_SESSION
                extendedDiagnosticMode: DcmDsdSubServiceUsed=0, DcmDsdSubServiceId=0x10, DcmDsdSubServiceSessionLevelRef=DCM_DEFAULT_SESSION, DcmDsdSubServiceSessionLevelRef=DCM_EXTENDED_DIAGNOSTIC_MODE, DcmDsdSubServiceSessionLevelRef=DCM_EXTENDED_DIAGNOSTIC_SESSION, DcmDsdSubServiceSessionLevelRef=DCM_SAFETY_SYSTEM_DIAGNOSTIC_SESSION
                quiescentCurrentDiagnosticMode: DcmDsdSubServiceUsed=1, DcmDsdSubServiceId=0x50, DcmDsdSubServiceSessionLevelRef=DCM_DEFAULT_SESSION, DcmDsdSubServiceSessionLevelRef=DCM_QUIESCENT_CURRENT_DIAGNOSTIC_MODE_START
                sleepModeStartRequest: DcmDsdSubServiceUsed=1, DcmDsdSubServiceId=0x51
            SID11_EcuReset: DcmDsdServiceUsed=1, DcmDsdSidTabServiceId=0x11, DcmDsdSidTabSubfuncAvail=1, DcmDsdSidTabSessionLevelRef=DCM_DEFAULT_SESSION, DcmDsdSidTabSessionLevelRef=DCM_ECU_PROGRAMMING_MODE, DcmDsdSidTabSessionLevelRef=DCM_EXTENDED_DIAGNOSTIC_MODE, DcmDsdSidTabSessionLevelRef=DCM_EXTENDED_DIAGNOSTIC_SESSION, DcmDsdSidTabSessionLevelRef=DCM_PROGRAMMING_SESSION, DcmDsdSidTabSessionLevelRef=DCM_SAFETY_SYSTEM_DIAGNOSTIC_SESSION
              5 x DcmDsdSubService:
                hardReset: DcmDsdSubServiceUsed=1, DcmDsdSubServiceId=0x01
                keyOnOffReset: DcmDsdSubServiceId=0x02, DcmDsdSubServiceUsed=0
                softReset: DcmDsdSubServiceUsed=0, DcmDsdSubServiceId=0x03
                enableRapidPowerShutdown: DcmDsdSubServiceUsed=0, DcmDsdSubServiceId=0x04
                disableRapidPowerShutdown: DcmDsdSubServiceUsed=0, DcmDsdSubServiceId=0x05
            SID14_ClearDiagnosticInfo: DcmDsdServiceUsed=1, DcmDsdSidTabServiceId=0x14, DcmDsdSidTabSubfuncAvail=0, DcmDsdSidTabSessionLevelRef=DCM_DEFAULT_SESSION, DcmDsdSidTabSessionLevelRef=DCM_EXTENDED_DIAGNOSTIC_MODE, DcmDsdSidTabSessionLevelRef=DCM_EXTENDED_DIAGNOSTIC_SESSION
            SID19_ReadDTCInformation: DcmDsdServiceUsed=1, DcmDsdSidTabServiceId=0x19, DcmDsdSidTabSubfuncAvail=1, DcmDsdSidTabSessionLevelRef=DCM_DEFAULT_SESSION, DcmDsdSidTabSessionLevelRef=DCM_EXTENDED_DIAGNOSTIC_MODE, DcmDsdSidTabSessionLevelRef=DCM_EXTENDED_DIAGNOSTIC_SESSION
              25 x DcmDsdSubService:
                Sub01: DcmDsdSubServiceUsed=1, DcmDsdSubServiceId=0x01
                Sub07: DcmDsdSubServiceUsed=0, DcmDsdSubServiceId=0x07
                Sub11: DcmDsdSubServiceUsed=0, DcmDsdSubServiceId=0x11
                Sub12: DcmDsdSubServiceUsed=0, DcmDsdSubServiceId=0x12
                Sub02: DcmDsdSubServiceUsed=0, DcmDsdSubServiceId=0x02
                Sub0A: DcmDsdSubServiceUsed=0, DcmDsdSubServiceId=0x0A
                Sub0F: DcmDsdSubServiceUsed=0, DcmDsdSubServiceId=0x0F
                Sub13: DcmDsdSubServiceUsed=0, DcmDsdSubServiceId=0x13
                Sub15: DcmDsdSubServiceUsed=0, DcmDsdSubServiceId=0x15
                Sub17: DcmDsdSubServiceUsed=0, DcmDsdSubServiceId=0x17
                Sub08: DcmDsdSubServiceUsed=0, DcmDsdSubServiceId=0x08
                Sub09: DcmDsdSubServiceUsed=0, DcmDsdSubServiceId=0x09
                Sub06: DcmDsdSubServiceUsed=0, DcmDsdSubServiceId=0x06
                Sub10: DcmDsdSubServiceUsed=0, DcmDsdSubServiceId=0x10
                Sub19: DcmDsdSubServiceUsed=0, DcmDsdSubServiceId=0x19
                Sub03: DcmDsdSubServiceUsed=0, DcmDsdSubServiceId=0x03
                Sub04: DcmDsdSubServiceUsed=0, DcmDsdSubServiceId=0x04
                Sub18: DcmDsdSubServiceUsed=0, DcmDsdSubServiceId=0x18
                Sub0B: DcmDsdSubServiceUsed=0, DcmDsdSubServiceId=0x0B
                Sub0C: DcmDsdSubServiceUsed=0, DcmDsdSubServiceId=0x0C
                Sub0D: DcmDsdSubServiceUsed=0, DcmDsdSubServiceId=0x0D
                Sub0E: DcmDsdSubServiceUsed=0, DcmDsdSubServiceId=0x0E
                Sub14: DcmDsdSubServiceUsed=0, DcmDsdSubServiceId=0x14
                Sub42: DcmDsdSubServiceUsed=0, DcmDsdSubServiceId=0x42
                Sub55: DcmDsdSubServiceUsed=0, DcmDsdSubServiceId=0x55
            SID22_ReadMemoryByIdentifier: DcmDsdServiceUsed=0, DcmDsdSidTabServiceId=0x22, DcmDsdSidTabSubfuncAvail=0, DcmDsdSidTabSessionLevelRef=DCM_DEFAULT_SESSION, DcmDsdSidTabSessionLevelRef=DCM_EXTENDED_DIAGNOSTIC_MODE, DcmDsdSidTabSessionLevelRef=DCM_EXTENDED_DIAGNOSTIC_SESSION, DcmDsdSidTabSessionLevelRef=DCM_SAFETY_SYSTEM_DIAGNOSTIC_SESSION, DcmDsdSidTabSessionLevelRef=DCM_QUIESCENT_CURRENT_DIAGNOSTIC_MODE_START
            SID23_ReadMemoryByAddress: DcmDsdServiceUsed=1, DcmDsdSidTabServiceId=0x23, DcmDsdSidTabSubfuncAvail=0, DcmDsdSidTabSessionLevelRef=DCM_DEFAULT_SESSION, DcmDsdSidTabSessionLevelRef=DCM_EXTENDED_DIAGNOSTIC_MODE, DcmDsdSidTabSessionLevelRef=DCM_EXTENDED_DIAGNOSTIC_SESSION
            SID24_ReadScalingDataByIdentifier: DcmDsdServiceUsed=0, DcmDsdSidTabServiceId=0x24, DcmDsdSidTabSubfuncAvail=0
            SID27_SecurityAccess: DcmDsdSidTabServiceId=0x27, DcmDsdSidTabSubfuncAvail=1, DcmDsdServiceUsed=1, DcmDsdSidTabSessionLevelRef=DCM_PROGRAMMING_SESSION, DcmDsdSidTabSessionLevelRef=DCM_EXTENDED_DIAGNOSTIC_SESSION, DcmDsdSidTabSessionLevelRef=DCM_ECU_PROGRAMMING_MODE, DcmDsdSidTabSessionLevelRef=DCM_EXTENDED_DIAGNOSTIC_MODE, DcmDsdSidTabSessionLevelRef=DCM_SAFETY_SYSTEM_DIAGNOSTIC_SESSION
              4 x DcmDsdSubService:
                GetSeed: DcmDsdSubServiceId=0x01, DcmDsdSubServiceUsed=0
                CompareKey: DcmDsdSubServiceId=0x02, DcmDsdSubServiceUsed=0
                GetSeed_HSAC: DcmDsdSubServiceUsed=1, DcmDsdSubServiceId=0x11
                CompareKey_HSAC: DcmDsdSubServiceUsed=1, DcmDsdSubServiceId=0x12
            SID28_CommunicationControl: DcmDsdServiceUsed=1, DcmDsdSidTabServiceId=0x28, DcmDsdSidTabSubfuncAvail=1, DcmDsdSidTabSessionLevelRef=DCM_EXTENDED_DIAGNOSTIC_SESSION, DcmDsdSidTabSessionLevelRef=DCM_PROGRAMMING_SESSION, DcmDsdSidTabSessionLevelRef=DCM_ECU_PROGRAMMING_MODE, DcmDsdSidTabSessionLevelRef=DCM_EXTENDED_DIAGNOSTIC_MODE
              4 x DcmDsdSubService, all with DcmDsdSubServiceUsed=1:
                enableRxAndTx: DcmDsdSubServiceId=0
                disableNormalMessageTransmission: DcmDsdSubServiceId=1
                disableRxAndEnableTx: DcmDsdSubServiceId=2
                disableRxAndTx: DcmDsdSubServiceId=3
            SID2A_ReadDataByPeriodicIdentifier: DcmDsdServiceUsed=0, DcmDsdSidTabServiceId=0x2A, DcmDsdSidTabSubfuncAvail=0, DcmDsdSidTabSessionLevelRef=DCM_EXTENDED_DIAGNOSTIC_MODE, DcmDsdSidTabSessionLevelRef=DCM_EXTENDED_DIAGNOSTIC_SESSION, DcmDsdSidTabSessionLevelRef=DCM_SAFETY_SYSTEM_DIAGNOSTIC_SESSION
            SID2C_DynamicallyDefineDataIdentifier: DcmDsdServiceUsed=0, DcmDsdSidTabServiceId=0x2C, DcmDsdSidTabSubfuncAvail=0, DcmDsdSidTabSessionLevelRef=DCM_EXTENDED_DIAGNOSTIC_MODE, DcmDsdSidTabSessionLevelRef=DCM_EXTENDED_DIAGNOSTIC_SESSION, DcmDsdSidTabSessionLevelRef=DCM_SAFETY_SYSTEM_DIAGNOSTIC_SESSION
              3 x DcmDsdSubService, all with DcmDsdSubServiceUsed=1:
                defineByIdentifier: DcmDsdSubServiceId=0x01
                defineByMemoryAddress: DcmDsdSubServiceId=0x02
                clearDynamicallyDefinedDataIdentifier: DcmDsdSubServiceId=0x03
            SID2E_WriteDataByIdentifier: DcmDsdServiceUsed=1, DcmDsdSidTabServiceId=0x2E, DcmDsdSidTabSubfuncAvail=0, DcmDsdSidTabSessionLevelRef=DCM_DEFAULT_SESSION, DcmDsdSidTabSessionLevelRef=DCM_ECU_PROGRAMMING_MODE, DcmDsdSidTabSessionLevelRef=DCM_EXTENDED_DIAGNOSTIC_MODE, DcmDsdSidTabSessionLevelRef=DCM_EXTENDED_DIAGNOSTIC_SESSION, DcmDsdSidTabSessionLevelRef=DCM_PROGRAMMING_SESSION, DcmDsdSidTabSessionLevelRef=DCM_SAFETY_SYSTEM_DIAGNOSTIC_SESSION
            SID2F_IOControlByIdentifier: DcmDsdServiceUsed=1, DcmDsdSidTabServiceId=0x2F, DcmDsdSidTabSubfuncAvail=0, DcmDsdSidTabSessionLevelRef=DCM_EXTENDED_DIAGNOSTIC_MODE, DcmDsdSidTabSessionLevelRef=DCM_EXTENDED_DIAGNOSTIC_SESSION, DcmDsdSidTabSecurityLevelRef=L9
            SID31_RoutineControl: DcmDsdServiceUsed=1, DcmDsdSidTabServiceId=0x31, DcmDsdSidTabSubfuncAvail=1, DcmDsdSidTabSessionLevelRef=DCM_ECU_PROGRAMMING_MODE, DcmDsdSidTabSessionLevelRef=DCM_EXTENDED_DIAGNOSTIC_MODE, DcmDsdSidTabSessionLevelRef=DCM_EXTENDED_DIAGNOSTIC_SESSION, DcmDsdSidTabSessionLevelRef=DCM_PROGRAMMING_SESSION, DcmDsdSidTabSessionLevelRef=DCM_SAFETY_SYSTEM_DIAGNOSTIC_SESSION
              3 x DcmDsdSubService:
                startRoutine: DcmDsdSubServiceUsed=1, DcmDsdSubServiceId=0x01
                stopRoutine: DcmDsdSubServiceUsed=1, DcmDsdSubServiceId=0x02
                requestRoutineResults: DcmDsdSubServiceUsed=0, DcmDsdSubServiceId=0x03
            SID34_RequestDownload: DcmDsdServiceUsed=1, DcmDsdSidTabServiceId=0x34, DcmDsdSidTabSubfuncAvail=0, DcmDsdSidTabSecurityLevelRef=L9, DcmDsdSidTabSessionLevelRef=DCM_ECU_PROGRAMMING_MODE, DcmDsdSidTabSessionLevelRef=DCM_EXTENDED_DIAGNOSTIC_MODE, DcmDsdSidTabSessionLevelRef=DCM_EXTENDED_DIAGNOSTIC_SESSION, DcmDsdSidTabSessionLevelRef=DCM_PROGRAMMING_SESSION
            SID35_RequestUpload: DcmDsdServiceUsed=1, DcmDsdSidTabServiceId=0x35, DcmDsdSidTabSubfuncAvail=0, DcmDsdSidTabSessionLevelRef=DCM_ECU_PROGRAMMING_MODE, DcmDsdSidTabSessionLevelRef=DCM_EXTENDED_DIAGNOSTIC_MODE, DcmDsdSidTabSessionLevelRef=DCM_EXTENDED_DIAGNOSTIC_SESSION, DcmDsdSidTabSessionLevelRef=DCM_PROGRAMMING_SESSION
            SID36_TransferData: DcmDsdServiceUsed=1, DcmDsdSidTabServiceId=0x36, DcmDsdSidTabSubfuncAvail=0, DcmDsdSidTabSecurityLevelRef=L9, DcmDsdSidTabSessionLevelRef=DCM_ECU_PROGRAMMING_MODE, DcmDsdSidTabSessionLevelRef=DCM_EXTENDED_DIAGNOSTIC_MODE, DcmDsdSidTabSessionLevelRef=DCM_EXTENDED_DIAGNOSTIC_SESSION, DcmDsdSidTabSessionLevelRef=DCM_PROGRAMMING_SESSION
            SID37_RequestTransferExit: DcmDsdServiceUsed=1, DcmDsdSidTabServiceId=0x37, DcmDsdSidTabSubfuncAvail=0, DcmDsdSidTabSecurityLevelRef=L9, DcmDsdSidTabSessionLevelRef=DCM_ECU_PROGRAMMING_MODE, DcmDsdSidTabSessionLevelRef=DCM_EXTENDED_DIAGNOSTIC_MODE, DcmDsdSidTabSessionLevelRef=DCM_EXTENDED_DIAGNOSTIC_SESSION, DcmDsdSidTabSessionLevelRef=DCM_PROGRAMMING_SESSION
            SID38_RequestFileTransfer: DcmDsdServiceUsed=0, DcmDsdSidTabServiceId=0x38, DcmDsdSidTabSubfuncAvail=0, DcmDsdSidTabSessionLevelRef=DCM_ECU_PROGRAMMING_MODE, DcmDsdSidTabSessionLevelRef=DCM_EXTENDED_DIAGNOSTIC_MODE, DcmDsdSidTabSessionLevelRef=DCM_EXTENDED_DIAGNOSTIC_SESSION, DcmDsdSidTabSessionLevelRef=DCM_PROGRAMMING_SESSION
            SID3D_WriteMemoryByAddress: DcmDsdServiceUsed=1, DcmDsdSidTabServiceId=0x3D, DcmDsdSidTabSubfuncAvail=0, DcmDsdSidTabSessionLevelRef=DCM_DEFAULT_SESSION, DcmDsdSidTabSessionLevelRef=DCM_ECU_PROGRAMMING_MODE, DcmDsdSidTabSessionLevelRef=DCM_EXTENDED_DIAGNOSTIC_MODE, DcmDsdSidTabSessionLevelRef=DCM_EXTENDED_DIAGNOSTIC_SESSION, DcmDsdSidTabSessionLevelRef=DCM_PROGRAMMING_SESSION
            SID3E_TesterPresent: DcmDsdServiceUsed=1, DcmDsdSidTabSubfuncAvail=1, DcmDsdSidTabServiceId=0x3E, DcmDsdSidTabSessionLevelRef=DCM_DEFAULT_SESSION, DcmDsdSidTabSessionLevelRef=DCM_ECU_PROGRAMMING_MODE, DcmDsdSidTabSessionLevelRef=DCM_EXTENDED_DIAGNOSTIC_MODE, DcmDsdSidTabSessionLevelRef=DCM_EXTENDED_DIAGNOSTIC_SESSION, DcmDsdSidTabSessionLevelRef=DCM_PROGRAMMING_SESSION, DcmDsdSidTabSessionLevelRef=DCM_SAFETY_SYSTEM_DIAGNOSTIC_SESSION
              DcmDsdSubService0 (DcmDsdSubService): DcmDsdSubServiceUsed=1, DcmDsdSubServiceId=0x00
            SID85_ControlDTCSetting: DcmDsdSidTabServiceId=0x85, DcmDsdSidTabSubfuncAvail=1, DcmDsdServiceUsed=1, DcmDsdSidTabSessionLevelRef=DCM_EXTENDED_DIAGNOSTIC_SESSION, DcmDsdSidTabSessionLevelRef=DCM_PROGRAMMING_SESSION, DcmDsdSidTabSessionLevelRef=DCM_ECU_PROGRAMMING_MODE, DcmDsdSidTabSessionLevelRef=DCM_EXTENDED_DIAGNOSTIC_MODE
              On (DcmDsdSubService): DcmDsdSubServiceId=0x01, DcmDsdSubServiceUsed=1
              Off (DcmDsdSubService): DcmDsdSubServiceId=0x02, DcmDsdSubServiceUsed=1
            SID86_ResponseOnEvent: DcmDsdServiceUsed=0, DcmDsdSidTabServiceId=0x86, DcmDsdSidTabSubfuncAvail=0
              6 x DcmDsdSubService, all with DcmDsdSubServiceUsed=1:
                stopResponseOnEvent: DcmDsdSubServiceId=0x00
                onDTCStatusChange: DcmDsdSubServiceId=0x01
                onChangeOfDataIdentifier: DcmDsdSubServiceId=0x03
                reportActivatedEvents: DcmDsdSubServiceId=0x04
                StartResponseOnEvent: DcmDsdSubServiceId=0x05
                clearResponseOnEvent: DcmDsdSubServiceId=0x06
            SID87_LinkControl: DcmDsdServiceUsed=1, DcmDsdSidTabServiceId=0x87, DcmDsdSidTabSubfuncAvail=1
              verifyModeTransitionWithFixedParameter (DcmDsdSubService): DcmDsdSubServiceUsed=1, DcmDsdSubServiceId=0x01
              verifyModeTransitionWithSpecificParameter (DcmDsdSubService): DcmDsdSubServiceUsed=1, DcmDsdSubServiceId=0x02
    DcmGeneral:
      DcmDevErrorDetect = 1
      DcmRespondAllRequest = 1
      DcmTaskTime = 0.005
      DcmVersionInfoApi = 1
      DcmStandardSupport = DCM_ES95486_SUPPORT
      DcmRemainUnlockCondition = 0
      DcmAutronFblUsed = 1
      DcmDemIntegrated = 1
      DcmNvmIntegrated = 1
      DcmHeaderFileInclusion = Fota_Diag.h
      DcmHeaderFileInclusion = Lin_Diag.h
      DcmVinRef = DID_F190h_VINDataIdentifier
