AUTOSAR XML (schema 00047)
package /AUTRON
  module config IoHwAb: implementation-config-variant=VARIANT-PRE-COMPILE, module-description=BswImplementation_IoHwAb
    IoHwAbGeneral: IoHwAbDevErrorDetect=1, IoHwAbVersionInfoApi=1, IoHwAbMcalVendorVersion=NXP_S32K31X_3_0_0_P01_HF01
      IoHwAbPortPinChs
        11 x IoHwAbPortPinCh, all with IoHwAbPolarity=HighActive:
          IoHwAbPortPinCh_PTA6: IoHwAbHwDioChRef=DioChannel_PTA6, IoHwAbHwPortPinRef=PortPin_PTA6
          IoHwAbPortPinCh_PTC20: IoHwAbHwDioChRef=DioChannel_PTC20, IoHwAbHwPortPinRef=PortPin_PTC20
          IoHwAbPortPinCh_PTC21: IoHwAbHwDioChRef=DioChannel_PTC21, IoHwAbHwPortPinRef=PortPin_PTC21
          IoHwAbPortPinCh_PTC23: IoHwAbHwDioChRef=DioChannel_PTC23, IoHwAbHwPortPinRef=PortPin_PTC23
          IoHwAbPortPinCh_PTB19: IoHwAbHwDioChRef=DioChannel_PTB19, IoHwAbHwPortPinRef=PortPin_PTB19
          IoHwAbPortPinCh_PTB26: IoHwAbHwDioChRef=DioChannel_PTB26, IoHwAbHwPortPinRef=PortPin_PTB26
          IoHwAbPortPinCh_PTA{29..31}: IoHwAbHwDioChRef=DioChannel_PTA{29..31}, IoHwAbHwPortPinRef=PortPin_PTA{29..31}
          IoHwAbPortPinCh_PTD16: IoHwAbHwDioChRef=DioChannel_PTD16, IoHwAbHwPortPinRef=PortPin_PTD16
          IoHwAbPortPinCh_PTD17: IoHwAbHwDioChRef=DioChannel_PTD17, IoHwAbHwPortPinRef=PortPin_PTD17
      IoHwAbAdcSetting: IoHwAbAdcReadDirectMaxDelay=0xffff
        IoHwAbAdcGroups
          6 x IoHwAbAdcGroup:
            IoHwAbAdcGroup_PTA1: IoHwAbHwAdcGroupRef=AdcGroup_PTA1
            IoHwAbAdcGroup_PTA9: IoHwAbHwAdcGroupRef=AdcGroup_PTA9
            IoHwAbAdcGroup_PTA11: IoHwAbHwAdcGroupRef=AdcGroup_PTA11
            IoHwAbAdcGroup_PTC11: IoHwAbHwAdcGroupRef=AdcGroup_PTC11
            IoHwAbAdcGroup_PTD21: IoHwAbHwAdcGroupRef=AdcGroup_PTD21
            IoHwAbAdcGroup_PTD24: IoHwAbHwAdcGroupRef=AdcGroup_PTD24
        IoHwAbAdcAllGroups
      IoHwAbPrefixConfig
    IoHwAbConfig: IoHwAbUseDigitalDirect=1, IoHwAbUseAnalogInputDirect=1, IoHwAbUsePwm=1, IoHwAbUseGpt=1, IoHwAbUseIcu=1, IoHwAbUseOcu=0, IoHwAbUseIOManager=0
      IoHwAbAnalogInputDirect
        3 x IoHwAbAnalogInputDirectLogical:
          IoHwAbAnalogInputDirectLogical_CANBAT: IoHwAbAdcGroupRef=IoHwAbAdcGroup_PTA9
          IoHwAbAnalogInputDirectLogical_Test1: IoHwAbAdcGroupRef=IoHwAbAdcGroup_PTC11
          IoHwAbAnalogInputDirectLogical_Test2: IoHwAbAdcGroupRef=IoHwAbAdcGroup_PTA11
      IoHwAbDigitalDirect
        4 x IoHwAbDigitalDirectLogical:
          IoHwAbDigitalDirectLogical_FD_CAN1_RX: IoHwAbPortPinChRef=IoHwAbPortPinCh_PTA6
          IoHwAbDigitalDirectLogical_FD_CAN1_STB: IoHwAbPortPinChRef=IoHwAbPortPinCh_PTC20
          IoHwAbDigitalDirectLogical_FD_CAN1_EN: IoHwAbPortPinChRef=IoHwAbPortPinCh_PTC21
          IoHwAbDigitalDirectLogical_FD_CAN1_ERRN: IoHwAbPortPinChRef=IoHwAbPortPinCh_PTC23
      IoHwAbGpt
        IoHwAbGptLogical0 (IoHwAbGptLogical): IoHwAbGptCallbackViaRte=1, IoHwAbHwGptChRef=GptChannelConfiguration_Test
      IoHwAbIcu
        4 x IoHwAbIcuLogical:
          IoHwAbIcuLogical0_EdgeCounter: IoHwAbIcuCallbackViaRte=0, IoHwAbHwIcuChRef=IcuChannel_EdgeCounter
          IoHwAbIcuLogical1_EdgeDetect: IoHwAbIcuCallbackViaRte=1, IoHwAbHwIcuChRef=IcuChannel_EdgeDetect
          IoHwAbIcuLogical2_Timestamp: IoHwAbIcuCallbackViaRte=1, IoHwAbHwIcuChRef=IcuChannel_Timestamp
          IoHwAbIcuLogical3_SignalMeasurement: IoHwAbIcuCallbackViaRte=0, IoHwAbHwIcuChRef=IcuChannel_SignalMeasurement
      IoHwAbPwm
        IoHwAbPwmLogical0 (IoHwAbPwmLogical): IoHwAbPwmCallbackViaRte=0, IoHwAbHwPwmChRef=PwmChannel_PTA12
      IoHwAbDemEventParameterRefs:
        IOHWAB_E_WRONG_STATE = IOHWAB_E_WRONG_STATE
        IOHWAB_E_WRONG_SETTING = IOHWAB_E_WRONG_SETTING
        IOHWAB_E_WRONG_PARAM = IOHWAB_E_WRONG_PARAM
        IOHWAB_E_SETUP_FAIL = IOHWAB_E_SETUP_FAIL
        IOHWAB_E_PROC_FAIL = IOHWAB_E_PROC_FAIL
        IOHWAB_E_BUSY = IOHWAB_E_BUSY
