AUTOSAR XML (schema 00047)
package /AUTRON
  module config Wdg_76_Acw: definition=Wdg, implementation-config-variant=VARIANT-PRE-COMPILE, module-description=BswImplementation_Wdg_76_Acw
    WdgGeneral:
      WdgDevErrorDetect = 1
      WdgIndex = 1
      WdgInitialTimeout = 4.0
      WdgMaxTimeout = 4.2
      WdgRunArea = ROM
      WdgTriggerLocation = Wdg_76_Acw_Cbk
      WdgVersionInfoApi = 1
      WdgDisableAllowed = 0
      WdgEcucPartitionRef = EcucPartitionCollection
    WdgSettingsConfig: WdgDefaultMode=WDGIF_SLOW_MODE
      WdgSettingsOff
      WdgSettingsSlow: WdgPeriod=0.4
      WdgSettingsFast: WdgPeriod=0.1
      WdgExternalConfiguration:
        FastModeLevel_High = 1
        DisableAllowEnableLevel_High = 1
        WdgInitDuty = 50
        WdgPrefixGptChannelName = GptConf_GptChannelConfiguration_
        WdgGptChannel = GptChannelConfiguration_WdgExt
        WdgDioTrigger = DioChannel_PTD12
    WdgPublishedInformation: WdgTriggerMode=WDG_TOGGLE
