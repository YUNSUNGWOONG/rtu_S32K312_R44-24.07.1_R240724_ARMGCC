AUTOSAR XML (schema 00047)
package /AUTRON
  module config Com: implementation-config-variant=VARIANT-PRE-COMPILE, module-description=BswImplementation_Com
    ComConfig: ComDataMemSize=0, ComMaxIPduCnt=0
      11 x ComIPdu, all with category=TOOL_CONFIGURED, ComIPduType=NORMAL:
        ComIPdu_LIN1_Master_Cmd: ComIPduDirection=SEND, ComIPduHandleId=0, ComIPduSignalProcessing=IMMEDIATE, ComIPduSignalGroupRef=ComISignalGroup_MsgGr_LIN1_Master_Cmd, ComPduIdRef=Pdu_ISignalIPdu_LIN1_Master_Cmd, ComIPduGroupRef=ComIPduGroupTx_ECU1_LIN1
          ComTxIpdu_ComIPdu_LIN1_Master_Cmd (ComTxIPdu): category=TOOL_CONFIGURED, ComTxIPduUnusedAreasDefault=0
            ComTxModeTrue_ComTxIpdu_ComIPdu_LIN1_Master_Cmd (ComTxModeTrue): category=TOOL_CONFIGURED
              ComTxMode_ComTxModeTrue_ComTxIpdu_ComIPdu_LIN1_Master_Cmd (ComTxMode): category=TOOL_CONFIGURED, ComTxModeMode=NONE
        ComIPdu_LIN1_FL_Sensor_Status: ComIPduDirection=RECEIVE, ComIPduHandleId=0, ComIPduSignalProcessing=IMMEDIATE, ComIPduSignalGroupRef=ComISignalGroup_MsgGr_LIN1_FL_Sensor_Status, ComPduIdRef=Pdu_ISignalIPdu_LIN1_FL_Sensor_Status, ComIPduGroupRef=ComIPduGroupRx_ECU1_LIN1
        ComIPdu_LIN1_FCL_Sensor_Status: ComIPduDirection=RECEIVE, ComIPduHandleId=1, ComIPduSignalProcessing=IMMEDIATE, ComIPduSignalGroupRef=ComISignalGroup_MsgGr_LIN1_FCL_Sensor_Status, ComPduIdRef=Pdu_ISignalIPdu_LIN1_FCL_Sensor_Status, ComIPduGroupRef=ComIPduGroupRx_ECU1_LIN1
        ComIPdu_LIN1_FCR_Sensor_Status: ComIPduDirection=RECEIVE, ComIPduHandleId=2, ComIPduSignalProcessing=IMMEDIATE, ComIPduSignalGroupRef=ComISignalGroup_MsgGr_LIN1_FCR_Sensor_Status, ComPduIdRef=Pdu_ISignalIPdu_LIN1_FCR_Sensor_Status, ComIPduGroupRef=ComIPduGroupRx_ECU1_LIN1
        ComIPdu_LIN1_FR_Sensor_Status: ComIPduDirection=RECEIVE, ComIPduHandleId=3, ComIPduSignalProcessing=IMMEDIATE, ComIPduSignalGroupRef=ComISignalGroup_MsgGr_LIN1_FR_Sensor_Status, ComPduIdRef=Pdu_ISignalIPdu_LIN1_FR_Sensor_Status, ComIPduGroupRef=ComIPduGroupRx_ECU1_LIN1
        ComIPdu_LIN1_RL_Sensor_Status: ComIPduDirection=RECEIVE, ComIPduHandleId=4, ComIPduSignalProcessing=IMMEDIATE, ComIPduSignalGroupRef=ComISignalGroup_MsgGr_LIN1_RL_Sensor_Status, ComPduIdRef=Pdu_ISignalIPdu_LIN1_RL_Sensor_Status, ComIPduGroupRef=ComIPduGroupRx_ECU1_LIN1
        ComIPdu_LIN1_RCL_Sensor_Status: ComIPduDirection=RECEIVE, ComIPduHandleId=5, ComIPduSignalProcessing=IMMEDIATE, ComIPduSignalGroupRef=ComISignalGroup_MsgGr_LIN1_RCL_Sensor_Status, ComPduIdRef=Pdu_ISignalIPdu_LIN1_RCL_Sensor_Status, ComIPduGroupRef=ComIPduGroupRx_ECU1_LIN1
        ComIPdu_LIN1_RCR_Sensor_Status: ComIPduDirection=RECEIVE, ComIPduHandleId=6, ComIPduSignalProcessing=IMMEDIATE, ComIPduSignalGroupRef=ComISignalGroup_MsgGr_LIN1_RCR_Sensor_Status, ComPduIdRef=Pdu_ISignalIPdu_LIN1_RCR_Sensor_Status, ComIPduGroupRef=ComIPduGroupRx_ECU1_LIN1
        ComIPdu_LIN1_RR_Sensor_Status: ComIPduDirection=RECEIVE, ComIPduHandleId=7, ComIPduSignalProcessing=IMMEDIATE, ComIPduSignalGroupRef=ComISignalGroup_MsgGr_LIN1_RR_Sensor_Status, ComPduIdRef=Pdu_ISignalIPdu_LIN1_RR_Sensor_Status, ComIPduGroupRef=ComIPduGroupRx_ECU1_LIN1
        ComIPdu_FD_CAN1_BSD_01_50ms_P11: ComIPduDirection=RECEIVE, ComIPduHandleId=8, ComIPduSignalProcessing=DEFERRED, ComIPduSignalGroupRef=ComISignalGroup_MsgGr_E2E_FD_CAN1_BSD_01_50ms_P11, ComPduIdRef=Pdu_ISignalIPdu_FD_CAN1_BSD_01_50ms_P11, ComIPduGroupRef=ComIPduGroupRx_ECU1_FD_CAN1_PNC32
        ComIPdu_FD_CAN1_TCU_01_10ms_P11: ComIPduDirection=SEND, ComIPduHandleId=7, ComIPduSignalProcessing=DEFERRED, ComIPduSignalGroupRef=ComISignalGroup_MsgGr_E2E_FD_CAN1_TCU_01_10ms_P11, ComPduIdRef=Pdu_ISignalIPdu_FD_CAN1_TCU_01_10ms_P11, ComIPduGroupRef=ComIPduGroupTx_ECU1_FD_CAN1_PNC32
          ComTxIpdu_ComIPdu_FD_CAN1_TCU_01_10ms_P11 (ComTxIPdu): category=TOOL_CONFIGURED, ComTxIPduUnusedAreasDefault=0, ComMinimumDelayTime=0.02
            ComTxModeTrue_ComTxIpdu_ComIPdu_FD_CAN1_TCU_01_10ms_P11 (ComTxModeTrue): category=TOOL_CONFIGURED
              ComTxMode_ComTxModeTrue_ComTxIpdu_ComIPdu_FD_CAN1_TCU_01_10ms_P11 (ComTxMode): category=TOOL_CONFIGURED, ComTxModeTimeOffset=0.0, ComTxModeTimePeriod=0.01, ComTxModeMode=PERIODIC
      ComIPduGroupTx_ECU1_LIN1 (ComIPduGroup): category=TOOL_CONFIGURED, ComIPduGroupHandleId=0
      ComIPduGroupRx_ECU1_LIN1 (ComIPduGroup): category=TOOL_CONFIGURED, ComIPduGroupHandleId=1
      11 x ComSignalGroup, all with category=TOOL_CONFIGURED:
        ComISignalGroup_MsgGr_LIN1_Master_Cmd: ComHandleId=0, ComSignalGroupArrayAccess=0, ComTransferProperty=TRIGGERED, ComSystemTemplateSignalGroupRef=SigGrp_LIN1_Master_Cmd
          19 x ComGroupSignal, all with category=TOOL_CONFIGURED, ComSignalEndianness=LITTLE_ENDIAN, ComSignalLength=1:
            LIN1_Master_Cmd_NAD: ComBitPosition=0, ComSignalInitValue=255, ComBitSize=8, ComSignalType=UINT8, ComHandleId=18, ComSystemTemplateSystemSignalRef=NAD
            LIN1_Master_Cmd_PCI_Type: ComBitPosition=8, ComSignalInitValue=3, ComBitSize=8, ComSignalType=UINT8, ComHandleId=19, ComSystemTemplateSystemSignalRef=PCI_Type
            LIN1_Master_Cmd_SID: ComBitPosition=16, ComSignalInitValue=0, ComBitSize=8, ComSignalType=UINT8, ComHandleId=20, ComSystemTemplateSystemSignalRef=SID
            LIN1_Master_Cmd_RL_Sensor_Tx: ComBitPosition=24, ComSignalInitValue=0, ComBitSize=1, ComSignalType=BOOLEAN, ComHandleId=21, ComSystemTemplateSystemSignalRef=RL_Sensor_Tx
            LIN1_Master_Cmd_RCL_Sensor_Tx: ComBitPosition=25, ComSignalInitValue=0, ComBitSize=1, ComSignalType=BOOLEAN, ComHandleId=22, ComSystemTemplateSystemSignalRef=RCL_Sensor_Tx
            LIN1_Master_Cmd_RCR_Sensor_Tx: ComBitPosition=26, ComSignalInitValue=0, ComBitSize=1, ComSignalType=BOOLEAN, ComHandleId=23, ComSystemTemplateSystemSignalRef=RCR_Sensor_Tx
            LIN1_Master_Cmd_RR_Sensor_Tx: ComBitPosition=27, ComSignalInitValue=0, ComBitSize=1, ComSignalType=BOOLEAN, ComHandleId=24, ComSystemTemplateSystemSignalRef=RR_Sensor_Tx
            LIN1_Master_Cmd_FL_Sensor_Tx: ComBitPosition=28, ComSignalInitValue=0, ComBitSize=1, ComSignalType=BOOLEAN, ComHandleId=25, ComSystemTemplateSystemSignalRef=FL_Sensor_Tx
            LIN1_Master_Cmd_FCL_Sensor_Tx: ComBitPosition=29, ComSignalInitValue=0, ComBitSize=1, ComSignalType=BOOLEAN, ComHandleId=26, ComSystemTemplateSystemSignalRef=FCL_Sensor_Tx
            LIN1_Master_Cmd_FCR_Sensor_Tx: ComBitPosition=30, ComSignalInitValue=0, ComBitSize=1, ComSignalType=BOOLEAN, ComHandleId=27, ComSystemTemplateSystemSignalRef=FCR_Sensor_Tx
            LIN1_Master_Cmd_FR_Sensor_Tx: ComBitPosition=31, ComSignalInitValue=0, ComBitSize=1, ComSignalType=BOOLEAN, ComHandleId=28, ComSystemTemplateSystemSignalRef=FR_Sensor_Tx
            LIN1_Master_Cmd_RL_Sensor_Rx: ComBitPosition=32, ComSignalInitValue=0, ComBitSize=1, ComSignalType=BOOLEAN, ComHandleId=29, ComSystemTemplateSystemSignalRef=RL_Sensor_Rx
            LIN1_Master_Cmd_RCL_Sensor_Rx: ComBitPosition=33, ComSignalInitValue=0, ComBitSize=1, ComSignalType=BOOLEAN, ComHandleId=30, ComSystemTemplateSystemSignalRef=RCL_Sensor_Rx
            LIN1_Master_Cmd_RCR_Sensor_Rx: ComBitPosition=34, ComSignalInitValue=0, ComBitSize=1, ComSignalType=BOOLEAN, ComHandleId=31, ComSystemTemplateSystemSignalRef=RCR_Sensor_Rx
            LIN1_Master_Cmd_RR_Sensor_Rx: ComBitPosition=35, ComSignalInitValue=0, ComBitSize=1, ComSignalType=BOOLEAN, ComHandleId=32, ComSystemTemplateSystemSignalRef=RR_Sensor_Rx
            LIN1_Master_Cmd_FL_Sensor_Rx: ComBitPosition=36, ComSignalInitValue=0, ComBitSize=1, ComSignalType=BOOLEAN, ComHandleId=33, ComSystemTemplateSystemSignalRef=FL_Sensor_Rx
            LIN1_Master_Cmd_FCL_Sensor_Rx: ComBitPosition=37, ComSignalInitValue=0, ComBitSize=1, ComSignalType=BOOLEAN, ComHandleId=34, ComSystemTemplateSystemSignalRef=FCL_Sensor_Rx
            LIN1_Master_Cmd_FCR_Sensor_Rx: ComBitPosition=38, ComSignalInitValue=0, ComBitSize=1, ComSignalType=BOOLEAN, ComHandleId=35, ComSystemTemplateSystemSignalRef=FCR_Sensor_Rx
            LIN1_Master_Cmd_FR_Sensor_Rx: ComBitPosition=39, ComSignalInitValue=0, ComBitSize=1, ComSignalType=BOOLEAN, ComHandleId=36, ComSystemTemplateSystemSignalRef=FR_Sensor_Rx
        ComISignalGroup_MsgGr_LIN1_FL_Sensor_Status: ComHandleId=0, ComSignalGroupArrayAccess=0, ComTransferProperty=TRIGGERED, ComSystemTemplateSignalGroupRef=SigGrp_LIN1_FL_Sensor_Status
          11 x ComGroupSignal, all with category=TOOL_CONFIGURED, ComSignalEndianness=LITTLE_ENDIAN, ComSignalInitValue=0:
            LIN1_FL_Sensor_Status_FL_TOF: ComBitPosition=0, ComBitSize=10, ComSignalLength=2, ComSignalType=UINT16, ComHandleId=11, ComSystemTemplateSystemSignalRef=FL_TOF
            LIN1_FL_Sensor_Status_FL_Sensor_Status_0: ComBitPosition=24, ComBitSize=1, ComSignalLength=1, ComSignalType=BOOLEAN, ComHandleId=12, ComSystemTemplateSystemSignalRef=FL_Sensor_Status_0
            LIN1_FL_Sensor_Status_FL_Sensor_Status_1: ComBitPosition=25, ComBitSize=1, ComSignalLength=1, ComSignalType=BOOLEAN, ComHandleId=13, ComSystemTemplateSystemSignalRef=FL_Sensor_Status_1
            LIN1_FL_Sensor_Status_FL_Sensor_Status_2: ComBitPosition=26, ComBitSize=1, ComSignalLength=1, ComSignalType=BOOLEAN, ComHandleId=14, ComSystemTemplateSystemSignalRef=FL_Sensor_Status_2
            LIN1_FL_Sensor_Status_FL_Sensor_Status_3: ComBitPosition=27, ComBitSize=1, ComSignalLength=1, ComSignalType=BOOLEAN, ComHandleId=15, ComSystemTemplateSystemSignalRef=FL_Sensor_Status_3
            LIN1_FL_Sensor_Status_FL_Sensor_Status_4: ComBitPosition=28, ComBitSize=1, ComSignalLength=1, ComSignalType=BOOLEAN, ComHandleId=16, ComSystemTemplateSystemSignalRef=FL_Sensor_Status_4
            LIN1_FL_Sensor_Status_FL_Sensor_Status_5: ComBitPosition=29, ComBitSize=1, ComSignalLength=1, ComSignalType=BOOLEAN, ComHandleId=17, ComSystemTemplateSystemSignalRef=FL_Sensor_Status_5
            LIN1_FL_Sensor_Status_FL_Sensor_Status_6: ComBitPosition=30, ComBitSize=1, ComSignalLength=1, ComSignalType=BOOLEAN, ComHandleId=18, ComSystemTemplateSystemSignalRef=FL_Sensor_Status_6
            LIN1_FL_Sensor_Status_FL_Sensor_Status_7: ComBitPosition=31, ComBitSize=1, ComSignalLength=1, ComSignalType=BOOLEAN, ComHandleId=19, ComSystemTemplateSystemSignalRef=FL_Sensor_Status_7
            LIN1_FL_Sensor_Status_FL_CRC: ComBitPosition=32, ComBitSize=8, ComSignalLength=1, ComSignalType=UINT8, ComHandleId=20, ComSystemTemplateSystemSignalRef=FL_CRC
            LIN1_FL_Sensor_Status_FL_Ringtime: ComBitPosition=40, ComBitSize=8, ComSignalLength=1, ComSignalType=UINT8, ComHandleId=21, ComSystemTemplateSystemSignalRef=FL_Ringtime
        ComISignalGroup_MsgGr_LIN1_FCL_Sensor_Status: ComHandleId=1, ComSignalGroupArrayAccess=0, ComTransferProperty=TRIGGERED, ComSystemTemplateSignalGroupRef=SigGrp_LIN1_FCL_Sensor_Status
          11 x ComGroupSignal, all with category=TOOL_CONFIGURED, ComSignalEndianness=LITTLE_ENDIAN, ComSignalInitValue=0:
            LIN1_FCL_Sensor_Status_FCL_TOF: ComBitPosition=0, ComBitSize=10, ComSignalLength=2, ComSignalType=UINT16, ComHandleId=22, ComSystemTemplateSystemSignalRef=FCL_TOF
            LIN1_FCL_Sensor_Status_FCL_Sensor_Status_0: ComBitPosition=24, ComBitSize=1, ComSignalLength=1, ComSignalType=BOOLEAN, ComHandleId=23, ComSystemTemplateSystemSignalRef=FCL_Sensor_Status_0
            LIN1_FCL_Sensor_Status_FCL_Sensor_Status_1: ComBitPosition=25, ComBitSize=1, ComSignalLength=1, ComSignalType=BOOLEAN, ComHandleId=24, ComSystemTemplateSystemSignalRef=FCL_Sensor_Status_1
            LIN1_FCL_Sensor_Status_FCL_Sensor_Status_2: ComBitPosition=26, ComBitSize=1, ComSignalLength=1, ComSignalType=BOOLEAN, ComHandleId=25, ComSystemTemplateSystemSignalRef=FCL_Sensor_Status_2
            LIN1_FCL_Sensor_Status_FCL_Sensor_Status_3: ComBitPosition=27, ComBitSize=1, ComSignalLength=1, ComSignalType=BOOLEAN, ComHandleId=26, ComSystemTemplateSystemSignalRef=FCL_Sensor_Status_3
            LIN1_FCL_Sensor_Status_FCL_Sensor_Status_4: ComBitPosition=28, ComBitSize=1, ComSignalLength=1, ComSignalType=BOOLEAN, ComHandleId=27, ComSystemTemplateSystemSignalRef=FCL_Sensor_Status_4
            LIN1_FCL_Sensor_Status_FCL_Sensor_Status_5: ComBitPosition=29, ComBitSize=1, ComSignalLength=1, ComSignalType=BOOLEAN, ComHandleId=28, ComSystemTemplateSystemSignalRef=FCL_Sensor_Status_5
            LIN1_FCL_Sensor_Status_FCL_Sensor_Status_6: ComBitPosition=30, ComBitSize=1, ComSignalLength=1, ComSignalType=BOOLEAN, ComHandleId=29, ComSystemTemplateSystemSignalRef=FCL_Sensor_Status_6
            LIN1_FCL_Sensor_Status_FCL_Sensor_Status_7: ComBitPosition=31, ComBitSize=1, ComSignalLength=1, ComSignalType=BOOLEAN, ComHandleId=30, ComSystemTemplateSystemSignalRef=FCL_Sensor_Status_7
            LIN1_FCL_Sensor_Status_FCL_CRC: ComBitPosition=32, ComBitSize=8, ComSignalLength=1, ComSignalType=UINT8, ComHandleId=31, ComSystemTemplateSystemSignalRef=FCL_CRC
            LIN1_FCL_Sensor_Status_FCL_Ringtime: ComBitPosition=40, ComBitSize=8, ComSignalLength=1, ComSignalType=UINT8, ComHandleId=32, ComSystemTemplateSystemSignalRef=FCL_Ringtime
        ComISignalGroup_MsgGr_LIN1_FCR_Sensor_Status: ComHandleId=2, ComSignalGroupArrayAccess=0, ComTransferProperty=TRIGGERED, ComSystemTemplateSignalGroupRef=SigGrp_LIN1_FCR_Sensor_Status
          11 x ComGroupSignal, all with category=TOOL_CONFIGURED, ComSignalEndianness=LITTLE_ENDIAN, ComSignalInitValue=0:
            LIN1_FCR_Sensor_Status_FCR_TOF: ComBitPosition=0, ComBitSize=10, ComSignalLength=2, ComSignalType=UINT16, ComHandleId=33, ComSystemTemplateSystemSignalRef=FCR_TOF
            LIN1_FCR_Sensor_Status_FCR_Sensor_Status_0: ComBitPosition=24, ComBitSize=1, ComSignalLength=1, ComSignalType=BOOLEAN, ComHandleId=34, ComSystemTemplateSystemSignalRef=FCR_Sensor_Status_0
            LIN1_FCR_Sensor_Status_FCR_Sensor_Status_1: ComBitPosition=25, ComBitSize=1, ComSignalLength=1, ComSignalType=BOOLEAN, ComHandleId=35, ComSystemTemplateSystemSignalRef=FCR_Sensor_Status_1
            LIN1_FCR_Sensor_Status_FCR_Sensor_Status_2: ComBitPosition=26, ComBitSize=1, ComSignalLength=1, ComSignalType=BOOLEAN, ComHandleId=36, ComSystemTemplateSystemSignalRef=FCR_Sensor_Status_2
            LIN1_FCR_Sensor_Status_FCR_Sensor_Status_3: ComBitPosition=27, ComBitSize=1, ComSignalLength=1, ComSignalType=BOOLEAN, ComHandleId=37, ComSystemTemplateSystemSignalRef=FCR_Sensor_Status_3
            LIN1_FCR_Sensor_Status_FCR_Sensor_Status_4: ComBitPosition=28, ComBitSize=1, ComSignalLength=1, ComSignalType=BOOLEAN, ComHandleId=38, ComSystemTemplateSystemSignalRef=FCR_Sensor_Status_4
            LIN1_FCR_Sensor_Status_FCR_Sensor_Status_5: ComBitPosition=29, ComBitSize=1, ComSignalLength=1, ComSignalType=BOOLEAN, ComHandleId=39, ComSystemTemplateSystemSignalRef=FCR_Sensor_Status_5
            LIN1_FCR_Sensor_Status_FCR_Sensor_Status_6: ComBitPosition=30, ComBitSize=1, ComSignalLength=1, ComSignalType=BOOLEAN, ComHandleId=40, ComSystemTemplateSystemSignalRef=FCR_Sensor_Status_6
            LIN1_FCR_Sensor_Status_FCR_Sensor_Status_7: ComBitPosition=31, ComBitSize=1, ComSignalLength=1, ComSignalType=BOOLEAN, ComHandleId=41, ComSystemTemplateSystemSignalRef=FCR_Sensor_Status_7
            LIN1_FCR_Sensor_Status_FCR_CRC: ComBitPosition=32, ComBitSize=8, ComSignalLength=1, ComSignalType=UINT8, ComHandleId=42, ComSystemTemplateSystemSignalRef=FCR_CRC
            LIN1_FCR_Sensor_Status_FCR_Ringtime: ComBitPosition=40, ComBitSize=8, ComSignalLength=1, ComSignalType=UINT8, ComHandleId=43, ComSystemTemplateSystemSignalRef=FCR_Ringtime
        ComISignalGroup_MsgGr_LIN1_FR_Sensor_Status: ComHandleId=3, ComSignalGroupArrayAccess=0, ComTransferProperty=TRIGGERED, ComSystemTemplateSignalGroupRef=SigGrp_LIN1_FR_Sensor_Status
          11 x ComGroupSignal, all with category=TOOL_CONFIGURED, ComSignalEndianness=LITTLE_ENDIAN, ComSignalInitValue=0:
            LIN1_FR_Sensor_Status_FR_TOF: ComBitPosition=0, ComBitSize=10, ComSignalLength=2, ComSignalType=UINT16, ComHandleId=44, ComSystemTemplateSystemSignalRef=FR_TOF
            LIN1_FR_Sensor_Status_FR_Sensor_Status_0: ComBitPosition=24, ComBitSize=1, ComSignalLength=1, ComSignalType=BOOLEAN, ComHandleId=45, ComSystemTemplateSystemSignalRef=FR_Sensor_Status_0
            LIN1_FR_Sensor_Status_FR_Sensor_Status_1: ComBitPosition=25, ComBitSize=1, ComSignalLength=1, ComSignalType=BOOLEAN, ComHandleId=46, ComSystemTemplateSystemSignalRef=FR_Sensor_Status_1
            LIN1_FR_Sensor_Status_FR_Sensor_Status_2: ComBitPosition=26, ComBitSize=1, ComSignalLength=1, ComSignalType=BOOLEAN, ComHandleId=47, ComSystemTemplateSystemSignalRef=FR_Sensor_Status_2
            LIN1_FR_Sensor_Status_FR_Sensor_Status_3: ComBitPosition=27, ComBitSize=1, ComSignalLength=1, ComSignalType=BOOLEAN, ComHandleId=48, ComSystemTemplateSystemSignalRef=FR_Sensor_Status_3
            LIN1_FR_Sensor_Status_FR_Sensor_Status_4: ComBitPosition=28, ComBitSize=1, ComSignalLength=1, ComSignalType=BOOLEAN, ComHandleId=49, ComSystemTemplateSystemSignalRef=FR_Sensor_Status_4
            LIN1_FR_Sensor_Status_FR_Sensor_Status_5: ComBitPosition=29, ComBitSize=1, ComSignalLength=1, ComSignalType=BOOLEAN, ComHandleId=50, ComSystemTemplateSystemSignalRef=FR_Sensor_Status_5
            LIN1_FR_Sensor_Status_FR_Sensor_Status_6: ComBitPosition=30, ComBitSize=1, ComSignalLength=1, ComSignalType=BOOLEAN, ComHandleId=51, ComSystemTemplateSystemSignalRef=FR_Sensor_Status_6
            LIN1_FR_Sensor_Status_FR_Sensor_Status_7: ComBitPosition=31, ComBitSize=1, ComSignalLength=1, ComSignalType=BOOLEAN, ComHandleId=52, ComSystemTemplateSystemSignalRef=FR_Sensor_Status_7
            LIN1_FR_Sensor_Status_FR_CRC: ComBitPosition=32, ComBitSize=8, ComSignalLength=1, ComSignalType=UINT8, ComHandleId=53, ComSystemTemplateSystemSignalRef=FR_CRC
            LIN1_FR_Sensor_Status_FR_Ringtime: ComBitPosition=40, ComBitSize=8, ComSignalLength=1, ComSignalType=UINT8, ComHandleId=54, ComSystemTemplateSystemSignalRef=FR_Ringtime
        ComISignalGroup_MsgGr_LIN1_RL_Sensor_Status: ComHandleId=4, ComSignalGroupArrayAccess=0, ComTransferProperty=TRIGGERED, ComSystemTemplateSignalGroupRef=SigGrp_LIN1_RL_Sensor_Status
          11 x ComGroupSignal, all with category=TOOL_CONFIGURED, ComSignalEndianness=LITTLE_ENDIAN, ComSignalInitValue=0:
            LIN1_RL_Sensor_Status_RL_TOF: ComBitPosition=0, ComBitSize=10, ComSignalLength=2, ComSignalType=UINT16, ComHandleId=55, ComSystemTemplateSystemSignalRef=RL_TOF
            LIN1_RL_Sensor_Status_RL_Sensor_Status_0: ComBitPosition=24, ComBitSize=1, ComSignalLength=1, ComSignalType=BOOLEAN, ComHandleId=56, ComSystemTemplateSystemSignalRef=RL_Sensor_Status_0
            LIN1_RL_Sensor_Status_RL_Sensor_Status_1: ComBitPosition=25, ComBitSize=1, ComSignalLength=1, ComSignalType=BOOLEAN, ComHandleId=57, ComSystemTemplateSystemSignalRef=RL_Sensor_Status_1
            LIN1_RL_Sensor_Status_RL_Sensor_Status_2: ComBitPosition=26, ComBitSize=1, ComSignalLength=1, ComSignalType=BOOLEAN, ComHandleId=58, ComSystemTemplateSystemSignalRef=RL_Sensor_Status_2
            LIN1_RL_Sensor_Status_RL_Sensor_Status_3: ComBitPosition=27, ComBitSize=1, ComSignalLength=1, ComSignalType=BOOLEAN, ComHandleId=59, ComSystemTemplateSystemSignalRef=RL_Sensor_Status_3
            LIN1_RL_Sensor_Status_RL_Sensor_Status_4: ComBitPosition=28, ComBitSize=1, ComSignalLength=1, ComSignalType=BOOLEAN, ComHandleId=60, ComSystemTemplateSystemSignalRef=RL_Sensor_Status_4
            LIN1_RL_Sensor_Status_RL_Sensor_Status_5: ComBitPosition=29, ComBitSize=1, ComSignalLength=1, ComSignalType=BOOLEAN, ComHandleId=61, ComSystemTemplateSystemSignalRef=RL_Sensor_Status_5
            LIN1_RL_Sensor_Status_RL_Sensor_Status_6: ComBitPosition=30, ComBitSize=1, ComSignalLength=1, ComSignalType=BOOLEAN, ComHandleId=62, ComSystemTemplateSystemSignalRef=RL_Sensor_Status_6
            LIN1_RL_Sensor_Status_RL_Sensor_Status_7: ComBitPosition=31, ComBitSize=1, ComSignalLength=1, ComSignalType=BOOLEAN, ComHandleId=63, ComSystemTemplateSystemSignalRef=RL_Sensor_Status_7
            LIN1_RL_Sensor_Status_RL_CRC: ComBitPosition=32, ComBitSize=8, ComSignalLength=1, ComSignalType=UINT8, ComHandleId=64, ComSystemTemplateSystemSignalRef=RL_CRC
            LIN1_RL_Sensor_Status_RL_Ringtime: ComBitPosition=40, ComBitSize=8, ComSignalLength=1, ComSignalType=UINT8, ComHandleId=65, ComSystemTemplateSystemSignalRef=RL_Ringtime
        ComISignalGroup_MsgGr_LIN1_RCL_Sensor_Status: ComHandleId=5, ComSignalGroupArrayAccess=0, ComTransferProperty=TRIGGERED, ComSystemTemplateSignalGroupRef=SigGrp_LIN1_RCL_Sensor_Status
          11 x ComGroupSignal, all with category=TOOL_CONFIGURED, ComSignalEndianness=LITTLE_ENDIAN, ComSignalInitValue=0:
            LIN1_RCL_Sensor_Status_RCL_TOF: ComBitPosition=0, ComBitSize=10, ComSignalLength=2, ComSignalType=UINT16, ComHandleId=66, ComSystemTemplateSystemSignalRef=RCL_TOF
            LIN1_RCL_Sensor_Status_RCL_Sensor_Status_0: ComBitPosition=24, ComBitSize=1, ComSignalLength=1, ComSignalType=BOOLEAN, ComHandleId=67, ComSystemTemplateSystemSignalRef=RCL_Sensor_Status_0
            LIN1_RCL_Sensor_Status_RCL_Sensor_Status_1: ComBitPosition=25, ComBitSize=1, ComSignalLength=1, ComSignalType=BOOLEAN, ComHandleId=68, ComSystemTemplateSystemSignalRef=RCL_Sensor_Status_1
            LIN1_RCL_Sensor_Status_RCL_Sensor_Status_2: ComBitPosition=26, ComBitSize=1, ComSignalLength=1, ComSignalType=BOOLEAN, ComHandleId=69, ComSystemTemplateSystemSignalRef=RCL_Sensor_Status_2
            LIN1_RCL_Sensor_Status_RCL_Sensor_Status_3: ComBitPosition=27, ComBitSize=1, ComSignalLength=1, ComSignalType=BOOLEAN, ComHandleId=70, ComSystemTemplateSystemSignalRef=RCL_Sensor_Status_3
            LIN1_RCL_Sensor_Status_RCL_Sensor_Status_4: ComBitPosition=28, ComBitSize=1, ComSignalLength=1, ComSignalType=BOOLEAN, ComHandleId=71, ComSystemTemplateSystemSignalRef=RCL_Sensor_Status_4
            LIN1_RCL_Sensor_Status_RCL_Sensor_Status_5: ComBitPosition=29, ComBitSize=1, ComSignalLength=1, ComSignalType=BOOLEAN, ComHandleId=72, ComSystemTemplateSystemSignalRef=RCL_Sensor_Status_5
            LIN1_RCL_Sensor_Status_RCL_Sensor_Status_6: ComBitPosition=30, ComBitSize=1, ComSignalLength=1, ComSignalType=BOOLEAN, ComHandleId=73, ComSystemTemplateSystemSignalRef=RCL_Sensor_Status_6
            LIN1_RCL_Sensor_Status_RCL_Sensor_Status_7: ComBitPosition=31, ComBitSize=1, ComSignalLength=1, ComSignalType=BOOLEAN, ComHandleId=74, ComSystemTemplateSystemSignalRef=RCL_Sensor_Status_7
            LIN1_RCL_Sensor_Status_RCL_CRC: ComBitPosition=32, ComBitSize=8, ComSignalLength=1, ComSignalType=UINT8, ComHandleId=75, ComSystemTemplateSystemSignalRef=RCL_CRC
            LIN1_RCL_Sensor_Status_RCL_Ringtime: ComBitPosition=40, ComBitSize=8, ComSignalLength=1, ComSignalType=UINT8, ComHandleId=76, ComSystemTemplateSystemSignalRef=RCL_Ringtime
        ComISignalGroup_MsgGr_LIN1_RCR_Sensor_Status: ComHandleId=6, ComSignalGroupArrayAccess=0, ComTransferProperty=TRIGGERED, ComSystemTemplateSignalGroupRef=SigGrp_LIN1_RCR_Sensor_Status
          11 x ComGroupSignal, all with category=TOOL_CONFIGURED, ComSignalEndianness=LITTLE_ENDIAN, ComSignalInitValue=0:
            LIN1_RCR_Sensor_Status_RCR_TOF: ComBitPosition=0, ComBitSize=10, ComSignalLength=2, ComSignalType=UINT16, ComHandleId=77, ComSystemTemplateSystemSignalRef=RCR_TOF
            LIN1_RCR_Sensor_Status_RCR_Sensor_Status_0: ComBitPosition=24, ComBitSize=1, ComSignalLength=1, ComSignalType=BOOLEAN, ComHandleId=78, ComSystemTemplateSystemSignalRef=RCR_Sensor_Status_0
            LIN1_RCR_Sensor_Status_RCR_Sensor_Status_1: ComBitPosition=25, ComBitSize=1, ComSignalLength=1, ComSignalType=BOOLEAN, ComHandleId=79, ComSystemTemplateSystemSignalRef=RCR_Sensor_Status_1
            LIN1_RCR_Sensor_Status_RCR_Sensor_Status_2: ComBitPosition=26, ComBitSize=1, ComSignalLength=1, ComSignalType=BOOLEAN, ComHandleId=80, ComSystemTemplateSystemSignalRef=RCR_Sensor_Status_2
            LIN1_RCR_Sensor_Status_RCR_Sensor_Status_3: ComBitPosition=27, ComBitSize=1, ComSignalLength=1, ComSignalType=BOOLEAN, ComHandleId=81, ComSystemTemplateSystemSignalRef=RCR_Sensor_Status_3
            LIN1_RCR_Sensor_Status_RCR_Sensor_Status_4: ComBitPosition=28, ComBitSize=1, ComSignalLength=1, ComSignalType=BOOLEAN, ComHandleId=82, ComSystemTemplateSystemSignalRef=RCR_Sensor_Status_4
            LIN1_RCR_Sensor_Status_RCR_Sensor_Status_5: ComBitPosition=29, ComBitSize=1, ComSignalLength=1, ComSignalType=BOOLEAN, ComHandleId=83, ComSystemTemplateSystemSignalRef=RCR_Sensor_Status_5
            LIN1_RCR_Sensor_Status_RCR_Sensor_Status_6: ComBitPosition=30, ComBitSize=1, ComSignalLength=1, ComSignalType=BOOLEAN, ComHandleId=84, ComSystemTemplateSystemSignalRef=RCR_Sensor_Status_6
            LIN1_RCR_Sensor_Status_RCR_Sensor_Status_7: ComBitPosition=31, ComBitSize=1, ComSignalLength=1, ComSignalType=BOOLEAN, ComHandleId=85, ComSystemTemplateSystemSignalRef=RCR_Sensor_Status_7
            LIN1_RCR_Sensor_Status_RCR_CRC: ComBitPosition=32, ComBitSize=8, ComSignalLength=1, ComSignalType=UINT8, ComHandleId=86, ComSystemTemplateSystemSignalRef=RCR_CRC
            LIN1_RCR_Sensor_Status_RCR_Ringtime: ComBitPosition=40, ComBitSize=8, ComSignalLength=1, ComSignalType=UINT8, ComHandleId=87, ComSystemTemplateSystemSignalRef=RCR_Ringtime
        ComISignalGroup_MsgGr_LIN1_RR_Sensor_Status: ComHandleId=7, ComSignalGroupArrayAccess=0, ComTransferProperty=TRIGGERED, ComSystemTemplateSignalGroupRef=SigGrp_LIN1_RR_Sensor_Status
          11 x ComGroupSignal, all with category=TOOL_CONFIGURED, ComSignalEndianness=LITTLE_ENDIAN, ComSignalInitValue=0:
            LIN1_RR_Sensor_Status_RR_TOF: ComBitPosition=0, ComBitSize=10, ComSignalLength=2, ComSignalType=UINT16, ComHandleId=88, ComSystemTemplateSystemSignalRef=RR_TOF
            LIN1_RR_Sensor_Status_RR_Sensor_Status_0: ComBitPosition=24, ComBitSize=1, ComSignalLength=1, ComSignalType=BOOLEAN, ComHandleId=89, ComSystemTemplateSystemSignalRef=RR_Sensor_Status_0
            LIN1_RR_Sensor_Status_RR_Sensor_Status_1: ComBitPosition=25, ComBitSize=1, ComSignalLength=1, ComSignalType=BOOLEAN, ComHandleId=90, ComSystemTemplateSystemSignalRef=RR_Sensor_Status_1
            LIN1_RR_Sensor_Status_RR_Sensor_Status_2: ComBitPosition=26, ComBitSize=1, ComSignalLength=1, ComSignalType=BOOLEAN, ComHandleId=91, ComSystemTemplateSystemSignalRef=RR_Sensor_Status_2
            LIN1_RR_Sensor_Status_RR_Sensor_Status_3: ComBitPosition=27, ComBitSize=1, ComSignalLength=1, ComSignalType=BOOLEAN, ComHandleId=92, ComSystemTemplateSystemSignalRef=RR_Sensor_Status_3
            LIN1_RR_Sensor_Status_RR_Sensor_Status_4: ComBitPosition=28, ComBitSize=1, ComSignalLength=1, ComSignalType=BOOLEAN, ComHandleId=93, ComSystemTemplateSystemSignalRef=RR_Sensor_Status_4
            LIN1_RR_Sensor_Status_RR_Sensor_Status_5: ComBitPosition=29, ComBitSize=1, ComSignalLength=1, ComSignalType=BOOLEAN, ComHandleId=94, ComSystemTemplateSystemSignalRef=RR_Sensor_Status_5
            LIN1_RR_Sensor_Status_RR_Sensor_Status_6: ComBitPosition=30, ComBitSize=1, ComSignalLength=1, ComSignalType=BOOLEAN, ComHandleId=95, ComSystemTemplateSystemSignalRef=RR_Sensor_Status_6
            LIN1_RR_Sensor_Status_RR_Sensor_Status_7: ComBitPosition=31, ComBitSize=1, ComSignalLength=1, ComSignalType=BOOLEAN, ComHandleId=96, ComSystemTemplateSystemSignalRef=RR_Sensor_Status_7
            LIN1_RR_Sensor_Status_RR_CRC: ComBitPosition=32, ComBitSize=8, ComSignalLength=1, ComSignalType=UINT8, ComHandleId=97, ComSystemTemplateSystemSignalRef=RR_CRC
            LIN1_RR_Sensor_Status_RR_Ringtime: ComBitPosition=40, ComBitSize=8, ComSignalLength=1, ComSignalType=UINT8, ComHandleId=98, ComSystemTemplateSystemSignalRef=RR_Ringtime
        ComISignalGroup_MsgGr_E2E_FD_CAN1_BSD_01_50ms_P11: ComHandleId=8, ComSignalGroupArrayAccess=1, ComTransferProperty=PENDING, ComSystemTemplateSignalGroupRef=MsgGr_FD_CAN1_BSD_01_50ms_P11
          4 x ComGroupSignal, all with category=TOOL_CONFIGURED, ComSignalEndianness=LITTLE_ENDIAN, ComSignalInitValue=0, ComSignalLength=1, ComSignalType=UINT8:
            FD_CAN1_BSD_01_50ms_P11_TCU_AlvCnt1Val_Rx_P11: ComBitPosition=12, ComBitSize=4, ComHandleId=100, ComTransferProperty=PENDING, ComSystemTemplateSystemSignalRef=TCU_AlvCnt1Val_Rx_P11
            FD_CAN1_BSD_01_50ms_P11_TCU_EngRpmDisSta_Rx_P11: ComBitPosition=24, ComBitSize=2, ComHandleId=101, ComTransferProperty=PENDING, ComSystemTemplateSystemSignalRef=TCU_EngRpmDisSta_Rx_P11
            FD_CAN1_BSD_01_50ms_P11_TCU_Crc1Val_Rx_P11: ComBitPosition=0, ComBitSize=8, ComHandleId=99, ComTransferProperty=PENDING, ComSystemTemplateSystemSignalRef=TCU_Crc1Val_Rx_P11
            FD_CAN1_BSD_01_50ms_P11_BSD_01_50ms_P11_E2EReserved: ComBitPosition=56, ComBitSize=8, ComHandleId=102, ComSystemTemplateSystemSignalRef=BSD_01_50ms_P11_E2EReserved
        ComISignalGroup_MsgGr_E2E_FD_CAN1_TCU_01_10ms_P11: ComHandleId=2, ComSignalGroupArrayAccess=1, ComTransferProperty=PENDING, ComSystemTemplateSignalGroupRef=MsgGr_FD_CAN1_TCU_01_10ms_P11
          4 x ComGroupSignal, all with category=TOOL_CONFIGURED, ComSignalEndianness=LITTLE_ENDIAN, ComSignalInitValue=0, ComSignalLength=1, ComSignalType=UINT8:
            FD_CAN1_TCU_01_10ms_P11_TCU_AlvCnt1Val_Tx_P11: ComBitPosition=12, ComBitSize=4, ComHandleId=57, ComTransferProperty=PENDING, ComSystemTemplateSystemSignalRef=TCU_AlvCnt1Val_Tx_P11
            FD_CAN1_TCU_01_10ms_P11_TCU_EngRpmDisSta_Tx_P11: ComBitPosition=24, ComBitSize=2, ComHandleId=58, ComTransferProperty=PENDING, ComSystemTemplateSystemSignalRef=TCU_EngRpmDisSta_Tx_P11
            FD_CAN1_TCU_01_10ms_P11_TCU_Crc1Val_Tx_P11: ComBitPosition=0, ComBitSize=8, ComHandleId=56, ComTransferProperty=PENDING, ComSystemTemplateSystemSignalRef=TCU_Crc1Val_Tx_P11
            FD_CAN1_TCU_01_10ms_P11_TCU_01_10ms_P11_E2EReserved: ComBitPosition=56, ComBitSize=8, ComHandleId=59, ComSystemTemplateSystemSignalRef=TCU_01_10ms_P11_E2EReserved
      ComTimeBase: category=TOOL_CONFIGURED, ComGwTimeBase=0.005, ComRxTimeBase=0.005, ComTxTimeBase=0.005
      4 x ComIPdu, all with category=TOOL_CONFIGURED, ComIPduSignalProcessing=DEFERRED:
        ComIPdu_FD_CAN1_Normal_Msg_FD_TP_01_B: ComIPduDirection=RECEIVE, ComIPduHandleId=9, ComIPduType=TP, ComIPduSignalRef=ComISignal_FD_CAN1_Normal_Msg_FD_TP_01_B_FD_CAN1_Normal_Msg_FD_TP_01_B_signal, ComPduIdRef=Pdu_ISignalIPdu_FD_CAN1_Normal_Msg_FD_TP_01_B, ComIPduGroupRef=ComIPduGroupRx_ECU1_FD_CAN1_PNC32
        ComIPdu_FD_CAN1_Normal_Msg_FD_TP_01_A: ComIPduDirection=SEND, ComIPduHandleId=1, ComIPduType=TP, ComIPduSignalRef=ComISignal_FD_CAN1_Normal_Msg_FD_TP_01_A_FD_CAN1_Normal_Msg_FD_TP_01_A_signal, ComPduIdRef=Pdu_ISignalIPdu_FD_CAN1_Normal_Msg_FD_TP_01_A, ComIPduGroupRef=ComIPduGroupTx_ECU1_FD_CAN1_PNC32
          ComTxIpdu_ComIPdu_FD_CAN1_Normal_Msg_FD_TP_01_A (ComTxIPdu): category=TOOL_CONFIGURED, ComTxIPduUnusedAreasDefault=0, ComMinimumDelayTime=0.02
            ComTxModeTrue_ComTxIpdu_ComIPdu_FD_CAN1_Normal_Msg_FD_TP_01_A (ComTxModeTrue): category=TOOL_CONFIGURED
              ComTxMode_ComTxModeTrue_ComTxIpdu_ComIPdu_FD_CAN1_Normal_Msg_FD_TP_01_A (ComTxMode): category=TOOL_CONFIGURED, ComTxModeNumberOfRepetitions=2, ComTxModeRepetitionPeriod=0.04, ComTxModeMode=DIRECT
        ComIPdu_FD_CAN1_AFLS_01_100ms: ComIPduDirection=SEND, ComIPduHandleId=6, ComIPduType=NORMAL, ComIPduSignalRef=ComISignal_FD_CAN1_AFLS_01_100ms_AFLS_Sta, ComIPduSignalRef=ComISignal_FD_CAN1_AFLS_01_100ms_AFLS_TrfChgSta, ComIPduSignalRef=ComISignal_FD_CAN1_AFLS_01_100ms_AFLS_TrfChgUSMSta, ComIPduSignalRef=ComISignal_FD_CAN1_AFLS_01_100ms_AFLS_LedHLmpSta, ComPduIdRef=Pdu_ISignalIPdu_FD_CAN1_AFLS_01_100ms, ComIPduGroupRef=ComIPduGroupTx_ECU1_FD_CAN1_PNC32
          ComTxIpdu_ComIPdu_FD_CAN1_AFLS_01_100ms (ComTxIPdu): category=TOOL_CONFIGURED, ComTxIPduUnusedAreasDefault=0, ComMinimumDelayTime=0.02
            ComTxModeTrue_ComTxIpdu_ComIPdu_FD_CAN1_AFLS_01_100ms (ComTxModeTrue): category=TOOL_CONFIGURED
              ComTxMode_ComTxModeTrue_ComTxIpdu_ComIPdu_FD_CAN1_AFLS_01_100ms (ComTxMode): category=TOOL_CONFIGURED, ComTxModeTimeOffset=0.0, ComTxModeTimePeriod=0.1, ComTxModeMode=PERIODIC
        ComIPdu_FD_CAN1_AHLS_01_300ms: ComIPduDirection=SEND, ComIPduHandleId=5, ComIPduType=NORMAL, ComIPduSignalRef=ComISignal_FD_CAN1_AHLS_01_300ms_AHLS_WrnLmpDis, ComIPduSignalRef=ComISignal_FD_CAN1_AHLS_01_300ms_AHLS_WrnMsgDis, ComPduIdRef=Pdu_ISignalIPdu_FD_CAN1_AHLS_01_300ms, ComIPduGroupRef=ComIPduGroupTx_ECU1_FD_CAN1_PNC32
          ComTxIpdu_ComIPdu_FD_CAN1_AHLS_01_300ms (ComTxIPdu): category=TOOL_CONFIGURED, ComTxIPduUnusedAreasDefault=0, ComMinimumDelayTime=0.02
            ComTxModeTrue_ComTxIpdu_ComIPdu_FD_CAN1_AHLS_01_300ms (ComTxModeTrue): category=TOOL_CONFIGURED
              ComTxMode_ComTxModeTrue_ComTxIpdu_ComIPdu_FD_CAN1_AHLS_01_300ms (ComTxMode): category=TOOL_CONFIGURED, ComTxModeTimeOffset=0.0, ComTxModeTimePeriod=0.3, ComTxModeMode=PERIODIC
      8 x ComSignal, all with category=TOOL_CONFIGURED, ComTransferProperty=PENDING, ComSigReportIdsMEnable=0:
        ComISignal_FD_CAN1_AFLS_01_100ms_AFLS_Sta: ComBitPosition=16, ComBitSize=2, ComSignalEndianness=LITTLE_ENDIAN, ComSignalInitValue=0, ComSignalLength=1, ComSignalType=UINT8, ComHandleId=13, ComSystemTemplateSystemSignalRef=AFLS_Sta
        ComISignal_FD_CAN1_AFLS_01_100ms_AFLS_TrfChgSta: ComBitPosition=18, ComBitSize=2, ComSignalEndianness=LITTLE_ENDIAN, ComSignalInitValue=0, ComSignalLength=1, ComSignalType=UINT8, ComHandleId=14, ComSystemTemplateSystemSignalRef=AFLS_TrfChgSta
        ComISignal_FD_CAN1_AFLS_01_100ms_AFLS_TrfChgUSMSta: ComBitPosition=20, ComBitSize=2, ComSignalEndianness=LITTLE_ENDIAN, ComSignalInitValue=0, ComSignalLength=1, ComSignalType=UINT8, ComHandleId=15, ComSystemTemplateSystemSignalRef=AFLS_TrfChgUSMSta
        ComISignal_FD_CAN1_AFLS_01_100ms_AFLS_LedHLmpSta: ComBitPosition=22, ComBitSize=2, ComSignalEndianness=LITTLE_ENDIAN, ComSignalInitValue=0, ComSignalLength=1, ComSignalType=UINT8, ComHandleId=16, ComSystemTemplateSystemSignalRef=AFLS_LedHLmpSta
        ComISignal_FD_CAN1_AHLS_01_300ms_AHLS_WrnLmpDis: ComBitPosition=0, ComBitSize=2, ComSignalEndianness=LITTLE_ENDIAN, ComSignalInitValue=0, ComSignalLength=1, ComSignalType=UINT8, ComHandleId=11, ComSystemTemplateSystemSignalRef=AHLS_WrnLmpDis
        ComISignal_FD_CAN1_AHLS_01_300ms_AHLS_WrnMsgDis: ComBitPosition=2, ComBitSize=2, ComSignalEndianness=LITTLE_ENDIAN, ComSignalInitValue=0, ComSignalLength=1, ComSignalType=UINT8, ComHandleId=12, ComSystemTemplateSystemSignalRef=AHLS_WrnMsgDis
        ComISignal_FD_CAN1_Normal_Msg_FD_TP_01_A_FD_CAN1_Normal_Msg_FD_TP_01_A_signal: ComBitPosition=0, ComSignalEndianness=opaque, ComSignalInitValue=0 0 0 0 0 0 0 0 0 0 0 0 0 0 0 0 0 0 0 0 0 0 0 0 0 0 0 0 0 0 0 0 0 0 0 0 0 0 0 0 0 0 0 0 0 0 0 0 0 0 0 0 0 0 0 0 0 0 0 0 0 0 0 0, ComSignalLength=64, ComSignalType=UINT8_N, ComHandleId=0, ComSystemTemplateSystemSignalRef=FD_CAN1_Normal_Msg_FD_TP_01_A_signal
        ComISignal_FD_CAN1_Normal_Msg_FD_TP_01_B_FD_CAN1_Normal_Msg_FD_TP_01_B_signal: ComBitPosition=0, ComSignalEndianness=opaque, ComSignalInitValue=0 0 0 0 0 0 0 0 0 0 0 0 0 0 0 0 0 0 0 0 0 0 0 0 0 0 0 0 0 0 0 0 0 0 0 0 0 0 0 0 0 0 0 0 0 0 0 0 0 0 0 0 0 0 0 0 0 0 0 0 0 0 0 0, ComSignalLength=64, ComSignalType=UINT8_N, ComHandleId=0, ComTimeout=0.0, ComSystemTemplateSystemSignalRef=FD_CAN1_Normal_Msg_FD_TP_01_B_signal
      ComIPduGroupRx_ECU1_FD_CAN1_PNC32 (ComIPduGroup): category=TOOL_CONFIGURED, ComIPduGroupHandleId=2
      ComIPduGroupTx_ECU1_FD_CAN1_PNC32 (ComIPduGroup): category=TOOL_CONFIGURED, ComIPduGroupHandleId=3
      ComIPdu_Rx_EIRA_CanNm (ComIPdu):
        category = TOOL_CONFIGURED
        ComIPduDirection = RECEIVE
        ComIPduHandleId = 20
        ComIPduSignalProcessing = DEFERRED
        ComIPduType = NORMAL
        ComIPduSignalRef = ComISignal_Rx_EIRA_CanNm
        ComPduIdRef = Pdu_ComMPdu_Rx_EIRA_CanNm
      ComIPdu_Tx_PncVector_FD_CAN1 (ComIPdu):
        category = TOOL_CONFIGURED
        ComIPduDirection = SEND
        ComIPduHandleId = 8
        ComIPduSignalProcessing = DEFERRED
        ComIPduType = NORMAL
        ComIPduSignalRef = ComISignal_Tx_PncVector_FD_CAN1
        ComPduIdRef = Pdu_ComMPdu_Tx_PncVector_FD_CAN1
        ComTxIpdu_ComIPdu_Tx_PncVector_FD_CAN1 (ComTxIPdu): category=TOOL_CONFIGURED, ComTxIPduUnusedAreasDefault=0, ComMinimumDelayTime=0.02
          ComTxModeTrue_ComTxIpdu_ComIPdu_Tx_PncVector_FD_CAN1 (ComTxModeTrue): category=TOOL_CONFIGURED
            ComTxMode_ComTxModeTrue_ComTxIpdu_ComIPdu_Tx_PncVector_FD_CAN1 (ComTxMode): category=TOOL_CONFIGURED, ComTxModeMode=NONE
      ComISignal_Rx_EIRA_CanNm (ComSignal):
        category = TOOL_CONFIGURED
        ComBitPosition = 0
        ComHandleId = 10
        ComSignalEndianness = opaque
        ComSignalInitValue = 0
        ComSignalLength = 4
        ComSignalType = UINT8_N
        ComTransferProperty = PENDING
        ComNotification = ComM_COMCbk_ComISignal_Rx_EIRA_CanNm
        ComSystemTemplateSystemSignalRef = PNI_CGW
      ComISignal_Tx_PncVector_FD_CAN1 (ComSignal):
        category = TOOL_CONFIGURED
        ComBitPosition = 0
        ComHandleId = 17
        ComSignalEndianness = opaque
        ComSignalInitValue = 0
        ComSignalLength = 4
        ComSignalType = UINT8_N
        ComTransferProperty = PENDING
        ComSystemTemplateSystemSignalRef = PNI_CGW
      ComIPduGroupTx_ECU1_LIN2 (ComIPduGroup): category=TOOL_CONFIGURED, ComIPduGroupHandleId=4
      ComIPduGroupRx_ECU1_LIN2 (ComIPduGroup): category=TOOL_CONFIGURED, ComIPduGroupHandleId=5
      11 x ComIPdu, all with category=TOOL_CONFIGURED, ComIPduType=NORMAL:
        ComIPdu_FD_CAN1_AtmResp: ComIPduDirection=SEND, ComIPduHandleId=3, ComIPduSignalProcessing=DEFERRED, ComIPduSignalRef=ComISignal_FD_CAN1_AtmResp_AtmResp_Sig_ModuleId, ComIPduSignalRef=ComISignal_FD_CAN1_AtmResp_AtmResp_Sig_TestFunction, ComIPduSignalRef=ComISignal_FD_CAN1_AtmResp_AtmResp_Sig_TestCaseNum, ComIPduSignalRef=ComISignal_FD_CAN1_AtmResp_AtmResp_Sig_Result, ComIPduSignalRef=ComISignal_FD_CAN1_AtmResp_AtmResp_Sig_AddExp1, ComIPduSignalRef=ComISignal_FD_CAN1_AtmResp_AtmResp_Sig_AddExp2, ComIPduSignalRef=ComISignal_FD_CAN1_AtmResp_AtmResp_Sig_AddExp3, ComIPduSignalRef=ComISignal_FD_CAN1_AtmResp_AtmResp_Sig_AddExp4, ComPduIdRef=Pdu_ISignalIPdu_FD_CAN1_AtmResp, ComIPduGroupRef=ComIPduGroupTx_ECU1_FD_CAN1_PNC32
          ComTxIpdu_ComIPdu_FD_CAN1_AtmResp (ComTxIPdu): category=TOOL_CONFIGURED, ComTxIPduUnusedAreasDefault=0, ComMinimumDelayTime=0.02
            ComTxModeTrue_ComTxIpdu_ComIPdu_FD_CAN1_AtmResp (ComTxModeTrue): category=TOOL_CONFIGURED
              ComTxMode_ComTxModeTrue_ComTxIpdu_ComIPdu_FD_CAN1_AtmResp (ComTxMode): category=TOOL_CONFIGURED, ComTxModeNumberOfRepetitions=2, ComTxModeRepetitionPeriod=0.04, ComTxModeMode=DIRECT
        ComIPdu_FD_CAN1_AtmReq: ComIPduDirection=RECEIVE, ComIPduHandleId=10, ComIPduSignalProcessing=DEFERRED, ComIPduSignalRef=ComISignal_FD_CAN1_AtmReq_AtmReq_Sig_ModuleId, ComIPduSignalRef=ComISignal_FD_CAN1_AtmReq_AtmReq_Sig_TestFunction, ComIPduSignalRef=ComISignal_FD_CAN1_AtmReq_AtmReq_Sig_TestCaseNum, ComIPduSignalRef=ComISignal_FD_CAN1_AtmReq_AtmReq_Sig_Cmd, ComIPduSignalRef=ComISignal_FD_CAN1_AtmReq_AtmReq_Sig_Param1, ComIPduSignalRef=ComISignal_FD_CAN1_AtmReq_AtmReq_Sig_Param2, ComIPduSignalRef=ComISignal_FD_CAN1_AtmReq_AtmReq_Sig_Param3, ComIPduSignalRef=ComISignal_FD_CAN1_AtmReq_AtmReq_Sig_Param4, ComPduIdRef=Pdu_ISignalIPdu_FD_CAN1_AtmReq, ComIPduGroupRef=ComIPduGroupRx_ECU1_FD_CAN1_PNC32
        ComIPdu_LIN2_Master_Cmd: ComIPduDirection=SEND, ComIPduHandleId=2, ComIPduSignalProcessing=IMMEDIATE, ComIPduSignalGroupRef=ComISignalGroup_MsgGr_LIN2_Master_Cmd, ComPduIdRef=Pdu_ISignalIPdu_LIN2_Master_Cmd, ComIPduGroupRef=ComIPduGroupTx_ECU1_LIN2
          ComTxIpdu_ComIPdu_LIN2_Master_Cmd (ComTxIPdu): category=TOOL_CONFIGURED, ComTxIPduUnusedAreasDefault=0
            ComTxModeTrue_ComTxIpdu_ComIPdu_LIN2_Master_Cmd (ComTxModeTrue): category=TOOL_CONFIGURED
              ComTxMode_ComTxModeTrue_ComTxIpdu_ComIPdu_LIN2_Master_Cmd (ComTxMode): category=TOOL_CONFIGURED, ComTxModeMode=NONE
        ComIPdu_LIN2_FL_Sensor_Status: ComIPduDirection=RECEIVE, ComIPduHandleId=11, ComIPduSignalProcessing=IMMEDIATE, ComIPduSignalGroupRef=ComISignalGroup_MsgGr_LIN2_FL_Sensor_Status, ComPduIdRef=Pdu_ISignalIPdu_LIN2_FL_Sensor_Status, ComIPduGroupRef=ComIPduGroupRx_ECU1_LIN2
        ComIPdu_LIN2_FCL_Sensor_Status: ComIPduDirection=RECEIVE, ComIPduHandleId=12, ComIPduSignalProcessing=IMMEDIATE, ComIPduSignalGroupRef=ComISignalGroup_MsgGr_LIN2_FCL_Sensor_Status, ComPduIdRef=Pdu_ISignalIPdu_LIN2_FCL_Sensor_Status, ComIPduGroupRef=ComIPduGroupRx_ECU1_LIN2
        ComIPdu_LIN2_FCR_Sensor_Status: ComIPduDirection=RECEIVE, ComIPduHandleId=13, ComIPduSignalProcessing=IMMEDIATE, ComIPduSignalGroupRef=ComISignalGroup_MsgGr_LIN2_FCR_Sensor_Status, ComPduIdRef=Pdu_ISignalIPdu_LIN2_FCR_Sensor_Status, ComIPduGroupRef=ComIPduGroupRx_ECU1_LIN2
        ComIPdu_LIN2_FR_Sensor_Status: ComIPduDirection=RECEIVE, ComIPduHandleId=14, ComIPduSignalProcessing=IMMEDIATE, ComIPduSignalGroupRef=ComISignalGroup_MsgGr_LIN2_FR_Sensor_Status, ComPduIdRef=Pdu_ISignalIPdu_LIN2_FR_Sensor_Status, ComIPduGroupRef=ComIPduGroupRx_ECU1_LIN2
        ComIPdu_LIN2_RL_Sensor_Status: ComIPduDirection=RECEIVE, ComIPduHandleId=15, ComIPduSignalProcessing=IMMEDIATE, ComIPduSignalGroupRef=ComISignalGroup_MsgGr_LIN2_RL_Sensor_Status, ComPduIdRef=Pdu_ISignalIPdu_LIN2_RL_Sensor_Status, ComIPduGroupRef=ComIPduGroupRx_ECU1_LIN2
        ComIPdu_LIN2_RCL_Sensor_Status: ComIPduDirection=RECEIVE, ComIPduHandleId=16, ComIPduSignalProcessing=IMMEDIATE, ComIPduSignalGroupRef=ComISignalGroup_MsgGr_LIN2_RCL_Sensor_Status, ComPduIdRef=Pdu_ISignalIPdu_LIN2_RCL_Sensor_Status, ComIPduGroupRef=ComIPduGroupRx_ECU1_LIN2
        ComIPdu_LIN2_RCR_Sensor_Status: ComIPduDirection=RECEIVE, ComIPduHandleId=17, ComIPduSignalProcessing=IMMEDIATE, ComIPduSignalGroupRef=ComISignalGroup_MsgGr_LIN2_RCR_Sensor_Status, ComPduIdRef=Pdu_ISignalIPdu_LIN2_RCR_Sensor_Status, ComIPduGroupRef=ComIPduGroupRx_ECU1_LIN2
        ComIPdu_LIN2_RR_Sensor_Status: ComIPduDirection=RECEIVE, ComIPduHandleId=18, ComIPduSignalProcessing=IMMEDIATE, ComIPduSignalGroupRef=ComISignalGroup_MsgGr_LIN2_RR_Sensor_Status, ComPduIdRef=Pdu_ISignalIPdu_LIN2_RR_Sensor_Status, ComIPduGroupRef=ComIPduGroupRx_ECU1_LIN2
      16 x ComSignal, all with category=TOOL_CONFIGURED, ComBitSize=8, ComSignalEndianness=LITTLE_ENDIAN, ComSignalInitValue=0, ComSignalLength=1, ComSignalType=UINT8, ComSigReportIdsMEnable=0:
        ComISignal_FD_CAN1_AtmReq_AtmReq_Sig_ModuleId: ComBitPosition=0, ComTransferProperty=PENDING, ComHandleId=1, ComTimeout=0.0, ComSystemTemplateSystemSignalRef=AtmReq_Sig_ModuleId
        ComISignal_FD_CAN1_AtmReq_AtmReq_Sig_TestFunction: ComBitPosition=8, ComTransferProperty=PENDING, ComHandleId=2, ComTimeout=0.0, ComSystemTemplateSystemSignalRef=AtmReq_Sig_TestFunction
        ComISignal_FD_CAN1_AtmReq_AtmReq_Sig_TestCaseNum: ComBitPosition=16, ComTransferProperty=PENDING, ComHandleId=3, ComTimeout=0.0, ComSystemTemplateSystemSignalRef=AtmReq_Sig_TestCaseNum
        ComISignal_FD_CAN1_AtmReq_AtmReq_Sig_Cmd: ComBitPosition=24, ComTransferProperty=PENDING, ComHandleId=4, ComTimeout=0.0, ComSystemTemplateSystemSignalRef=AtmReq_Sig_Cmd
        ComISignal_FD_CAN1_AtmReq_AtmReq_Sig_Param1: ComBitPosition=32, ComTransferProperty=PENDING, ComHandleId=5, ComTimeout=0.0, ComSystemTemplateSystemSignalRef=AtmReq_Sig_Param1
        ComISignal_FD_CAN1_AtmReq_AtmReq_Sig_Param2: ComBitPosition=40, ComTransferProperty=PENDING, ComHandleId=6, ComTimeout=0.0, ComSystemTemplateSystemSignalRef=AtmReq_Sig_Param2
        ComISignal_FD_CAN1_AtmReq_AtmReq_Sig_Param3: ComBitPosition=48, ComTransferProperty=PENDING, ComHandleId=7, ComTimeout=0.0, ComSystemTemplateSystemSignalRef=AtmReq_Sig_Param3
        ComISignal_FD_CAN1_AtmReq_AtmReq_Sig_Param4: ComBitPosition=56, ComTransferProperty=PENDING, ComHandleId=8, ComTimeout=0.0, ComSystemTemplateSystemSignalRef=AtmReq_Sig_Param4
        ComISignal_FD_CAN1_AtmResp_AtmResp_Sig_ModuleId: ComBitPosition=0, ComTransferProperty=TRIGGERED, ComHandleId=1, ComSystemTemplateSystemSignalRef=AtmResp_Sig_ModuleId
        ComISignal_FD_CAN1_AtmResp_AtmResp_Sig_TestFunction: ComBitPosition=8, ComTransferProperty=TRIGGERED, ComHandleId=2, ComSystemTemplateSystemSignalRef=AtmResp_Sig_TestFunction
        ComISignal_FD_CAN1_AtmResp_AtmResp_Sig_TestCaseNum: ComBitPosition=16, ComTransferProperty=TRIGGERED, ComHandleId=3, ComSystemTemplateSystemSignalRef=AtmResp_Sig_TestCaseNum
        ComISignal_FD_CAN1_AtmResp_AtmResp_Sig_Result: ComBitPosition=24, ComTransferProperty=TRIGGERED, ComHandleId=4, ComSystemTemplateSystemSignalRef=AtmResp_Sig_Result
        ComISignal_FD_CAN1_AtmResp_AtmResp_Sig_AddExp1: ComBitPosition=32, ComTransferProperty=TRIGGERED, ComHandleId=5, ComSystemTemplateSystemSignalRef=AtmResp_Sig_AddExp1
        ComISignal_FD_CAN1_AtmResp_AtmResp_Sig_AddExp2: ComBitPosition=40, ComTransferProperty=TRIGGERED, ComHandleId=6, ComSystemTemplateSystemSignalRef=AtmResp_Sig_AddExp2
        ComISignal_FD_CAN1_AtmResp_AtmResp_Sig_AddExp3: ComBitPosition=48, ComTransferProperty=TRIGGERED, ComHandleId=7, ComSystemTemplateSystemSignalRef=AtmResp_Sig_AddExp3
        ComISignal_FD_CAN1_AtmResp_AtmResp_Sig_AddExp4: ComBitPosition=56, ComTransferProperty=TRIGGERED, ComHandleId=8, ComSystemTemplateSystemSignalRef=AtmResp_Sig_AddExp4
      9 x ComSignalGroup, all with category=TOOL_CONFIGURED, ComSignalGroupArrayAccess=0, ComTransferProperty=TRIGGERED:
        ComISignalGroup_MsgGr_LIN2_Master_Cmd: ComHandleId=1, ComSystemTemplateSignalGroupRef=SigGrp_LIN2_Master_Cmd
          19 x ComGroupSignal, all with category=TOOL_CONFIGURED, ComSignalEndianness=LITTLE_ENDIAN, ComSignalLength=1:
            LIN2_Master_Cmd_NAD: ComBitPosition=0, ComSignalInitValue=255, ComBitSize=8, ComSignalType=UINT8, ComHandleId=37, ComSystemTemplateSystemSignalRef=NAD
            LIN2_Master_Cmd_PCI_Type: ComBitPosition=8, ComSignalInitValue=3, ComBitSize=8, ComSignalType=UINT8, ComHandleId=38, ComSystemTemplateSystemSignalRef=PCI_Type
            LIN2_Master_Cmd_SID: ComBitPosition=16, ComSignalInitValue=0, ComBitSize=8, ComSignalType=UINT8, ComHandleId=39, ComSystemTemplateSystemSignalRef=SID
            LIN2_Master_Cmd_RL_Sensor_Tx: ComBitPosition=24, ComSignalInitValue=0, ComBitSize=1, ComSignalType=BOOLEAN, ComHandleId=40, ComSystemTemplateSystemSignalRef=RL_Sensor_Tx
            LIN2_Master_Cmd_RCL_Sensor_Tx: ComBitPosition=25, ComSignalInitValue=0, ComBitSize=1, ComSignalType=BOOLEAN, ComHandleId=41, ComSystemTemplateSystemSignalRef=RCL_Sensor_Tx
            LIN2_Master_Cmd_RCR_Sensor_Tx: ComBitPosition=26, ComSignalInitValue=0, ComBitSize=1, ComSignalType=BOOLEAN, ComHandleId=42, ComSystemTemplateSystemSignalRef=RCR_Sensor_Tx
            LIN2_Master_Cmd_RR_Sensor_Tx: ComBitPosition=27, ComSignalInitValue=0, ComBitSize=1, ComSignalType=BOOLEAN, ComHandleId=43, ComSystemTemplateSystemSignalRef=RR_Sensor_Tx
            LIN2_Master_Cmd_FL_Sensor_Tx: ComBitPosition=28, ComSignalInitValue=0, ComBitSize=1, ComSignalType=BOOLEAN, ComHandleId=44, ComSystemTemplateSystemSignalRef=FL_Sensor_Tx
            LIN2_Master_Cmd_FCL_Sensor_Tx: ComBitPosition=29, ComSignalInitValue=0, ComBitSize=1, ComSignalType=BOOLEAN, ComHandleId=45, ComSystemTemplateSystemSignalRef=FCL_Sensor_Tx
            LIN2_Master_Cmd_FCR_Sensor_Tx: ComBitPosition=30, ComSignalInitValue=0, ComBitSize=1, ComSignalType=BOOLEAN, ComHandleId=46, ComSystemTemplateSystemSignalRef=FCR_Sensor_Tx
            LIN2_Master_Cmd_FR_Sensor_Tx: ComBitPosition=31, ComSignalInitValue=0, ComBitSize=1, ComSignalType=BOOLEAN, ComHandleId=47, ComSystemTemplateSystemSignalRef=FR_Sensor_Tx
            LIN2_Master_Cmd_RL_Sensor_Rx: ComBitPosition=32, ComSignalInitValue=0, ComBitSize=1, ComSignalType=BOOLEAN, ComHandleId=48, ComSystemTemplateSystemSignalRef=RL_Sensor_Rx
            LIN2_Master_Cmd_RCL_Sensor_Rx: ComBitPosition=33, ComSignalInitValue=0, ComBitSize=1, ComSignalType=BOOLEAN, ComHandleId=49, ComSystemTemplateSystemSignalRef=RCL_Sensor_Rx
            LIN2_Master_Cmd_RCR_Sensor_Rx: ComBitPosition=34, ComSignalInitValue=0, ComBitSize=1, ComSignalType=BOOLEAN, ComHandleId=50, ComSystemTemplateSystemSignalRef=RCR_Sensor_Rx
            LIN2_Master_Cmd_RR_Sensor_Rx: ComBitPosition=35, ComSignalInitValue=0, ComBitSize=1, ComSignalType=BOOLEAN, ComHandleId=51, ComSystemTemplateSystemSignalRef=RR_Sensor_Rx
            LIN2_Master_Cmd_FL_Sensor_Rx: ComBitPosition=36, ComSignalInitValue=0, ComBitSize=1, ComSignalType=BOOLEAN, ComHandleId=52, ComSystemTemplateSystemSignalRef=FL_Sensor_Rx
            LIN2_Master_Cmd_FCL_Sensor_Rx: ComBitPosition=37, ComSignalInitValue=0, ComBitSize=1, ComSignalType=BOOLEAN, ComHandleId=53, ComSystemTemplateSystemSignalRef=FCL_Sensor_Rx
            LIN2_Master_Cmd_FCR_Sensor_Rx: ComBitPosition=38, ComSignalInitValue=0, ComBitSize=1, ComSignalType=BOOLEAN, ComHandleId=54, ComSystemTemplateSystemSignalRef=FCR_Sensor_Rx
            LIN2_Master_Cmd_FR_Sensor_Rx: ComBitPosition=39, ComSignalInitValue=0, ComBitSize=1, ComSignalType=BOOLEAN, ComHandleId=55, ComSystemTemplateSystemSignalRef=FR_Sensor_Rx
        ComISignalGroup_MsgGr_LIN2_FL_Sensor_Status: ComHandleId=9, ComSystemTemplateSignalGroupRef=SigGrp_LIN2_FL_Sensor_Status
          11 x ComGroupSignal, all with category=TOOL_CONFIGURED, ComSignalEndianness=LITTLE_ENDIAN, ComSignalInitValue=0:
            LIN2_FL_Sensor_Status_FL_TOF: ComBitPosition=0, ComBitSize=10, ComSignalLength=2, ComSignalType=UINT16, ComHandleId=103, ComSystemTemplateSystemSignalRef=FL_TOF
            LIN2_FL_Sensor_Status_FL_Sensor_Status_0: ComBitPosition=24, ComBitSize=1, ComSignalLength=1, ComSignalType=BOOLEAN, ComHandleId=104, ComSystemTemplateSystemSignalRef=FL_Sensor_Status_0
            LIN2_FL_Sensor_Status_FL_Sensor_Status_1: ComBitPosition=25, ComBitSize=1, ComSignalLength=1, ComSignalType=BOOLEAN, ComHandleId=105, ComSystemTemplateSystemSignalRef=FL_Sensor_Status_1
            LIN2_FL_Sensor_Status_FL_Sensor_Status_2: ComBitPosition=26, ComBitSize=1, ComSignalLength=1, ComSignalType=BOOLEAN, ComHandleId=106, ComSystemTemplateSystemSignalRef=FL_Sensor_Status_2
            LIN2_FL_Sensor_Status_FL_Sensor_Status_3: ComBitPosition=27, ComBitSize=1, ComSignalLength=1, ComSignalType=BOOLEAN, ComHandleId=107, ComSystemTemplateSystemSignalRef=FL_Sensor_Status_3
            LIN2_FL_Sensor_Status_FL_Sensor_Status_4: ComBitPosition=28, ComBitSize=1, ComSignalLength=1, ComSignalType=BOOLEAN, ComHandleId=108, ComSystemTemplateSystemSignalRef=FL_Sensor_Status_4
            LIN2_FL_Sensor_Status_FL_Sensor_Status_5: ComBitPosition=29, ComBitSize=1, ComSignalLength=1, ComSignalType=BOOLEAN, ComHandleId=109, ComSystemTemplateSystemSignalRef=FL_Sensor_Status_5
            LIN2_FL_Sensor_Status_FL_Sensor_Status_6: ComBitPosition=30, ComBitSize=1, ComSignalLength=1, ComSignalType=BOOLEAN, ComHandleId=110, ComSystemTemplateSystemSignalRef=FL_Sensor_Status_6
            LIN2_FL_Sensor_Status_FL_Sensor_Status_7: ComBitPosition=31, ComBitSize=1, ComSignalLength=1, ComSignalType=BOOLEAN, ComHandleId=111, ComSystemTemplateSystemSignalRef=FL_Sensor_Status_7
            LIN2_FL_Sensor_Status_FL_CRC: ComBitPosition=32, ComBitSize=8, ComSignalLength=1, ComSignalType=UINT8, ComHandleId=112, ComSystemTemplateSystemSignalRef=FL_CRC
            LIN2_FL_Sensor_Status_FL_Ringtime: ComBitPosition=40, ComBitSize=8, ComSignalLength=1, ComSignalType=UINT8, ComHandleId=113, ComSystemTemplateSystemSignalRef=FL_Ringtime
        ComISignalGroup_MsgGr_LIN2_FCL_Sensor_Status: ComHandleId=10, ComSystemTemplateSignalGroupRef=SigGrp_LIN2_FCL_Sensor_Status
          11 x ComGroupSignal, all with category=TOOL_CONFIGURED, ComSignalEndianness=LITTLE_ENDIAN, ComSignalInitValue=0:
            LIN2_FCL_Sensor_Status_FCL_TOF: ComBitPosition=0, ComBitSize=10, ComSignalLength=2, ComSignalType=UINT16, ComHandleId=114, ComSystemTemplateSystemSignalRef=FCL_TOF
            LIN2_FCL_Sensor_Status_FCL_Sensor_Status_0: ComBitPosition=24, ComBitSize=1, ComSignalLength=1, ComSignalType=BOOLEAN, ComHandleId=115, ComSystemTemplateSystemSignalRef=FCL_Sensor_Status_0
            LIN2_FCL_Sensor_Status_FCL_Sensor_Status_1: ComBitPosition=25, ComBitSize=1, ComSignalLength=1, ComSignalType=BOOLEAN, ComHandleId=116, ComSystemTemplateSystemSignalRef=FCL_Sensor_Status_1
            LIN2_FCL_Sensor_Status_FCL_Sensor_Status_2: ComBitPosition=26, ComBitSize=1, ComSignalLength=1, ComSignalType=BOOLEAN, ComHandleId=117, ComSystemTemplateSystemSignalRef=FCL_Sensor_Status_2
            LIN2_FCL_Sensor_Status_FCL_Sensor_Status_3: ComBitPosition=27, ComBitSize=1, ComSignalLength=1, ComSignalType=BOOLEAN, ComHandleId=118, ComSystemTemplateSystemSignalRef=FCL_Sensor_Status_3
            LIN2_FCL_Sensor_Status_FCL_Sensor_Status_4: ComBitPosition=28, ComBitSize=1, ComSignalLength=1, ComSignalType=BOOLEAN, ComHandleId=119, ComSystemTemplateSystemSignalRef=FCL_Sensor_Status_4
            LIN2_FCL_Sensor_Status_FCL_Sensor_Status_5: ComBitPosition=29, ComBitSize=1, ComSignalLength=1, ComSignalType=BOOLEAN, ComHandleId=120, ComSystemTemplateSystemSignalRef=FCL_Sensor_Status_5
            LIN2_FCL_Sensor_Status_FCL_Sensor_Status_6: ComBitPosition=30, ComBitSize=1, ComSignalLength=1, ComSignalType=BOOLEAN, ComHandleId=121, ComSystemTemplateSystemSignalRef=FCL_Sensor_Status_6
            LIN2_FCL_Sensor_Status_FCL_Sensor_Status_7: ComBitPosition=31, ComBitSize=1, ComSignalLength=1, ComSignalType=BOOLEAN, ComHandleId=122, ComSystemTemplateSystemSignalRef=FCL_Sensor_Status_7
            LIN2_FCL_Sensor_Status_FCL_CRC: ComBitPosition=32, ComBitSize=8, ComSignalLength=1, ComSignalType=UINT8, ComHandleId=123, ComSystemTemplateSystemSignalRef=FCL_CRC
            LIN2_FCL_Sensor_Status_FCL_Ringtime: ComBitPosition=40, ComBitSize=8, ComSignalLength=1, ComSignalType=UINT8, ComHandleId=124, ComSystemTemplateSystemSignalRef=FCL_Ringtime
        ComISignalGroup_MsgGr_LIN2_FCR_Sensor_Status: ComHandleId=11, ComSystemTemplateSignalGroupRef=SigGrp_LIN2_FCR_Sensor_Status
          11 x ComGroupSignal, all with category=TOOL_CONFIGURED, ComSignalEndianness=LITTLE_ENDIAN, ComSignalInitValue=0:
            LIN2_FCR_Sensor_Status_FCR_TOF: ComBitPosition=0, ComBitSize=10, ComSignalLength=2, ComSignalType=UINT16, ComHandleId=125, ComSystemTemplateSystemSignalRef=FCR_TOF
            LIN2_FCR_Sensor_Status_FCR_Sensor_Status_0: ComBitPosition=24, ComBitSize=1, ComSignalLength=1, ComSignalType=BOOLEAN, ComHandleId=126, ComSystemTemplateSystemSignalRef=FCR_Sensor_Status_0
            LIN2_FCR_Sensor_Status_FCR_Sensor_Status_1: ComBitPosition=25, ComBitSize=1, ComSignalLength=1, ComSignalType=BOOLEAN, ComHandleId=127, ComSystemTemplateSystemSignalRef=FCR_Sensor_Status_1
            LIN2_FCR_Sensor_Status_FCR_Sensor_Status_2: ComBitPosition=26, ComBitSize=1, ComSignalLength=1, ComSignalType=BOOLEAN, ComHandleId=128, ComSystemTemplateSystemSignalRef=FCR_Sensor_Status_2
            LIN2_FCR_Sensor_Status_FCR_Sensor_Status_3: ComBitPosition=27, ComBitSize=1, ComSignalLength=1, ComSignalType=BOOLEAN, ComHandleId=129, ComSystemTemplateSystemSignalRef=FCR_Sensor_Status_3
            LIN2_FCR_Sensor_Status_FCR_Sensor_Status_4: ComBitPosition=28, ComBitSize=1, ComSignalLength=1, ComSignalType=BOOLEAN, ComHandleId=130, ComSystemTemplateSystemSignalRef=FCR_Sensor_Status_4
            LIN2_FCR_Sensor_Status_FCR_Sensor_Status_5: ComBitPosition=29, ComBitSize=1, ComSignalLength=1, ComSignalType=BOOLEAN, ComHandleId=131, ComSystemTemplateSystemSignalRef=FCR_Sensor_Status_5
            LIN2_FCR_Sensor_Status_FCR_Sensor_Status_6: ComBitPosition=30, ComBitSize=1, ComSignalLength=1, ComSignalType=BOOLEAN, ComHandleId=132, ComSystemTemplateSystemSignalRef=FCR_Sensor_Status_6
            LIN2_FCR_Sensor_Status_FCR_Sensor_Status_7: ComBitPosition=31, ComBitSize=1, ComSignalLength=1, ComSignalType=BOOLEAN, ComHandleId=133, ComSystemTemplateSystemSignalRef=FCR_Sensor_Status_7
            LIN2_FCR_Sensor_Status_FCR_CRC: ComBitPosition=32, ComBitSize=8, ComSignalLength=1, ComSignalType=UINT8, ComHandleId=134, ComSystemTemplateSystemSignalRef=FCR_CRC
            LIN2_FCR_Sensor_Status_FCR_Ringtime: ComBitPosition=40, ComBitSize=8, ComSignalLength=1, ComSignalType=UINT8, ComHandleId=135, ComSystemTemplateSystemSignalRef=FCR_Ringtime
        ComISignalGroup_MsgGr_LIN2_FR_Sensor_Status: ComHandleId=12, ComSystemTemplateSignalGroupRef=SigGrp_LIN2_FR_Sensor_Status
          11 x ComGroupSignal, all with category=TOOL_CONFIGURED, ComSignalEndianness=LITTLE_ENDIAN, ComSignalInitValue=0:
            LIN2_FR_Sensor_Status_FR_TOF: ComBitPosition=0, ComBitSize=10, ComSignalLength=2, ComSignalType=UINT16, ComHandleId=136, ComSystemTemplateSystemSignalRef=FR_TOF
            LIN2_FR_Sensor_Status_FR_Sensor_Status_0: ComBitPosition=24, ComBitSize=1, ComSignalLength=1, ComSignalType=BOOLEAN, ComHandleId=137, ComSystemTemplateSystemSignalRef=FR_Sensor_Status_0
            LIN2_FR_Sensor_Status_FR_Sensor_Status_1: ComBitPosition=25, ComBitSize=1, ComSignalLength=1, ComSignalType=BOOLEAN, ComHandleId=138, ComSystemTemplateSystemSignalRef=FR_Sensor_Status_1
            LIN2_FR_Sensor_Status_FR_Sensor_Status_2: ComBitPosition=26, ComBitSize=1, ComSignalLength=1, ComSignalType=BOOLEAN, ComHandleId=139, ComSystemTemplateSystemSignalRef=FR_Sensor_Status_2
            LIN2_FR_Sensor_Status_FR_Sensor_Status_3: ComBitPosition=27, ComBitSize=1, ComSignalLength=1, ComSignalType=BOOLEAN, ComHandleId=140, ComSystemTemplateSystemSignalRef=FR_Sensor_Status_3
            LIN2_FR_Sensor_Status_FR_Sensor_Status_4: ComBitPosition=28, ComBitSize=1, ComSignalLength=1, ComSignalType=BOOLEAN, ComHandleId=141, ComSystemTemplateSystemSignalRef=FR_Sensor_Status_4
            LIN2_FR_Sensor_Status_FR_Sensor_Status_5: ComBitPosition=29, ComBitSize=1, ComSignalLength=1, ComSignalType=BOOLEAN, ComHandleId=142, ComSystemTemplateSystemSignalRef=FR_Sensor_Status_5
            LIN2_FR_Sensor_Status_FR_Sensor_Status_6: ComBitPosition=30, ComBitSize=1, ComSignalLength=1, ComSignalType=BOOLEAN, ComHandleId=143, ComSystemTemplateSystemSignalRef=FR_Sensor_Status_6
            LIN2_FR_Sensor_Status_FR_Sensor_Status_7: ComBitPosition=31, ComBitSize=1, ComSignalLength=1, ComSignalType=BOOLEAN, ComHandleId=144, ComSystemTemplateSystemSignalRef=FR_Sensor_Status_7
            LIN2_FR_Sensor_Status_FR_CRC: ComBitPosition=32, ComBitSize=8, ComSignalLength=1, ComSignalType=UINT8, ComHandleId=145, ComSystemTemplateSystemSignalRef=FR_CRC
            LIN2_FR_Sensor_Status_FR_Ringtime: ComBitPosition=40, ComBitSize=8, ComSignalLength=1, ComSignalType=UINT8, ComHandleId=146, ComSystemTemplateSystemSignalRef=FR_Ringtime
        ComISignalGroup_MsgGr_LIN2_RL_Sensor_Status: ComHandleId=13, ComSystemTemplateSignalGroupRef=SigGrp_LIN2_RL_Sensor_Status
          11 x ComGroupSignal, all with category=TOOL_CONFIGURED, ComSignalEndianness=LITTLE_ENDIAN, ComSignalInitValue=0:
            LIN2_RL_Sensor_Status_RL_TOF: ComBitPosition=0, ComBitSize=10, ComSignalLength=2, ComSignalType=UINT16, ComHandleId=147, ComSystemTemplateSystemSignalRef=RL_TOF
            LIN2_RL_Sensor_Status_RL_Sensor_Status_0: ComBitPosition=24, ComBitSize=1, ComSignalLength=1, ComSignalType=BOOLEAN, ComHandleId=148, ComSystemTemplateSystemSignalRef=RL_Sensor_Status_0
            LIN2_RL_Sensor_Status_RL_Sensor_Status_1: ComBitPosition=25, ComBitSize=1, ComSignalLength=1, ComSignalType=BOOLEAN, ComHandleId=149, ComSystemTemplateSystemSignalRef=RL_Sensor_Status_1
            LIN2_RL_Sensor_Status_RL_Sensor_Status_2: ComBitPosition=26, ComBitSize=1, ComSignalLength=1, ComSignalType=BOOLEAN, ComHandleId=150, ComSystemTemplateSystemSignalRef=RL_Sensor_Status_2
            LIN2_RL_Sensor_Status_RL_Sensor_Status_3: ComBitPosition=27, ComBitSize=1, ComSignalLength=1, ComSignalType=BOOLEAN, ComHandleId=151, ComSystemTemplateSystemSignalRef=RL_Sensor_Status_3
            LIN2_RL_Sensor_Status_RL_Sensor_Status_4: ComBitPosition=28, ComBitSize=1, ComSignalLength=1, ComSignalType=BOOLEAN, ComHandleId=152, ComSystemTemplateSystemSignalRef=RL_Sensor_Status_4
            LIN2_RL_Sensor_Status_RL_Sensor_Status_5: ComBitPosition=29, ComBitSize=1, ComSignalLength=1, ComSignalType=BOOLEAN, ComHandleId=153, ComSystemTemplateSystemSignalRef=RL_Sensor_Status_5
            LIN2_RL_Sensor_Status_RL_Sensor_Status_6: ComBitPosition=30, ComBitSize=1, ComSignalLength=1, ComSignalType=BOOLEAN, ComHandleId=154, ComSystemTemplateSystemSignalRef=RL_Sensor_Status_6
            LIN2_RL_Sensor_Status_RL_Sensor_Status_7: ComBitPosition=31, ComBitSize=1, ComSignalLength=1, ComSignalType=BOOLEAN, ComHandleId=155, ComSystemTemplateSystemSignalRef=RL_Sensor_Status_7
            LIN2_RL_Sensor_Status_RL_CRC: ComBitPosition=32, ComBitSize=8, ComSignalLength=1, ComSignalType=UINT8, ComHandleId=156, ComSystemTemplateSystemSignalRef=RL_CRC
            LIN2_RL_Sensor_Status_RL_Ringtime: ComBitPosition=40, ComBitSize=8, ComSignalLength=1, ComSignalType=UINT8, ComHandleId=157, ComSystemTemplateSystemSignalRef=RL_Ringtime
        ComISignalGroup_MsgGr_LIN2_RCL_Sensor_Status: ComHandleId=14, ComSystemTemplateSignalGroupRef=SigGrp_LIN2_RCL_Sensor_Status
          11 x ComGroupSignal, all with category=TOOL_CONFIGURED, ComSignalEndianness=LITTLE_ENDIAN, ComSignalInitValue=0:
            LIN2_RCL_Sensor_Status_RCL_TOF: ComBitPosition=0, ComBitSize=10, ComSignalLength=2, ComSignalType=UINT16, ComHandleId=158, ComSystemTemplateSystemSignalRef=RCL_TOF
            LIN2_RCL_Sensor_Status_RCL_Sensor_Status_0: ComBitPosition=24, ComBitSize=1, ComSignalLength=1, ComSignalType=BOOLEAN, ComHandleId=159, ComSystemTemplateSystemSignalRef=RCL_Sensor_Status_0
            LIN2_RCL_Sensor_Status_RCL_Sensor_Status_1: ComBitPosition=25, ComBitSize=1, ComSignalLength=1, ComSignalType=BOOLEAN, ComHandleId=160, ComSystemTemplateSystemSignalRef=RCL_Sensor_Status_1
            LIN2_RCL_Sensor_Status_RCL_Sensor_Status_2: ComBitPosition=26, ComBitSize=1, ComSignalLength=1, ComSignalType=BOOLEAN, ComHandleId=161, ComSystemTemplateSystemSignalRef=RCL_Sensor_Status_2
            LIN2_RCL_Sensor_Status_RCL_Sensor_Status_3: ComBitPosition=27, ComBitSize=1, ComSignalLength=1, ComSignalType=BOOLEAN, ComHandleId=162, ComSystemTemplateSystemSignalRef=RCL_Sensor_Status_3
            LIN2_RCL_Sensor_Status_RCL_Sensor_Status_4: ComBitPosition=28, ComBitSize=1, ComSignalLength=1, ComSignalType=BOOLEAN, ComHandleId=163, ComSystemTemplateSystemSignalRef=RCL_Sensor_Status_4
            LIN2_RCL_Sensor_Status_RCL_Sensor_Status_5: ComBitPosition=29, ComBitSize=1, ComSignalLength=1, ComSignalType=BOOLEAN, ComHandleId=164, ComSystemTemplateSystemSignalRef=RCL_Sensor_Status_5
            LIN2_RCL_Sensor_Status_RCL_Sensor_Status_6: ComBitPosition=30, ComBitSize=1, ComSignalLength=1, ComSignalType=BOOLEAN, ComHandleId=165, ComSystemTemplateSystemSignalRef=RCL_Sensor_Status_6
            LIN2_RCL_Sensor_Status_RCL_Sensor_Status_7: ComBitPosition=31, ComBitSize=1, ComSignalLength=1, ComSignalType=BOOLEAN, ComHandleId=166, ComSystemTemplateSystemSignalRef=RCL_Sensor_Status_7
            LIN2_RCL_Sensor_Status_RCL_CRC: ComBitPosition=32, ComBitSize=8, ComSignalLength=1, ComSignalType=UINT8, ComHandleId=167, ComSystemTemplateSystemSignalRef=RCL_CRC
            LIN2_RCL_Sensor_Status_RCL_Ringtime: ComBitPosition=40, ComBitSize=8, ComSignalLength=1, ComSignalType=UINT8, ComHandleId=168, ComSystemTemplateSystemSignalRef=RCL_Ringtime
        ComISignalGroup_MsgGr_LIN2_RCR_Sensor_Status: ComHandleId=15, ComSystemTemplateSignalGroupRef=SigGrp_LIN2_RCR_Sensor_Status
          11 x ComGroupSignal, all with category=TOOL_CONFIGURED, ComSignalEndianness=LITTLE_ENDIAN, ComSignalInitValue=0:
            LIN2_RCR_Sensor_Status_RCR_TOF: ComBitPosition=0, ComBitSize=10, ComSignalLength=2, ComSignalType=UINT16, ComHandleId=169, ComSystemTemplateSystemSignalRef=RCR_TOF
            LIN2_RCR_Sensor_Status_RCR_Sensor_Status_0: ComBitPosition=24, ComBitSize=1, ComSignalLength=1, ComSignalType=BOOLEAN, ComHandleId=170, ComSystemTemplateSystemSignalRef=RCR_Sensor_Status_0
            LIN2_RCR_Sensor_Status_RCR_Sensor_Status_1: ComBitPosition=25, ComBitSize=1, ComSignalLength=1, ComSignalType=BOOLEAN, ComHandleId=171, ComSystemTemplateSystemSignalRef=RCR_Sensor_Status_1
            LIN2_RCR_Sensor_Status_RCR_Sensor_Status_2: ComBitPosition=26, ComBitSize=1, ComSignalLength=1, ComSignalType=BOOLEAN, ComHandleId=172, ComSystemTemplateSystemSignalRef=RCR_Sensor_Status_2
            LIN2_RCR_Sensor_Status_RCR_Sensor_Status_3: ComBitPosition=27, ComBitSize=1, ComSignalLength=1, ComSignalType=BOOLEAN, ComHandleId=173, ComSystemTemplateSystemSignalRef=RCR_Sensor_Status_3
            LIN2_RCR_Sensor_Status_RCR_Sensor_Status_4: ComBitPosition=28, ComBitSize=1, ComSignalLength=1, ComSignalType=BOOLEAN, ComHandleId=174, ComSystemTemplateSystemSignalRef=RCR_Sensor_Status_4
            LIN2_RCR_Sensor_Status_RCR_Sensor_Status_5: ComBitPosition=29, ComBitSize=1, ComSignalLength=1, ComSignalType=BOOLEAN, ComHandleId=175, ComSystemTemplateSystemSignalRef=RCR_Sensor_Status_5
            LIN2_RCR_Sensor_Status_RCR_Sensor_Status_6: ComBitPosition=30, ComBitSize=1, ComSignalLength=1, ComSignalType=BOOLEAN, ComHandleId=176, ComSystemTemplateSystemSignalRef=RCR_Sensor_Status_6
            LIN2_RCR_Sensor_Status_RCR_Sensor_Status_7: ComBitPosition=31, ComBitSize=1, ComSignalLength=1, ComSignalType=BOOLEAN, ComHandleId=177, ComSystemTemplateSystemSignalRef=RCR_Sensor_Status_7
            LIN2_RCR_Sensor_Status_RCR_CRC: ComBitPosition=32, ComBitSize=8, ComSignalLength=1, ComSignalType=UINT8, ComHandleId=178, ComSystemTemplateSystemSignalRef=RCR_CRC
            LIN2_RCR_Sensor_Status_RCR_Ringtime: ComBitPosition=40, ComBitSize=8, ComSignalLength=1, ComSignalType=UINT8, ComHandleId=179, ComSystemTemplateSystemSignalRef=RCR_Ringtime
        ComISignalGroup_MsgGr_LIN2_RR_Sensor_Status: ComHandleId=16, ComSystemTemplateSignalGroupRef=SigGrp_LIN2_RR_Sensor_Status
          11 x ComGroupSignal, all with category=TOOL_CONFIGURED, ComSignalEndianness=LITTLE_ENDIAN, ComSignalInitValue=0:
            LIN2_RR_Sensor_Status_RR_TOF: ComBitPosition=0, ComBitSize=10, ComSignalLength=2, ComSignalType=UINT16, ComHandleId=180, ComSystemTemplateSystemSignalRef=RR_TOF
            LIN2_RR_Sensor_Status_RR_Sensor_Status_0: ComBitPosition=24, ComBitSize=1, ComSignalLength=1, ComSignalType=BOOLEAN, ComHandleId=181, ComSystemTemplateSystemSignalRef=RR_Sensor_Status_0
            LIN2_RR_Sensor_Status_RR_Sensor_Status_1: ComBitPosition=25, ComBitSize=1, ComSignalLength=1, ComSignalType=BOOLEAN, ComHandleId=182, ComSystemTemplateSystemSignalRef=RR_Sensor_Status_1
            LIN2_RR_Sensor_Status_RR_Sensor_Status_2: ComBitPosition=26, ComBitSize=1, ComSignalLength=1, ComSignalType=BOOLEAN, ComHandleId=183, ComSystemTemplateSystemSignalRef=RR_Sensor_Status_2
            LIN2_RR_Sensor_Status_RR_Sensor_Status_3: ComBitPosition=27, ComBitSize=1, ComSignalLength=1, ComSignalType=BOOLEAN, ComHandleId=184, ComSystemTemplateSystemSignalRef=RR_Sensor_Status_3
            LIN2_RR_Sensor_Status_RR_Sensor_Status_4: ComBitPosition=28, ComBitSize=1, ComSignalLength=1, ComSignalType=BOOLEAN, ComHandleId=185, ComSystemTemplateSystemSignalRef=RR_Sensor_Status_4
            LIN2_RR_Sensor_Status_RR_Sensor_Status_5: ComBitPosition=29, ComBitSize=1, ComSignalLength=1, ComSignalType=BOOLEAN, ComHandleId=186, ComSystemTemplateSystemSignalRef=RR_Sensor_Status_5
            LIN2_RR_Sensor_Status_RR_Sensor_Status_6: ComBitPosition=30, ComBitSize=1, ComSignalLength=1, ComSignalType=BOOLEAN, ComHandleId=187, ComSystemTemplateSystemSignalRef=RR_Sensor_Status_6
            LIN2_RR_Sensor_Status_RR_Sensor_Status_7: ComBitPosition=31, ComBitSize=1, ComSignalLength=1, ComSignalType=BOOLEAN, ComHandleId=188, ComSystemTemplateSystemSignalRef=RR_Sensor_Status_7
            LIN2_RR_Sensor_Status_RR_CRC: ComBitPosition=32, ComBitSize=8, ComSignalLength=1, ComSignalType=UINT8, ComHandleId=189, ComSystemTemplateSystemSignalRef=RR_CRC
            LIN2_RR_Sensor_Status_RR_Ringtime: ComBitPosition=40, ComBitSize=8, ComSignalLength=1, ComSignalType=UINT8, ComHandleId=190, ComSystemTemplateSystemSignalRef=RR_Ringtime
      ComIPdu_FD_CAN1_V_CGW_02_A (ComIPdu):
        category = TOOL_CONFIGURED
        ComIPduDirection = RECEIVE
        ComIPduHandleId = 19
        ComIPduType = NORMAL
        ComIPduSignalProcessing = DEFERRED
        ComIPduSignalRef = ComISignal_FD_CAN1_V_CGW_02_A_V_CGW_02_A_SIG
        ComPduIdRef = Pdu_ISignalIPdu_FD_CAN1_V_CGW_02_A
        ComIPduGroupRef = ComIPduGroupRx_ECU1_FD_CAN1_PNC32
      ComIPdu_FD_CAN1_V_CGW_01_B (ComIPdu):
        category = TOOL_CONFIGURED
        ComIPduDirection = SEND
        ComIPduHandleId = 4
        ComIPduType = NORMAL
        ComIPduSignalProcessing = DEFERRED
        ComIPduSignalRef = ComISignal_FD_CAN1_V_CGW_01_B_V_CGW_01_B_SigGrp_1
        ComIPduSignalRef = ComISignal_FD_CAN1_V_CGW_01_B_V_CGW_01_B_SigGrp_2
        ComPduIdRef = Pdu_ISignalIPdu_FD_CAN1_V_CGW_01_B
        ComIPduGroupRef = ComIPduGroupTx_ECU1_FD_CAN1_PNC32
        ComTxIpdu_ComIPdu_FD_CAN1_V_CGW_01_B (ComTxIPdu): category=TOOL_CONFIGURED, ComTxIPduUnusedAreasDefault=0, ComMinimumDelayTime=0.02
          ComTxModeTrue_ComTxIpdu_ComIPdu_FD_CAN1_V_CGW_01_B (ComTxModeTrue): category=TOOL_CONFIGURED
            ComTxMode_ComTxModeTrue_ComTxIpdu_ComIPdu_FD_CAN1_V_CGW_01_B (ComTxMode): category=TOOL_CONFIGURED, ComTxModeNumberOfRepetitions=2, ComTxModeRepetitionPeriod=0.04, ComTxModeMode=DIRECT
      3 x ComSignal, all with category=TOOL_CONFIGURED, ComTransferProperty=PENDING, ComSigReportIdsMEnable=0:
        ComISignal_FD_CAN1_V_CGW_01_B_V_CGW_01_B_SigGrp_1: ComBitPosition=0, ComBitSize=8, ComSignalEndianness=LITTLE_ENDIAN, ComSignalInitValue=0, ComSignalLength=1, ComSignalType=UINT8, ComHandleId=9, ComSystemTemplateSystemSignalRef=V_CGW_01_B_SigGrp_1
        ComISignal_FD_CAN1_V_CGW_01_B_V_CGW_01_B_SigGrp_2: ComBitPosition=8, ComBitSize=4, ComSignalEndianness=LITTLE_ENDIAN, ComSignalInitValue=0, ComSignalLength=1, ComSignalType=UINT8, ComHandleId=10, ComSystemTemplateSystemSignalRef=V_CGW_01_B_SigGrp_2
        ComISignal_FD_CAN1_V_CGW_02_A_V_CGW_02_A_SIG: ComBitPosition=0, ComBitSize=64, ComSignalEndianness=opaque, ComSignalInitValue=0 0 0 0 0 0 0 0, ComSignalLength=8, ComSignalType=UINT8_N, ComHandleId=9, ComTimeout=0.0, ComSystemTemplateSystemSignalRef=V_CGW_02_A_SIG
    ComGeneral:
      ComSupportedIPduGroups = 6
      ComEnableMDTForCyclicTransmission = 1
      ComMainFunctionBasedTransmit = 1
      ComEnableSignalGroupArrayApi = 1
      ComVersionInfoApi = 1
      ComConfigurationUseDet = 1
