AUTOSAR XML (schema 4-0-3)
package /AUTRON
  module config CryIf: ecuc-def-edition=4.4.7, implementation-config-variant=VARIANT-PRE-COMPILE, module-description=BswImplementation_CryIf
    CryIfGeneral: CryIfDevErrorDetect=1, CryIfVersionInfoApi=1
    25 x CryIfKey:
      RandomSeed_L9: CryIfKeyId=0, CryIfKeyRef=CryptoKey_RandomSeed_L9
      Dummy: CryIfKeyId=1, CryIfKeyRef=Dummy
      PBKDF2_Source_Key: CryIfKeyId=2, CryIfKeyRef=PBKDF2_Source_Key
      PBKDF2_Target_Key: CryIfKeyId=3, CryIfKeyRef=PBKDF2_Target_Key
      PBKDF2_Extracted_Key: CryIfKeyId=4, CryIfKeyRef=PBKDF2_Extracted_Key
      PBKDF2_ExtractedKey: CryIfKeyId=5, CryIfKeyRef=PBKDF2_ExtractedKey
      PBKDF2_Encrypt_Key: CryIfKeyId=6, CryIfKeyRef=PBKDF2_Encrypt_Key
      PBKDF2_Decrypt_Key: CryIfKeyId=7, CryIfKeyRef=PBKDF2_Decrypt_Key
      PBKDF2_Source_Key_PSK0: CryIfKeyId=8, CryIfKeyRef=PBKDF2_Source_Key_PSK0
      PBKDF2_Source_Key_PSK1: CryIfKeyId=9, CryIfKeyRef=PBKDF2_Source_Key_PSK1
      PBKDF2_Source_Key_PSK2: CryIfKeyId=10, CryIfKeyRef=PBKDF2_Source_Key_PSK2
      PBKDF2_Source_Key_PSK3: CryIfKeyId=11, CryIfKeyRef=PBKDF2_Source_Key_PSK3
      PBKDF2_Source_Key_PSK4: CryIfKeyId=12, CryIfKeyRef=PBKDF2_Source_Key_PSK4
      PBKDF2_Source_Key_PSK5: CryIfKeyId=13, CryIfKeyRef=PBKDF2_Source_Key_PSK5
      PBKDF2_Source_Key_PSK6: CryIfKeyId=14, CryIfKeyRef=PBKDF2_Source_Key_PSK6
      PBKDF2_Source_Key_PSK7: CryIfKeyId=15, CryIfKeyRef=PBKDF2_Source_Key_PSK7
      PBKDF2_Source_Key_PSK8: CryIfKeyId=16, CryIfKeyRef=PBKDF2_Source_Key_PSK8
      PBKDF2_Source_Key_PSK9: CryIfKeyId=17, CryIfKeyRef=PBKDF2_Source_Key_PSK9
      Hash_Dummy_Fota: CryIfKeyId=18, CryIfKeyRef=CryptoKey_Hash_Dummy_Fota
      Pkcs1_Asims_Public_Key: CryIfKeyId=19, CryIfKeyRef=CryptoKey_RSASSA_PKCS1_v1_5_Asims_Public_Key
      Decr_AES_CTR_Key0: CryIfKeyId=20, CryIfKeyRef=CryptoKey_Decr_AES_CTR_Key0
      Decr_AES_CTR_Key1: CryIfKeyId=21, CryIfKeyRef=CryptoKey_Decr_AES_CTR_Key1
      MacVer_AES_CMAC_key: CryIfKeyId=22, CryIfKeyRef=CryptoKey_MacVer_AES_CMAC_key
      MacGen_Sha256_HMAC_key: CryIfKeyId=23, CryIfKeyRef=MacGen_Sha256_HMAC_key
      MacVer_Sha256_HMAC_key: CryIfKeyId=24, CryIfKeyRef=MacVer_Sha256_HMAC_key
    CryIfChannel_CryptoLib (CryIfChannel): CryIfChannelId=0, CryIfDriverObjectRef=HaeCryptoLib
    CryIfChannel_HaeHSE (CryIfChannel): CryIfChannelId=1, CryIfDriverObjectRef=HaeHSE
