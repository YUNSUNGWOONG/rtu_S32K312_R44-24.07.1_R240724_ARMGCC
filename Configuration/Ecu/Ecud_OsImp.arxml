AUTOSAR XML (schema 4-3-0)
package /AUTOSAR
  module config OsImp: implementation-config-variant=VARIANT-PRE-COMPILE, module-description=BswImplementation_OsImp
    OsImpGeneral: OsImpCpuLoad=1
    OsImpConfiguration
      7 x OsImpRamSector:
        MEM_ITCM: OsImpRamDefaultValue=0x0, OsImpRamInitProperty=PowerOnReset, OsImpRamSectionBaseAddress=0x00000000, OsImpRamSectionSize=0x00008000
        MEM_DTCM: OsImpRamDefaultValue=0x0, OsImpRamInitProperty=PowerOnReset, OsImpRamSectionSize=0x00010000, OsImpRamSectionBaseAddress=0x20000000
        RAM_RETENTION: OsImpRamDefaultValue=0, OsImpRamInitProperty=PowerOnReset, OsImpRamSectionBaseAddress=0x20400200, OsImpRamSectionSize=0x00003E00
        RAM_SYSTEM: OsImpRamDefaultValue=0, OsImpRamInitProperty=PowerOnReset, OsImpRamSectionBaseAddress=0x20404000, OsImpRamSectionSize=0x00014000
        MEM_ITCM_Wakeup: OsImpRamDefaultValue=0, OsImpRamInitProperty=WakeUp, OsImpRamSectionBaseAddress=0x00000000, OsImpRamSectionSize=0x00008000
        MEM_DTCM_Wakeup: OsImpRamDefaultValue=0, OsImpRamInitProperty=WakeUp, OsImpRamSectionBaseAddress=0x20000000, OsImpRamSectionSize=0x00010000
        RAM_SYSTEM_Wakeup: OsImpRamDefaultValue=0, OsImpRamInitProperty=WakeUp, OsImpRamSectionBaseAddress=0x20404000, OsImpRamSectionSize=0x00014000
