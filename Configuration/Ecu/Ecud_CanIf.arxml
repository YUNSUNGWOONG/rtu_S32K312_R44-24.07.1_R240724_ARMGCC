AUTOSAR XML (schema 00047)
package /AUTRON
  module config CanIf: implementation-config-variant=VARIANT-PRE-COMPILE, module-description=BswImplementation_CanIf
    CanIfDispatchCfg:
      CanIfDispatchUserCtrlBusOffUL = CAN_SM
      CanIfDispatchUserCtrlModeIndicationUL = CAN_SM
      CanIfDispatchUserValidateWakeupEventUL = ECUM
      CanIfDispatchUserCheckTrcvWakeFlagIndicationUL = CAN_SM
      CanIfDispatchUserClearTrcvWufFlagIndicationUL = CAN_SM
      CanIfDispatchUserTrcvModeIndicationUL = CAN_SM
      CanIfDispatchUserConfirmPnAvailabilityUL = CAN_SM
    CanIfPrivateCfg:
      CanIfPrivateSoftwareFilterType = BINARY
      CanIfSupportTTCAN = 0
      CanIfSupportCanCM = 1
      CanIfSupportCANFD = 1
      CanIfFixedBuffer = 1
      CanIfPrivateDataLengthCheck = 1
    CanIfPublicCfg:
      CanIfPublicMultipleDrvSupport = 0
      CanIfPublicReadRxPduDataApi = 1
      CanIfPublicReadRxPduNotifyStatusApi = 1
      CanIfPublicReadTxPduNotifyStatusApi = 1
      CanIfPublicTxBuffering = 0
      CanIfPublicTxConfirmPollingSupport = 1
      CanIfPublicWakeupCheckValidSupport = 0
      CanIfPublicWakeupCheckValidByNM = 0
      CanIfMetaDataSupport = 1
      CanIfPublicHandleTypeEnum = UINT16
      CanIfCANFDID16BitSupport = 0
      CanIfCANFDDiscreteDlcSupport = 0
      CanIfAutronTrcvDrvSupport = 1
      CanIfExternalTrcvDrvSupport = 0
      CanIfDevErrorDetect = 1
      CanIfVersionInfoApi = 1
      CanIfSetBaudrateApi = 0
      CanIfPublicIcomSupport = 0
      CanIfTriggerTransmitSupport = 1
      CanIfTxOfflineActiveSupport = 0
      CanIfWakeupSupport = 0
      CanIfBusMirroringSupport = 0
      CanIfPublicSetDynamicTxIdApi = 0
      CanIfPublicPnSupport = 1
    CanIfTrcvDrvCfg0 (CanIfTrcvDrvCfg)
      CanIfTrcvCfg_FD_CAN1 (CanIfTrcvCfg): CanIfTrcvWakeupSupport=0, CanIfTrcvId=0, CanIfTrcvCanTrcvRef=CanTrcvChannel_FD_CAN1
    CanIfInitCfg: CanIfInitCfgSet=0
      CanIfInitHohCfg0 (CanIfInitHohCfg): category=TOOL_CONFIGURED
        6 x CanIfHrhCfg, all with category=TOOL_CONFIGURED, CanIfHrhSoftwareFilter=1, CanIfHrhCanCtrlIdRef=CanIfCtrlCfg_ECU1_FD_CAN1:
          CanIfHrhCfg_IN_0x500_0x57f_ECU1_FD_CAN1_NM_Message: CanIfHrhIdSymRef=IN_HwObj_0x500_0x57f_ECU1_FD_CAN1_NM_Message
            CanIfHrhRangeCfg0 (CanIfHrhRangeCfg): category=TOOL_CONFIGURED, CanIfHrhRangeRxPduLowerCanId=1280, CanIfHrhRangeRxPduUpperCanId=1407, CanIfHrhRangeRxPduRangeCanIdType=STANDARD
          CanIfHrhCfg_IN_ECU1_FD_CAN1_0x7df_FD_CAN1_Diag_Msg_TP_Func_FD_CAN1: CanIfHrhIdSymRef=IN_HwObj_ECU1_FD_CAN1_0x7df_FD_CAN1_Diag_Msg_TP_Func_FD_CAN1
          CanIfHrhCfg_IN_ECU1_FD_CAN1_0x650_FD_CAN1_AtmReq: CanIfHrhIdSymRef=IN_HwObj_ECU1_FD_CAN1_0x650_FD_CAN1_AtmReq
          CanIfHrhCfg_IN_ECU1_FD_CAN1_0x18c_FD_CAN1_BSD_01_50ms_P11: CanIfHrhIdSymRef=IN_HwObj_ECU1_FD_CAN1_0x18c_FD_CAN1_BSD_01_50ms_P11
          CanIfHrhCfg_IN_ECU1_FD_CAN1_0x205_FD_CAN1_V_CGW_02_A: CanIfHrhIdSymRef=IN_HwObj_ECU1_FD_CAN1_0x205_FD_CAN1_V_CGW_02_A
          CanIfHrhCfg_IN_0x748_0x77e_ECU1_FD_CAN1: CanIfHrhIdSymRef=IN_HwObj_0x748_0x77e_ECU1_FD_CAN1
        8 x CanIfHthCfg, all with category=TOOL_CONFIGURED, CanIfHthCanCtrlIdRef=CanIfCtrlCfg_ECU1_FD_CAN1:
          CanIfHthCfg_OUT_ECU1_FD_CAN1_0x42_FD_CAN1_TCU_01_10ms_P11: CanIfHthIdSymRef=OUT_HwObj_ECU1_FD_CAN1_0x42_FD_CAN1_TCU_01_10ms_P11
          CanIfHthCfg_OUT_ECU1_FD_CAN1_0x202_FD_CAN1_V_CGW_01_B: CanIfHthIdSymRef=OUT_HwObj_ECU1_FD_CAN1_0x202_FD_CAN1_V_CGW_01_B
          CanIfHthCfg_OUT_ECU1_FD_CAN1_0x2b0_FD_CAN1_AFLS_01_100ms: CanIfHthIdSymRef=OUT_HwObj_ECU1_FD_CAN1_0x2b0_FD_CAN1_AFLS_01_100ms
          CanIfHthCfg_OUT_ECU1_FD_CAN1_0x400_FD_CAN1_AHLS_01_300ms: CanIfHthIdSymRef=OUT_HwObj_ECU1_FD_CAN1_0x400_FD_CAN1_AHLS_01_300ms
          CanIfHthCfg_OUT_ECU1_FD_CAN1_0x502_FD_CAN1_NM_CGW: CanIfHthIdSymRef=OUT_HwObj_ECU1_FD_CAN1_0x502_FD_CAN1_NM_CGW
          CanIfHthCfg_OUT_ECU1_FD_CAN1_0x651_FD_CAN1_AtmResp: CanIfHthIdSymRef=OUT_HwObj_ECU1_FD_CAN1_0x651_FD_CAN1_AtmResp
          CanIfHthCfg_OUT_ECU1_FD_CAN1_0x75a_FD_CAN1_Normal_Msg_FD_TP_01_A: CanIfHthIdSymRef=OUT_HwObj_ECU1_FD_CAN1_0x75a_FD_CAN1_Normal_Msg_FD_TP_01_A
          CanIfHthCfg_OUT_ECU1_FD_CAN1_0x760_FD_CAN1_Diag_Msg_TP_Phys_Res_FD_CAN1: CanIfHthIdSymRef=OUT_HwObj_ECU1_FD_CAN1_0x760_FD_CAN1_Diag_Msg_TP_Phys_Res_FD_CAN1
      8 x CanIfBufferCfg, all with category=TOOL_CONFIGURED, CanIfBufferSize=0:
        CanIfBufferCfg_OUT_ECU1_FD_CAN1_0x42_FD_CAN1_TCU_01_10ms_P11: CanIfBufferHthRef=CanIfHthCfg_OUT_ECU1_FD_CAN1_0x42_FD_CAN1_TCU_01_10ms_P11
        CanIfBufferCfg_OUT_ECU1_FD_CAN1_0x202_FD_CAN1_V_CGW_01_B: CanIfBufferHthRef=CanIfHthCfg_OUT_ECU1_FD_CAN1_0x202_FD_CAN1_V_CGW_01_B
        CanIfBufferCfg_OUT_ECU1_FD_CAN1_0x2b0_FD_CAN1_AFLS_01_100ms: CanIfBufferHthRef=CanIfHthCfg_OUT_ECU1_FD_CAN1_0x2b0_FD_CAN1_AFLS_01_100ms
        CanIfBufferCfg_OUT_ECU1_FD_CAN1_0x400_FD_CAN1_AHLS_01_300ms: CanIfBufferHthRef=CanIfHthCfg_OUT_ECU1_FD_CAN1_0x400_FD_CAN1_AHLS_01_300ms
        CanIfBufferCfg_OUT_ECU1_FD_CAN1_0x502_FD_CAN1_NM_CGW: CanIfBufferHthRef=CanIfHthCfg_OUT_ECU1_FD_CAN1_0x502_FD_CAN1_NM_CGW
        CanIfBufferCfg_OUT_ECU1_FD_CAN1_0x651_FD_CAN1_AtmResp: CanIfBufferHthRef=CanIfHthCfg_OUT_ECU1_FD_CAN1_0x651_FD_CAN1_AtmResp
        CanIfBufferCfg_OUT_ECU1_FD_CAN1_0x75a_FD_CAN1_Normal_Msg_FD_TP_01_A: CanIfBufferHthRef=CanIfHthCfg_OUT_ECU1_FD_CAN1_0x75a_FD_CAN1_Normal_Msg_FD_TP_01_A
        CanIfBufferCfg_OUT_ECU1_FD_CAN1_0x760_FD_CAN1_Diag_Msg_TP_Phys_Res_FD_CAN1: CanIfBufferHthRef=CanIfHthCfg_OUT_ECU1_FD_CAN1_0x760_FD_CAN1_Diag_Msg_TP_Phys_Res_FD_CAN1
      7 x CanIfRxPduCfg, all with category=TOOL_CONFIGURED, CanIfRxPduCanIdType=STANDARD_CAN, CanIfRxPduCanIdMask=2015, CanIfPduReportIdsMEnable=0, CanIfRxPduReadData=0, CanIfRxPduReadNotifyStatus=0:
        CanIfRxPduCfg_IN_ECU1_FD_CAN1_0x18c_FD_CAN1_BSD_01_50ms_P11: CanIfRxPduCanId=396, CanIfRxPduId=0, CanIfRxPduDataLength=8, CanIfRxPduDataLengthCheck=1, CanIfRxPduUserRxIndicationUL=PDUR, CanIfRxPduHrhIdRef=CanIfHrhCfg_IN_ECU1_FD_CAN1_0x18c_FD_CAN1_BSD_01_50ms_P11, CanIfRxPduRef=Pdu_ISignalIPdu_FD_CAN1_BSD_01_50ms_P11
        CanIfRxPduCfg_IN_ECU1_FD_CAN1_0x205_FD_CAN1_V_CGW_02_A: CanIfRxPduCanId=517, CanIfRxPduId=1, CanIfRxPduDataLength=8, CanIfRxPduDataLengthCheck=1, CanIfRxPduUserRxIndicationUL=PDUR, CanIfRxPduHrhIdRef=CanIfHrhCfg_IN_ECU1_FD_CAN1_0x205_FD_CAN1_V_CGW_02_A, CanIfRxPduRef=Pdu_ISignalIPdu_FD_CAN1_V_CGW_02_A
        CanIfRxPduCfg_IN_ECU1_FD_CAN1_CANNM_MESSAGE: CanIfRxPduCanId=1288, CanIfRxPduId=2, CanIfRxPduDataLength=8, CanIfRxPduDataLengthCheck=1, CanIfRxPduUserRxIndicationUL=CAN_NM, CanIfRxPduHrhIdRef=CanIfHrhCfg_IN_0x500_0x57f_ECU1_FD_CAN1_NM_Message, CanIfRxPduRef=Pdu_NmPdu_FD_CAN1_NM_MDPS
          CanIfRxPduCanIdRange0 (CanIfRxPduCanIdRange): category=TOOL_CONFIGURED, CanIfRxPduCanIdRangeLowerCanId=1280, CanIfRxPduCanIdRangeUpperCanId=1407
        CanIfRxPduCfg_IN_ECU1_FD_CAN1_0x650_FD_CAN1_AtmReq: CanIfRxPduCanId=1616, CanIfRxPduId=3, CanIfRxPduDataLength=8, CanIfRxPduDataLengthCheck=1, CanIfRxPduUserRxIndicationUL=PDUR, CanIfRxPduHrhIdRef=CanIfHrhCfg_IN_ECU1_FD_CAN1_0x650_FD_CAN1_AtmReq, CanIfRxPduRef=Pdu_ISignalIPdu_FD_CAN1_AtmReq
        CanIfRxPduCfg_IN_ECU1_FD_CAN1_0x75e_FD_CAN1_Normal_Msg_FD_TP_01_B: CanIfRxPduCanId=1886, CanIfRxPduId=4, CanIfRxPduDataLength=64, CanIfRxPduDataLengthCheck=0, CanIfRxPduUserRxIndicationUL=CAN_TP, CanIfRxPduHrhIdRef=CanIfHrhCfg_IN_0x748_0x77e_ECU1_FD_CAN1, CanIfRxPduRef=Pdu_NPdu_FD_CAN1_Normal_Msg_FD_TP_01_B
        CanIfRxPduCfg_IN_ECU1_FD_CAN1_0x768_FD_CAN1_Diag_Msg_TP_Phys_Req_FD_CAN1: CanIfRxPduCanId=1896, CanIfRxPduId=5, CanIfRxPduDataLength=8, CanIfRxPduDataLengthCheck=0, CanIfRxPduUserRxIndicationUL=CAN_TP, CanIfRxPduHrhIdRef=CanIfHrhCfg_IN_0x748_0x77e_ECU1_FD_CAN1, CanIfRxPduRef=Pdu_NPdu_FD_CAN1_Diag_Msg_TP_Phys_Req_FD_CAN1
        CanIfRxPduCfg_IN_ECU1_FD_CAN1_0x7df_FD_CAN1_Diag_Msg_TP_Func_FD_CAN1: CanIfRxPduCanId=2015, CanIfRxPduId=6, CanIfRxPduDataLength=8, CanIfRxPduDataLengthCheck=0, CanIfRxPduUserRxIndicationUL=CAN_TP, CanIfRxPduHrhIdRef=CanIfHrhCfg_IN_ECU1_FD_CAN1_0x7df_FD_CAN1_Diag_Msg_TP_Func_FD_CAN1, CanIfRxPduRef=Pdu_NPdu_FD_CAN1_Diag_Msg_TP_Func_FD_CAN1
      8 x CanIfTxPduCfg, all with category=TOOL_CONFIGURED, CanIfTxPduCanIdType=STANDARD_FD_CAN, CanIfTxPduCanIdMask=2015, CanIfTxPduPnFilterPdu=0, CanIfTxPduTruncation=1, CanIfTxPduReadNotifyStatus=0, CanIfTxPduType=STATIC:
        CanIfTxPduCfg_OUT_ECU1_FD_CAN1_0x42_FD_CAN1_TCU_01_10ms_P11: CanIfTxPduCanId=66, CanIfTxPduId=0, CanIfTxPduUserTxConfirmationUL=PDUR, CanIfTxPduBufferRef=CanIfBufferCfg_OUT_ECU1_FD_CAN1_0x42_FD_CAN1_TCU_01_10ms_P11, CanIfTxPduRef=Pdu_ISignalIPdu_FD_CAN1_TCU_01_10ms_P11
        CanIfTxPduCfg_OUT_ECU1_FD_CAN1_0x202_FD_CAN1_V_CGW_01_B: CanIfTxPduCanId=514, CanIfTxPduId=1, CanIfTxPduUserTxConfirmationUL=PDUR, CanIfTxPduBufferRef=CanIfBufferCfg_OUT_ECU1_FD_CAN1_0x202_FD_CAN1_V_CGW_01_B, CanIfTxPduRef=Pdu_ISignalIPdu_FD_CAN1_V_CGW_01_B
        CanIfTxPduCfg_OUT_ECU1_FD_CAN1_0x2b0_FD_CAN1_AFLS_01_100ms: CanIfTxPduCanId=688, CanIfTxPduId=2, CanIfTxPduUserTxConfirmationUL=PDUR, CanIfTxPduBufferRef=CanIfBufferCfg_OUT_ECU1_FD_CAN1_0x2b0_FD_CAN1_AFLS_01_100ms, CanIfTxPduRef=Pdu_ISignalIPdu_FD_CAN1_AFLS_01_100ms
        CanIfTxPduCfg_OUT_ECU1_FD_CAN1_0x400_FD_CAN1_AHLS_01_300ms: CanIfTxPduCanId=1024, CanIfTxPduId=3, CanIfTxPduUserTxConfirmationUL=PDUR, CanIfTxPduBufferRef=CanIfBufferCfg_OUT_ECU1_FD_CAN1_0x400_FD_CAN1_AHLS_01_300ms, CanIfTxPduRef=Pdu_ISignalIPdu_FD_CAN1_AHLS_01_300ms
        CanIfTxPduCfg_OUT_ECU1_FD_CAN1_0x502_FD_CAN1_NM_CGW: CanIfTxPduCanId=1282, CanIfTxPduId=4, CanIfTxPduUserTxConfirmationUL=CAN_NM, CanIfTxPduBufferRef=CanIfBufferCfg_OUT_ECU1_FD_CAN1_0x502_FD_CAN1_NM_CGW, CanIfTxPduRef=Pdu_NmPdu_FD_CAN1_NM_CGW
        CanIfTxPduCfg_OUT_ECU1_FD_CAN1_0x651_FD_CAN1_AtmResp: CanIfTxPduCanId=1617, CanIfTxPduId=5, CanIfTxPduUserTxConfirmationUL=PDUR, CanIfTxPduBufferRef=CanIfBufferCfg_OUT_ECU1_FD_CAN1_0x651_FD_CAN1_AtmResp, CanIfTxPduRef=Pdu_ISignalIPdu_FD_CAN1_AtmResp
        CanIfTxPduCfg_OUT_ECU1_FD_CAN1_0x75a_FD_CAN1_Normal_Msg_FD_TP_01_A: CanIfTxPduCanId=1882, CanIfTxPduId=6, CanIfTxPduUserTxConfirmationUL=CAN_TP, CanIfTxPduBufferRef=CanIfBufferCfg_OUT_ECU1_FD_CAN1_0x75a_FD_CAN1_Normal_Msg_FD_TP_01_A, CanIfTxPduRef=Pdu_NPdu_FD_CAN1_Normal_Msg_FD_TP_01_A
        CanIfTxPduCfg_OUT_ECU1_FD_CAN1_0x760_FD_CAN1_Diag_Msg_TP_Phys_Res_FD_CAN1: CanIfTxPduCanId=1888, CanIfTxPduId=7, CanIfTxPduUserTxConfirmationUL=CAN_TP, CanIfTxPduBufferRef=CanIfBufferCfg_OUT_ECU1_FD_CAN1_0x760_FD_CAN1_Diag_Msg_TP_Phys_Res_FD_CAN1, CanIfTxPduRef=Pdu_NPdu_FD_CAN1_Diag_Msg_TP_Phys_Res_FD_CAN1
    CanIfCtrlDrvCfg0 (CanIfCtrlDrvCfg): CanIfCtrlDrvInitHohConfigRef=CanIfInitHohCfg0, CanIfCtrlDrvNameRef=CanGeneral
      CanIfCtrlCfg_ECU1_FD_CAN1 (CanIfCtrlCfg): category=TOOL_CONFIGURED, CanIfCtrlId=0, CanIfCtrlWakeupSupport=0, CanIfCtrlCanCtrlRef=ECU1_FD_CAN1
