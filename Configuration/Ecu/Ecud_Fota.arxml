AUTOSAR XML (schema 4-3-0)
package /EcucModules
  module config Fota: implementation-config-variant=VARIANT-PRE-COMPILE, module-description=BswImplementation_Fota
    FotaGeneral:
      FotaDevErrorDetect = 1
      FotaMainfunctionPeriod = 0.005
      FotaMode = APP_MODE
      FotaStartUpCommandAddress = 0x20400000
      FotaStartUpCommandValue = 0xA5430911
      FotaPartitionFlagSecurityValue = 0x90482442
      FotaCommonRAMAddress = 0x20400004
      FotaTpBlockLength = 514
      FotaVersionInfoAPI = 0
      FotaARMArchitectureEcu = 1
      FotaBootManagerEnable = 0
      FotaSoftwareVersionCheckEnable = 0
      FotaCpdKeyValue = 0x19801217
      FotaDownGradeProtection = 0
      FotaMcuMemoryAccessType = FOTA_SINGLE_TYPE
      FotaStandardSupport = FOTA_OTA_ES98765_01
      FotaVersionLengthMaximum = 0x7F
      FotaLargeSector = 0
    FotaSwUnit_RTSW (FotaSwUnit): FotaEcuSwUnit=0xF1B1, FotaSoftwareType=FOTA_RTSW_TYPE, FotaSwUnitIndex=0, FotaMemDriverRef=MemInstance0
      FotaBlockInfo: ModuleInfoAddress=0x00460020
        5 x FotaBlock:
          FotaBlock0_Meta: BlockType=METADATA, BlockIndex=0, BlockStartAddress=0x1000, BlockEndAddress=0x1047
            MetaDataInfo:
              MdBlockHeaderLength = 8
              MdBlockMetadataLength = 48
              MdBlockDecKeyMACLength = 16
              MetadataWriteToFlash = 0
              CsmMetadataHashJob = Hash_SHA256_Sync
              CsmKeyForKeyDerivationPassword = PBKDF2_Source_Key_PSK0
              CsmKeyForKeyDerivationResult = PBKDF2_ExtractedKey
              CsmDecryptKey = Decr_AES_CTR_Key0_swlib_Fota
              CsmDecryptKeyVerifyJob = MacVer_AES_CMAC_key
          FotaBlock0_Fw0: BlockType=FIRMWARE, BlockIndex=1, BlockStartAddress=0x460000, BlockEndAddress=0x4608FF
            BlockProcessing: IsEncrypted=1
          FotaBlock0_Fw1: BlockType=FIRMWARE, BlockIndex=2, BlockStartAddress=0x460C00, BlockEndAddress=0x4DFFFF
            BlockProcessing: IsEncrypted=1
          FotaBlock_Partition: BlockType=PARTITION_FLAG, BlockIndex=3, BlockStartAddress=0x460900, BlockEndAddress=0x4609FF
          FotaBlock0_Signature: BlockType=SIGNATURE, BlockStartAddress=0x460A00, BlockEndAddress=0x460BFF, BlockIndex=4
            VerificationInfo:
              VerifyBufferUsed = 0
              VerifySizeOfOneCycle = 512
              CsmAlgorithm = SignatureVerify_RSASSA_PKCS1_v1_5_Fota
              TargetBlock = FotaBlock0_Fw0
              TargetBlock = FotaBlock0_Fw1
