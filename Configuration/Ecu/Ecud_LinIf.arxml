AUTOSAR XML (schema 00047)
package /AUTRON
  module config LinIf: implementation-config-variant=VARIANT-PRE-COMPILE, module-description=BswImplementation_LinIf
    LinIfGeneral:
      category = TOOL_CONFIGURED
      LinIfBusMirroringSupported = 0
      LinIfDevErrorDetect = 1
      LinIfMultipleDriversSupported = 0
      LinIfNcOptionalRequestSupported = 0
      LinIfTpSupported = 1
      LinIfVersionInfoApi = 1
      LinIfTrcvDriverSupported = 1
      LinIfMultipleTrcvDriverSupported = 0
      LinIfBlockWakeupRepetitionMax = 1
    LinIfGlobalConfig
      LinIfChannel_LIN1 (LinIfChannel):
        category = TOOL_CONFIGURED
        LinIfBusIdleTimeoutPeriod = 0.1
        LinIfWakeupConfirmationUL = LIN_SM
        LinIfGotoSleepConfirmationUL = LIN_SM
        LinIfMainFunctionPeriod = 0.005
        LinIfScheduleRequestConfirmationUL = LIN_SM
        LinIfErrorNotificationFunction = Rte_Call_CallbackError_lin_cbk_err
        LinIfAfterScheduleFunction = Rte_Call_CallbackAfterSchedule_lin_after_schedule
        LinIfChannelRef = LinChannel_LIN1
        LinIfComMNetworkHandleRef = ComMChannel_LIN1
        LinIfNodeType: category=TOOL_CONFIGURED
          LinIfMaster_LIN1 (LinIfMaster): category=TOOL_CONFIGURED, LinIfJitter=0.0
        11 x LinIfFrame, all with category=TOOL_CONFIGURED:
          LinIfFrame_LinFrameTriggering_LIN1_Master_Cmd: LinIfChecksumType=ENHANCED, LinIfFrameId=8, LinIfFrameType=UNCONDITIONAL, LinIfFrameIndex=0
            LinIfPduDirection: category=TOOL_CONFIGURED
              LinIfTxPdu_LinFrameTriggering_LIN1_Master_Cmd_FramePort_LIN1_Master_Cmd (LinIfTxPdu): category=TOOL_CONFIGURED, LinIfTxPduId=0, LinIfUserTxUL=PDUR, LinIfTxPduRef=Pdu_ISignalIPdu_LIN1_Master_Cmd
          LinIfFrame_LinFrameTriggering_LIN1_FL_Sensor_Status: LinIfChecksumType=ENHANCED, LinIfFrameId=4, LinIfFrameType=UNCONDITIONAL, LinIfFrameIndex=1
            LinIfPduDirection: category=TOOL_CONFIGURED
              LinIfRxPdu_LinFrameTriggering_LIN1_FL_Sensor_Status_FramePort_LIN1_FL_Sensor_Status (LinIfRxPdu): category=TOOL_CONFIGURED, LinIfUserRxIndicationUL=PDUR, LinIfRxPduRef=Pdu_ISignalIPdu_LIN1_FL_Sensor_Status
          LinIfFrame_LinFrameTriggering_LIN1_FCL_Sensor_Status: LinIfChecksumType=ENHANCED, LinIfFrameId=5, LinIfFrameType=UNCONDITIONAL, LinIfFrameIndex=2
            LinIfPduDirection: category=TOOL_CONFIGURED
              LinIfRxPdu_LinFrameTriggering_LIN1_FCL_Sensor_Status_FramePort_LIN1_FCL_Sensor_Status (LinIfRxPdu): category=TOOL_CONFIGURED, LinIfUserRxIndicationUL=PDUR, LinIfRxPduRef=Pdu_ISignalIPdu_LIN1_FCL_Sensor_Status
          LinIfFrame_LinFrameTriggering_LIN1_FCR_Sensor_Status: LinIfChecksumType=ENHANCED, LinIfFrameId=6, LinIfFrameType=UNCONDITIONAL, LinIfFrameIndex=3
            LinIfPduDirection: category=TOOL_CONFIGURED
              LinIfRxPdu_LinFrameTriggering_LIN1_FCR_Sensor_Status_FramePort_LIN1_FCR_Sensor_Status (LinIfRxPdu): category=TOOL_CONFIGURED, LinIfUserRxIndicationUL=PDUR, LinIfRxPduRef=Pdu_ISignalIPdu_LIN1_FCR_Sensor_Status
          LinIfFrame_LinFrameTriggering_LIN1_FR_Sensor_Status: LinIfChecksumType=ENHANCED, LinIfFrameId=7, LinIfFrameType=UNCONDITIONAL, LinIfFrameIndex=4
            LinIfPduDirection: category=TOOL_CONFIGURED
              LinIfRxPdu_LinFrameTriggering_LIN1_FR_Sensor_Status_FramePort_LIN1_FR_Sensor_Status (LinIfRxPdu): category=TOOL_CONFIGURED, LinIfUserRxIndicationUL=PDUR, LinIfRxPduRef=Pdu_ISignalIPdu_LIN1_FR_Sensor_Status
          LinIfFrame_LinFrameTriggering_LIN1_RL_Sensor_Status: LinIfChecksumType=ENHANCED, LinIfFrameId=0, LinIfFrameType=UNCONDITIONAL, LinIfFrameIndex=5
            LinIfPduDirection: category=TOOL_CONFIGURED
              LinIfRxPdu_LinFrameTriggering_LIN1_RL_Sensor_Status_FramePort_LIN1_RL_Sensor_Status (LinIfRxPdu): category=TOOL_CONFIGURED, LinIfUserRxIndicationUL=PDUR, LinIfRxPduRef=Pdu_ISignalIPdu_LIN1_RL_Sensor_Status
          LinIfFrame_LinFrameTriggering_LIN1_RCL_Sensor_Status: LinIfChecksumType=ENHANCED, LinIfFrameId=1, LinIfFrameType=UNCONDITIONAL, LinIfFrameIndex=6
            LinIfPduDirection: category=TOOL_CONFIGURED
              LinIfRxPdu_LinFrameTriggering_LIN1_RCL_Sensor_Status_FramePort_LIN1_RCL_Sensor_Status (LinIfRxPdu): category=TOOL_CONFIGURED, LinIfUserRxIndicationUL=PDUR, LinIfRxPduRef=Pdu_ISignalIPdu_LIN1_RCL_Sensor_Status
          LinIfFrame_LinFrameTriggering_LIN1_RCR_Sensor_Status: LinIfChecksumType=ENHANCED, LinIfFrameId=2, LinIfFrameType=UNCONDITIONAL, LinIfFrameIndex=7
            LinIfPduDirection: category=TOOL_CONFIGURED
              LinIfRxPdu_LinFrameTriggering_LIN1_RCR_Sensor_Status_FramePort_LIN1_RCR_Sensor_Status (LinIfRxPdu): category=TOOL_CONFIGURED, LinIfUserRxIndicationUL=PDUR, LinIfRxPduRef=Pdu_ISignalIPdu_LIN1_RCR_Sensor_Status
          LinIfFrame_LinFrameTriggering_LIN1_RR_Sensor_Status: LinIfChecksumType=ENHANCED, LinIfFrameId=3, LinIfFrameType=UNCONDITIONAL, LinIfFrameIndex=8
            LinIfPduDirection: category=TOOL_CONFIGURED
              LinIfRxPdu_LinFrameTriggering_LIN1_RR_Sensor_Status_FramePort_LIN1_RR_Sensor_Status (LinIfRxPdu): category=TOOL_CONFIGURED, LinIfUserRxIndicationUL=PDUR, LinIfRxPduRef=Pdu_ISignalIPdu_LIN1_RR_Sensor_Status
          LinIfFrame_LinFrameTriggering_LIN1_MasterReq: LinIfChecksumType=CLASSIC, LinIfFrameId=60, LinIfFrameIndex=9, LinIfFrameType=MRF
            LinIfPduDirection: category=TOOL_CONFIGURED
              LinIfTxPdu_LinFrameTriggering_LIN1_MasterReq_FramePort_LIN1_MasterReq (LinIfTxPdu): category=TOOL_CONFIGURED, LinIfTxPduId=9, LinIfUserTxUL=PDUR, LinIfTxPduRef=Pdu_DcmIPdu_LIN1_MasterReq
          LinIfFrame_LinFrameTriggering_LIN1_SlaveResp: LinIfChecksumType=CLASSIC, LinIfFrameId=61, LinIfFrameType=SRF, LinIfFrameIndex=10
            LinIfPduDirection: category=TOOL_CONFIGURED
              LinIfRxPdu_LinFrameTriggering_LIN1_SlaveResp_FramePort_LIN1_SlaveResp (LinIfRxPdu): category=TOOL_CONFIGURED, LinIfUserRxIndicationUL=PDUR, LinIfRxPduRef=Pdu_DcmIPdu_LIN1_SlaveResp
        23 x LinIfScheduleTable, all with category=TOOL_CONFIGURED, LinIfResumePosition=START_FROM_BEGINNING, LinIfRunMode=RUN_CONTINUOUS:
          LinIfScheduleTable_LIN1_NULL: LinIfScheduleTableIndex=0
          LinIfScheduleTable_LIN1_SCHEDULER_RPAS_NORMAL: LinIfScheduleTableIndex=1
            12 x LinIfEntry, all with category=TOOL_CONFIGURED:
              LinIfEntry_LinScheduleTable_SCHEDULER_RPAS_NORMAL_0: LinIfDelay=0.08, LinIfEntryIndex=0, LinIfFrameRef=LinIfFrame_LinFrameTriggering_LIN1_Master_Cmd
              LinIfEntry_LinScheduleTable_SCHEDULER_RPAS_NORMAL_1: LinIfDelay=0.01, LinIfEntryIndex=1, LinIfFrameRef=LinIfFrame_LinFrameTriggering_LIN1_RL_Sensor_Status
              LinIfEntry_LinScheduleTable_SCHEDULER_RPAS_NORMAL_2: LinIfDelay=0.08, LinIfEntryIndex=2, LinIfFrameRef=LinIfFrame_LinFrameTriggering_LIN1_Master_Cmd
              LinIfEntry_LinScheduleTable_SCHEDULER_RPAS_NORMAL_3: LinIfDelay=0.01, LinIfEntryIndex=3, LinIfFrameRef=LinIfFrame_LinFrameTriggering_LIN1_RR_Sensor_Status
              LinIfEntry_LinScheduleTable_SCHEDULER_RPAS_NORMAL_4: LinIfDelay=0.08, LinIfEntryIndex=4, LinIfFrameRef=LinIfFrame_LinFrameTriggering_LIN1_Master_Cmd
              LinIfEntry_LinScheduleTable_SCHEDULER_RPAS_NORMAL_5: LinIfDelay=0.01, LinIfEntryIndex=5, LinIfFrameRef=LinIfFrame_LinFrameTriggering_LIN1_RL_Sensor_Status
              LinIfEntry_LinScheduleTable_SCHEDULER_RPAS_NORMAL_6: LinIfDelay=0.01, LinIfEntryIndex=6, LinIfFrameRef=LinIfFrame_LinFrameTriggering_LIN1_RCL_Sensor_Status
              LinIfEntry_LinScheduleTable_SCHEDULER_RPAS_NORMAL_7: LinIfDelay=0.01, LinIfEntryIndex=7, LinIfFrameRef=LinIfFrame_LinFrameTriggering_LIN1_RCR_Sensor_Status
              LinIfEntry_LinScheduleTable_SCHEDULER_RPAS_NORMAL_8: LinIfDelay=0.08, LinIfEntryIndex=8, LinIfFrameRef=LinIfFrame_LinFrameTriggering_LIN1_Master_Cmd
              LinIfEntry_LinScheduleTable_SCHEDULER_RPAS_NORMAL_9: LinIfDelay=0.01, LinIfEntryIndex=9, LinIfFrameRef=LinIfFrame_LinFrameTriggering_LIN1_RCL_Sensor_Status
              LinIfEntry_LinScheduleTable_SCHEDULER_RPAS_NORMAL_10: LinIfDelay=0.01, LinIfEntryIndex=10, LinIfFrameRef=LinIfFrame_LinFrameTriggering_LIN1_RCR_Sensor_Status
              LinIfEntry_LinScheduleTable_SCHEDULER_RPAS_NORMAL_11: LinIfDelay=0.01, LinIfEntryIndex=11, LinIfFrameRef=LinIfFrame_LinFrameTriggering_LIN1_RR_Sensor_Status
          LinIfScheduleTable_LIN1_SCHEDULER_RPAS_CRC_COMPARE: LinIfScheduleTableIndex=2
            5 x LinIfEntry, all with category=TOOL_CONFIGURED:
              LinIfEntry_LinScheduleTable_SCHEDULER_RPAS_CRC_COMPARE_0: LinIfDelay=0.02, LinIfEntryIndex=0, LinIfFrameRef=LinIfFrame_LinFrameTriggering_LIN1_Master_Cmd
              LinIfEntry_LinScheduleTable_SCHEDULER_RPAS_CRC_COMPARE_1: LinIfDelay=0.01, LinIfEntryIndex=1, LinIfFrameRef=LinIfFrame_LinFrameTriggering_LIN1_RL_Sensor_Status
              LinIfEntry_LinScheduleTable_SCHEDULER_RPAS_CRC_COMPARE_2: LinIfDelay=0.01, LinIfEntryIndex=2, LinIfFrameRef=LinIfFrame_LinFrameTriggering_LIN1_RCL_Sensor_Status
              LinIfEntry_LinScheduleTable_SCHEDULER_RPAS_CRC_COMPARE_3: LinIfDelay=0.01, LinIfEntryIndex=3, LinIfFrameRef=LinIfFrame_LinFrameTriggering_LIN1_RCR_Sensor_Status
              LinIfEntry_LinScheduleTable_SCHEDULER_RPAS_CRC_COMPARE_4: LinIfDelay=0.01, LinIfEntryIndex=4, LinIfFrameRef=LinIfFrame_LinFrameTriggering_LIN1_RR_Sensor_Status
          LinIfScheduleTable_LIN1_SCHEDULER_PAS_NORMAL: LinIfScheduleTableIndex=3
            14 x LinIfEntry, all with category=TOOL_CONFIGURED:
              LinIfEntry_LinScheduleTable_SCHEDULER_PAS_NORMAL_0: LinIfDelay=0.08, LinIfEntryIndex=0, LinIfFrameRef=LinIfFrame_LinFrameTriggering_LIN1_Master_Cmd
              LinIfEntry_LinScheduleTable_SCHEDULER_PAS_NORMAL_1: LinIfDelay=0.01, LinIfEntryIndex=1, LinIfFrameRef=LinIfFrame_LinFrameTriggering_LIN1_RL_Sensor_Status
              LinIfEntry_LinScheduleTable_SCHEDULER_PAS_NORMAL_2: LinIfDelay=0.01, LinIfEntryIndex=2, LinIfFrameRef=LinIfFrame_LinFrameTriggering_LIN1_FR_Sensor_Status
              LinIfEntry_LinScheduleTable_SCHEDULER_PAS_NORMAL_3: LinIfDelay=0.08, LinIfEntryIndex=3, LinIfFrameRef=LinIfFrame_LinFrameTriggering_LIN1_Master_Cmd
              LinIfEntry_LinScheduleTable_SCHEDULER_PAS_NORMAL_4: LinIfDelay=0.01, LinIfEntryIndex=4, LinIfFrameRef=LinIfFrame_LinFrameTriggering_LIN1_RR_Sensor_Status
              LinIfEntry_LinScheduleTable_SCHEDULER_PAS_NORMAL_5: LinIfDelay=0.01, LinIfEntryIndex=5, LinIfFrameRef=LinIfFrame_LinFrameTriggering_LIN1_FL_Sensor_Status
              LinIfEntry_LinScheduleTable_SCHEDULER_PAS_NORMAL_6: LinIfDelay=0.08, LinIfEntryIndex=6, LinIfFrameRef=LinIfFrame_LinFrameTriggering_LIN1_Master_Cmd
              LinIfEntry_LinScheduleTable_SCHEDULER_PAS_NORMAL_7: LinIfDelay=0.01, LinIfEntryIndex=7, LinIfFrameRef=LinIfFrame_LinFrameTriggering_LIN1_RL_Sensor_Status
              LinIfEntry_LinScheduleTable_SCHEDULER_PAS_NORMAL_8: LinIfDelay=0.01, LinIfEntryIndex=8, LinIfFrameRef=LinIfFrame_LinFrameTriggering_LIN1_RCL_Sensor_Status
              LinIfEntry_LinScheduleTable_SCHEDULER_PAS_NORMAL_9: LinIfDelay=0.01, LinIfEntryIndex=9, LinIfFrameRef=LinIfFrame_LinFrameTriggering_LIN1_RCR_Sensor_Status
              LinIfEntry_LinScheduleTable_SCHEDULER_PAS_NORMAL_10: LinIfDelay=0.08, LinIfEntryIndex=10, LinIfFrameRef=LinIfFrame_LinFrameTriggering_LIN1_Master_Cmd
              LinIfEntry_LinScheduleTable_SCHEDULER_PAS_NORMAL_11: LinIfDelay=0.01, LinIfEntryIndex=11, LinIfFrameRef=LinIfFrame_LinFrameTriggering_LIN1_RCL_Sensor_Status
              LinIfEntry_LinScheduleTable_SCHEDULER_PAS_NORMAL_12: LinIfDelay=0.01, LinIfEntryIndex=12, LinIfFrameRef=LinIfFrame_LinFrameTriggering_LIN1_RCR_Sensor_Status
              LinIfEntry_LinScheduleTable_SCHEDULER_PAS_NORMAL_13: LinIfDelay=0.01, LinIfEntryIndex=13, LinIfFrameRef=LinIfFrame_LinFrameTriggering_LIN1_RR_Sensor_Status
          LinIfScheduleTable_LIN1_SCHEDULER_PAS_CRC_COMPARE: LinIfScheduleTableIndex=4
            9 x LinIfEntry, all with category=TOOL_CONFIGURED:
              LinIfEntry_LinScheduleTable_SCHEDULER_PAS_CRC_COMPARE_0: LinIfDelay=0.02, LinIfEntryIndex=0, LinIfFrameRef=LinIfFrame_LinFrameTriggering_LIN1_Master_Cmd
              LinIfEntry_LinScheduleTable_SCHEDULER_PAS_CRC_COMPARE_1: LinIfDelay=0.01, LinIfEntryIndex=1, LinIfFrameRef=LinIfFrame_LinFrameTriggering_LIN1_RL_Sensor_Status
              LinIfEntry_LinScheduleTable_SCHEDULER_PAS_CRC_COMPARE_2: LinIfDelay=0.01, LinIfEntryIndex=2, LinIfFrameRef=LinIfFrame_LinFrameTriggering_LIN1_RCL_Sensor_Status
              LinIfEntry_LinScheduleTable_SCHEDULER_PAS_CRC_COMPARE_3: LinIfDelay=0.01, LinIfEntryIndex=3, LinIfFrameRef=LinIfFrame_LinFrameTriggering_LIN1_RCR_Sensor_Status
              LinIfEntry_LinScheduleTable_SCHEDULER_PAS_CRC_COMPARE_4: LinIfDelay=0.01, LinIfEntryIndex=4, LinIfFrameRef=LinIfFrame_LinFrameTriggering_LIN1_RR_Sensor_Status
              LinIfEntry_LinScheduleTable_SCHEDULER_PAS_CRC_COMPARE_5: LinIfDelay=0.01, LinIfEntryIndex=5, LinIfFrameRef=LinIfFrame_LinFrameTriggering_LIN1_FL_Sensor_Status
              LinIfEntry_LinScheduleTable_SCHEDULER_PAS_CRC_COMPARE_6: LinIfDelay=0.01, LinIfEntryIndex=6, LinIfFrameRef=LinIfFrame_LinFrameTriggering_LIN1_FCL_Sensor_Status
              LinIfEntry_LinScheduleTable_SCHEDULER_PAS_CRC_COMPARE_7: LinIfDelay=0.01, LinIfEntryIndex=7, LinIfFrameRef=LinIfFrame_LinFrameTriggering_LIN1_FCR_Sensor_Status
              LinIfEntry_LinScheduleTable_SCHEDULER_PAS_CRC_COMPARE_8: LinIfDelay=0.01, LinIfEntryIndex=8, LinIfFrameRef=LinIfFrame_LinFrameTriggering_LIN1_FR_Sensor_Status
          LinIfScheduleTable_LIN1_SCHEDULER_FRONT_PAS_NORMAL: LinIfScheduleTableIndex=5
            12 x LinIfEntry, all with category=TOOL_CONFIGURED:
              LinIfEntry_LinScheduleTable_SCHEDULER_FRONT_PAS_NORMAL_0: LinIfDelay=0.08, LinIfEntryIndex=0, LinIfFrameRef=LinIfFrame_LinFrameTriggering_LIN1_Master_Cmd
              LinIfEntry_LinScheduleTable_SCHEDULER_FRONT_PAS_NORMAL_1: LinIfDelay=0.01, LinIfEntryIndex=1, LinIfFrameRef=LinIfFrame_LinFrameTriggering_LIN1_FL_Sensor_Status
              LinIfEntry_LinScheduleTable_SCHEDULER_FRONT_PAS_NORMAL_2: LinIfDelay=0.08, LinIfEntryIndex=2, LinIfFrameRef=LinIfFrame_LinFrameTriggering_LIN1_Master_Cmd
              LinIfEntry_LinScheduleTable_SCHEDULER_FRONT_PAS_NORMAL_3: LinIfDelay=0.01, LinIfEntryIndex=3, LinIfFrameRef=LinIfFrame_LinFrameTriggering_LIN1_FR_Sensor_Status
              LinIfEntry_LinScheduleTable_SCHEDULER_FRONT_PAS_NORMAL_4: LinIfDelay=0.08, LinIfEntryIndex=4, LinIfFrameRef=LinIfFrame_LinFrameTriggering_LIN1_Master_Cmd
              LinIfEntry_LinScheduleTable_SCHEDULER_FRONT_PAS_NORMAL_5: LinIfDelay=0.01, LinIfEntryIndex=5, LinIfFrameRef=LinIfFrame_LinFrameTriggering_LIN1_FL_Sensor_Status
              LinIfEntry_LinScheduleTable_SCHEDULER_FRONT_PAS_NORMAL_6: LinIfDelay=0.01, LinIfEntryIndex=6, LinIfFrameRef=LinIfFrame_LinFrameTriggering_LIN1_FCL_Sensor_Status
              LinIfEntry_LinScheduleTable_SCHEDULER_FRONT_PAS_NORMAL_7: LinIfDelay=0.01, LinIfEntryIndex=7, LinIfFrameRef=LinIfFrame_LinFrameTriggering_LIN1_FCR_Sensor_Status
              LinIfEntry_LinScheduleTable_SCHEDULER_FRONT_PAS_NORMAL_8: LinIfDelay=0.08, LinIfEntryIndex=8, LinIfFrameRef=LinIfFrame_LinFrameTriggering_LIN1_Master_Cmd
              LinIfEntry_LinScheduleTable_SCHEDULER_FRONT_PAS_NORMAL_9: LinIfDelay=0.01, LinIfEntryIndex=9, LinIfFrameRef=LinIfFrame_LinFrameTriggering_LIN1_FCL_Sensor_Status
              LinIfEntry_LinScheduleTable_SCHEDULER_FRONT_PAS_NORMAL_10: LinIfDelay=0.01, LinIfEntryIndex=10, LinIfFrameRef=LinIfFrame_LinFrameTriggering_LIN1_FCR_Sensor_Status
              LinIfEntry_LinScheduleTable_SCHEDULER_FRONT_PAS_NORMAL_11: LinIfDelay=0.01, LinIfEntryIndex=11, LinIfFrameRef=LinIfFrame_LinFrameTriggering_LIN1_FR_Sensor_Status
          LinIfScheduleTable_LIN1_SCHEDULER_PAS_DIAG_IBU: LinIfScheduleTableIndex=6
            LinIfEntry_LinScheduleTable_SCHEDULER_PAS_DIAG_IBU_0 (LinIfEntry): category=TOOL_CONFIGURED, LinIfDelay=0.01, LinIfEntryIndex=0, LinIfFrameRef=LinIfFrame_LinFrameTriggering_LIN1_Master_Cmd
          LinIfScheduleTable_LIN1_SCHEDULER_PAS_DIAG_FL: LinIfScheduleTableIndex=7
            LinIfEntry_LinScheduleTable_SCHEDULER_PAS_DIAG_FL_0 (LinIfEntry): category=TOOL_CONFIGURED, LinIfDelay=0.01, LinIfEntryIndex=0, LinIfFrameRef=LinIfFrame_LinFrameTriggering_LIN1_FL_Sensor_Status
          LinIfScheduleTable_LIN1_SCHEDULER_PAS_DIAG_FCL: LinIfScheduleTableIndex=8
            LinIfEntry_LinScheduleTable_SCHEDULER_PAS_DIAG_FCL_0 (LinIfEntry): category=TOOL_CONFIGURED, LinIfDelay=0.01, LinIfEntryIndex=0, LinIfFrameRef=LinIfFrame_LinFrameTriggering_LIN1_FCL_Sensor_Status
          LinIfScheduleTable_LIN1_SCHEDULER_PAS_DIAG_FCR: LinIfScheduleTableIndex=9
            LinIfEntry_LinScheduleTable_SCHEDULER_PAS_DIAG_FCR_0 (LinIfEntry): category=TOOL_CONFIGURED, LinIfDelay=0.01, LinIfEntryIndex=0, LinIfFrameRef=LinIfFrame_LinFrameTriggering_LIN1_FCR_Sensor_Status
          LinIfScheduleTable_LIN1_SCHEDULER_PAS_DIAG_FR: LinIfScheduleTableIndex=10
            LinIfEntry_LinScheduleTable_SCHEDULER_PAS_DIAG_FR_0 (LinIfEntry): category=TOOL_CONFIGURED, LinIfDelay=0.01, LinIfEntryIndex=0, LinIfFrameRef=LinIfFrame_LinFrameTriggering_LIN1_FR_Sensor_Status
          LinIfScheduleTable_LIN1_SCHEDULER_PAS_DIAG_RL: LinIfScheduleTableIndex=11
            LinIfEntry_LinScheduleTable_SCHEDULER_PAS_DIAG_RL_0 (LinIfEntry): category=TOOL_CONFIGURED, LinIfDelay=0.01, LinIfEntryIndex=0, LinIfFrameRef=LinIfFrame_LinFrameTriggering_LIN1_RL_Sensor_Status
          LinIfScheduleTable_LIN1_SCHEDULER_PAS_DIAG_RCL: LinIfScheduleTableIndex=12
            LinIfEntry_LinScheduleTable_SCHEDULER_PAS_DIAG_RCL_0 (LinIfEntry): category=TOOL_CONFIGURED, LinIfDelay=0.01, LinIfEntryIndex=0, LinIfFrameRef=LinIfFrame_LinFrameTriggering_LIN1_RCL_Sensor_Status
          LinIfScheduleTable_LIN1_SCHEDULER_PAS_DIAG_RCR: LinIfScheduleTableIndex=13
            LinIfEntry_LinScheduleTable_SCHEDULER_PAS_DIAG_RCR_0 (LinIfEntry): category=TOOL_CONFIGURED, LinIfDelay=0.01, LinIfEntryIndex=0, LinIfFrameRef=LinIfFrame_LinFrameTriggering_LIN1_RCR_Sensor_Status
          LinIfScheduleTable_LIN1_SCHEDULER_PAS_DIAG_RR: LinIfScheduleTableIndex=14
            LinIfEntry_LinScheduleTable_SCHEDULER_PAS_DIAG_RR_0 (LinIfEntry): category=TOOL_CONFIGURED, LinIfDelay=0.01, LinIfEntryIndex=0, LinIfFrameRef=LinIfFrame_LinFrameTriggering_LIN1_RR_Sensor_Status
          LinIfScheduleTable_LIN1_SCHEDULER_RPAS_VER_CHECK: LinIfScheduleTableIndex=15
            8 x LinIfEntry, all with category=TOOL_CONFIGURED, LinIfDelay=0.015:
              LinIfEntry_LinScheduleTable_SCHEDULER_RPAS_VER_CHECK_0: LinIfEntryIndex=0, LinIfFrameRef=LinIfFrame_LinFrameTriggering_LIN1_MasterReq
              LinIfEntry_LinScheduleTable_SCHEDULER_RPAS_VER_CHECK_1: LinIfEntryIndex=1, LinIfFrameRef=LinIfFrame_LinFrameTriggering_LIN1_SlaveResp
              LinIfEntry_LinScheduleTable_SCHEDULER_RPAS_VER_CHECK_2: LinIfEntryIndex=2, LinIfFrameRef=LinIfFrame_LinFrameTriggering_LIN1_MasterReq
              LinIfEntry_LinScheduleTable_SCHEDULER_RPAS_VER_CHECK_3: LinIfEntryIndex=3, LinIfFrameRef=LinIfFrame_LinFrameTriggering_LIN1_SlaveResp
              LinIfEntry_LinScheduleTable_SCHEDULER_RPAS_VER_CHECK_4: LinIfEntryIndex=4, LinIfFrameRef=LinIfFrame_LinFrameTriggering_LIN1_MasterReq
              LinIfEntry_LinScheduleTable_SCHEDULER_RPAS_VER_CHECK_5: LinIfEntryIndex=5, LinIfFrameRef=LinIfFrame_LinFrameTriggering_LIN1_SlaveResp
              LinIfEntry_LinScheduleTable_SCHEDULER_RPAS_VER_CHECK_6: LinIfEntryIndex=6, LinIfFrameRef=LinIfFrame_LinFrameTriggering_LIN1_MasterReq
              LinIfEntry_LinScheduleTable_SCHEDULER_RPAS_VER_CHECK_7: LinIfEntryIndex=7, LinIfFrameRef=LinIfFrame_LinFrameTriggering_LIN1_SlaveResp
          LinIfScheduleTable_LIN1_SCHEDULER_FPAS_VER_CHECK: LinIfScheduleTableIndex=16
            32 x LinIfEntry, all with category=TOOL_CONFIGURED, LinIfDelay=0.015:
              LinIfEntry_LinScheduleTable_SCHEDULER_FPAS_VER_CHECK_0: LinIfEntryIndex=0, LinIfFrameRef=LinIfFrame_LinFrameTriggering_LIN1_MasterReq
              LinIfEntry_LinScheduleTable_SCHEDULER_FPAS_VER_CHECK_1: LinIfEntryIndex=1, LinIfFrameRef=LinIfFrame_LinFrameTriggering_LIN1_SlaveResp
              LinIfEntry_LinScheduleTable_SCHEDULER_FPAS_VER_CHECK_2: LinIfEntryIndex=2, LinIfFrameRef=LinIfFrame_LinFrameTriggering_LIN1_MasterReq
              LinIfEntry_LinScheduleTable_SCHEDULER_FPAS_VER_CHECK_3: LinIfEntryIndex=3, LinIfFrameRef=LinIfFrame_LinFrameTriggering_LIN1_SlaveResp
              LinIfEntry_LinScheduleTable_SCHEDULER_FPAS_VER_CHECK_4: LinIfEntryIndex=4, LinIfFrameRef=LinIfFrame_LinFrameTriggering_LIN1_MasterReq
              LinIfEntry_LinScheduleTable_SCHEDULER_FPAS_VER_CHECK_5: LinIfEntryIndex=5, LinIfFrameRef=LinIfFrame_LinFrameTriggering_LIN1_SlaveResp
              LinIfEntry_LinScheduleTable_SCHEDULER_FPAS_VER_CHECK_6: LinIfEntryIndex=6, LinIfFrameRef=LinIfFrame_LinFrameTriggering_LIN1_MasterReq
              LinIfEntry_LinScheduleTable_SCHEDULER_FPAS_VER_CHECK_7: LinIfEntryIndex=7, LinIfFrameRef=LinIfFrame_LinFrameTriggering_LIN1_SlaveResp
              LinIfEntry_LinScheduleTable_SCHEDULER_FPAS_VER_CHECK_8: LinIfEntryIndex=8, LinIfFrameRef=LinIfFrame_LinFrameTriggering_LIN1_MasterReq
              LinIfEntry_LinScheduleTable_SCHEDULER_FPAS_VER_CHECK_9: LinIfEntryIndex=9, LinIfFrameRef=LinIfFrame_LinFrameTriggering_LIN1_SlaveResp
              LinIfEntry_LinScheduleTable_SCHEDULER_FPAS_VER_CHECK_10: LinIfEntryIndex=10, LinIfFrameRef=LinIfFrame_LinFrameTriggering_LIN1_MasterReq
              LinIfEntry_LinScheduleTable_SCHEDULER_FPAS_VER_CHECK_11: LinIfEntryIndex=11, LinIfFrameRef=LinIfFrame_LinFrameTriggering_LIN1_SlaveResp
              LinIfEntry_LinScheduleTable_SCHEDULER_FPAS_VER_CHECK_12: LinIfEntryIndex=12, LinIfFrameRef=LinIfFrame_LinFrameTriggering_LIN1_MasterReq
              LinIfEntry_LinScheduleTable_SCHEDULER_FPAS_VER_CHECK_13: LinIfEntryIndex=13, LinIfFrameRef=LinIfFrame_LinFrameTriggering_LIN1_SlaveResp
              LinIfEntry_LinScheduleTable_SCHEDULER_FPAS_VER_CHECK_14: LinIfEntryIndex=14, LinIfFrameRef=LinIfFrame_LinFrameTriggering_LIN1_MasterReq
              LinIfEntry_LinScheduleTable_SCHEDULER_FPAS_VER_CHECK_15: LinIfEntryIndex=15, LinIfFrameRef=LinIfFrame_LinFrameTriggering_LIN1_SlaveResp
              LinIfEntry_LinScheduleTable_SCHEDULER_FPAS_VER_CHECK_16: LinIfEntryIndex=16, LinIfFrameRef=LinIfFrame_LinFrameTriggering_LIN1_MasterReq
              LinIfEntry_LinScheduleTable_SCHEDULER_FPAS_VER_CHECK_17: LinIfEntryIndex=17, LinIfFrameRef=LinIfFrame_LinFrameTriggering_LIN1_SlaveResp
              LinIfEntry_LinScheduleTable_SCHEDULER_FPAS_VER_CHECK_18: LinIfEntryIndex=18, LinIfFrameRef=LinIfFrame_LinFrameTriggering_LIN1_MasterReq
              LinIfEntry_LinScheduleTable_SCHEDULER_FPAS_VER_CHECK_19: LinIfEntryIndex=19, LinIfFrameRef=LinIfFrame_LinFrameTriggering_LIN1_SlaveResp
              LinIfEntry_LinScheduleTable_SCHEDULER_FPAS_VER_CHECK_20: LinIfEntryIndex=20, LinIfFrameRef=LinIfFrame_LinFrameTriggering_LIN1_MasterReq
              LinIfEntry_LinScheduleTable_SCHEDULER_FPAS_VER_CHECK_21: LinIfEntryIndex=21, LinIfFrameRef=LinIfFrame_LinFrameTriggering_LIN1_SlaveResp
              LinIfEntry_LinScheduleTable_SCHEDULER_FPAS_VER_CHECK_22: LinIfEntryIndex=22, LinIfFrameRef=LinIfFrame_LinFrameTriggering_LIN1_MasterReq
              LinIfEntry_LinScheduleTable_SCHEDULER_FPAS_VER_CHECK_23: LinIfEntryIndex=23, LinIfFrameRef=LinIfFrame_LinFrameTriggering_LIN1_SlaveResp
              LinIfEntry_LinScheduleTable_SCHEDULER_FPAS_VER_CHECK_24: LinIfEntryIndex=24, LinIfFrameRef=LinIfFrame_LinFrameTriggering_LIN1_MasterReq
              LinIfEntry_LinScheduleTable_SCHEDULER_FPAS_VER_CHECK_25: LinIfEntryIndex=25, LinIfFrameRef=LinIfFrame_LinFrameTriggering_LIN1_SlaveResp
              LinIfEntry_LinScheduleTable_SCHEDULER_FPAS_VER_CHECK_26: LinIfEntryIndex=26, LinIfFrameRef=LinIfFrame_LinFrameTriggering_LIN1_MasterReq
              LinIfEntry_LinScheduleTable_SCHEDULER_FPAS_VER_CHECK_27: LinIfEntryIndex=27, LinIfFrameRef=LinIfFrame_LinFrameTriggering_LIN1_SlaveResp
              LinIfEntry_LinScheduleTable_SCHEDULER_FPAS_VER_CHECK_28: LinIfEntryIndex=28, LinIfFrameRef=LinIfFrame_LinFrameTriggering_LIN1_MasterReq
              LinIfEntry_LinScheduleTable_SCHEDULER_FPAS_VER_CHECK_29: LinIfEntryIndex=29, LinIfFrameRef=LinIfFrame_LinFrameTriggering_LIN1_SlaveResp
              LinIfEntry_LinScheduleTable_SCHEDULER_FPAS_VER_CHECK_30: LinIfEntryIndex=30, LinIfFrameRef=LinIfFrame_LinFrameTriggering_LIN1_MasterReq
              LinIfEntry_LinScheduleTable_SCHEDULER_FPAS_VER_CHECK_31: LinIfEntryIndex=31, LinIfFrameRef=LinIfFrame_LinFrameTriggering_LIN1_SlaveResp
          LinIfScheduleTable_LIN1_SCHEDULER_RPAS_TUNNING_WRITE: LinIfScheduleTableIndex=17
            16 x LinIfEntry, all with category=TOOL_CONFIGURED, LinIfDelay=0.015, LinIfFrameRef=LinIfFrame_LinFrameTriggering_LIN1_MasterReq:
              LinIfEntry_LinScheduleTable_SCHEDULER_RPAS_TUNNING_WRITE_{0..15}: LinIfEntryIndex={0..15}
          LinIfScheduleTable_LIN1_SCHEDULER_RPAS_TEMP_COMP: LinIfScheduleTableIndex=18
            4 x LinIfEntry, all with category=TOOL_CONFIGURED, LinIfDelay=0.015, LinIfFrameRef=LinIfFrame_LinFrameTriggering_LIN1_MasterReq:
              LinIfEntry_LinScheduleTable_SCHEDULER_RPAS_TEMP_COMP_{0..3}: LinIfEntryIndex={0..3}
          LinIfScheduleTable_LIN1_SCHEDULER_FPAS_TUNNING_WRITE: LinIfScheduleTableIndex=19
            32 x LinIfEntry, all with category=TOOL_CONFIGURED, LinIfDelay=0.015, LinIfFrameRef=LinIfFrame_LinFrameTriggering_LIN1_MasterReq:
              LinIfEntry_LinScheduleTable_SCHEDULER_FPAS_TUNNING_WRITE_{0..31}: LinIfEntryIndex={0..31}
          LinIfScheduleTable_LIN1_SCHEDULER_PAS_TEMP_COMP: LinIfScheduleTableIndex=20
            8 x LinIfEntry, all with category=TOOL_CONFIGURED, LinIfDelay=0.015, LinIfFrameRef=LinIfFrame_LinFrameTriggering_LIN1_MasterReq:
              LinIfEntry_LinScheduleTable_SCHEDULER_PAS_TEMP_COMP_{0..7}: LinIfEntryIndex={0..7}
          LinIfScheduleTable_LIN1_SCHEDULER_PAS_DIAG: LinIfScheduleTableIndex=21
            LinIfEntry_LinScheduleTable_SCHEDULER_PAS_DIAG_0 (LinIfEntry): category=TOOL_CONFIGURED, LinIfDelay=0.015, LinIfEntryIndex=0, LinIfFrameRef=LinIfFrame_LinFrameTriggering_LIN1_MasterReq
            LinIfEntry_LinScheduleTable_SCHEDULER_PAS_DIAG_1 (LinIfEntry): category=TOOL_CONFIGURED, LinIfDelay=0.015, LinIfEntryIndex=1, LinIfFrameRef=LinIfFrame_LinFrameTriggering_LIN1_SlaveResp
          LinIfScheduleTable_LIN1_SCHEDULER_PAS_SENSOR_REQUEST: LinIfScheduleTableIndex=22
            LinIfEntry_LinScheduleTable_SCHEDULER_PAS_SENSOR_REQUEST_0 (LinIfEntry): category=TOOL_CONFIGURED, LinIfDelay=0.015, LinIfEntryIndex=0, LinIfFrameRef=LinIfFrame_LinFrameTriggering_LIN1_MasterReq
        LinIfTransceiverDrvConfig: LinIfTrcvIdRef=LIN1
      LinIfChannel_LIN2 (LinIfChannel):
        category = TOOL_CONFIGURED
        LinIfGotoSleepConfirmationUL = LIN_SM
        LinIfScheduleRequestConfirmationUL = LIN_SM
        LinIfWakeupConfirmationUL = LIN_SM
        LinIfErrorNotificationFunction = Rte_Call_CallbackError_lin_cbk_err
        LinIfAfterScheduleFunction = Rte_Call_CallbackAfterSchedule_lin_after_schedule
        LinIfBusIdleTimeoutPeriod = 0.1
        LinIfMainFunctionPeriod = 0.005
        LinIfComMNetworkHandleRef = ComMChannel_LIN2
        LinIfChannelRef = LinChannel_LIN2
        LinIfNodeType: category=TOOL_CONFIGURED
          LinIfMaster_LIN2 (LinIfMaster): category=TOOL_CONFIGURED, LinIfJitter=0.0
        11 x LinIfFrame, all with category=TOOL_CONFIGURED:
          LinIfFrame_LinFrameTriggering_LIN2_Master_Cmd: LinIfFrameId=8, LinIfChecksumType=ENHANCED, LinIfFrameType=UNCONDITIONAL
            LinIfPduDirection: category=TOOL_CONFIGURED
              LinIfTxPdu_LinFrameTriggering_LIN2_Master_Cmd_FramePort_LIN2_Master_Cmd (LinIfTxPdu): category=TOOL_CONFIGURED, LinIfTxPduId=0, LinIfUserTxUL=PDUR, LinIfTxPduRef=Pdu_ISignalIPdu_LIN2_Master_Cmd
          LinIfFrame_LinFrameTriggering_LIN2_FL_Sensor_Status: LinIfFrameId=4, LinIfChecksumType=ENHANCED, LinIfFrameType=UNCONDITIONAL
            LinIfPduDirection: category=TOOL_CONFIGURED
              LinIfRxPdu_LinFrameTriggering_LIN2_FL_Sensor_Status_FramePort_LIN2_FL_Sensor_Status (LinIfRxPdu): category=TOOL_CONFIGURED, LinIfUserRxIndicationUL=PDUR, LinIfRxPduRef=Pdu_ISignalIPdu_LIN2_FL_Sensor_Status
          LinIfFrame_LinFrameTriggering_LIN2_FCL_Sensor_Status: LinIfFrameId=5, LinIfChecksumType=ENHANCED, LinIfFrameType=UNCONDITIONAL
            LinIfPduDirection: category=TOOL_CONFIGURED
              LinIfRxPdu_LinFrameTriggering_LIN2_FCL_Sensor_Status_FramePort_LIN2_FCL_Sensor_Status (LinIfRxPdu): category=TOOL_CONFIGURED, LinIfUserRxIndicationUL=PDUR, LinIfRxPduRef=Pdu_ISignalIPdu_LIN2_FCL_Sensor_Status
          LinIfFrame_LinFrameTriggering_LIN2_FCR_Sensor_Status: LinIfFrameId=6, LinIfChecksumType=ENHANCED, LinIfFrameType=UNCONDITIONAL
            LinIfPduDirection: category=TOOL_CONFIGURED
              LinIfRxPdu_LinFrameTriggering_LIN2_FCR_Sensor_Status_FramePort_LIN2_FCR_Sensor_Status (LinIfRxPdu): category=TOOL_CONFIGURED, LinIfUserRxIndicationUL=PDUR, LinIfRxPduRef=Pdu_ISignalIPdu_LIN2_FCR_Sensor_Status
          LinIfFrame_LinFrameTriggering_LIN2_FR_Sensor_Status: LinIfFrameId=7, LinIfChecksumType=ENHANCED, LinIfFrameType=UNCONDITIONAL
            LinIfPduDirection: category=TOOL_CONFIGURED
              LinIfRxPdu_LinFrameTriggering_LIN2_FR_Sensor_Status_FramePort_LIN2_FR_Sensor_Status (LinIfRxPdu): category=TOOL_CONFIGURED, LinIfUserRxIndicationUL=PDUR, LinIfRxPduRef=Pdu_ISignalIPdu_LIN2_FR_Sensor_Status
          LinIfFrame_LinFrameTriggering_LIN2_RL_Sensor_Status: LinIfFrameId=0, LinIfChecksumType=ENHANCED, LinIfFrameType=UNCONDITIONAL
            LinIfPduDirection: category=TOOL_CONFIGURED
              LinIfRxPdu_LinFrameTriggering_LIN2_RL_Sensor_Status_FramePort_LIN2_RL_Sensor_Status (LinIfRxPdu): category=TOOL_CONFIGURED, LinIfUserRxIndicationUL=PDUR, LinIfRxPduRef=Pdu_ISignalIPdu_LIN2_RL_Sensor_Status
          LinIfFrame_LinFrameTriggering_LIN2_RCL_Sensor_Status: LinIfFrameId=1, LinIfChecksumType=ENHANCED, LinIfFrameType=UNCONDITIONAL
            LinIfPduDirection: category=TOOL_CONFIGURED
              LinIfRxPdu_LinFrameTriggering_LIN2_RCL_Sensor_Status_FramePort_LIN2_RCL_Sensor_Status (LinIfRxPdu): category=TOOL_CONFIGURED, LinIfUserRxIndicationUL=PDUR, LinIfRxPduRef=Pdu_ISignalIPdu_LIN2_RCL_Sensor_Status
          LinIfFrame_LinFrameTriggering_LIN2_RCR_Sensor_Status: LinIfFrameId=2, LinIfChecksumType=ENHANCED, LinIfFrameType=UNCONDITIONAL
            LinIfPduDirection: category=TOOL_CONFIGURED
              LinIfRxPdu_LinFrameTriggering_LIN2_RCR_Sensor_Status_FramePort_LIN2_RCR_Sensor_Status (LinIfRxPdu): category=TOOL_CONFIGURED, LinIfUserRxIndicationUL=PDUR, LinIfRxPduRef=Pdu_ISignalIPdu_LIN2_RCR_Sensor_Status
          LinIfFrame_LinFrameTriggering_LIN2_RR_Sensor_Status: LinIfFrameId=3, LinIfChecksumType=ENHANCED, LinIfFrameType=UNCONDITIONAL
            LinIfPduDirection: category=TOOL_CONFIGURED
              LinIfRxPdu_LinFrameTriggering_LIN2_RR_Sensor_Status_FramePort_LIN2_RR_Sensor_Status (LinIfRxPdu): category=TOOL_CONFIGURED, LinIfUserRxIndicationUL=PDUR, LinIfRxPduRef=Pdu_ISignalIPdu_LIN2_RR_Sensor_Status
          LinIfFrame_LinFrameTriggering_LIN2_MasterReq: LinIfFrameId=60, LinIfChecksumType=CLASSIC, LinIfFrameType=MRF
            LinIfPduDirection: category=TOOL_CONFIGURED
              LinIfTxPdu_LinFrameTriggering_LIN2_MasterReq_FramePort_LIN2_MasterReq (LinIfTxPdu): category=TOOL_CONFIGURED, LinIfTxPduId=9, LinIfUserTxUL=PDUR, LinIfTxPduRef=Pdu_DcmIPdu_LIN2_MasterReq
          LinIfFrame_LinFrameTriggering_LIN2_SlaveResp: LinIfFrameId=61, LinIfChecksumType=CLASSIC, LinIfFrameType=SRF
            LinIfPduDirection: category=TOOL_CONFIGURED
              LinIfRxPdu_LinFrameTriggering_LIN2_SlaveResp_FramePort_LIN2_SlaveResp (LinIfRxPdu): category=TOOL_CONFIGURED, LinIfUserRxIndicationUL=PDUR, LinIfRxPduRef=Pdu_DcmIPdu_LIN2_SlaveResp
        23 x LinIfScheduleTable, all with category=TOOL_CONFIGURED, LinIfResumePosition=START_FROM_BEGINNING, LinIfRunMode=RUN_CONTINUOUS:
          LinIfScheduleTable_LIN2_NULL: LinIfScheduleTableIndex=0
          LinIfScheduleTable_LIN2_SCHEDULER_RPAS_NORMAL: LinIfScheduleTableIndex=1
            12 x LinIfEntry, all with category=TOOL_CONFIGURED:
              LinIfEntry_LinScheduleTable_SCHEDULER_RPAS_NORMAL_0: LinIfDelay=0.08, LinIfEntryIndex=0, LinIfFrameRef=LinIfFrame_LinFrameTriggering_LIN2_Master_Cmd
              LinIfEntry_LinScheduleTable_SCHEDULER_RPAS_NORMAL_1: LinIfDelay=0.01, LinIfEntryIndex=1, LinIfFrameRef=LinIfFrame_LinFrameTriggering_LIN2_RL_Sensor_Status
              LinIfEntry_LinScheduleTable_SCHEDULER_RPAS_NORMAL_2: LinIfDelay=0.08, LinIfEntryIndex=2, LinIfFrameRef=LinIfFrame_LinFrameTriggering_LIN2_Master_Cmd
              LinIfEntry_LinScheduleTable_SCHEDULER_RPAS_NORMAL_3: LinIfDelay=0.01, LinIfEntryIndex=3, LinIfFrameRef=LinIfFrame_LinFrameTriggering_LIN2_RR_Sensor_Status
              LinIfEntry_LinScheduleTable_SCHEDULER_RPAS_NORMAL_4: LinIfDelay=0.08, LinIfEntryIndex=4, LinIfFrameRef=LinIfFrame_LinFrameTriggering_LIN2_Master_Cmd
              LinIfEntry_LinScheduleTable_SCHEDULER_RPAS_NORMAL_5: LinIfDelay=0.01, LinIfEntryIndex=5, LinIfFrameRef=LinIfFrame_LinFrameTriggering_LIN2_RL_Sensor_Status
              LinIfEntry_LinScheduleTable_SCHEDULER_RPAS_NORMAL_6: LinIfDelay=0.01, LinIfEntryIndex=6, LinIfFrameRef=LinIfFrame_LinFrameTriggering_LIN2_RCL_Sensor_Status
              LinIfEntry_LinScheduleTable_SCHEDULER_RPAS_NORMAL_7: LinIfDelay=0.01, LinIfEntryIndex=7, LinIfFrameRef=LinIfFrame_LinFrameTriggering_LIN2_RCR_Sensor_Status
              LinIfEntry_LinScheduleTable_SCHEDULER_RPAS_NORMAL_8: LinIfDelay=0.08, LinIfEntryIndex=8, LinIfFrameRef=LinIfFrame_LinFrameTriggering_LIN2_Master_Cmd
              LinIfEntry_LinScheduleTable_SCHEDULER_RPAS_NORMAL_9: LinIfDelay=0.01, LinIfEntryIndex=9, LinIfFrameRef=LinIfFrame_LinFrameTriggering_LIN2_RCL_Sensor_Status
              LinIfEntry_LinScheduleTable_SCHEDULER_RPAS_NORMAL_10: LinIfDelay=0.01, LinIfEntryIndex=10, LinIfFrameRef=LinIfFrame_LinFrameTriggering_LIN2_RCR_Sensor_Status
              LinIfEntry_LinScheduleTable_SCHEDULER_RPAS_NORMAL_11: LinIfDelay=0.01, LinIfEntryIndex=11, LinIfFrameRef=LinIfFrame_LinFrameTriggering_LIN2_RR_Sensor_Status
          LinIfScheduleTable_LIN2_SCHEDULER_RPAS_CRC_COMPARE: LinIfScheduleTableIndex=2
            5 x LinIfEntry, all with category=TOOL_CONFIGURED:
              LinIfEntry_LinScheduleTable_SCHEDULER_RPAS_CRC_COMPARE_0: LinIfDelay=0.02, LinIfEntryIndex=0, LinIfFrameRef=LinIfFrame_LinFrameTriggering_LIN2_Master_Cmd
              LinIfEntry_LinScheduleTable_SCHEDULER_RPAS_CRC_COMPARE_1: LinIfDelay=0.01, LinIfEntryIndex=1, LinIfFrameRef=LinIfFrame_LinFrameTriggering_LIN2_RL_Sensor_Status
              LinIfEntry_LinScheduleTable_SCHEDULER_RPAS_CRC_COMPARE_2: LinIfDelay=0.01, LinIfEntryIndex=2, LinIfFrameRef=LinIfFrame_LinFrameTriggering_LIN2_RCL_Sensor_Status
              LinIfEntry_LinScheduleTable_SCHEDULER_RPAS_CRC_COMPARE_3: LinIfDelay=0.01, LinIfEntryIndex=3, LinIfFrameRef=LinIfFrame_LinFrameTriggering_LIN2_RCR_Sensor_Status
              LinIfEntry_LinScheduleTable_SCHEDULER_RPAS_CRC_COMPARE_4: LinIfDelay=0.01, LinIfEntryIndex=4, LinIfFrameRef=LinIfFrame_LinFrameTriggering_LIN2_RR_Sensor_Status
          LinIfScheduleTable_LIN2_SCHEDULER_PAS_NORMAL: LinIfScheduleTableIndex=3
            14 x LinIfEntry, all with category=TOOL_CONFIGURED:
              LinIfEntry_LinScheduleTable_SCHEDULER_PAS_NORMAL_0: LinIfDelay=0.08, LinIfEntryIndex=0, LinIfFrameRef=LinIfFrame_LinFrameTriggering_LIN2_Master_Cmd
              LinIfEntry_LinScheduleTable_SCHEDULER_PAS_NORMAL_1: LinIfDelay=0.01, LinIfEntryIndex=1, LinIfFrameRef=LinIfFrame_LinFrameTriggering_LIN2_RL_Sensor_Status
              LinIfEntry_LinScheduleTable_SCHEDULER_PAS_NORMAL_2: LinIfDelay=0.01, LinIfEntryIndex=2, LinIfFrameRef=LinIfFrame_LinFrameTriggering_LIN2_FR_Sensor_Status
              LinIfEntry_LinScheduleTable_SCHEDULER_PAS_NORMAL_3: LinIfDelay=0.08, LinIfEntryIndex=3, LinIfFrameRef=LinIfFrame_LinFrameTriggering_LIN2_Master_Cmd
              LinIfEntry_LinScheduleTable_SCHEDULER_PAS_NORMAL_4: LinIfDelay=0.01, LinIfEntryIndex=4, LinIfFrameRef=LinIfFrame_LinFrameTriggering_LIN2_RR_Sensor_Status
              LinIfEntry_LinScheduleTable_SCHEDULER_PAS_NORMAL_5: LinIfDelay=0.01, LinIfEntryIndex=5, LinIfFrameRef=LinIfFrame_LinFrameTriggering_LIN2_FL_Sensor_Status
              LinIfEntry_LinScheduleTable_SCHEDULER_PAS_NORMAL_6: LinIfDelay=0.08, LinIfEntryIndex=6, LinIfFrameRef=LinIfFrame_LinFrameTriggering_LIN2_Master_Cmd
              LinIfEntry_LinScheduleTable_SCHEDULER_PAS_NORMAL_7: LinIfDelay=0.01, LinIfEntryIndex=7, LinIfFrameRef=LinIfFrame_LinFrameTriggering_LIN2_RL_Sensor_Status
              LinIfEntry_LinScheduleTable_SCHEDULER_PAS_NORMAL_8: LinIfDelay=0.01, LinIfEntryIndex=8, LinIfFrameRef=LinIfFrame_LinFrameTriggering_LIN2_RCL_Sensor_Status
              LinIfEntry_LinScheduleTable_SCHEDULER_PAS_NORMAL_9: LinIfDelay=0.01, LinIfEntryIndex=9, LinIfFrameRef=LinIfFrame_LinFrameTriggering_LIN2_RCR_Sensor_Status
              LinIfEntry_LinScheduleTable_SCHEDULER_PAS_NORMAL_10: LinIfDelay=0.08, LinIfEntryIndex=10, LinIfFrameRef=LinIfFrame_LinFrameTriggering_LIN2_Master_Cmd
              LinIfEntry_LinScheduleTable_SCHEDULER_PAS_NORMAL_11: LinIfDelay=0.01, LinIfEntryIndex=11, LinIfFrameRef=LinIfFrame_LinFrameTriggering_LIN2_RCL_Sensor_Status
              LinIfEntry_LinScheduleTable_SCHEDULER_PAS_NORMAL_12: LinIfDelay=0.01, LinIfEntryIndex=12, LinIfFrameRef=LinIfFrame_LinFrameTriggering_LIN2_RCR_Sensor_Status
              LinIfEntry_LinScheduleTable_SCHEDULER_PAS_NORMAL_13: LinIfDelay=0.01, LinIfEntryIndex=13, LinIfFrameRef=LinIfFrame_LinFrameTriggering_LIN2_RR_Sensor_Status
          LinIfScheduleTable_LIN2_SCHEDULER_PAS_CRC_COMPARE: LinIfScheduleTableIndex=4
            9 x LinIfEntry, all with category=TOOL_CONFIGURED:
              LinIfEntry_LinScheduleTable_SCHEDULER_PAS_CRC_COMPARE_0: LinIfDelay=0.02, LinIfEntryIndex=0, LinIfFrameRef=LinIfFrame_LinFrameTriggering_LIN2_Master_Cmd
              LinIfEntry_LinScheduleTable_SCHEDULER_PAS_CRC_COMPARE_1: LinIfDelay=0.01, LinIfEntryIndex=1, LinIfFrameRef=LinIfFrame_LinFrameTriggering_LIN2_RL_Sensor_Status
              LinIfEntry_LinScheduleTable_SCHEDULER_PAS_CRC_COMPARE_2: LinIfDelay=0.01, LinIfEntryIndex=2, LinIfFrameRef=LinIfFrame_LinFrameTriggering_LIN2_RCL_Sensor_Status
              LinIfEntry_LinScheduleTable_SCHEDULER_PAS_CRC_COMPARE_3: LinIfDelay=0.01, LinIfEntryIndex=3, LinIfFrameRef=LinIfFrame_LinFrameTriggering_LIN2_RCR_Sensor_Status
              LinIfEntry_LinScheduleTable_SCHEDULER_PAS_CRC_COMPARE_4: LinIfDelay=0.01, LinIfEntryIndex=4, LinIfFrameRef=LinIfFrame_LinFrameTriggering_LIN2_RR_Sensor_Status
              LinIfEntry_LinScheduleTable_SCHEDULER_PAS_CRC_COMPARE_5: LinIfDelay=0.01, LinIfEntryIndex=5, LinIfFrameRef=LinIfFrame_LinFrameTriggering_LIN2_FL_Sensor_Status
              LinIfEntry_LinScheduleTable_SCHEDULER_PAS_CRC_COMPARE_6: LinIfDelay=0.01, LinIfEntryIndex=6, LinIfFrameRef=LinIfFrame_LinFrameTriggering_LIN2_FCL_Sensor_Status
              LinIfEntry_LinScheduleTable_SCHEDULER_PAS_CRC_COMPARE_7: LinIfDelay=0.01, LinIfEntryIndex=7, LinIfFrameRef=LinIfFrame_LinFrameTriggering_LIN2_FCR_Sensor_Status
              LinIfEntry_LinScheduleTable_SCHEDULER_PAS_CRC_COMPARE_8: LinIfDelay=0.01, LinIfEntryIndex=8, LinIfFrameRef=LinIfFrame_LinFrameTriggering_LIN2_FR_Sensor_Status
          LinIfScheduleTable_LIN2_SCHEDULER_FRONT_PAS_NORMAL: LinIfScheduleTableIndex=5
            12 x LinIfEntry, all with category=TOOL_CONFIGURED:
              LinIfEntry_LinScheduleTable_SCHEDULER_FRONT_PAS_NORMAL_0: LinIfDelay=0.08, LinIfEntryIndex=0, LinIfFrameRef=LinIfFrame_LinFrameTriggering_LIN2_Master_Cmd
              LinIfEntry_LinScheduleTable_SCHEDULER_FRONT_PAS_NORMAL_1: LinIfDelay=0.01, LinIfEntryIndex=1, LinIfFrameRef=LinIfFrame_LinFrameTriggering_LIN2_FL_Sensor_Status
              LinIfEntry_LinScheduleTable_SCHEDULER_FRONT_PAS_NORMAL_2: LinIfDelay=0.08, LinIfEntryIndex=2, LinIfFrameRef=LinIfFrame_LinFrameTriggering_LIN2_Master_Cmd
              LinIfEntry_LinScheduleTable_SCHEDULER_FRONT_PAS_NORMAL_3: LinIfDelay=0.01, LinIfEntryIndex=3, LinIfFrameRef=LinIfFrame_LinFrameTriggering_LIN2_FR_Sensor_Status
              LinIfEntry_LinScheduleTable_SCHEDULER_FRONT_PAS_NORMAL_4: LinIfDelay=0.08, LinIfEntryIndex=4, LinIfFrameRef=LinIfFrame_LinFrameTriggering_LIN2_Master_Cmd
              LinIfEntry_LinScheduleTable_SCHEDULER_FRONT_PAS_NORMAL_5: LinIfDelay=0.01, LinIfEntryIndex=5, LinIfFrameRef=LinIfFrame_LinFrameTriggering_LIN2_FL_Sensor_Status
              LinIfEntry_LinScheduleTable_SCHEDULER_FRONT_PAS_NORMAL_6: LinIfDelay=0.01, LinIfEntryIndex=6, LinIfFrameRef=LinIfFrame_LinFrameTriggering_LIN2_FCL_Sensor_Status
              LinIfEntry_LinScheduleTable_SCHEDULER_FRONT_PAS_NORMAL_7: LinIfDelay=0.01, LinIfEntryIndex=7, LinIfFrameRef=LinIfFrame_LinFrameTriggering_LIN2_FCR_Sensor_Status
              LinIfEntry_LinScheduleTable_SCHEDULER_FRONT_PAS_NORMAL_8: LinIfDelay=0.08, LinIfEntryIndex=8, LinIfFrameRef=LinIfFrame_LinFrameTriggering_LIN2_Master_Cmd
              LinIfEntry_LinScheduleTable_SCHEDULER_FRONT_PAS_NORMAL_9: LinIfDelay=0.01, LinIfEntryIndex=9, LinIfFrameRef=LinIfFrame_LinFrameTriggering_LIN2_FCL_Sensor_Status
              LinIfEntry_LinScheduleTable_SCHEDULER_FRONT_PAS_NORMAL_10: LinIfDelay=0.01, LinIfEntryIndex=10, LinIfFrameRef=LinIfFrame_LinFrameTriggering_LIN2_FCR_Sensor_Status
              LinIfEntry_LinScheduleTable_SCHEDULER_FRONT_PAS_NORMAL_11: LinIfDelay=0.01, LinIfEntryIndex=11, LinIfFrameRef=LinIfFrame_LinFrameTriggering_LIN2_FR_Sensor_Status
          LinIfScheduleTable_LIN2_SCHEDULER_PAS_DIAG_IBU: LinIfScheduleTableIndex=6
            LinIfEntry_LinScheduleTable_SCHEDULER_PAS_DIAG_IBU_0 (LinIfEntry): category=TOOL_CONFIGURED, LinIfDelay=0.01, LinIfEntryIndex=0, LinIfFrameRef=LinIfFrame_LinFrameTriggering_LIN2_Master_Cmd
          LinIfScheduleTable_LIN2_SCHEDULER_PAS_DIAG_FL: LinIfScheduleTableIndex=7
            LinIfEntry_LinScheduleTable_SCHEDULER_PAS_DIAG_FL_0 (LinIfEntry): category=TOOL_CONFIGURED, LinIfDelay=0.01, LinIfEntryIndex=0, LinIfFrameRef=LinIfFrame_LinFrameTriggering_LIN2_FL_Sensor_Status
          LinIfScheduleTable_LIN2_SCHEDULER_PAS_DIAG_FCL: LinIfScheduleTableIndex=8
            LinIfEntry_LinScheduleTable_SCHEDULER_PAS_DIAG_FCL_0 (LinIfEntry): category=TOOL_CONFIGURED, LinIfDelay=0.01, LinIfEntryIndex=0, LinIfFrameRef=LinIfFrame_LinFrameTriggering_LIN2_FCL_Sensor_Status
          LinIfScheduleTable_LIN2_SCHEDULER_PAS_DIAG_FCR: LinIfScheduleTableIndex=9
            LinIfEntry_LinScheduleTable_SCHEDULER_PAS_DIAG_FCR_0 (LinIfEntry): category=TOOL_CONFIGURED, LinIfDelay=0.01, LinIfEntryIndex=0, LinIfFrameRef=LinIfFrame_LinFrameTriggering_LIN2_FCR_Sensor_Status
          LinIfScheduleTable_LIN2_SCHEDULER_PAS_DIAG_FR: LinIfScheduleTableIndex=10
            LinIfEntry_LinScheduleTable_SCHEDULER_PAS_DIAG_FR_0 (LinIfEntry): category=TOOL_CONFIGURED, LinIfDelay=0.01, LinIfEntryIndex=0, LinIfFrameRef=LinIfFrame_LinFrameTriggering_LIN2_FR_Sensor_Status
          LinIfScheduleTable_LIN2_SCHEDULER_PAS_DIAG_RL: LinIfScheduleTableIndex=11
            LinIfEntry_LinScheduleTable_SCHEDULER_PAS_DIAG_RL_0 (LinIfEntry): category=TOOL_CONFIGURED, LinIfDelay=0.01, LinIfEntryIndex=0, LinIfFrameRef=LinIfFrame_LinFrameTriggering_LIN2_RL_Sensor_Status
          LinIfScheduleTable_LIN2_SCHEDULER_PAS_DIAG_RCL: LinIfScheduleTableIndex=12
            LinIfEntry_LinScheduleTable_SCHEDULER_PAS_DIAG_RCL_0 (LinIfEntry): category=TOOL_CONFIGURED, LinIfDelay=0.01, LinIfEntryIndex=0, LinIfFrameRef=LinIfFrame_LinFrameTriggering_LIN2_RCL_Sensor_Status
          LinIfScheduleTable_LIN2_SCHEDULER_PAS_DIAG_RCR: LinIfScheduleTableIndex=13
            LinIfEntry_LinScheduleTable_SCHEDULER_PAS_DIAG_RCR_0 (LinIfEntry): category=TOOL_CONFIGURED, LinIfDelay=0.01, LinIfEntryIndex=0, LinIfFrameRef=LinIfFrame_LinFrameTriggering_LIN2_RCR_Sensor_Status
          LinIfScheduleTable_LIN2_SCHEDULER_PAS_DIAG_RR: LinIfScheduleTableIndex=14
            LinIfEntry_LinScheduleTable_SCHEDULER_PAS_DIAG_RR_0 (LinIfEntry): category=TOOL_CONFIGURED, LinIfDelay=0.01, LinIfEntryIndex=0, LinIfFrameRef=LinIfFrame_LinFrameTriggering_LIN2_RR_Sensor_Status
          LinIfScheduleTable_LIN2_SCHEDULER_RPAS_VER_CHECK: LinIfScheduleTableIndex=15
            8 x LinIfEntry, all with category=TOOL_CONFIGURED, LinIfDelay=0.015:
              LinIfEntry_LinScheduleTable_SCHEDULER_RPAS_VER_CHECK_0: LinIfEntryIndex=0, LinIfFrameRef=LinIfFrame_LinFrameTriggering_LIN2_MasterReq
              LinIfEntry_LinScheduleTable_SCHEDULER_RPAS_VER_CHECK_1: LinIfEntryIndex=1, LinIfFrameRef=LinIfFrame_LinFrameTriggering_LIN2_SlaveResp
              LinIfEntry_LinScheduleTable_SCHEDULER_RPAS_VER_CHECK_2: LinIfEntryIndex=2, LinIfFrameRef=LinIfFrame_LinFrameTriggering_LIN2_MasterReq
              LinIfEntry_LinScheduleTable_SCHEDULER_RPAS_VER_CHECK_3: LinIfEntryIndex=3, LinIfFrameRef=LinIfFrame_LinFrameTriggering_LIN2_SlaveResp
              LinIfEntry_LinScheduleTable_SCHEDULER_RPAS_VER_CHECK_4: LinIfEntryIndex=4, LinIfFrameRef=LinIfFrame_LinFrameTriggering_LIN2_MasterReq
              LinIfEntry_LinScheduleTable_SCHEDULER_RPAS_VER_CHECK_5: LinIfEntryIndex=5, LinIfFrameRef=LinIfFrame_LinFrameTriggering_LIN2_SlaveResp
              LinIfEntry_LinScheduleTable_SCHEDULER_RPAS_VER_CHECK_6: LinIfEntryIndex=6, LinIfFrameRef=LinIfFrame_LinFrameTriggering_LIN2_MasterReq
              LinIfEntry_LinScheduleTable_SCHEDULER_RPAS_VER_CHECK_7: LinIfEntryIndex=7, LinIfFrameRef=LinIfFrame_LinFrameTriggering_LIN2_SlaveResp
          LinIfScheduleTable_LIN2_SCHEDULER_FPAS_VER_CHECK: LinIfScheduleTableIndex=16
            32 x LinIfEntry, all with category=TOOL_CONFIGURED, LinIfDelay=0.015:
              LinIfEntry_LinScheduleTable_SCHEDULER_FPAS_VER_CHECK_0: LinIfEntryIndex=0, LinIfFrameRef=LinIfFrame_LinFrameTriggering_LIN2_MasterReq
              LinIfEntry_LinScheduleTable_SCHEDULER_FPAS_VER_CHECK_1: LinIfEntryIndex=1, LinIfFrameRef=LinIfFrame_LinFrameTriggering_LIN2_SlaveResp
              LinIfEntry_LinScheduleTable_SCHEDULER_FPAS_VER_CHECK_2: LinIfEntryIndex=2, LinIfFrameRef=LinIfFrame_LinFrameTriggering_LIN2_MasterReq
              LinIfEntry_LinScheduleTable_SCHEDULER_FPAS_VER_CHECK_3: LinIfEntryIndex=3, LinIfFrameRef=LinIfFrame_LinFrameTriggering_LIN2_SlaveResp
              LinIfEntry_LinScheduleTable_SCHEDULER_FPAS_VER_CHECK_4: LinIfEntryIndex=4, LinIfFrameRef=LinIfFrame_LinFrameTriggering_LIN2_MasterReq
              LinIfEntry_LinScheduleTable_SCHEDULER_FPAS_VER_CHECK_5: LinIfEntryIndex=5, LinIfFrameRef=LinIfFrame_LinFrameTriggering_LIN2_SlaveResp
              LinIfEntry_LinScheduleTable_SCHEDULER_FPAS_VER_CHECK_6: LinIfEntryIndex=6, LinIfFrameRef=LinIfFrame_LinFrameTriggering_LIN2_MasterReq
              LinIfEntry_LinScheduleTable_SCHEDULER_FPAS_VER_CHECK_7: LinIfEntryIndex=7, LinIfFrameRef=LinIfFrame_LinFrameTriggering_LIN2_SlaveResp
              LinIfEntry_LinScheduleTable_SCHEDULER_FPAS_VER_CHECK_8: LinIfEntryIndex=8, LinIfFrameRef=LinIfFrame_LinFrameTriggering_LIN2_MasterReq
              LinIfEntry_LinScheduleTable_SCHEDULER_FPAS_VER_CHECK_9: LinIfEntryIndex=9, LinIfFrameRef=LinIfFrame_LinFrameTriggering_LIN2_SlaveResp
              LinIfEntry_LinScheduleTable_SCHEDULER_FPAS_VER_CHECK_10: LinIfEntryIndex=10, LinIfFrameRef=LinIfFrame_LinFrameTriggering_LIN2_MasterReq
              LinIfEntry_LinScheduleTable_SCHEDULER_FPAS_VER_CHECK_11: LinIfEntryIndex=11, LinIfFrameRef=LinIfFrame_LinFrameTriggering_LIN2_SlaveResp
              LinIfEntry_LinScheduleTable_SCHEDULER_FPAS_VER_CHECK_12: LinIfEntryIndex=12, LinIfFrameRef=LinIfFrame_LinFrameTriggering_LIN2_MasterReq
              LinIfEntry_LinScheduleTable_SCHEDULER_FPAS_VER_CHECK_13: LinIfEntryIndex=13, LinIfFrameRef=LinIfFrame_LinFrameTriggering_LIN2_SlaveResp
              LinIfEntry_LinScheduleTable_SCHEDULER_FPAS_VER_CHECK_14: LinIfEntryIndex=14, LinIfFrameRef=LinIfFrame_LinFrameTriggering_LIN2_MasterReq
              LinIfEntry_LinScheduleTable_SCHEDULER_FPAS_VER_CHECK_15: LinIfEntryIndex=15, LinIfFrameRef=LinIfFrame_LinFrameTriggering_LIN2_SlaveResp
              LinIfEntry_LinScheduleTable_SCHEDULER_FPAS_VER_CHECK_16: LinIfEntryIndex=16, LinIfFrameRef=LinIfFrame_LinFrameTriggering_LIN2_MasterReq
              LinIfEntry_LinScheduleTable_SCHEDULER_FPAS_VER_CHECK_17: LinIfEntryIndex=17, LinIfFrameRef=LinIfFrame_LinFrameTriggering_LIN2_SlaveResp
              LinIfEntry_LinScheduleTable_SCHEDULER_FPAS_VER_CHECK_18: LinIfEntryIndex=18, LinIfFrameRef=LinIfFrame_LinFrameTriggering_LIN2_MasterReq
              LinIfEntry_LinScheduleTable_SCHEDULER_FPAS_VER_CHECK_19: LinIfEntryIndex=19, LinIfFrameRef=LinIfFrame_LinFrameTriggering_LIN2_SlaveResp
              LinIfEntry_LinScheduleTable_SCHEDULER_FPAS_VER_CHECK_20: LinIfEntryIndex=20, LinIfFrameRef=LinIfFrame_LinFrameTriggering_LIN2_MasterReq
              LinIfEntry_LinScheduleTable_SCHEDULER_FPAS_VER_CHECK_21: LinIfEntryIndex=21, LinIfFrameRef=LinIfFrame_LinFrameTriggering_LIN2_SlaveResp
              LinIfEntry_LinScheduleTable_SCHEDULER_FPAS_VER_CHECK_22: LinIfEntryIndex=22, LinIfFrameRef=LinIfFrame_LinFrameTriggering_LIN2_MasterReq
              LinIfEntry_LinScheduleTable_SCHEDULER_FPAS_VER_CHECK_23: LinIfEntryIndex=23, LinIfFrameRef=LinIfFrame_LinFrameTriggering_LIN2_SlaveResp
              LinIfEntry_LinScheduleTable_SCHEDULER_FPAS_VER_CHECK_24: LinIfEntryIndex=24, LinIfFrameRef=LinIfFrame_LinFrameTriggering_LIN2_MasterReq
              LinIfEntry_LinScheduleTable_SCHEDULER_FPAS_VER_CHECK_25: LinIfEntryIndex=25, LinIfFrameRef=LinIfFrame_LinFrameTriggering_LIN2_SlaveResp
              LinIfEntry_LinScheduleTable_SCHEDULER_FPAS_VER_CHECK_26: LinIfEntryIndex=26, LinIfFrameRef=LinIfFrame_LinFrameTriggering_LIN2_MasterReq
              LinIfEntry_LinScheduleTable_SCHEDULER_FPAS_VER_CHECK_27: LinIfEntryIndex=27, LinIfFrameRef=LinIfFrame_LinFrameTriggering_LIN2_SlaveResp
              LinIfEntry_LinScheduleTable_SCHEDULER_FPAS_VER_CHECK_28: LinIfEntryIndex=28, LinIfFrameRef=LinIfFrame_LinFrameTriggering_LIN2_MasterReq
              LinIfEntry_LinScheduleTable_SCHEDULER_FPAS_VER_CHECK_29: LinIfEntryIndex=29, LinIfFrameRef=LinIfFrame_LinFrameTriggering_LIN2_SlaveResp
              LinIfEntry_LinScheduleTable_SCHEDULER_FPAS_VER_CHECK_30: LinIfEntryIndex=30, LinIfFrameRef=LinIfFrame_LinFrameTriggering_LIN2_MasterReq
              LinIfEntry_LinScheduleTable_SCHEDULER_FPAS_VER_CHECK_31: LinIfEntryIndex=31, LinIfFrameRef=LinIfFrame_LinFrameTriggering_LIN2_SlaveResp
          LinIfScheduleTable_LIN2_SCHEDULER_RPAS_TUNNING_WRITE: LinIfScheduleTableIndex=17
            16 x LinIfEntry, all with category=TOOL_CONFIGURED, LinIfDelay=0.015, LinIfFrameRef=LinIfFrame_LinFrameTriggering_LIN2_MasterReq:
              LinIfEntry_LinScheduleTable_SCHEDULER_RPAS_TUNNING_WRITE_{0..15}: LinIfEntryIndex={0..15}
          LinIfScheduleTable_LIN2_SCHEDULER_RPAS_TEMP_COMP: LinIfScheduleTableIndex=18
            4 x LinIfEntry, all with category=TOOL_CONFIGURED, LinIfDelay=0.015, LinIfFrameRef=LinIfFrame_LinFrameTriggering_LIN2_MasterReq:
              LinIfEntry_LinScheduleTable_SCHEDULER_RPAS_TEMP_COMP_{0..3}: LinIfEntryIndex={0..3}
          LinIfScheduleTable_LIN2_SCHEDULER_FPAS_TUNNING_WRITE: LinIfScheduleTableIndex=19
            32 x LinIfEntry, all with category=TOOL_CONFIGURED, LinIfDelay=0.015, LinIfFrameRef=LinIfFrame_LinFrameTriggering_LIN2_MasterReq:
              LinIfEntry_LinScheduleTable_SCHEDULER_FPAS_TUNNING_WRITE_{0..31}: LinIfEntryIndex={0..31}
          LinIfScheduleTable_LIN2_SCHEDULER_PAS_TEMP_COMP: LinIfScheduleTableIndex=20
            8 x LinIfEntry, all with category=TOOL_CONFIGURED, LinIfDelay=0.015, LinIfFrameRef=LinIfFrame_LinFrameTriggering_LIN2_MasterReq:
              LinIfEntry_LinScheduleTable_SCHEDULER_PAS_TEMP_COMP_{0..7}: LinIfEntryIndex={0..7}
          LinIfScheduleTable_LIN2_SCHEDULER_PAS_DIAG: LinIfScheduleTableIndex=21
            LinIfEntry_LinScheduleTable_SCHEDULER_PAS_DIAG_0 (LinIfEntry): category=TOOL_CONFIGURED, LinIfDelay=0.015, LinIfEntryIndex=0, LinIfFrameRef=LinIfFrame_LinFrameTriggering_LIN2_MasterReq
            LinIfEntry_LinScheduleTable_SCHEDULER_PAS_DIAG_1 (LinIfEntry): category=TOOL_CONFIGURED, LinIfDelay=0.015, LinIfEntryIndex=1, LinIfFrameRef=LinIfFrame_LinFrameTriggering_LIN2_SlaveResp
          LinIfScheduleTable_LIN2_SCHEDULER_PAS_SENSOR_REQUEST: LinIfScheduleTableIndex=22
            LinIfEntry_LinScheduleTable_SCHEDULER_PAS_SENSOR_REQUEST_0 (LinIfEntry): category=TOOL_CONFIGURED, LinIfDelay=0.015, LinIfEntryIndex=0, LinIfFrameRef=LinIfFrame_LinFrameTriggering_LIN2_MasterReq
        LinIfTransceiverDrvConfig: LinIfTrcvIdRef=LIN2
  module config LinTp: implementation-config-variant=VARIANT-PRE-COMPILE
    LinTpGeneral: LinTpChangeParameterApi=(unset), LinTpVersionInfoApi=1
    LinTpGlobalConfig
      LinTpChannelConfig0 (LinTpChannelConfig):
        LinTpDropNotRequestedNad = 1
        LinTpScheduleChangeDiag = 1
        LinTpMaxNumberOfRespPendingFrames = 2
        LinTpP2Max = 0.05
        LinTpP2Timing = 0.05
        LinTpChannelRef = ComMChannel_LIN1
      LinTpTxNSdu0 (LinTpTxNSdu):
        category = TOOL_CONFIGURED
        LinTpTxNSduId = 0
        LinTpMaxBufReq = 2
        LinTpNas = 0.05
        LinTpTxNSduNad = 126
        LinTpTxNSduChannelRef = ComMChannel_LIN1
        LinTpTxNSduPduRef = Pdu_DcmIPdu_LIN1_MasterReq
      LinTpRxNSdu0 (LinTpRxNSdu): category=TOOL_CONFIGURED, LinTpRxNSduId=0, LinTpRxNSduNad=0, LinTpRxNSduChannelRef=ComMChannel_LIN1, LinTpRxNSduPduRef=Pdu_DcmIPdu_LIN1_SlaveResp
      LinTpChannelConfigLIN2 (LinTpChannelConfig): category=TOOL_CONFIGURED, LinTpDropNotRequestedNad=1, LinTpScheduleChangeDiag=0, LinTpChannelRef=ComMChannel_LIN2
      LinTpTxNSdu_LIN2 (LinTpTxNSdu): category=TOOL_CONFIGURED, LinTpTxNSduId=0, LinTpTxNSduChannelRef=ComMChannel_LIN2, LinTpTxNSduPduRef=Pdu_DcmIPdu_LIN2_MasterReq
      LinTpRxNSdu_LIN2 (LinTpRxNSdu): category=TOOL_CONFIGURED, LinTpRxNSduId=0, LinTpRxNSduChannelRef=ComMChannel_LIN2, LinTpRxNSduPduRef=Pdu_DcmIPdu_LIN2_SlaveResp
