AUTOSAR XML (schema 4.0)
package /AUTRON
  module config EcuM: implementation-config-variant=VARIANT-POST-BUILD-SELECTABLE, module-description=BswImplementation_EcuM
    EcuMConfiguration
      EcuMCommonConfiguration: category=TOOL_CONFIGURED, EcuMConfigConsistencyHash=123456789, EcuMDefaultAppMode=OsAppMode0, EcuMOSResource=OsResource_BG
        EcuMCalloutUserIncludeFiles:
          EcuMCalloutUserIncludeFile = Rte_Main.h
          EcuMCalloutUserIncludeFile = Os_Imp_Cfg.h
          EcuMCalloutUserIncludeFile = Wdg_43_Instance0.h
          EcuMCalloutUserIncludeFile = Cache_Setup.h
          EcuMCalloutUserIncludeFile = EcuM_Cbk.h
          EcuMCalloutUserIncludeFile = Lin.h
          EcuMCalloutUserIncludeFile = Mem_Integration.h
        EcuMDefaultShutdownTarget: EcuMDefaultShutdownTarget=EcuMShutdownTargetSleep, EcuMDefaultResetModeRef=ECUM_RESET_MCU, EcuMDefaultSleepModeRef=ECUM_SLEEP_STANDBY
        EcuMDriverInitListOne
          38 x EcuMDriverInitItem, all with Used=1:
            User_Cache: EcuMModuleParameter=VOID, EcuMDriverInitItemIndex=0, EcuMModuleService=Init
            Mcu_Init: EcuMModuleService=Init, EcuMDriverInitItemIndex=1, EcuMModuleParameter=POSTBUILD_PTR, EcuMModulePostBuildPtr=&Mcu_Config, EcuMModuleRef=Mcu
            Init: EcuMModuleParameter=VOID, EcuMDriverInitItemIndex=2, EcuMModuleService=McuSetMode
            Mcl_Init: EcuMModuleParameter=POSTBUILD_PTR, EcuMModuleService=Init, EcuMDriverInitItemIndex=3, EcuMModulePostBuildPtr=&Mcl_Config, EcuMModuleRef=Mcl
            Port_Init: EcuMModuleService=Init, EcuMDriverInitItemIndex=4, EcuMModuleParameter=POSTBUILD_PTR, EcuMModulePostBuildPtr=&Port_Config, EcuMModuleRef=Port
            Adc_Init: EcuMModuleParameter=POSTBUILD_PTR, EcuMModuleService=Init, EcuMDriverInitItemIndex=5, EcuMModulePostBuildPtr=&Adc_Config, EcuMModuleRef=Adc
            Gpt_Init: EcuMModuleService=Init, EcuMDriverInitItemIndex=6, EcuMModuleParameter=POSTBUILD_PTR, EcuMModulePostBuildPtr=&Gpt_Config, EcuMModuleRef=Gpt
            Pwm_Init: EcuMModuleParameter=POSTBUILD_PTR, EcuMModuleService=Init, EcuMDriverInitItemIndex=7, EcuMModulePostBuildPtr=&Pwm_Config, EcuMModuleRef=Pwm
            Icu_Init: EcuMDriverInitItemIndex=8, EcuMModuleParameter=POSTBUILD_PTR, EcuMModulePostBuildPtr=&Icu_Config, EcuMModuleService=Init, EcuMModuleRef=Icu
            Spi_Init: EcuMModuleParameter=NULL_PTR, EcuMModuleService=Init, EcuMDriverInitItemIndex=9, EcuMModuleRef=Spi
            Can_43_FLEXCAN: EcuMModuleService=Init, EcuMDriverInitItemIndex=10, EcuMModuleParameter=POSTBUILD_PTR, EcuMModulePostBuildPtr=&Can_43_FLEXCAN_Config
            Lin_43_LPUART_FLEXIO: EcuMModuleParameter=POSTBUILD_PTR, EcuMModuleService=Init, EcuMDriverInitItemIndex=11, EcuMModulePostBuildPtr=&Lin_43_LPUART_FLEXIO_Config
            Wdg_43_Instance0: EcuMModuleParameter=POSTBUILD_PTR, EcuMModuleService=Init, EcuMDriverInitItemIndex=12, EcuMModulePostBuildPtr=&Wdg_Config_0
            CanIf_Init: EcuMModuleService=Init, EcuMDriverInitItemIndex=13, EcuMModuleParameter=NULL_PTR, EcuMModuleRef=CanIf
            CanSM_Init: EcuMModuleService=Init, EcuMDriverInitItemIndex=14, EcuMModuleParameter=NULL_PTR, EcuMModuleRef=CanSM
            CanTp_Init: EcuMModuleParameter=NULL_PTR, EcuMModuleService=Init, EcuMDriverInitItemIndex=15, EcuMModuleRef=CanTp
            CanTrcv_Init: EcuMModuleService=Init, EcuMDriverInitItemIndex=16, EcuMModuleParameter=NULL_PTR, EcuMModuleRef=CanTrcv
            PduR_Init: EcuMModuleService=Init, EcuMDriverInitItemIndex=17, EcuMModuleParameter=NULL_PTR, EcuMModuleRef=PduR
            Com_Init: EcuMModuleService=Init, EcuMDriverInitItemIndex=18, EcuMModuleParameter=NULL_PTR, EcuMModuleRef=Com
            ComM_Init: EcuMModuleService=Init, EcuMDriverInitItemIndex=19, EcuMModuleParameter=NULL_PTR, EcuMModuleRef=ComM
            IoHwAb_Init: EcuMModuleParameter=NULL_PTR, EcuMModuleService=Init, EcuMDriverInitItemIndex=21, EcuMModuleRef=IoHwAb
            ExtWdg_Init: EcuMModuleParameter=NULL_PTR, EcuMModuleService=Init, EcuMDriverInitItemIndex=22, EcuMModuleRef=Wdg_76_Acw
            WdgM_Init: EcuMModuleParameter=NULL_PTR, EcuMModuleService=Init, EcuMDriverInitItemIndex=23, EcuMModuleRef=WdgM
            Csm_Init: EcuMModuleParameter=NULL_PTR, EcuMModuleService=Init, EcuMDriverInitItemIndex=24, EcuMModuleRef=Csm
            E2EXf_Init: EcuMModuleParameter=NULL_PTR, EcuMModuleService=Init, EcuMDriverInitItemIndex=25, EcuMModuleRef=E2EXf
            ComXf_Init: EcuMModuleParameter=NULL_PTR, EcuMModuleService=Init, EcuMDriverInitItemIndex=26, EcuMModuleRef=ComXf
            CanCM_Init: EcuMModuleParameter=VOID, EcuMModuleService=Init, EcuMDriverInitItemIndex=27, EcuMModuleRef=CanCM
            Nm_Init: EcuMModuleParameter=NULL_PTR, EcuMModuleService=Init, EcuMDriverInitItemIndex=29, EcuMModuleRef=Nm
            CanNm: EcuMModuleParameter=NULL_PTR, EcuMModuleService=Init, EcuMDriverInitItemIndex=30, EcuMModuleRef=CanNm
            StbM_Init: EcuMModuleParameter=NULL_PTR, EcuMModuleService=Init, EcuMDriverInitItemIndex=31, EcuMModuleRef=StbM
            LinIf_Init: EcuMModuleParameter=NULL_PTR, EcuMModuleService=Init, EcuMDriverInitItemIndex=32, EcuMModuleRef=LinIf
            LinSM_Init: EcuMModuleParameter=NULL_PTR, EcuMModuleService=Init, EcuMDriverInitItemIndex=33, EcuMModuleRef=LinSM
            LinTrcv_Init: EcuMModuleParameter=NULL_PTR, EcuMModuleService=Init, EcuMDriverInitItemIndex=34, EcuMModuleRef=LinTrcv
            IpduM_Init: EcuMModuleParameter=NULL_PTR, EcuMModuleService=Init, EcuMDriverInitItemIndex=35, EcuMModuleRef=IpduM
            Crypto_76_HaeModule_Init: EcuMDriverInitItemIndex=36, EcuMModuleParameter=NULL_PTR, EcuMModuleService=Init, EcuMModuleRef=Crypto_76_HaeModule
            CryIf_Init: EcuMModuleParameter=NULL_PTR, EcuMModuleService=Init, EcuMDriverInitItemIndex=37, EcuMModuleRef=CryIf
            FiM_Init: EcuMModuleParameter=NULL_PTR, EcuMModuleService=Init, EcuMDriverInitItemIndex=38, EcuMModuleRef=FiM
            Dcm_Init: EcuMModuleParameter=NULL_PTR, EcuMModuleService=Init, EcuMDriverInitItemIndex=39, EcuMModuleRef=Dcm
        EcuMDriverInitListZero
          Det_Init (EcuMDriverInitItem): EcuMModuleParameter=NULL_PTR, EcuMModuleService=Init, EcuMDriverInitItemIndex=0, Used=1, EcuMModuleRef=Det
          Dem_PreInit (EcuMDriverInitItem): EcuMModuleParameter=NULL_PTR, EcuMModuleService=PreInit, EcuMDriverInitItemIndex=1, Used=1, EcuMModuleRef=Dem
        ECUM_SLEEP_STANDBY (EcuMSleepMode):
          EcuMSleepModeId = 0
          EcuMSleepModeSuspend = 1
          EcuMSleepModeMcuModeRef = McuModeSettingConf_STANDBY
          EcuMWakeupSourceMask = ECUM_WKSOURCE_FD_CAN1_RX
          EcuMWakeupSourceMask = ECUM_WKSOURCE_FD_CAN1_RX_POLL
          EcuMWakeupSourceMask = ECUM_WKSOURCE_GPT
          EcuMWakeupSourceMask = ECUM_WKSOURCE_LIN1_RX
        9 x EcuMWakeupSource, all with EcuMWakeupSourcePolling=0, EcuMResetReasonRef=MCU_RESET_UNDEFINED:
          ECUM_WKSOURCE_POWER: category=TOOL_CONFIGURED, EcuMWakeupSourceId=0
          ECUM_WKSOURCE_RESET: category=TOOL_CONFIGURED, EcuMWakeupSourceId=1
          ECUM_WKSOURCE_INTERNAL_RESET: category=TOOL_CONFIGURED, EcuMWakeupSourceId=2
          ECUM_WKSOURCE_INTERNAL_WDG: category=TOOL_CONFIGURED, EcuMWakeupSourceId=3
          ECUM_WKSOURCE_EXTERNAL_WDG: category=TOOL_CONFIGURED, EcuMWakeupSourceId=4
          ECUM_WKSOURCE_GPT: category=TOOL_CONFIGURED, EcuMWakeupSourceId=5
          ECUM_WKSOURCE_FD_CAN1_RX: EcuMWakeupSourceId=6, EcuMComMChannelRef=ComMChannel_FD_CAN1
          ECUM_WKSOURCE_FD_CAN1_RX_POLL: EcuMWakeupSourceId=7, EcuMComMChannelRef=ComMChannel_FD_CAN1
          ECUM_WKSOURCE_LIN1_RX: EcuMWakeupSourceId=10, EcuMComMChannelRef=ComMChannel_LIN1
      EcuMFlexConfiguration:
        category = TOOL_CONFIGURED
        EcuMPartitionRef = EcucPartition_Main
        EcuMNormalMcuClockRef = McuClockSettingConfig_0
        EcuMNormalMcuModeRef = McuModeSettingConf_RUN
        ECUM_ALARM_Sleep (EcuMAlarmClock): EcuMAlarmClockId=0, EcuMAlarmClockTimeOut=0, EcuMAlarmClockUser=ECUM_USER_APP
        EcuMDriverDeInitListOffOs: EcuMDriverDeInitListOffOsRef=EcuMDriverListShutdown
        EcuMDriverInitListTwo (EcuMDriverInitListBswM)
          Mem_Driver (EcuMDriverInitItem): EcuMModuleParameter=VOID, EcuMDriverInitItemIndex=0, EcuMModuleService=StartUp, Used=1
        EcuMDriverInitListThree (EcuMDriverInitListBswM)
          3 x EcuMDriverInitItem, all with EcuMModuleService=Init, Used=1:
            Com_Init: EcuMModuleParameter=NULL_PTR, EcuMDriverInitItemIndex=0, EcuMModuleRef=Com
            Dem_Init: EcuMDriverInitItemIndex=1, EcuMModuleParameter=VOID, EcuMModuleRef=Dem
            KeyM_Init: EcuMModuleParameter=NULL_PTR, EcuMDriverInitItemIndex=2, EcuMModuleRef=KeyM
        EcuMDriverListShutdown (EcuMDriverListStartupOrShutdown)
        EcuMGoDownAllowedUsers: EcuMGoDownAllowedUserRef=ECUM_USER_BSWM, EcuMGoDownAllowedUserRef=ECUM_USER_APP, EcuMGoDownAllowedUserRef=ECUM_USER_TESTER
        EcuMSetClockAllowedUsers: EcuMSetClockAllowedUserRef=ECUM_USER_APP
        3 x EcuMFlexUserConfig, all with EcuMFlexEcucPartitionRef=EcucPartition_Main:
          ECUM_USER_BSWM: EcuMFlexUser=42
          ECUM_USER_TESTER: EcuMFlexUser=254
          ECUM_USER_APP: EcuMFlexUser=255
        6 x EcuMResetMode:
          ECUM_RESET_MCU: category=TOOL_CONFIGURED, EcuMResetModeId=0
          ECUM_RESET_WDG: category=TOOL_CONFIGURED, EcuMResetModeId=1
          ECUM_RESET_IO: category=TOOL_CONFIGURED, EcuMResetModeId=2
          ECUM_RESET_APP: EcuMResetModeId=3
          ECUM_RESET_DCM: EcuMResetModeId=4
          ECUM_RESET_UNDEFINED: EcuMResetModeId=5
        5 x EcuMShutdownCause:
          ECUM_CAUSE_UNKNOWN: category=TOOL_CONFIGURED, EcuMShutdownCauseId=0
          ECUM_CAUSE_ECU_STATE: category=TOOL_CONFIGURED, EcuMShutdownCauseId=1
          ECUM_CAUSE_WDGM: category=TOOL_CONFIGURED, EcuMShutdownCauseId=2
          ECUM_CAUSE_DCM: category=TOOL_CONFIGURED, EcuMShutdownCauseId=3
          ECUM_CAUSE_XCP: EcuMShutdownCauseId=4
    EcuMFlexGeneral: EcuMModeHandling=1, EcuMLpTransitionCalloutEnabled=1, EcuMResetLoopDetection=0, EcuMSetProgrammableInterrupts=0, EcuMAlarmClockPresent=0
    EcuMGeneral: EcuMDevErrorDetect=1, EcuMIncludeDet=1, EcuMMainFunctionPeriod=0.01, EcuMVersionInfoApi=1
