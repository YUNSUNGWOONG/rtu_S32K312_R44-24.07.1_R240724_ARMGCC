AUTOSAR XML (schema 00047)
package /AUTRON
  module config ComXf: definition=Xfrm, implementation-config-variant=VARIANT-PRE-COMPILE, module-description=BswImplementation_ComXf
    XfrmGeneral: XfrmDevErrorDetect=1, XfrmVersionInfoApi=1, XfrmCpuEndianness=LITTLE_ENDIAN, XfrmInstanceId=0
    ComXf_MsgGr_E2E_FD_CAN1_BSD_01_50ms_P11 (XfrmImplementationMapping):
      XfrmTransformationTechnologyRef = XfTechRx_ComXf_P11_8
      XfrmInvTransformerBswModuleEntryRef = ComXf_Inv_Com_ComISignalGroup_MsgGr_E2E_FD_CAN1_BSD_01_50ms_P11
      XfrmSignalGroupRef = ComISignalGroup_MsgGr_E2E_FD_CAN1_BSD_01_50ms_P11
      XfrmSignal: category=TOOL_CONFIGURED
        XfrmSignalChoice: category=TOOL_CONFIGURED
          XfrmISignalGroupRefChoice: category=TOOL_CONFIGURED, XfrmISignalGroupRef=MsgGr_E2E_FD_CAN1_BSD_01_50ms_P11
    ComXf_MsgGr_E2E_FD_CAN1_TCU_01_10ms_P11 (XfrmImplementationMapping):
      XfrmTransformationTechnologyRef = XfTechTx_ComXf_P11_8
      XfrmTransformerBswModuleEntryRef = ComXf_Com_ComISignalGroup_MsgGr_E2E_FD_CAN1_TCU_01_10ms_P11
      XfrmSignalGroupRef = ComISignalGroup_MsgGr_E2E_FD_CAN1_TCU_01_10ms_P11
      XfrmSignal: category=TOOL_CONFIGURED
        XfrmSignalChoice: category=TOOL_CONFIGURED
          XfrmISignalGroupRefChoice: category=TOOL_CONFIGURED, XfrmISignalGroupRef=MsgGr_E2E_FD_CAN1_TCU_01_10ms_P11
