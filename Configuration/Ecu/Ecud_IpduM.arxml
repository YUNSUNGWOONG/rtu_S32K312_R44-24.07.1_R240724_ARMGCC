AUTOSAR XML (schema 00047)
package /AUTRON
  module config IpduM: implementation-config-variant=VARIANT-PRE-COMPILE, module-description=BswImplementation_IpduM
    IpduMConfig
    IpduMGeneral: IpduMDevErrorDetect=1, IpduMStaticPartExists=0, IpduMVersionInfoApi=1, IpduMHeaderByteOrder=IPDUM_LITTLE_ENDIAN, IpduMEnableModule=0
    IpduMPublishedInformation: IpduMRxDirectComInvocation=0
