AUTOSAR XML (schema 4-0-3)
package /AUTRON
  module config Csm: implementation-config-variant=VARIANT-PRE-COMPILE, module-description=BswImplementation_Csm
    CsmGeneral: CsmDevErrorDetect=1, CsmVersionInfoApi=1, CsmUseDeprecated=0, CsmMainFunctionPeriod=0.01
    CsmJobs
      13 x CsmJob, all with CsmProcessingMode=CRYPTO_PROCESSING_SYNC:
        RandomGenerate_L9: CsmJobId=0, CsmJobInterfaceUsePort=CRYPTO_USE_PORT, CsmJobPriority=0, CsmJobKeyRef=RandomSeed_L9, CsmJobPrimitiveRef=Crypto_SW/RandomGenerate_L9, CsmJobQueueRef=CsmQueue_CryptoLib
        Hash_Sha256_Async: CsmJobId=1, CsmJobInterfaceUsePort=CRYPTO_USE_PORT, CsmJobPriority=1, CsmJobKeyRef=Dummy, CsmJobPrimitiveRef=CsmHash, CsmJobQueueRef=CsmQueue_CryptoLib
        Hash_SHA256_Sync: CsmJobId=2, CsmJobInterfaceUsePort=CRYPTO_USE_PORT, CsmJobPriority=1, CsmJobKeyRef=Dummy, CsmJobPrimitiveRef=CsmHash, CsmJobQueueRef=CsmQueue_HSI
        RNG_HSE_Sync: CsmJobId=3, CsmJobInterfaceUsePort=CRYPTO_USE_PORT, CsmJobPriority=2, CsmJobKeyRef=Dummy, CsmJobPrimitiveRef=CsmRandomGenerate, CsmJobQueueRef=CsmQueue_CryptoLib
        EncryptAES_ECB_sync: CsmJobId=4, CsmJobInterfaceUsePort=CRYPTO_USE_PORT, CsmJobPriority=2, CsmJobKeyRef=PBKDF2_Extracted_Key, CsmJobPrimitiveRef=CsmEncryptAES_ECB, CsmJobQueueRef=CsmQueue_CryptoLib
        DecryptAES_ECB_sync: CsmJobId=5, CsmJobInterfaceUsePort=CRYPTO_USE_PORT, CsmJobPriority=2, CsmJobKeyRef=PBKDF2_Decrypt_Key, CsmJobPrimitiveRef=CsmDecryptAES_ECB, CsmJobQueueRef=CsmQueue_HSI
        Hash_Sha256_Fota: CsmJobId=6, CsmJobInterfaceUsePort=CRYPTO_USE_FNC, CsmJobPrimitiveCallbackUpdateNotification=0, CsmJobPriority=1, CsmJobKeyRef=Hash_Dummy_Fota, CsmJobPrimitiveRef=Crypto_SW/Hash_Sha256_Fota, CsmJobQueueRef=CsmQueue_HSI
        SignatureVerify_RSASSA_PKCS1_v1_5_Fota: CsmJobId=7, CsmJobInterfaceUsePort=CRYPTO_USE_FNC, CsmJobPrimitiveCallbackUpdateNotification=0, CsmJobPriority=1, CsmJobKeyRef=Pkcs1_Asims_Public_key, CsmJobPrimitiveRef=CsmSignatureVerify_RSASSA_PKCS1_v1_5, CsmJobQueueRef=CsmQueue_CryptoLib
        Decr_AES_CTR_Job0_swlib_Fota: CsmJobId=8, CsmJobInterfaceUsePort=CRYPTO_USE_FNC, CsmJobPrimitiveCallbackUpdateNotification=0, CsmJobPriority=2, CsmJobKeyRef=Decr_AES_CTR_Key0_swlib_Fota, CsmJobPrimitiveRef=Decrypt_AES_CTR, CsmJobQueueRef=CsmQueue_HSI
        Decr_AES_CTR_Job1_swlib_Fota: CsmJobId=9, CsmJobInterfaceUsePort=CRYPTO_USE_FNC, CsmJobPrimitiveCallbackUpdateNotification=0, CsmJobPriority=2, CsmJobKeyRef=Decr_AES_CTR_Key1_swlib_Fota, CsmJobPrimitiveRef=Decrypt_AES_CTR, CsmJobQueueRef=CsmQueue_HSI
        MacVer_AES_CMAC_key: CsmJobId=10, CsmJobInterfaceUsePort=CRYPTO_USE_FNC, CsmJobPriority=1, CsmJobKeyRef=CsmKeys/MacVer_AES_CMAC_key, CsmJobPrimitiveRef=CsmMacVerify, CsmJobQueueRef=CsmQueue_CryptoLib
        MacGen_Sha256_HMAC_key: CsmJobId=11, CsmJobInterfaceUsePort=CRYPTO_USE_PORT, CsmJobPriority=2, CsmJobKeyRef=CsmKeys/MacGen_Sha256_HMAC_key, CsmJobPrimitiveRef=CsmSha256HmacGenerate, CsmJobQueueRef=CsmQueue_HSI
        MacVer_Sha256_HMAC_key: CsmJobId=12, CsmJobInterfaceUsePort=CRYPTO_USE_PORT, CsmJobPriority=2, CsmJobKeyRef=CsmKeys/MacVer_Sha256_HMAC_key, CsmJobPrimitiveRef=CsmSha256HmacVerify, CsmJobQueueRef=CsmQueue_HSI
    CsmKeys
      25 x CsmKey:
        RandomSeed_L9: CsmKeyId=0, CsmKeyUsePort=1, CsmKeyRef=RandomSeed_L9
        Dummy: CsmKeyId=1, CsmKeyUsePort=1, CsmKeyRef=Dummy
        PBKDF2_Source_Key: CsmKeyId=2, CsmKeyUsePort=1, CsmKeyRef=PBKDF2_Source_Key
        PBKDF2_Target_Key: CsmKeyId=3, CsmKeyUsePort=1, CsmKeyRef=PBKDF2_Target_Key
        PBKDF2_Extracted_Key: CsmKeyId=4, CsmKeyUsePort=1, CsmKeyRef=PBKDF2_Extracted_Key
        PBKDF2_ExtractedKey: CsmKeyId=5, CsmKeyUsePort=0, CsmKeyRef=PBKDF2_ExtractedKey
        PBKDF2_Encrypt_Key: CsmKeyId=6, CsmKeyUsePort=0, CsmKeyRef=PBKDF2_Encrypt_Key
        PBKDF2_Decrypt_Key: CsmKeyId=7, CsmKeyUsePort=0, CsmKeyRef=PBKDF2_Decrypt_Key
        PBKDF2_Source_Key_PSK0: CsmKeyId=8, CsmKeyUsePort=0, CsmKeyRef=PBKDF2_Source_Key_PSK0
        PBKDF2_Source_Key_PSK1: CsmKeyId=9, CsmKeyUsePort=0, CsmKeyRef=PBKDF2_Source_Key_PSK1
        PBKDF2_Source_Key_PSK2: CsmKeyId=10, CsmKeyUsePort=0, CsmKeyRef=PBKDF2_Source_Key_PSK2
        PBKDF2_Source_Key_PSK3: CsmKeyId=11, CsmKeyUsePort=0, CsmKeyRef=PBKDF2_Source_Key_PSK3
        PBKDF2_Source_Key_PSK4: CsmKeyId=12, CsmKeyUsePort=0, CsmKeyRef=PBKDF2_Source_Key_PSK4
        PBKDF2_Source_Key_PSK5: CsmKeyId=13, CsmKeyUsePort=0, CsmKeyRef=PBKDF2_Source_Key_PSK5
        PBKDF2_Source_Key_PSK6: CsmKeyId=14, CsmKeyUsePort=0, CsmKeyRef=PBKDF2_Source_Key_PSK6
        PBKDF2_Source_Key_PSK7: CsmKeyId=15, CsmKeyUsePort=0, CsmKeyRef=PBKDF2_Source_Key_PSK7
        PBKDF2_Source_Key_PSK8: CsmKeyId=16, CsmKeyUsePort=0, CsmKeyRef=PBKDF2_Source_Key_PSK8
        PBKDF2_Source_Key_PSK9: CsmKeyId=17, CsmKeyUsePort=0, CsmKeyRef=PBKDF2_Source_Key_PSK9
        Hash_Dummy_Fota: CsmKeyId=18, CsmKeyUsePort=0, CsmKeyRef=Hash_Dummy_Fota
        Pkcs1_Asims_Public_key: CsmKeyId=19, CsmKeyUsePort=0, CsmKeyRef=Pkcs1_Asims_Public_Key
        Decr_AES_CTR_Key0_swlib_Fota: CsmKeyId=20, CsmKeyUsePort=0, CsmKeyRef=Decr_AES_CTR_Key0
        Decr_AES_CTR_Key1_swlib_Fota: CsmKeyId=21, CsmKeyUsePort=0, CsmKeyRef=Decr_AES_CTR_Key1
        MacVer_AES_CMAC_key: CsmKeyId=22, CsmKeyUsePort=0, CsmKeyRef=MacVer_AES_CMAC_key
        MacGen_Sha256_HMAC_key: CsmKeyId=23, CsmKeyUsePort=0, CsmKeyRef=MacGen_Sha256_HMAC_key
        MacVer_Sha256_HMAC_key: CsmKeyId=24, CsmKeyUsePort=0, CsmKeyRef=MacVer_Sha256_HMAC_key
    Crypto_HSE (CsmPrimitives)
      CsmDecryptAES_ECB (CsmDecrypt)
        DecryptAES_ECB (CsmDecryptConfig):
          CsmDecryptAlgorithmFamily = CRYPTO_ALGOFAM_AES
          CsmDecryptAlgorithmKeyLength = 50
          CsmDecryptAlgorithmMode = CRYPTO_ALGOMODE_ECB
          CsmDecryptAlgorithmSecondaryFamily = CRYPTO_ALGOFAM_NOT_SET
          CsmDecryptDataMaxLength = 500
          CsmDecryptResultMaxLength = 500
      CsmEncryptAES_ECB (CsmEncrypt)
        EncryptAES_ECB (CsmEncryptConfig):
          CsmEncryptAlgorithmFamily = CRYPTO_ALGOFAM_AES
          CsmEncryptAlgorithmKeyLength = 50
          CsmEncryptAlgorithmMode = CRYPTO_ALGOMODE_ECB
          CsmEncryptAlgorithmSecondaryFamily = CRYPTO_ALGOFAM_NOT_SET
          CsmEncryptDataMaxLength = 500
          CsmEncryptResultMaxLength = 500
      CsmHash
        CsmHashConfig:
          CsmHashAlgorithmFamily = CRYPTO_ALGOFAM_SHA2_256
          CsmHashAlgorithmMode = CRYPTO_ALGOMODE_NOT_SET
          CsmHashAlgorithmSecondaryFamily = CRYPTO_ALGOFAM_NOT_SET
          CsmHashDataMaxLength = 64
          CsmHashResultLength = 32
      CsmSha256HmacGenerate (CsmMacGenerate)
        CsmMacGenerateConfig:
          CsmMacGenerateAlgorithmFamily = CRYPTO_ALGOFAM_SHA2_256
          CsmMacGenerateAlgorithmKeyLength = 32
          CsmMacGenerateAlgorithmMode = CRYPTO_ALGOMODE_HMAC
          CsmMacGenerateAlgorithmSecondaryFamily = CRYPTO_ALGOFAM_NOT_SET
          CsmMacGenerateDataMaxLength = 326656
          CsmMacGenerateResultLength = 32
      CsmSha256HmacVerify (CsmMacVerify)
        CsmMacVerifyConfig:
          CsmMacVerifyAlgorithmFamily = CRYPTO_ALGOFAM_SHA2_256
          CsmMacVerifyAlgorithmKeyLength = 32
          CsmMacVerifyAlgorithmMode = CRYPTO_ALGOMODE_HMAC
          CsmMacVerifyAlgorithmSecondaryFamily = CRYPTO_ALGOFAM_NOT_SET
          CsmMacVerifyCompareLength = 32
          CsmMacVerifyDataMaxLength = 326656
      CsmRandomGenerate
        CsmRandomGenerateConfig:
          CsmRandomGenerateAlgorithmFamily = CRYPTO_ALGOFAM_RNG
          CsmRandomGenerateAlgorithmMode = CRYPTO_ALGOMODE_CTRDRBG
          CsmRandomGenerateAlgorithmSecondaryFamily = CRYPTO_ALGOFAM_NOT_SET
          CsmRandomGenerateResultLength = 16
    Crypto_SW (CsmPrimitives)
      Decrypt_AES_CTR (CsmDecrypt)
        CsmDecryptConfig:
          CsmDecryptAlgorithmFamily = CRYPTO_ALGOFAM_AES
          CsmDecryptAlgorithmKeyLength = 16
          CsmDecryptAlgorithmMode = CRYPTO_ALGOMODE_CTR
          CsmDecryptAlgorithmSecondaryFamily = CRYPTO_ALGOFAM_NOT_SET
      Hash_Sha256_Fota (CsmHash)
        CsmHashConfig:
          CsmHashAlgorithmFamily = CRYPTO_ALGOFAM_SHA2_256
          CsmHashAlgorithmMode = CRYPTO_ALGOMODE_NOT_SET
          CsmHashAlgorithmSecondaryFamily = CRYPTO_ALGOFAM_NOT_SET
          CsmHashDataMaxLength = 65536
          CsmHashResultLength = 32
      CsmMacVerify
        CsmMacVerifyConfig:
          CsmMacVerifyAlgorithmFamily = CRYPTO_ALGOFAM_AES
          CsmMacVerifyAlgorithmKeyLength = 16
          CsmMacVerifyAlgorithmMode = CRYPTO_ALGOMODE_CMAC
          CsmMacVerifyAlgorithmSecondaryFamily = CRYPTO_ALGOFAM_NOT_SET
          CsmMacVerifyCompareLength = 128
      RandomGenerate_L9 (CsmRandomGenerate)
        CsmRandomGenerateConfig:
          CsmRandomGenerateAlgorithmFamily = CRYPTO_ALGOFAM_RNG
          CsmRandomGenerateAlgorithmMode = CRYPTO_ALGOMODE_NOT_SET
          CsmRandomGenerateAlgorithmSecondaryFamily = CRYPTO_ALGOFAM_NOT_SET
          CsmRandomGenerateResultLength = 8
      CsmSignatureVerify_RSASSA_PKCS1_v1_5 (CsmSignatureVerify)
        CsmSignatureVerifyConfig:
          CsmSignatureVerifyAlgorithmFamily = CRYPTO_ALGOFAM_RSA
          CsmSignatureVerifyAlgorithmMode = CRYPTO_ALGOMODE_RSASSA_PKCS1_v1_5
          CsmSignatureVerifyAlgorithmSecondaryFamily = CRYPTO_ALGOFAM_SHA2_256
          CsmSignatureVerifyCompareLength = 256
          CsmSignatureVerifyDataMaxLength = 256
          CsmSignatureVerifyKeyLength = 256
    CsmQueues
      CsmQueue_HSI (CsmQueue): CsmQueueSize=3, CsmChannelRef=CryIfChannel_HaeHSE
      CsmQueue_CryptoLib (CsmQueue): CsmQueueSize=10, CsmChannelRef=CryIfChannel_CryptoLib
