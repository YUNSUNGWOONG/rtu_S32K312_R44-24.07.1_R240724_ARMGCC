AUTOSAR XML (schema 00047)
package /AUTRON
  module config NvM: implementation-config-variant=VARIANT-PRE-COMPILE, module-description=BswImplementation_NvM
    NvMCommon:
      NvMApiConfigClass = NVM_API_CONFIG_CLASS_3
      NvMBswMMultiBlockJobStatusInformation = 1
      NvMCompiledConfigId = 59
      NvMCrcNumOfBytes = 16
      NvMDatasetSelectionBits = 2
      NvMDevErrorDetect = 1
      NvMDrvModeSwitch = 1
      NvMJobPrioritization = 1
      NvMPollingMode = 0
      NvMRepeatMirrorOperations = 3
      NvMSetRamBlockStatusApi = 1
      NvMSizeStandardJobQueue = 20
      NvMVersionInfoApi = 1
      NvMSizeImmediateJobQueue = 20
      NvMMainFunctionPeriod = 0.005
      NvMDynamicConfiguration = 0
      NvMDefaultROMCRCEnabled = 0
      NvMUserJobFunction = Mem_76_Pfls_MainFunction
      NvMMainfunctionTriggerRef = OsAlarm_BSW_Mem_Process
      NvMUserIncludeFiles: NvMUserIncludeFiles=Mem_Integration.h, Rte_NvM.h, Dem_Ram.h, KeyM_Cfg.h, Mem_76_Pfls.h
    7 x NvMBlockDescriptor, all with NvMBlockUseSyncMechanism=0, NvMBlockWriteProt=0, NvMBswMBlockStatusInformation=0, NvMMaxNumOfReadRetries=1, NvMMaxNumOfWriteRetries=1, NvMNvramDeviceId=0, NvMResistantToChangedSw=0, NvMRomBlockNum=0, NvMStaticBlockIDCheck=0, NvMWriteBlockOnce=0, NvMDefaultROMCRCEnabled=0, NvMBlockJobPriority=1, NvMBlockUseAutoValidation=0, NvMBlockUseCRCCompMechanism=0, NvMBlockUseSetRamBlockStatus=0, NvMSelectBlockForFirstInitAll=0:
      NvMBlock_ConfigID: NvMWriteVerificationDataSize=2, NvMNvramBlockIdentifier=1, NvMNvBlockBaseNumber=1, NvMNvBlockLength=2, NvMNvBlockNum=2, NvMSelectBlockForReadAll=1, NvMSelectBlockForWriteAll=1, NvMBlockManagementType=NVM_BLOCK_REDUNDANT, NvMCalcRamBlockCrc=1, NvMBlockCrcType=NVM_CRC16, NvMRamBlockDataAddress=ConfigIDRamBlock, NvMWriteVerification=1, NvMBlockUseCrc=1
        NvMTargetBlockReference
          NvMFeeRef: NvMNameOfFeeBlock=FeeBlock_ConfigID
      NvMBlock_DemNonVolatileData: NvMWriteVerification=0, NvMBlockManagementType=NVM_BLOCK_NATIVE, NvMBlockUseCrc=0, NvMCalcRamBlockCrc=0, NvMNvBlockBaseNumber=2, NvMNvBlockLength=8, NvMNvBlockNum=1, NvMNvramBlockIdentifier=2, NvMRamBlockDataAddress=&Dem_NonVolatileData, NvMSelectBlockForReadAll=1, NvMSelectBlockForWriteAll=1, NvMWriteVerificationDataSize=8
        NvMTargetBlockReference
          NvMFeeRef: NvMNameOfFeeBlock=FeeBlock_DemNonVolatileData
      NvMBlock_DemEventStatusNvRamBlock: NvMWriteVerification=0, NvMBlockManagementType=NVM_BLOCK_REDUNDANT, NvMBlockUseCrc=0, NvMCalcRamBlockCrc=0, NvMNvBlockBaseNumber=3, NvMNvBlockLength=212, NvMNvBlockNum=2, NvMNvramBlockIdentifier=3, NvMRamBlockDataAddress=&Dem_EventStatusNvRamData, NvMSelectBlockForReadAll=1, NvMSelectBlockForWriteAll=1, NvMWriteVerificationDataSize=212
        NvMTargetBlockReference
          NvMFeeRef: NvMNameOfFeeBlock=FeeBlock_DemEventStatusNvRamBlock
      NvMBlock_DemPrimaryEventMemoryEntry_0: NvMWriteVerification=0, NvMBlockManagementType=NVM_BLOCK_NATIVE, NvMBlockUseCrc=0, NvMCalcRamBlockCrc=0, NvMNvBlockBaseNumber=4, NvMNvBlockLength=16, NvMNvBlockNum=1, NvMNvramBlockIdentifier=4, NvMRamBlockDataAddress=&Dem_PrimaryEventMemory[0], NvMSelectBlockForReadAll=1, NvMSelectBlockForWriteAll=1, NvMWriteVerificationDataSize=16
        NvMTargetBlockReference
          NvMFeeRef: NvMNameOfFeeBlock=FeeBlock_DemPrimaryEventMemoryEntry_0
      NvMBlock_DemPrimaryEventMemoryEntry_1: NvMWriteVerification=0, NvMBlockManagementType=NVM_BLOCK_NATIVE, NvMBlockUseCrc=0, NvMCalcRamBlockCrc=0, NvMNvBlockBaseNumber=5, NvMNvBlockLength=16, NvMNvBlockNum=1, NvMNvramBlockIdentifier=5, NvMRamBlockDataAddress=&Dem_PrimaryEventMemory[1], NvMSelectBlockForReadAll=1, NvMSelectBlockForWriteAll=1, NvMWriteVerificationDataSize=16
        NvMTargetBlockReference
          NvMFeeRef: NvMNameOfFeeBlock=FeeBlock_DemPrimaryEventMemoryEntry_1
      NvMBlock_DemPrimaryEventMemoryEntry_2: NvMWriteVerification=0, NvMBlockManagementType=NVM_BLOCK_NATIVE, NvMBlockUseCrc=0, NvMCalcRamBlockCrc=0, NvMNvBlockBaseNumber=6, NvMNvBlockLength=16, NvMNvBlockNum=1, NvMNvramBlockIdentifier=6, NvMRamBlockDataAddress=&Dem_PrimaryEventMemory[2], NvMSelectBlockForReadAll=1, NvMSelectBlockForWriteAll=1, NvMWriteVerificationDataSize=16
        NvMTargetBlockReference
          NvMFeeRef: NvMNameOfFeeBlock=FeeBlock_DemPrimaryEventMemoryEntry_2
      NvMBlock_Test_Native_6: NvMWriteVerification=0, NvMBlockManagementType=NVM_BLOCK_NATIVE, NvMBlockUseCrc=0, NvMCalcRamBlockCrc=0, NvMNvBlockBaseNumber=7, NvMNvBlockLength=7, NvMNvBlockNum=1, NvMNvramBlockIdentifier=7, NvMSelectBlockForReadAll=0, NvMSelectBlockForWriteAll=0, NvMWriteVerificationDataSize=7
        NvMTargetBlockReference
          NvMFeeRef: NvMNameOfFeeBlock=FeeBlock_Test_Native_6
    NvmDemEventParameterRefs:
      NVM_E_HARDWARE = NVM_E_QUEUE_OVERFLOW
      NVM_E_INTEGRITY_FAILED = NVM_E_INTEGRITY_FAILED
      NVM_E_LOSS_OF_REDUNDANCY = NVM_E_LOSS_OF_REDUNDANCY
      NVM_E_REQ_FAILED = NVM_E_REQ_FAILED
      NVM_E_VERIFY_FAILED = NVM_E_VERIFY_FAILED
      NVM_E_WRITE_PROTECTED = NVM_E_WRITE_PROTECTED
      NVM_E_WRONG_BLOCK_ID = NVM_E_WRONG_BLOCK_ID
    9 x NvMBlockDescriptor, all with NvMBlockUseAutoValidation=0, NvMBlockUseCRCCompMechanism=0, NvMBlockUseSyncMechanism=0, NvMBswMBlockStatusInformation=0, NvMMaxNumOfReadRetries=1, NvMStaticBlockIDCheck=0, NvMWriteVerification=0, NvMBlockUseCrc=0, NvMBlockManagementType=NVM_BLOCK_NATIVE, NvMBlockJobPriority=1, NvMBlockWriteProt=0, NvMCalcRamBlockCrc=0, NvMMaxNumOfWriteRetries=1, NvMNvBlockLength=16, NvMNvramDeviceId=0, NvMNvBlockNum=1, NvMResistantToChangedSw=0, NvMRomBlockNum=0, NvMWriteBlockOnce=0, NvMWriteVerificationDataSize=16, NvMDefaultROMCRCEnabled=0, NvMBlockUseSetRamBlockStatus=0, NvMSelectBlockForFirstInitAll=0:
      NvMBlock_DemUserDefinedEventMemoryEntry_0: NvMNvBlockBaseNumber=8, NvMNvramBlockIdentifier=8, NvMRamBlockDataAddress=&Dem_UserDefinedEventMemory[0], NvMSelectBlockForReadAll=1, NvMSelectBlockForWriteAll=1
        NvMTargetBlockReference
          NvMFeeRef: NvMNameOfFeeBlock=FeeBlock_DemUserDefinedEventMemoryEntry_0
      NvMBlock_DemUserDefinedEventMemoryEntry_1: NvMNvBlockBaseNumber=9, NvMNvramBlockIdentifier=9, NvMRamBlockDataAddress=&Dem_UserDefinedEventMemory[1], NvMSelectBlockForReadAll=1, NvMSelectBlockForWriteAll=1
        NvMTargetBlockReference
          NvMFeeRef: NvMNameOfFeeBlock=FeeBlock_DemUserDefinedEventMemoryEntry_1
      NvMBlock_DemUserDefinedEventMemoryEntry_2: NvMNvBlockBaseNumber=10, NvMNvramBlockIdentifier=10, NvMRamBlockDataAddress=&Dem_UserDefinedEventMemory[2], NvMSelectBlockForReadAll=1, NvMSelectBlockForWriteAll=1
        NvMTargetBlockReference
          NvMFeeRef: NvMNameOfFeeBlock=FeeBlock_DemUserDefinedEventMemoryEntry_2
      NvMBlock_DemMirrorEventMemory_0: NvMNvBlockBaseNumber=11, NvMNvramBlockIdentifier=11, NvMRamBlockDataAddress=&Dem_MirrorEventMemory[0], NvMSelectBlockForReadAll=1, NvMSelectBlockForWriteAll=1
        NvMTargetBlockReference
          NvMFeeRef: NvMNameOfFeeBlock=FeeBlock_DemMirrorEventMemory_0
      NvMBlock_DemMirrorEventMemory_1: NvMNvBlockBaseNumber=12, NvMNvramBlockIdentifier=12, NvMRamBlockDataAddress=&Dem_MirrorEventMemory[1], NvMSelectBlockForReadAll=1, NvMSelectBlockForWriteAll=1
        NvMTargetBlockReference
          NvMFeeRef: NvMNameOfFeeBlock=FeeBlock_DemMirrorEventMemory_1
      NvMBlock_DemMirrorEventMemory_2: NvMNvBlockBaseNumber=13, NvMNvramBlockIdentifier=13, NvMRamBlockDataAddress=&Dem_MirrorEventMemory[2], NvMSelectBlockForReadAll=1, NvMSelectBlockForWriteAll=1
        NvMTargetBlockReference
          NvMFeeRef: NvMNameOfFeeBlock=FeeBlock_DemMirrorEventMemory_2
      NvMBlock_DemPermanentEventMemory_0: NvMNvBlockBaseNumber=14, NvMNvramBlockIdentifier=14, NvMSelectBlockForReadAll=0, NvMSelectBlockForWriteAll=0
        NvMTargetBlockReference
          NvMFeeRef: NvMNameOfFeeBlock=FeeBlock_DemPermanentEventMemory_0
      NvMBlock_DemPermanentEventMemory_1: NvMNvBlockBaseNumber=15, NvMNvramBlockIdentifier=15, NvMSelectBlockForReadAll=0, NvMSelectBlockForWriteAll=0
        NvMTargetBlockReference
          NvMFeeRef: NvMNameOfFeeBlock=FeeBlock_DemPermanentEventMemory_1
      NvMBlock_DemPermanentEventMemory_2: NvMNvBlockBaseNumber=16, NvMNvramBlockIdentifier=16, NvMSelectBlockForReadAll=0, NvMSelectBlockForWriteAll=0
        NvMTargetBlockReference
          NvMFeeRef: NvMNameOfFeeBlock=FeeBlock_DemPermanentEventMemory_2
