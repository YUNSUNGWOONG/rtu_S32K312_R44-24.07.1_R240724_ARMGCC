AUTOSAR XML (schema 00047)
package /AUTRON
  module config WdgIf: implementation-config-variant=VARIANT-PRE-COMPILE, module-description=BswImplementation_WdgIf
    WdgIfDevice_Int (WdgIfDevice): WdgIfDeviceIndex=0, WdgIfDriverRef=WdgGeneral
    WdgIfDevice_Ext (WdgIfDevice): WdgIfDeviceIndex=1, WdgIfDriverRef=WdgGeneral
    WdgIfGeneral: WdgIfDevErrorDetect=1, WdgIfVersionInfoApi=1
