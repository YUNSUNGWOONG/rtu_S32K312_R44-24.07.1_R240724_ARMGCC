AUTOSAR XML (schema 00047)
package /AUTRON
  module config LinTrcv: implementation-config-variant=VARIANT-PRE-COMPILE, module-description=BswImplementation_LinTrcv
    LinTrcvGeneral:
      LinTrcvDevErrorDetect = 1
      LinTrcvIndex = 0
      LinTrcvVersionInfoApi = 1
      LinTrcvWakeUpSupport = 1
      LinTrcvTimerType = None
      LinTrcvWaitTime = 0.00005
      LinTrcvEcucPartitionRef = EcucPartition_Main
    LIN1 (LinTrcvChannel): LinTrcvChannelId=0, LinTrcvChannelUsed=1, LinTrcvWakeupByBusUsed=0, LinTrcvStandbyModeUsed=0
      LinTrcvAccess
        LinTrcvDioAccess
          3 x LinTrcvDioChannelAccess:
            LinTrcvDioChannelAccess_EN: LinTrcvHardwareInterfaceName=EN, LinTrcvDioSymRefName=DioChannel_PTD10
            LinTrcvDioChannelAccess0: LinTrcvHardwareInterfaceName=TX, LinTrcvDioSymRefName=DioChannel_PTB1
            LinTrcvDioChannelAccess1: LinTrcvHardwareInterfaceName=RX, LinTrcvDioSymRefName=DioChannel_PTB0
    LIN2 (LinTrcvChannel): LinTrcvChannelId=1, LinTrcvChannelUsed=1, LinTrcvWakeupByBusUsed=0, LinTrcvStandbyModeUsed=0
      LinTrcvAccess
        LinTrcvDioAccess
          3 x LinTrcvDioChannelAccess:
            LinTrcvDioChannelAccess0: LinTrcvHardwareInterfaceName=EN, LinTrcvDioSymRefName=DioChannel_PTD11
            LinTrcvDioChannelAccess1: LinTrcvHardwareInterfaceName=TX, LinTrcvDioSymRefName=DioChannel_PTB27
            LinTrcvDioChannelAccess2: LinTrcvHardwareInterfaceName=RX, LinTrcvDioSymRefName=DioChannel_PTB28
