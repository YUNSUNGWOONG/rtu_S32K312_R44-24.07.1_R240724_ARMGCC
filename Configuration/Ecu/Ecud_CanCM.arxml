AUTOSAR XML (schema 00047)
package /AUTRON
  module config CanCM: implementation-config-variant=VARIANT-PRE-COMPILE, module-description=BswImplementation_CanCM
    CanCMGlobalConfig:
      CanCMVersionInfoApi = 1
      CanCMDevErrorDetect = 1
      CanCMMainFunctionPeriod = 0.005
      CanCMDemStatusReport = 1
      CanCMDisableDMOnAbnormalVoltage = 1
      CanCMWakeupSupport = 1
      CanCMHysteresisSupport = 1
      CanCMFilteringConstant = 0
    CanCMChannel_FD_CAN1 (CanCMChannelConfig):
      CanCMVoltageHysteresis = 8
      CanCMChannelId = 0
      CanCMNetworkActivationTime = 0.22
      CanCMVoltageErrorDelayTime = 0.2
      CanCMTimeoutMonitoringStartTime = 1
      CanCMVoltageAbnormalUpper = 4086
      CanCMVoltageAbnormalLower = 10
      CanCMVoltageCriticalUpper = 4096
      CanCMVoltageCriticalLower = 0
      CanCMComMChannelId = ComMChannel_FD_CAN1
      CanCMDemEventParameterRefs: CANCM_E_BAT_FAIL=CANCM_E_BAT_FAIL
      CanCMWakeupParameterRefs: CanCMEcuMWakeupSourceRef=ECUM_WKSOURCE_FD_CAN1_RX_POLL, CanCMIoHwAbWakeupPinNameRef=IoHwAbDigitalDirectLogical_FD_CAN1_RX
    CanCMBatMon_VBAT (CanCMBatMonConfig): CanCMAdcDefault=2640, CanCMBatAnalogInputRef=IoHwAbAnalogInputDirectLogical_CANBAT
