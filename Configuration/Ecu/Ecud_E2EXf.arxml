AUTOSAR XML (schema 00047)
package /AUTRON
  module config E2EXf: definition=Xfrm, implementation-config-variant=VARIANT-PRE-COMPILE, module-description=BswImplementation_E2EXf
    XfrmGeneral: XfrmDevErrorDetect=1, XfrmInstanceId=0, XfrmVersionInfoApi=1
    E2EXf_MsgGr_E2E_FD_CAN1_BSD_01_50ms_P11 (XfrmImplementationMapping):
      XfrmTransformationTechnologyRef = XfTechRx_E2EXf_P11_8
      XfrmInvTransformerBswModuleEntryRef = E2EXf_Inv_Com_ComISignalGroup_MsgGr_E2E_FD_CAN1_BSD_01_50ms_P11
      XfrmSignal: category=TOOL_CONFIGURED
        XfrmSignalChoice: category=TOOL_CONFIGURED
          XfrmISignalGroupRefChoice: category=TOOL_CONFIGURED, XfrmISignalGroupRef=MsgGr_E2E_FD_CAN1_BSD_01_50ms_P11
    E2EXf_MsgGr_E2E_FD_CAN1_TCU_01_10ms_P11 (XfrmImplementationMapping):
      XfrmTransformationTechnologyRef = XfTechTx_E2EXf_P11_8
      XfrmTransformerBswModuleEntryRef = E2EXf_Com_ComISignalGroup_MsgGr_E2E_FD_CAN1_TCU_01_10ms_P11
      XfrmSignal: category=TOOL_CONFIGURED
        XfrmSignalChoice: category=TOOL_CONFIGURED
          XfrmISignalGroupRefChoice: category=TOOL_CONFIGURED, XfrmISignalGroupRef=MsgGr_E2E_FD_CAN1_TCU_01_10ms_P11
