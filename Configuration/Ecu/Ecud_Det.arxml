AUTOSAR XML (schema 00047)
package /AUTRON
  module config Det: implementation-config-variant=VARIANT-PRE-COMPILE, module-description=BswImplementation_Det, post-build-variant-used=true
    DetGeneral: DetVersionInfoApi=1, DetRamBufferSize=255, DetForwardToDlt=0
    DetNotification: DetErrorHook=Det_ErrorHook
    DetConfigSet
      DS000 (DetModule): DetModuleId=4096
        Ins0 (DetModuleInstance): DetInstanceId=0
