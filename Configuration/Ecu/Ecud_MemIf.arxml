AUTOSAR XML (schema 00047)
package /AUTRON
  module config MemIf: ecuc-def-edition=4.4.7, implementation-config-variant=VARIANT-PRE-COMPILE, module-description=BswImplementation_MemIf
    MemIfGeneral: MemIfNumberOfDevices=1, MemIfDevErrorDetect=1, MemIfVersionInfoApi=1
