AUTOSAR XML (schema 00047)
package /AUTRON
  module config WdgM: implementation-config-variant=VARIANT-PRE-COMPILE, module-description=BswImplementation_WdgM, post-build-variant-used=false
    WdgMGeneral: WdgMDevErrorDetect=1, WdgMOffModeEnabled=1, WdgMDemStoppedSupervisionReport=1, WdgMImmediateReset=1, WdgMVersionInfoApi=1
      SE_Init (WdgMSupervisedEntity):
        WdgMSupervisedEntityId = 300
        WdgMInternalCheckpointInitialRef = CP_Init_ILS_0
        WdgMInternalCheckpointFinalRef = CP_Init_ILS_1
        WdgMEcucPartitionRef = EcucPartition_Main
        WdgMOsCounter = OsCounter_Main
        3 x WdgMCheckpoint:
          CP_Init_AS0: WdgMCheckpointId=0
          CP_Init_ILS_0: WdgMCheckpointId=1
          CP_Init_ILS_1: WdgMCheckpointId=2
      SE_WdgMTest (WdgMSupervisedEntity):
        WdgMSupervisedEntityId = 400
        WdgMInternalCheckpointInitialRef = CP_WdgMTest_ILS_0
        WdgMInternalCheckpointFinalRef = CP_WdgMTest_ILS_1
        WdgMEcucPartitionRef = EcucPartition_Main
        3 x WdgMCheckpoint:
          CP_WdgMTest_AS0: WdgMCheckpointId=0
          CP_WdgMTest_ILS_0: WdgMCheckpointId=1
          CP_WdgMTest_ILS_1: WdgMCheckpointId=2
      WdgMWatchdog_Int (WdgMWatchdog): WdgMWatchdogName=Watchdog_Int, WdgMWatchdogDeviceRef=WdgIfDevice_Int
      WdgMWatchdog_Ext (WdgMWatchdog): WdgMWatchdogName=Watchdog_Ext, WdgMWatchdogDeviceRef=WdgIfDevice_Ext
    WdgMConfigSet0 (WdgMConfigSet): WdgMDeInitTimeout=4000, WdgMCoreID=0, WdgMInitialMode=WdgMMode0
      WdgMMode0 (WdgMMode): WdgMExpiredSupervisionCycleTol=0, WdgMModeId=0, WdgMSupervisionCycle=0.010
        WdgMAliveSupervision0 (WdgMAliveSupervision): WdgMExpectedAliveIndications=1, WdgMMaxMargin=0, WdgMMinMargin=0, WdgMSupervisionReferenceCycle=800, WdgMAliveSupervisionCheckpointRef=CP_Init_AS0
        WdgMLocalStatusParams0 (WdgMLocalStatusParams): WdgMFailedAliveSupervisionRefCycleTol=0, WdgMLocalStatusSupervisedEntityRef=SE_Init
        WdgMTrigger_Int (WdgMTrigger): WdgMTriggerConditionValue=500, WdgMWatchdogMode=WDGIF_SLOW_MODE, WdgMTriggerWatchdogRef=WdgMWatchdog_Int
        WdgMTrigger_Ext (WdgMTrigger): WdgMTriggerConditionValue=500, WdgMWatchdogMode=WDGIF_SLOW_MODE, WdgMTriggerWatchdogRef=WdgMWatchdog_Ext
      WdgMDemEventParameterRefs: WDGM_E_SET_MODE=WDGM_E_SET_MODE, WDGM_E_SUPERVISION=WDGM_E_MONITORING
      WdgMMode1 (WdgMMode): WdgMExpiredSupervisionCycleTol=2, WdgMModeId=1, WdgMSupervisionCycle=0.010
        WdgMAliveSupervision0 (WdgMAliveSupervision): WdgMExpectedAliveIndications=10, WdgMMaxMargin=1, WdgMMinMargin=1, WdgMSupervisionReferenceCycle=10, WdgMAliveSupervisionCheckpointRef=CP_Init_AS0
        WdgMLocalStatusParams0 (WdgMLocalStatusParams): WdgMFailedAliveSupervisionRefCycleTol=1, WdgMLocalStatusSupervisedEntityRef=SE_Init
        WdgMTrigger_Int (WdgMTrigger): WdgMTriggerConditionValue=200, WdgMWatchdogMode=WDGIF_FAST_MODE, WdgMTriggerWatchdogRef=WdgMWatchdog_Int
        WdgMTrigger_Ext (WdgMTrigger): WdgMTriggerConditionValue=200, WdgMWatchdogMode=WDGIF_FAST_MODE, WdgMTriggerWatchdogRef=WdgMWatchdog_Ext
