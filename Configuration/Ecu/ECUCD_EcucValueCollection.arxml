AUTOSAR XML (schema 00047)
package /EcucValueCollection
  ecuc value collection EcucValueCollection: category=MANAGED_ECUC_MODULES, ecu-extract=EcuExtract
    ecuc-values:
      CanSM
      Com
      ComM
      Dio
      EcuC
      Gpt
      Port
      Rte
      HwResource
      Mcu
      CanTrcv
      Adc
      CanIf
      PduR
      Det
      Icu
      Pwm
      IoHwAb
      CanTp
      Wdg
      WdgIf
      WdgM
      Wdg_76_Acw
      Crc
      Dem
      Spi
      Dcm
      E2EXf
      MemIf
      NvM
      BswM
      EcuM
      CanCM
      StbM
      Tm
      Nm
      CanNm
      FiM
      LinIf
      LinSM
      LinTrcv
      IpduM
      ComXf
      CryIf
      LinTp
      KeyM
      Csm
      Fee
      Fls
      OsImp
      Crypto
      Mcl
      Os
      Resource
      OsProfiler
      BaseNXP
      Can
      Lin
      Fota
      Mem_76_Pfls
      Crypto_76_HaeModule
