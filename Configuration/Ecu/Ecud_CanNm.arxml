AUTOSAR XML (schema 00047)
package /AUTRON
  module config CanNm: implementation-config-variant=VARIANT-PRE-COMPILE, module-description=BswImplementation_CanNm
    CanNmGlobalConfig:
      CanNmBusLoadReductionEnabled = 0
      CanNmBusSynchronizationEnabled = 0
      CanNmComControlEnabled = 1
      CanNmCoordinatorSyncSupport = 0
      CanNmDevErrorDetect = 1
      CanNmGlobalPnSupport = 1
      CanNmImmediateRestartEnabled = 0
      CanNmImmediateTxconfEnabled = 0
      CanNmMainFunctionPeriod = 0.005
      CanNmPduRxIndicationEnabled = 0
      CanNmPnEiraCalcEnabled = 1
      CanNmRemoteSleepIndEnabled = 0
      CanNmStateChangeIndEnabled = 0
      CanNmVersionInfoApi = 1
      CanNmUserDataEnabled = 1
      CanNmComUserDataSupport = 1
      CanNmPassiveModeEnabled = 0
      CanNmPnResetTime = 0.5
      CanNmPassiveNodeEnabled = 0
      CanNmPnEiraRxNSduRef = Pdu_ComMPdu_Rx_EIRA_CanNm
      CanNmChannelConfig_FD_CAN1 (CanNmChannelConfig):
        category = TOOL_CONFIGURED
        CanNmActiveWakeupBitEnabled = 1
        CanNmAllNmMessagesKeepAwake = 0
        CanNmBusLoadReductionActive = 0
        CanNmCarWakeUpFilterEnabled = 0
        CanNmCarWakeUpRxEnabled = 0
        CanNmImmediateNmCycleTime = 0.01
        CanNmImmediateNmTransmissions = 3
        CanNmMsgCycleOffset = 0.0
        CanNmMsgCycleTime = 0.1
        CanNmMsgReducedTime = 1.0
        CanNmMsgTimeoutTime = 0.005
        CanNmNodeDetectionEnabled = 1
        CanNmNodeId = 2
        CanNmNodeIdEnabled = 1
        CanNmPduCbvPosition = CANNM_PDU_BYTE_1
        CanNmPduNidPosition = CANNM_PDU_BYTE_0
        CanNmPnEnabled = 1
        CanNmPnEraCalcEnabled = 0
        CanNmPnHandleMultipleNetworkRequests = 0
        CanNmRemoteSleepIndTime = 5.0
        CanNmRepeatMessageTime = 1.2
        CanNmRepeatMsgIndEnabled = 0
        CanNmTimeoutTime = 1.0
        CanNmWaitBusSleepTime = 1.5
        CanNmForcePnAvailabilityConfEnabled = 1
        CanNmCarWakeUpBitPosition = 0
        CanNmCarWakeUpBytePosition = 4
        CanNmPduNetworkRequestReasonPosition = CANNM_PDU_BYTE_2
        CanNmPduNmStatePosition = CANNM_PDU_BYTE_3
        CanNmComMNetworkHandleRef = ComMChannel_FD_CAN1
        CanNmRxPdu_IN_ECU1_FD_CAN1_CANNM_MESSAGE (CanNmRxPdu): category=TOOL_CONFIGURED, CanNmRxPduId=0, CanNmRxPduRef=Pdu_NmPdu_FD_CAN1_NM_MDPS
        CanNmTxPdu_NmPdu_FD_CAN1_NM_CGW (CanNmTxPdu): category=TOOL_CONFIGURED, CanNmTxConfirmationPduId=0, CanNmTxPduRef=Pdu_NmPdu_FD_CAN1_NM_CGW
        CanNmUserDataTxPdu_FD_CAN1 (CanNmUserDataTxPdu): category=TOOL_CONFIGURED, CanNmTxUserDataPduId=0, CanNmTxUserDataPduRef=Pdu_ComMPdu_Tx_PncVector_FD_CAN1
      CanNmPnInfo: category=TOOL_CONFIGURED, CanNmPnInfoLength=4, CanNmPnInfoOffset=4
        4 x CanNmPnFilterMaskByte, all with category=TOOL_CONFIGURED:
          CanNmPnFilterMaskByte_4: CanNmPnFilterMaskByteIndex=0, CanNmPnFilterMaskByteValue=1
          CanNmPnFilterMaskByte_5: CanNmPnFilterMaskByteIndex=1, CanNmPnFilterMaskByteValue=0
          CanNmPnFilterMaskByte_6: CanNmPnFilterMaskByteIndex=2, CanNmPnFilterMaskByteValue=0
          CanNmPnFilterMaskByte_7: CanNmPnFilterMaskByteIndex=3, CanNmPnFilterMaskByteValue=0
