AUTOSAR XML (schema 00047)
package /AUTRON
  module config PduR: implementation-config-variant=VARIANT-PRE-COMPILE, module-description=BswImplementation_PduR
    8 x PduRBswModules, all with PduRRetransmission=0, PduRTxConfirmation=1:
      PduRBswModules_Com: PduRCancelReceive=0, PduRCancelTransmit=1, PduRLowerModule=0, PduRTransportProtocol=1, PduRTriggertransmit=1, PduRUpperModule=1, PduRUseTag=0, PduRCommunicationInterface=1, PduRBswModuleRef=Com
      PduRBswModules_CanIf: PduRCancelReceive=1, PduRCancelTransmit=0, PduRCommunicationInterface=1, PduRLowerModule=1, PduRTransportProtocol=0, PduRTriggertransmit=1, PduRUpperModule=0, PduRUseTag=0, PduRBswModuleRef=CanIf
      PduRBswModules_CanTp: PduRCancelReceive=1, PduRCancelTransmit=1, PduRCommunicationInterface=0, PduRLowerModule=1, PduRTransportProtocol=1, PduRTriggertransmit=0, PduRUpperModule=0, PduRUseTag=0, PduRBswModuleRef=CanTp
      PduRBswModules_Dcm: PduRCancelTransmit=1, PduRCommunicationInterface=0, PduRLowerModule=0, PduRTransportProtocol=1, PduRTriggertransmit=0, PduRUpperModule=1, PduRUseTag=0, PduRCancelReceive=1, PduRBswModuleRef=Dcm
      PduRBswModules_CanNm: PduRCommunicationInterface=1, PduRLowerModule=1, PduRTriggertransmit=1, PduRCancelReceive=0, PduRCancelTransmit=0, PduRTransportProtocol=0, PduRUpperModule=0, PduRUseTag=0, PduRBswModuleRef=CanNm
      PduRBswModules_LinIf: PduRCancelReceive=0, PduRCancelTransmit=0, PduRCommunicationInterface=1, PduRLowerModule=1, PduRTransportProtocol=0, PduRTriggertransmit=1, PduRUpperModule=0, PduRUseTag=0, PduRBswModuleRef=LinIf
      PduRBswModules_IpduM: PduRCancelReceive=0, PduRCancelTransmit=0, PduRCommunicationInterface=1, PduRLowerModule=1, PduRTransportProtocol=0, PduRTriggertransmit=1, PduRUpperModule=1, PduRUseTag=0, PduRBswModuleRef=IpduM
      PduRBswModules_LinTp: PduRCancelReceive=1, PduRCancelTransmit=1, PduRCommunicationInterface=0, PduRLowerModule=1, PduRTransportProtocol=1, PduRTriggertransmit=0, PduRUpperModule=0, PduRUseTag=1, PduRBswModuleRef=LinTp
    PduRGeneral: PduRDevErrorDetect=1, PduRVersionInfoApi=0, PduRTxInterruptBased=0, PduRRxInterruptBased=0, PduRSharedGatewayIfBuffer=0, PduRZeroCostOperation=0
    PduRRoutingPaths: PduRConfigurationId=0
      11 x PduRDestPdu, all with category=TOOL_CONFIGURED, PduRTransmissionConfirmation=1:
        PduR_LIN1_Master_Cmd_DestPdu: PduRDestPduHandleId=0, PduRDestPduRef=Pdu_ISignalIPdu_LIN1_Master_Cmd
        PduR_LIN1_FL_Sensor_Status_DestPdu: PduRDestPduHandleId=0, PduRDestPduRef=Pdu_ISignalIPdu_LIN1_FL_Sensor_Status
        PduR_LIN1_FCL_Sensor_Status_DestPdu: PduRDestPduHandleId=1, PduRDestPduRef=Pdu_ISignalIPdu_LIN1_FCL_Sensor_Status
        PduR_LIN1_FCR_Sensor_Status_DestPdu: PduRDestPduHandleId=2, PduRDestPduRef=Pdu_ISignalIPdu_LIN1_FCR_Sensor_Status
        PduR_LIN1_FR_Sensor_Status_DestPdu: PduRDestPduHandleId=3, PduRDestPduRef=Pdu_ISignalIPdu_LIN1_FR_Sensor_Status
        PduR_LIN1_RL_Sensor_Status_DestPdu: PduRDestPduHandleId=4, PduRDestPduRef=Pdu_ISignalIPdu_LIN1_RL_Sensor_Status
        PduR_LIN1_RCL_Sensor_Status_DestPdu: PduRDestPduHandleId=5, PduRDestPduRef=Pdu_ISignalIPdu_LIN1_RCL_Sensor_Status
        PduR_LIN1_RCR_Sensor_Status_DestPdu: PduRDestPduHandleId=6, PduRDestPduRef=Pdu_ISignalIPdu_LIN1_RCR_Sensor_Status
        PduR_LIN1_RR_Sensor_Status_DestPdu: PduRDestPduHandleId=7, PduRDestPduRef=Pdu_ISignalIPdu_LIN1_RR_Sensor_Status
        PduR_FD_CAN1_BSD_01_50ms_P11_DestPdu: PduRDestPduHandleId=8, PduRDestPduRef=Pdu_ISignalIPdu_FD_CAN1_BSD_01_50ms_P11
        PduR_FD_CAN1_TCU_01_10ms_P11_DestPdu: PduRDestPduHandleId=1, PduRDestPduRef=Pdu_ISignalIPdu_FD_CAN1_TCU_01_10ms_P11
      13 x PduRRoutingPath, all with category=TOOL_CONFIGURED:
        OUT_PduTriggering_LIN1_Master_Cmd_RoutingPath: PduRSrcPduRRef=PduR_LIN1_Master_Cmd_SrcPdu, PduRDestPduRRef=PduR_LIN1_Master_Cmd_DestPdu
        IN_PduTriggering_LIN1_FL_Sensor_Status_RoutingPath: PduRSrcPduRRef=PduR_LIN1_FL_Sensor_Status_SrcPdu, PduRDestPduRRef=PduR_LIN1_FL_Sensor_Status_DestPdu
        IN_PduTriggering_LIN1_FCL_Sensor_Status_RoutingPath: PduRSrcPduRRef=PduR_LIN1_FCL_Sensor_Status_SrcPdu, PduRDestPduRRef=PduR_LIN1_FCL_Sensor_Status_DestPdu
        IN_PduTriggering_LIN1_FCR_Sensor_Status_RoutingPath: PduRSrcPduRRef=PduR_LIN1_FCR_Sensor_Status_SrcPdu, PduRDestPduRRef=PduR_LIN1_FCR_Sensor_Status_DestPdu
        IN_PduTriggering_LIN1_FR_Sensor_Status_RoutingPath: PduRSrcPduRRef=PduR_LIN1_FR_Sensor_Status_SrcPdu, PduRDestPduRRef=PduR_LIN1_FR_Sensor_Status_DestPdu
        IN_PduTriggering_LIN1_RL_Sensor_Status_RoutingPath: PduRSrcPduRRef=PduR_LIN1_RL_Sensor_Status_SrcPdu, PduRDestPduRRef=PduR_LIN1_RL_Sensor_Status_DestPdu
        IN_PduTriggering_LIN1_RCL_Sensor_Status_RoutingPath: PduRSrcPduRRef=PduR_LIN1_RCL_Sensor_Status_SrcPdu, PduRDestPduRRef=PduR_LIN1_RCL_Sensor_Status_DestPdu
        IN_PduTriggering_LIN1_RCR_Sensor_Status_RoutingPath: PduRSrcPduRRef=PduR_LIN1_RCR_Sensor_Status_SrcPdu, PduRDestPduRRef=PduR_LIN1_RCR_Sensor_Status_DestPdu
        IN_PduTriggering_LIN1_RR_Sensor_Status_RoutingPath: PduRSrcPduRRef=PduR_LIN1_RR_Sensor_Status_SrcPdu, PduRDestPduRRef=PduR_LIN1_RR_Sensor_Status_DestPdu
        OUT_PduTriggering_LIN1_MasterReq_RoutingPath: PduRSrcPduRRef=PduR_DcmIPdu_LIN1_MasterReq_SrcPdu, PduRDestPduRRef=PduR_DcmIPdu_LIN1_MasterReq_DestPdu
        IN_PduTriggering_LIN1_SlaveResp_RoutingPath: PduRSrcPduRRef=PduR_DcmIPdu_LIN1_SlaveResp_SrcPdu, PduRDestPduRRef=PduR_DcmIPdu_LIN1_SlaveResp_DestPdu
        IN_FD_CAN1_BSD_01_50ms_P11_RoutingPath: PduRSrcPduRRef=PduR_FD_CAN1_BSD_01_50ms_P11_SrcPdu, PduRDestPduRRef=PduR_FD_CAN1_BSD_01_50ms_P11_DestPdu
        OUT_FD_CAN1_TCU_01_10ms_P11_RoutingPath: PduRSrcPduRRef=PduR_FD_CAN1_TCU_01_10ms_P11_SrcPdu, PduRDestPduRRef=PduR_FD_CAN1_TCU_01_10ms_P11_DestPdu
      11 x PduRSrcPdu, all with category=TOOL_CONFIGURED, PduRSrcPduUpTxConf=1:
        PduR_LIN1_Master_Cmd_SrcPdu: PduRSourcePduHandleId=0, PduRSrcPduRef=Pdu_ISignalIPdu_LIN1_Master_Cmd
        PduR_LIN1_FL_Sensor_Status_SrcPdu: PduRSourcePduHandleId=0, PduRSrcPduRef=Pdu_ISignalIPdu_LIN1_FL_Sensor_Status
        PduR_LIN1_FCL_Sensor_Status_SrcPdu: PduRSourcePduHandleId=1, PduRSrcPduRef=Pdu_ISignalIPdu_LIN1_FCL_Sensor_Status
        PduR_LIN1_FCR_Sensor_Status_SrcPdu: PduRSourcePduHandleId=2, PduRSrcPduRef=Pdu_ISignalIPdu_LIN1_FCR_Sensor_Status
        PduR_LIN1_FR_Sensor_Status_SrcPdu: PduRSourcePduHandleId=3, PduRSrcPduRef=Pdu_ISignalIPdu_LIN1_FR_Sensor_Status
        PduR_LIN1_RL_Sensor_Status_SrcPdu: PduRSourcePduHandleId=4, PduRSrcPduRef=Pdu_ISignalIPdu_LIN1_RL_Sensor_Status
        PduR_LIN1_RCL_Sensor_Status_SrcPdu: PduRSourcePduHandleId=5, PduRSrcPduRef=Pdu_ISignalIPdu_LIN1_RCL_Sensor_Status
        PduR_LIN1_RCR_Sensor_Status_SrcPdu: PduRSourcePduHandleId=6, PduRSrcPduRef=Pdu_ISignalIPdu_LIN1_RCR_Sensor_Status
        PduR_LIN1_RR_Sensor_Status_SrcPdu: PduRSourcePduHandleId=7, PduRSrcPduRef=Pdu_ISignalIPdu_LIN1_RR_Sensor_Status
        PduR_FD_CAN1_BSD_01_50ms_P11_SrcPdu: PduRSourcePduHandleId=8, PduRSrcPduRef=Pdu_ISignalIPdu_FD_CAN1_BSD_01_50ms_P11
        PduR_FD_CAN1_TCU_01_10ms_P11_SrcPdu: PduRSourcePduHandleId=1, PduRSrcPduRef=Pdu_ISignalIPdu_FD_CAN1_TCU_01_10ms_P11
      IN_FD_CAN1_Normal_Msg_FD_TP_01_B_RoutingPath (PduRRoutingPath): category=TOOL_CONFIGURED, PduRSrcPduRRef=PduR_FD_CAN1_Normal_Msg_FD_TP_01_B_SrcPdu, PduRDestPduRRef=PduR_FD_CAN1_Normal_Msg_FD_TP_01_B_DestPdu
      PduR_FD_CAN1_Normal_Msg_FD_TP_01_B_DestPdu (PduRDestPdu): category=TOOL_CONFIGURED, PduRDestPduHandleId=9, PduRTransmissionConfirmation=1, PduRDestPduRef=Pdu_ISignalIPdu_FD_CAN1_Normal_Msg_FD_TP_01_B
      PduR_FD_CAN1_Normal_Msg_FD_TP_01_B_SrcPdu (PduRSrcPdu): category=TOOL_CONFIGURED, PduRSourcePduHandleId=0, PduRSrcPduUpTxConf=1, PduRSrcPduRef=Pdu_ISignalIPdu_FD_CAN1_Normal_Msg_FD_TP_01_B
      OUT_FD_CAN1_Normal_Msg_FD_TP_01_A_RoutingPath (PduRRoutingPath): category=TOOL_CONFIGURED, PduRSrcPduRRef=PduR_FD_CAN1_Normal_Msg_FD_TP_01_A_SrcPdu, PduRDestPduRRef=PduR_FD_CAN1_Normal_Msg_FD_TP_01_A_DestPdu
      PduR_FD_CAN1_Normal_Msg_FD_TP_01_A_DestPdu (PduRDestPdu): category=TOOL_CONFIGURED, PduRDestPduHandleId=0, PduRTransmissionConfirmation=1, PduRDestPduRef=Pdu_ISignalIPdu_FD_CAN1_Normal_Msg_FD_TP_01_A
      PduR_FD_CAN1_Normal_Msg_FD_TP_01_A_SrcPdu (PduRSrcPdu): category=TOOL_CONFIGURED, PduRSourcePduHandleId=2, PduRSrcPduUpTxConf=1, PduRSrcPduRef=Pdu_ISignalIPdu_FD_CAN1_Normal_Msg_FD_TP_01_A
      OUT_FD_CAN1_AFLS_01_100ms_RoutingPath (PduRRoutingPath): category=TOOL_CONFIGURED, PduRSrcPduRRef=PduR_FD_CAN1_AFLS_01_100ms_SrcPdu, PduRDestPduRRef=PduR_FD_CAN1_AFLS_01_100ms_DestPdu
      PduR_FD_CAN1_AFLS_01_100ms_DestPdu (PduRDestPdu): category=TOOL_CONFIGURED, PduRDestPduHandleId=2, PduRTransmissionConfirmation=1, PduRDestPduRef=Pdu_ISignalIPdu_FD_CAN1_AFLS_01_100ms
      PduR_FD_CAN1_AFLS_01_100ms_SrcPdu (PduRSrcPdu): category=TOOL_CONFIGURED, PduRSourcePduHandleId=3, PduRSrcPduUpTxConf=1, PduRSrcPduRef=Pdu_ISignalIPdu_FD_CAN1_AFLS_01_100ms
      OUT_FD_CAN1_AHLS_01_300ms_RoutingPath (PduRRoutingPath): category=TOOL_CONFIGURED, PduRSrcPduRRef=PduR_FD_CAN1_AHLS_01_300ms_SrcPdu, PduRDestPduRRef=PduR_FD_CAN1_AHLS_01_300ms_DestPdu
      PduR_FD_CAN1_AHLS_01_300ms_DestPdu (PduRDestPdu): category=TOOL_CONFIGURED, PduRDestPduHandleId=3, PduRTransmissionConfirmation=1, PduRDestPduRef=Pdu_ISignalIPdu_FD_CAN1_AHLS_01_300ms
      PduR_FD_CAN1_AHLS_01_300ms_SrcPdu (PduRSrcPdu): category=TOOL_CONFIGURED, PduRSourcePduHandleId=4, PduRSrcPduUpTxConf=1, PduRSrcPduRef=Pdu_ISignalIPdu_FD_CAN1_AHLS_01_300ms
      IN_ComMPdu_Rx_EIRA_CanNm_RoutingPath (PduRRoutingPath): category=TOOL_CONFIGURED, PduRSrcPduRRef=PduR_Rx_EIRA_CanNm_SrcPdu, PduRDestPduRRef=PduR_Rx_EIRA_CanNm_DestPdu
      PduR_Rx_EIRA_CanNm_DestPdu (PduRDestPdu): category=TOOL_CONFIGURED, PduRTransmissionConfirmation=1, PduRDestPduHandleId=10, PduRDestPduRef=Pdu_ComMPdu_Rx_EIRA_CanNm
      PduR_Rx_EIRA_CanNm_SrcPdu (PduRSrcPdu): category=TOOL_CONFIGURED, PduRSourcePduHandleId=9, PduRSrcPduUpTxConf=1, PduRSrcPduRef=Pdu_ComMPdu_Rx_EIRA_CanNm
      OUT_ComMPdu_Tx_PncVector_FD_CAN1_RoutingPath (PduRRoutingPath): category=TOOL_CONFIGURED, PduRSrcPduRRef=PduR_Tx_PncVector_FD_CAN1_SrcPdu, PduRDestPduRRef=PduR_Tx_PncVector_FD_CAN1_DestPdu
      PduR_Tx_PncVector_FD_CAN1_DestPdu (PduRDestPdu): category=TOOL_CONFIGURED, PduRTransmissionConfirmation=1, PduRDestPduHandleId=4, PduRDestPduRef=Pdu_ComMPdu_Tx_PncVector_FD_CAN1
      PduR_Tx_PncVector_FD_CAN1_SrcPdu (PduRSrcPdu): category=TOOL_CONFIGURED, PduRSourcePduHandleId=5, PduRSrcPduUpTxConf=1, PduRSrcPduRef=Pdu_ComMPdu_Tx_PncVector_FD_CAN1
      PduR_DcmIPdu_LIN1_MasterReq_DestPdu (PduRDestPdu): category=TOOL_CONFIGURED, PduRDestPduHandleId=1, PduRTransmissionConfirmation=1, PduRDestPduRef=Pdu_DcmIPdu_LIN1_MasterReq
      PduR_DcmIPdu_LIN1_MasterReq_SrcPdu (PduRSrcPdu): category=TOOL_CONFIGURED, PduRSourcePduHandleId=6, PduRSrcPduUpTxConf=1, PduRSrcPduRef=Pdu_DcmIPdu_LIN1_MasterReq
      PduR_DcmIPdu_LIN1_SlaveResp_DestPdu (PduRDestPdu): category=TOOL_CONFIGURED, PduRDestPduHandleId=11, PduRTransmissionConfirmation=1, PduRDestPduRef=Pdu_DcmIPdu_LIN1_SlaveResp
      PduR_DcmIPdu_LIN1_SlaveResp_SrcPdu (PduRSrcPdu): category=TOOL_CONFIGURED, PduRSourcePduHandleId=1, PduRSrcPduUpTxConf=1, PduRSrcPduRef=Pdu_DcmIPdu_LIN1_SlaveResp
      OUT_FD_CAN1_Diag_Msg_TP_Phys_Res_FD_CAN1_RoutingPath (PduRRoutingPath):
        category = TOOL_CONFIGURED
        PduRSrcPduRRef = PduR_DcmIPdu_FD_CAN1_Diag_Msg_TP_Phys_Res_FD_CAN1_SrcPdu
        PduRDestPduRRef = PduR_DcmIPdu_FD_CAN1_Diag_Msg_TP_Phys_Res_FD_CAN1_DestPdu
      PduR_DcmIPdu_FD_CAN1_Diag_Msg_TP_Phys_Res_FD_CAN1_DestPdu (PduRDestPdu): category=TOOL_CONFIGURED, PduRDestPduHandleId=2, PduRTransmissionConfirmation=1, PduRDestPduRef=Pdu_DcmIPdu_FD_CAN1_Diag_Msg_TP_Phys_Res_FD_CAN1
      PduR_DcmIPdu_FD_CAN1_Diag_Msg_TP_Phys_Res_FD_CAN1_SrcPdu (PduRSrcPdu): category=TOOL_CONFIGURED, PduRSourcePduHandleId=7, PduRSrcPduUpTxConf=1, PduRSrcPduRef=Pdu_DcmIPdu_FD_CAN1_Diag_Msg_TP_Phys_Res_FD_CAN1
      IN_FD_CAN1_Diag_Msg_TP_Phys_Req_FD_CAN1_RoutingPath (PduRRoutingPath):
        category = TOOL_CONFIGURED
        PduRSrcPduRRef = PduR_DcmIPdu_FD_CAN1_Diag_Msg_TP_Phys_Req_FD_CAN1_SrcPdu
        PduRDestPduRRef = PduR_DcmIPdu_FD_CAN1_Diag_Msg_TP_Phys_Req_FD_CAN1_DestPdu
      PduR_DcmIPdu_FD_CAN1_Diag_Msg_TP_Phys_Req_FD_CAN1_DestPdu (PduRDestPdu): category=TOOL_CONFIGURED, PduRDestPduHandleId=12, PduRTransmissionConfirmation=1, PduRDestPduRef=Pdu_DcmIPdu_FD_CAN1_Diag_Msg_TP_Phys_Req_FD_CAN1
      PduR_DcmIPdu_FD_CAN1_Diag_Msg_TP_Phys_Req_FD_CAN1_SrcPdu (PduRSrcPdu): category=TOOL_CONFIGURED, PduRSourcePduHandleId=2, PduRSrcPduUpTxConf=1, PduRSrcPduRef=Pdu_DcmIPdu_FD_CAN1_Diag_Msg_TP_Phys_Req_FD_CAN1
      IN_FD_CAN1_Diag_Msg_TP_Func_FD_CAN1_RoutingPath (PduRRoutingPath):
        category = TOOL_CONFIGURED
        PduRSrcPduRRef = PduR_DcmIPdu_FD_CAN1_Diag_Msg_TP_Func_FD_CAN1_SrcPdu
        PduRDestPduRRef = PduR_DcmIPdu_FD_CAN1_Diag_Msg_TP_Func_FD_CAN1_DestPdu
      PduR_DcmIPdu_FD_CAN1_Diag_Msg_TP_Func_FD_CAN1_DestPdu (PduRDestPdu): category=TOOL_CONFIGURED, PduRDestPduHandleId=13, PduRTransmissionConfirmation=1, PduRDestPduRef=Pdu_DcmIPdu_FD_CAN1_Diag_Msg_TP_Func_FD_CAN1
      PduR_DcmIPdu_FD_CAN1_Diag_Msg_TP_Func_FD_CAN1_SrcPdu (PduRSrcPdu): category=TOOL_CONFIGURED, PduRSourcePduHandleId=3, PduRSrcPduUpTxConf=1, PduRSrcPduRef=Pdu_DcmIPdu_FD_CAN1_Diag_Msg_TP_Func_FD_CAN1
      OUT_FD_CAN1_AtmResp_RoutingPath (PduRRoutingPath): category=TOOL_CONFIGURED, PduRSrcPduRRef=PduR_FD_CAN1_AtmResp_SrcPdu, PduRDestPduRRef=PduR_FD_CAN1_AtmResp_DestPdu
      PduR_FD_CAN1_AtmResp_DestPdu (PduRDestPdu): category=TOOL_CONFIGURED, PduRDestPduHandleId=5, PduRTransmissionConfirmation=1, PduRDestPduRef=Pdu_ISignalIPdu_FD_CAN1_AtmResp
      PduR_FD_CAN1_AtmResp_SrcPdu (PduRSrcPdu): category=TOOL_CONFIGURED, PduRSourcePduHandleId=8, PduRSrcPduUpTxConf=1, PduRSrcPduRef=Pdu_ISignalIPdu_FD_CAN1_AtmResp
      IN_FD_CAN1_AtmReq_RoutingPath (PduRRoutingPath): category=TOOL_CONFIGURED, PduRSrcPduRRef=PduR_FD_CAN1_AtmReq_SrcPdu, PduRDestPduRRef=PduR_FD_CAN1_AtmReq_DestPdu
      PduR_FD_CAN1_AtmReq_DestPdu (PduRDestPdu): category=TOOL_CONFIGURED, PduRDestPduHandleId=14, PduRTransmissionConfirmation=1, PduRDestPduRef=Pdu_ISignalIPdu_FD_CAN1_AtmReq
      PduR_FD_CAN1_AtmReq_SrcPdu (PduRSrcPdu): category=TOOL_CONFIGURED, PduRSourcePduHandleId=10, PduRSrcPduUpTxConf=1, PduRSrcPduRef=Pdu_ISignalIPdu_FD_CAN1_AtmReq
      OUT_PduTriggering_LIN2_Master_Cmd_RoutingPath (PduRRoutingPath): category=TOOL_CONFIGURED, PduRSrcPduRRef=PduR_LIN2_Master_Cmd_SrcPdu, PduRDestPduRRef=PduR_LIN2_Master_Cmd_DestPdu
      PduR_LIN2_Master_Cmd_DestPdu (PduRDestPdu): category=TOOL_CONFIGURED, PduRDestPduHandleId=6, PduRTransmissionConfirmation=1, PduRDestPduRef=Pdu_ISignalIPdu_LIN2_Master_Cmd
      PduR_LIN2_Master_Cmd_SrcPdu (PduRSrcPdu): category=TOOL_CONFIGURED, PduRSourcePduHandleId=9, PduRSrcPduUpTxConf=1, PduRSrcPduRef=Pdu_ISignalIPdu_LIN2_Master_Cmd
      IN_PduTriggering_LIN2_FL_Sensor_Status_RoutingPath (PduRRoutingPath): category=TOOL_CONFIGURED, PduRSrcPduRRef=PduR_LIN2_FL_Sensor_Status_SrcPdu, PduRDestPduRRef=PduR_LIN2_FL_Sensor_Status_DestPdu
      PduR_LIN2_FL_Sensor_Status_DestPdu (PduRDestPdu): category=TOOL_CONFIGURED, PduRDestPduHandleId=15, PduRTransmissionConfirmation=1, PduRDestPduRef=Pdu_ISignalIPdu_LIN2_FL_Sensor_Status
      PduR_LIN2_FL_Sensor_Status_SrcPdu (PduRSrcPdu): category=TOOL_CONFIGURED, PduRSourcePduHandleId=11, PduRSrcPduUpTxConf=1, PduRSrcPduRef=Pdu_ISignalIPdu_LIN2_FL_Sensor_Status
      IN_PduTriggering_LIN2_FCL_Sensor_Status_RoutingPath (PduRRoutingPath): category=TOOL_CONFIGURED, PduRSrcPduRRef=PduR_LIN2_FCL_Sensor_Status_SrcPdu, PduRDestPduRRef=PduR_LIN2_FCL_Sensor_Status_DestPdu
      PduR_LIN2_FCL_Sensor_Status_DestPdu (PduRDestPdu): category=TOOL_CONFIGURED, PduRDestPduHandleId=16, PduRTransmissionConfirmation=1, PduRDestPduRef=Pdu_ISignalIPdu_LIN2_FCL_Sensor_Status
      PduR_LIN2_FCL_Sensor_Status_SrcPdu (PduRSrcPdu): category=TOOL_CONFIGURED, PduRSourcePduHandleId=12, PduRSrcPduUpTxConf=1, PduRSrcPduRef=Pdu_ISignalIPdu_LIN2_FCL_Sensor_Status
      IN_PduTriggering_LIN2_FCR_Sensor_Status_RoutingPath (PduRRoutingPath): category=TOOL_CONFIGURED, PduRSrcPduRRef=PduR_LIN2_FCR_Sensor_Status_SrcPdu, PduRDestPduRRef=PduR_LIN2_FCR_Sensor_Status_DestPdu
      PduR_LIN2_FCR_Sensor_Status_DestPdu (PduRDestPdu): category=TOOL_CONFIGURED, PduRDestPduHandleId=17, PduRTransmissionConfirmation=1, PduRDestPduRef=Pdu_ISignalIPdu_LIN2_FCR_Sensor_Status
      PduR_LIN2_FCR_Sensor_Status_SrcPdu (PduRSrcPdu): category=TOOL_CONFIGURED, PduRSourcePduHandleId=13, PduRSrcPduUpTxConf=1, PduRSrcPduRef=Pdu_ISignalIPdu_LIN2_FCR_Sensor_Status
      IN_PduTriggering_LIN2_FR_Sensor_Status_RoutingPath (PduRRoutingPath): category=TOOL_CONFIGURED, PduRSrcPduRRef=PduR_LIN2_FR_Sensor_Status_SrcPdu, PduRDestPduRRef=PduR_LIN2_FR_Sensor_Status_DestPdu
      PduR_LIN2_FR_Sensor_Status_DestPdu (PduRDestPdu): category=TOOL_CONFIGURED, PduRDestPduHandleId=18, PduRTransmissionConfirmation=1, PduRDestPduRef=Pdu_ISignalIPdu_LIN2_FR_Sensor_Status
      PduR_LIN2_FR_Sensor_Status_SrcPdu (PduRSrcPdu): category=TOOL_CONFIGURED, PduRSourcePduHandleId=14, PduRSrcPduUpTxConf=1, PduRSrcPduRef=Pdu_ISignalIPdu_LIN2_FR_Sensor_Status
      IN_PduTriggering_LIN2_RL_Sensor_Status_RoutingPath (PduRRoutingPath): category=TOOL_CONFIGURED, PduRSrcPduRRef=PduR_LIN2_RL_Sensor_Status_SrcPdu, PduRDestPduRRef=PduR_LIN2_RL_Sensor_Status_DestPdu
      PduR_LIN2_RL_Sensor_Status_DestPdu (PduRDestPdu): category=TOOL_CONFIGURED, PduRDestPduHandleId=19, PduRTransmissionConfirmation=1, PduRDestPduRef=Pdu_ISignalIPdu_LIN2_RL_Sensor_Status
      PduR_LIN2_RL_Sensor_Status_SrcPdu (PduRSrcPdu): category=TOOL_CONFIGURED, PduRSourcePduHandleId=15, PduRSrcPduUpTxConf=1, PduRSrcPduRef=Pdu_ISignalIPdu_LIN2_RL_Sensor_Status
      IN_PduTriggering_LIN2_RCL_Sensor_Status_RoutingPath (PduRRoutingPath): category=TOOL_CONFIGURED, PduRSrcPduRRef=PduR_LIN2_RCL_Sensor_Status_SrcPdu, PduRDestPduRRef=PduR_LIN2_RCL_Sensor_Status_DestPdu
      PduR_LIN2_RCL_Sensor_Status_DestPdu (PduRDestPdu): category=TOOL_CONFIGURED, PduRDestPduHandleId=20, PduRTransmissionConfirmation=1, PduRDestPduRef=Pdu_ISignalIPdu_LIN2_RCL_Sensor_Status
      PduR_LIN2_RCL_Sensor_Status_SrcPdu (PduRSrcPdu): category=TOOL_CONFIGURED, PduRSourcePduHandleId=16, PduRSrcPduUpTxConf=1, PduRSrcPduRef=Pdu_ISignalIPdu_LIN2_RCL_Sensor_Status
      IN_PduTriggering_LIN2_RCR_Sensor_Status_RoutingPath (PduRRoutingPath): category=TOOL_CONFIGURED, PduRSrcPduRRef=PduR_LIN2_RCR_Sensor_Status_SrcPdu, PduRDestPduRRef=PduR_LIN2_RCR_Sensor_Status_DestPdu
      PduR_LIN2_RCR_Sensor_Status_DestPdu (PduRDestPdu): category=TOOL_CONFIGURED, PduRDestPduHandleId=21, PduRTransmissionConfirmation=1, PduRDestPduRef=Pdu_ISignalIPdu_LIN2_RCR_Sensor_Status
      PduR_LIN2_RCR_Sensor_Status_SrcPdu (PduRSrcPdu): category=TOOL_CONFIGURED, PduRSourcePduHandleId=17, PduRSrcPduUpTxConf=1, PduRSrcPduRef=Pdu_ISignalIPdu_LIN2_RCR_Sensor_Status
      IN_PduTriggering_LIN2_RR_Sensor_Status_RoutingPath (PduRRoutingPath): category=TOOL_CONFIGURED, PduRSrcPduRRef=PduR_LIN2_RR_Sensor_Status_SrcPdu, PduRDestPduRRef=PduR_LIN2_RR_Sensor_Status_DestPdu
      PduR_LIN2_RR_Sensor_Status_DestPdu (PduRDestPdu): category=TOOL_CONFIGURED, PduRDestPduHandleId=22, PduRTransmissionConfirmation=1, PduRDestPduRef=Pdu_ISignalIPdu_LIN2_RR_Sensor_Status
      PduR_LIN2_RR_Sensor_Status_SrcPdu (PduRSrcPdu): category=TOOL_CONFIGURED, PduRSourcePduHandleId=18, PduRSrcPduUpTxConf=1, PduRSrcPduRef=Pdu_ISignalIPdu_LIN2_RR_Sensor_Status
      IN_FD_CAN1_V_CGW_02_A_RoutingPath (PduRRoutingPath): category=TOOL_CONFIGURED, PduRSrcPduRRef=PduR_FD_CAN1_V_CGW_02_A_SrcPdu, PduRDestPduRRef=PduR_FD_CAN1_V_CGW_02_A_DestPdu
      PduR_FD_CAN1_V_CGW_02_A_DestPdu (PduRDestPdu): category=TOOL_CONFIGURED, PduRDestPduHandleId=23, PduRTransmissionConfirmation=1, PduRDestPduRef=Pdu_ISignalIPdu_FD_CAN1_V_CGW_02_A
      PduR_FD_CAN1_V_CGW_02_A_SrcPdu (PduRSrcPdu): category=TOOL_CONFIGURED, PduRSourcePduHandleId=19, PduRSrcPduUpTxConf=1, PduRSrcPduRef=Pdu_ISignalIPdu_FD_CAN1_V_CGW_02_A
      OUT_FD_CAN1_V_CGW_01_B_RoutingPath (PduRRoutingPath): category=TOOL_CONFIGURED, PduRSrcPduRRef=PduR_FD_CAN1_V_CGW_01_B_SrcPdu, PduRDestPduRRef=PduR_FD_CAN1_V_CGW_01_B_DestPdu
      PduR_FD_CAN1_V_CGW_01_B_DestPdu (PduRDestPdu): category=TOOL_CONFIGURED, PduRDestPduHandleId=7, PduRTransmissionConfirmation=1, PduRDestPduRef=Pdu_ISignalIPdu_FD_CAN1_V_CGW_01_B
      PduR_FD_CAN1_V_CGW_01_B_SrcPdu (PduRSrcPdu): category=TOOL_CONFIGURED, PduRSourcePduHandleId=10, PduRSrcPduUpTxConf=1, PduRSrcPduRef=Pdu_ISignalIPdu_FD_CAN1_V_CGW_01_B
