AUTOSAR XML (schema 00047)
package /AUTRON
  module config StbM: implementation-config-variant=VARIANT-PRE-COMPILE, module-description=BswImplementation_StbM
    StbMGeneral: StbMDevErrorDetect=1, StbMMainFunctionPeriod=0.005, StbMTimeRecordingSupport=1, StbMGetCurrentTimeExtendedAvailable=1, StbMVersionInfoApi=1
    5 x StbMSynchronizedTimeBase:
      Client0: StbMIsSystemWideGlobalTimeMaster=0, StbMNotificationInterface=SR_INTERFACE, StbMSynchronizedTimeBaseIdentifier=0, StbMAllowSystemWideGlobalTimeMaster=0, StbMSyncLossTimeout=1, StbMTimeLeapFutureThreshold=1, StbMTimeLeapPastThreshold=1, StbMClearTimeleapCount=1, StbMStatusNotificationMask=42
        StbMLocalTimeClock: StbMClockFrequency=800, StbMClockPrescaler=1, StbMLocalTimeHardware=OsCounter_Main
        StbMTimeCorrection:
          StbMAllowMasterRateCorrection = 0
          StbMRateCorrectionMeasurementDuration = 1
          StbMRateCorrectionsPerMeasurementDuration = 3
          StbMOffsetCorrectionJumpThreshold = 0
        StbMTimeRecording: StbMOffsetTimeRecordTableBlockCount=0, StbMSyncTimeRecordTableBlockCount=20
      Provider0: StbMAllowSystemWideGlobalTimeMaster=1, StbMIsSystemWideGlobalTimeMaster=1, StbMNotificationInterface=NO_NOTIFICATION, StbMSynchronizedTimeBaseIdentifier=1
        StbMLocalTimeClock: StbMClockFrequency=800, StbMClockPrescaler=1, StbMLocalTimeHardware=OsCounter_Main
      Offset0: StbMAllowSystemWideGlobalTimeMaster=1, StbMIsSystemWideGlobalTimeMaster=1, StbMNotificationInterface=NO_NOTIFICATION, StbMSynchronizedTimeBaseIdentifier=16, StbMOffsetTimeBase=Provider0
      Provider1: StbMAllowSystemWideGlobalTimeMaster=1, StbMIsSystemWideGlobalTimeMaster=1, StbMNotificationInterface=NO_NOTIFICATION, StbMSynchronizedTimeBaseIdentifier=2
        StbMLocalTimeClock: StbMClockFrequency=800, StbMClockPrescaler=1, StbMLocalTimeHardware=OsCounter_Main
      CertTime: StbMAllowSystemWideGlobalTimeMaster=1, StbMIsSystemWideGlobalTimeMaster=1, StbMNotificationInterface=NO_NOTIFICATION, StbMSynchronizedTimeBaseIdentifier=3
        StbMLocalTimeClock: StbMClockFrequency=800, StbMClockPrescaler=1, StbMLocalTimeHardware=OsCounter_Main
