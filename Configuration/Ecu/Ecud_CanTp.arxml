AUTOSAR XML (schema 00047)
package /AUTRON
  module config CanTp: implementation-config-variant=VARIANT-PRE-COMPILE, module-description=BswImplementation_CanTp
    CanTpConfig: CanTpMainFunctionPeriod=0.005, CanTpMaxChannelCnt=0
      3 x CanTpChannel, all with category=TOOL_CONFIGURED:
        CanTpChannel_0_Pdu_DcmIPdu_FD_CAN1_Diag_Msg_TP_Phys_Req_FD_CAN1
          CanTpTxNSdu_0_Pdu_DcmIPdu_FD_CAN1_Diag_Msg_TP_Phys_Res_FD_CAN1 (CanTpTxNSdu):
            category = TOOL_CONFIGURED
            CanTpTxAddressingFormat = CANTP_STANDARD
            CanTpTxPaddingActivation = CANTP_ON
            CanTpTxNSduId = 0
            CanTpTc = 1
            CanTpNbs = 1
            CanTpNcs = 0.005
            CanTpTxTaType = CANTP_PHYSICAL
            CanTpNas = 1
            CanTpTxNSduRef = Pdu_DcmIPdu_FD_CAN1_Diag_Msg_TP_Phys_Res_FD_CAN1
            CanTpTxNPdu_0 (CanTpTxNPdu): category=TOOL_CONFIGURED, CanTpTxNPduConfirmationPduId=0, CanTpTxNPduRef=Pdu_NPdu_FD_CAN1_Diag_Msg_TP_Phys_Res_FD_CAN1
            CanTpRxFcNPdu_0 (CanTpRxFcNPdu): category=TOOL_CONFIGURED, CanTpRxFcNPduId=0, CanTpRxFcNPduRef=Pdu_NPdu_FD_CAN1_Diag_Msg_TP_Phys_Req_FD_CAN1
            CanTpNSa_0 (CanTpNSa): category=TOOL_CONFIGURED, CanTpNSa=8
            CanTpNTa_0 (CanTpNTa): category=TOOL_CONFIGURED, CanTpNTa=240
          CanTpRxNSdu_0_Pdu_DcmIPdu_FD_CAN1_Diag_Msg_TP_Phys_Req_FD_CAN1 (CanTpRxNSdu):
            category = TOOL_CONFIGURED
            CanTpRxPaddingActivation = CANTP_ON
            CanTpRxAddressingFormat = CANTP_STANDARD
            CanTpRxTaType = CANTP_PHYSICAL
            CanTpRxNSduId = 0
            CanTpBs = 0
            CanTpNar = 1
            CanTpNbr = 0.005
            CanTpNcr = 1
            CanTpRxWftMax = 0
            CanTpSTmin = 0.005
            CanTpRxNSduRef = Pdu_DcmIPdu_FD_CAN1_Diag_Msg_TP_Phys_Req_FD_CAN1
            CanTpTxFcNPdu_0 (CanTpTxFcNPdu): category=TOOL_CONFIGURED, CanTpTxFcNPduConfirmationPduId=0, CanTpTxFcNPduRef=Pdu_NPdu_FD_CAN1_Diag_Msg_TP_Phys_Res_FD_CAN1
            CanTpRxNPdu_0 (CanTpRxNPdu): category=TOOL_CONFIGURED, CanTpRxNPduId=0, CanTpRxNPduRef=Pdu_NPdu_FD_CAN1_Diag_Msg_TP_Phys_Req_FD_CAN1
            CanTpNSa_0 (CanTpNSa): category=TOOL_CONFIGURED, CanTpNSa=8
            CanTpNTa_0 (CanTpNTa): category=TOOL_CONFIGURED, CanTpNTa=240
        CanTpChannel_1_Pdu_ISignalIPdu_FD_CAN1_Normal_Msg_FD_TP_01_B
          CanTpRxNSdu_1_Pdu_ISignalIPdu_FD_CAN1_Normal_Msg_FD_TP_01_B (CanTpRxNSdu):
            category = TOOL_CONFIGURED
            CanTpRxPaddingActivation = CANTP_ON
            CanTpRxAddressingFormat = CANTP_STANDARD
            CanTpRxTaType = CANTP_PHYSICAL
            CanTpRxNSduId = 1
            CanTpBs = 0
            CanTpNar = 1
            CanTpNbr = 0.005
            CanTpNcr = 1
            CanTpRxWftMax = 0
            CanTpSTmin = 0.005
            CanTpRxNSduRef = Pdu_ISignalIPdu_FD_CAN1_Normal_Msg_FD_TP_01_B
            CanTpTxFcNPdu_1 (CanTpTxFcNPdu): category=TOOL_CONFIGURED, CanTpTxFcNPduConfirmationPduId=1, CanTpTxFcNPduRef=Pdu_NPdu_FD_CAN1_Normal_Msg_FD_TP_01_A
            CanTpRxNPdu_1 (CanTpRxNPdu): category=TOOL_CONFIGURED, CanTpRxNPduId=1, CanTpRxNPduRef=Pdu_NPdu_FD_CAN1_Normal_Msg_FD_TP_01_B
            CanTpNSa_1 (CanTpNSa): category=TOOL_CONFIGURED, CanTpNSa=8
            CanTpNTa_1 (CanTpNTa): category=TOOL_CONFIGURED, CanTpNTa=240
          CanTpTxNSdu_1_Pdu_ISignalIPdu_FD_CAN1_Normal_Msg_FD_TP_01_A (CanTpTxNSdu):
            category = TOOL_CONFIGURED
            CanTpTxAddressingFormat = CANTP_STANDARD
            CanTpTxPaddingActivation = CANTP_ON
            CanTpTxNSduId = 1
            CanTpTc = 1
            CanTpNbs = 1
            CanTpNcs = 0.005
            CanTpTxTaType = CANTP_PHYSICAL
            CanTpNas = 1
            CanTpTxNSduRef = Pdu_ISignalIPdu_FD_CAN1_Normal_Msg_FD_TP_01_A
            CanTpTxNPdu_1 (CanTpTxNPdu): category=TOOL_CONFIGURED, CanTpTxNPduConfirmationPduId=1, CanTpTxNPduRef=Pdu_NPdu_FD_CAN1_Normal_Msg_FD_TP_01_A
            CanTpRxFcNPdu_1 (CanTpRxFcNPdu): category=TOOL_CONFIGURED, CanTpRxFcNPduId=1, CanTpRxFcNPduRef=Pdu_NPdu_FD_CAN1_Normal_Msg_FD_TP_01_B
            CanTpNSa_1 (CanTpNSa): category=TOOL_CONFIGURED, CanTpNSa=8
            CanTpNTa_1 (CanTpNTa): category=TOOL_CONFIGURED, CanTpNTa=240
        CanTpChannel_2_RxOnly_Pdu_DcmIPdu_FD_CAN1_Diag_Msg_TP_Func_FD_CAN1
          CanTpRxNSdu_2_Pdu_DcmIPdu_FD_CAN1_Diag_Msg_TP_Func_FD_CAN1 (CanTpRxNSdu):
            category = TOOL_CONFIGURED
            CanTpRxPaddingActivation = CANTP_ON
            CanTpRxAddressingFormat = CANTP_STANDARD
            CanTpRxTaType = CANTP_FUNCTIONAL
            CanTpRxNSduId = 2
            CanTpBs = 0
            CanTpNar = 1
            CanTpNbr = 0.005
            CanTpNcr = 1
            CanTpRxWftMax = 0
            CanTpSTmin = 0.005
            CanTpRxNSduRef = Pdu_DcmIPdu_FD_CAN1_Diag_Msg_TP_Func_FD_CAN1
            CanTpRxNPdu_2 (CanTpRxNPdu): category=TOOL_CONFIGURED, CanTpRxNPduId=2, CanTpRxNPduRef=Pdu_NPdu_FD_CAN1_Diag_Msg_TP_Func_FD_CAN1
            CanTpNSa_2 (CanTpNSa): category=TOOL_CONFIGURED, CanTpNSa=8
            CanTpNTa_2 (CanTpNTa): category=TOOL_CONFIGURED, CanTpNTa=240
    CanTpGeneral:
      CanTpChangeParameterApi = 0
      CanTpPaddingByte = 85
      CanTpReadParameterApi = 0
      CanTpVersionInfoApi = 1
      CanTpDynIdSupport = 1
      CanTpGenericConnectionSupport = 1
      CanTpFlexibleDataRateSupport = 1
      CanTpDevErrorDetect = 1
