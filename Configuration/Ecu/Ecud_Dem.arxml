AUTOSAR XML (schema 00047)
package /AUTRON
  module config Dem: implementation-config-variant=VARIANT-PRE-COMPILE, module-description=BswImplementation_Dem
    DemConfigSet
      93 x DemEventParameter, all with DemEventAvailable=1, DemOperationCycleRef=DemOperationCycle0:
        ETH_E_ACCESS: DemEventId=1, DemEventKind=DEM_EVENT_KIND_BSW, DemEventConfirmationThreshold=1, DemFFPrestorageSupported=0
          DemDebounceAlgorithmClass
            DemDebounceMonitorInternal
        ETH_E_ALIGNMENT: DemEventConfirmationThreshold=1, DemEventId=2, DemEventKind=DEM_EVENT_KIND_BSW, DemFFPrestorageSupported=0
          DemDebounceAlgorithmClass
            DemDebounceMonitorInternal
        ETH_E_CRC: DemEventConfirmationThreshold=1, DemEventId=3, DemEventKind=DEM_EVENT_KIND_BSW, DemFFPrestorageSupported=0
          DemDebounceAlgorithmClass
            DemDebounceMonitorInternal
        ETH_E_LATECOLLISON: DemEventConfirmationThreshold=1, DemEventId=4, DemEventKind=DEM_EVENT_KIND_BSW, DemFFPrestorageSupported=0
          DemDebounceAlgorithmClass
            DemDebounceMonitorInternal
        ETH_E_MULTIPLECOLLISION: DemEventConfirmationThreshold=1, DemEventId=5, DemEventKind=DEM_EVENT_KIND_BSW, DemFFPrestorageSupported=0
          DemDebounceAlgorithmClass
            DemDebounceMonitorInternal
        ETH_E_OVERSIZEFRAME: DemEventConfirmationThreshold=1, DemEventId=6, DemEventKind=DEM_EVENT_KIND_BSW, DemFFPrestorageSupported=0
          DemDebounceAlgorithmClass
            DemDebounceMonitorInternal
        ETH_E_RX_FRAMES_LOST: DemEventConfirmationThreshold=1, DemEventId=7, DemEventKind=DEM_EVENT_KIND_BSW, DemFFPrestorageSupported=0
          DemDebounceAlgorithmClass
            DemDebounceMonitorInternal
        ETH_E_SINGLECOLLISION: DemEventConfirmationThreshold=1, DemEventId=8, DemEventKind=DEM_EVENT_KIND_BSW, DemFFPrestorageSupported=0
          DemDebounceAlgorithmClass
            DemDebounceMonitorInternal
        ETH_E_UNDERSIZRFRAME: DemEventConfirmationThreshold=1, DemEventId=9, DemEventKind=DEM_EVENT_KIND_BSW, DemFFPrestorageSupported=0
          DemDebounceAlgorithmClass
            DemDebounceMonitorInternal
        FEE_E_GC_ERASE: DemEventConfirmationThreshold=1, DemEventId=10, DemEventKind=DEM_EVENT_KIND_BSW, DemFFPrestorageSupported=0
          DemDebounceAlgorithmClass
            DemDebounceMonitorInternal
        FEE_E_GC_INIT: DemEventConfirmationThreshold=1, DemEventId=11, DemEventKind=DEM_EVENT_KIND_BSW, DemFFPrestorageSupported=0
          DemDebounceAlgorithmClass
            DemDebounceMonitorInternal
        FEE_E_GC_READ: DemEventConfirmationThreshold=1, DemEventId=12, DemEventKind=DEM_EVENT_KIND_BSW, DemFFPrestorageSupported=0
          DemDebounceAlgorithmClass
            DemDebounceMonitorInternal
        FEE_E_GC_TRIG: DemEventConfirmationThreshold=1, DemEventId=13, DemEventKind=DEM_EVENT_KIND_BSW, DemFFPrestorageSupported=0
          DemDebounceAlgorithmClass
            DemDebounceMonitorInternal
        FEE_E_GC_WRITE: DemEventConfirmationThreshold=1, DemEventId=14, DemEventKind=DEM_EVENT_KIND_BSW, DemFFPrestorageSupported=0
          DemDebounceAlgorithmClass
            DemDebounceMonitorInternal
        FEE_E_INVALIDATE: DemEventConfirmationThreshold=1, DemEventId=15, DemEventKind=DEM_EVENT_KIND_BSW, DemFFPrestorageSupported=0
          DemDebounceAlgorithmClass
            DemDebounceMonitorInternal
        FEE_E_READ: DemEventConfirmationThreshold=1, DemEventId=16, DemEventKind=DEM_EVENT_KIND_BSW, DemFFPrestorageSupported=0
          DemDebounceAlgorithmClass
            DemDebounceMonitorInternal
        FEE_E_UNCONFIG_BLK_EXCEEDED: DemEventConfirmationThreshold=1, DemEventId=17, DemEventKind=DEM_EVENT_KIND_BSW, DemFFPrestorageSupported=0
          DemDebounceAlgorithmClass
            DemDebounceMonitorInternal
        FEE_E_WRITE: DemEventConfirmationThreshold=1, DemEventId=18, DemEventKind=DEM_EVENT_KIND_BSW, DemFFPrestorageSupported=0
          DemDebounceAlgorithmClass
            DemDebounceMonitorInternal
        FEE_E_WRITE_CYCLES_EXHAUSTED: DemEventConfirmationThreshold=1, DemEventId=19, DemEventKind=DEM_EVENT_KIND_BSW, DemFFPrestorageSupported=0
          DemDebounceAlgorithmClass
            DemDebounceMonitorInternal
        FLS_E_COMPARE_FAILED: DemEventConfirmationThreshold=1, DemEventId=20, DemEventKind=DEM_EVENT_KIND_BSW, DemFFPrestorageSupported=0
          DemDebounceAlgorithmClass
            DemDebounceMonitorInternal
        FLS_E_ERASE_FAILED: DemEventConfirmationThreshold=1, DemEventId=21, DemEventKind=DEM_EVENT_KIND_BSW, DemFFPrestorageSupported=0
          DemDebounceAlgorithmClass
            DemDebounceMonitorInternal
        FLS_E_READ_FAILED: DemEventId=22, DemEventKind=DEM_EVENT_KIND_BSW, DemFFPrestorageSupported=0, DemEventConfirmationThreshold=1
          DemDebounceAlgorithmClass
            DemDebounceMonitorInternal
        FLS_E_UNEXPECTED_FLASH_ID: DemEventConfirmationThreshold=1, DemEventId=23, DemEventKind=DEM_EVENT_KIND_BSW, DemFFPrestorageSupported=0
          DemDebounceAlgorithmClass
            DemDebounceMonitorInternal
        FLS_E_WRITE_FAILED: DemEventConfirmationThreshold=1, DemEventId=24, DemEventKind=DEM_EVENT_KIND_BSW, DemFFPrestorageSupported=0
          DemDebounceAlgorithmClass
            DemDebounceMonitorInternal
        MCU_E_CCU6_CLC_ENABLE_ERR: DemEventConfirmationThreshold=1, DemEventId=25, DemEventKind=DEM_EVENT_KIND_BSW, DemFFPrestorageSupported=0
          DemDebounceAlgorithmClass
            DemDebounceMonitorInternal
        MCU_E_CCU6_CLC_DISABLE_ERR: DemEventConfirmationThreshold=1, DemEventId=26, DemEventKind=DEM_EVENT_KIND_BSW, DemFFPrestorageSupported=0
          DemDebounceAlgorithmClass
            DemDebounceMonitorInternal
        MCU_E_CCUCON_UPDATE_ERR: DemEventConfirmationThreshold=1, DemEventId=27, DemEventKind=DEM_EVENT_KIND_BSW, DemFFPrestorageSupported=0
          DemDebounceAlgorithmClass
            DemDebounceMonitorInternal
        MCU_E_CLOCK_FAILURE: DemEventConfirmationThreshold=1, DemEventId=28, DemEventKind=DEM_EVENT_KIND_BSW, DemFFPrestorageSupported=0
          DemDebounceAlgorithmClass
            DemDebounceMonitorInternal
        MCU_E_CONVCTRL_CLC_ENABLE_ERR: DemEventConfirmationThreshold=1, DemEventId=29, DemEventKind=DEM_EVENT_KIND_BSW, DemFFPrestorageSupported=0
          DemDebounceAlgorithmClass
            DemDebounceMonitorInternal
        MCU_E_CONVCTRL_CLC_DISABLE_ERR: DemEventConfirmationThreshold=1, DemEventId=30, DemEventKind=DEM_EVENT_KIND_BSW, DemFFPrestorageSupported=0
          DemDebounceAlgorithmClass
            DemDebounceMonitorInternal
        MCU_E_GPT12_CLC_ENABLE_ERR: DemEventConfirmationThreshold=1, DemEventId=31, DemEventKind=DEM_EVENT_KIND_BSW, DemFFPrestorageSupported=0
          DemDebounceAlgorithmClass
            DemDebounceMonitorInternal
        MCU_E_GPT12_CLC_DISABLE_ERR: DemEventConfirmationThreshold=1, DemEventId=32, DemEventKind=DEM_EVENT_KIND_BSW, DemFFPrestorageSupported=0
          DemDebounceAlgorithmClass
            DemDebounceMonitorInternal
        MCU_E_GTM_CLC_ENABLE_ERR: DemEventConfirmationThreshold=1, DemEventId=33, DemEventKind=DEM_EVENT_KIND_BSW, DemFFPrestorageSupported=0
          DemDebounceAlgorithmClass
            DemDebounceMonitorInternal
        MCU_E_GTM_CLC_DISABLE_ERR: DemEventConfirmationThreshold=1, DemEventId=34, DemEventKind=DEM_EVENT_KIND_BSW, DemFFPrestorageSupported=0
          DemDebounceAlgorithmClass
            DemDebounceMonitorInternal
        MCU_E_OSC_FAILURE: DemEventConfirmationThreshold=1, DemEventId=35, DemEventKind=DEM_EVENT_KIND_BSW, DemFFPrestorageSupported=0
          DemDebounceAlgorithmClass
            DemDebounceMonitorInternal
        MCU_E_PERIPHERAL_PLL_LOCK_LOSS: DemEventConfirmationThreshold=1, DemEventId=36, DemEventKind=DEM_EVENT_KIND_BSW, DemFFPrestorageSupported=0
          DemDebounceAlgorithmClass
            DemDebounceMonitorInternal
        MCU_E_PERIPHERAL_PLL_TIMEOUT_ERR: DemEventConfirmationThreshold=1, DemEventId=37, DemEventKind=DEM_EVENT_KIND_BSW, DemFFPrestorageSupported=0
          DemDebounceAlgorithmClass
            DemDebounceMonitorInternal
        MCU_E_PMSWCR_UPDATE_ERR: DemEventConfirmationThreshold=1, DemEventId=38, DemEventKind=DEM_EVENT_KIND_BSW, DemFFPrestorageSupported=0
          DemDebounceAlgorithmClass
            DemDebounceMonitorInternal
        MCU_E_SYSTEM_PLL_LOCK_LOSS: DemEventConfirmationThreshold=1, DemEventId=39, DemEventKind=DEM_EVENT_KIND_BSW, DemFFPrestorageSupported=0
          DemDebounceAlgorithmClass
            DemDebounceMonitorInternal
        MCU_E_SYSTEM_PLL_TIMEOUT_ERR: DemEventConfirmationThreshold=1, DemEventId=40, DemEventKind=DEM_EVENT_KIND_BSW, DemFFPrestorageSupported=0
          DemDebounceAlgorithmClass
            DemDebounceMonitorInternal
        SPI_E_HARDWARE_ERROR: DemEventConfirmationThreshold=1, DemEventId=41, DemEventKind=DEM_EVENT_KIND_BSW, DemFFPrestorageSupported=0
          DemDebounceAlgorithmClass
            DemDebounceMonitorInternal
        WDG_E_DISABLE_REJECTED: DemEventConfirmationThreshold=1, DemEventId=42, DemEventKind=DEM_EVENT_KIND_BSW, DemFFPrestorageSupported=0
          DemDebounceAlgorithmClass
            DemDebounceMonitorInternal
        WDG_E_MODE_FAILED: DemEventConfirmationThreshold=1, DemEventId=43, DemEventKind=DEM_EVENT_KIND_BSW, DemFFPrestorageSupported=0
          DemDebounceAlgorithmClass
            DemDebounceMonitorInternal
        CANCM_E_BAT_FAIL: DemEventConfirmationThreshold=1, DemEventId=44, DemEventKind=DEM_EVENT_KIND_BSW, DemFFPrestorageSupported=0
          DemDebounceAlgorithmClass
            DemDebounceMonitorInternal
        CANSM_E_BUS_OFF_FD_CAN1: DemEventConfirmationThreshold=1, DemEventId=45, DemEventKind=DEM_EVENT_KIND_BSW, DemFFPrestorageSupported=0
          DemIndicatorAttribute0 (DemIndicatorAttribute):
            DemIndicatorBehaviour = DEM_INDICATOR_BLINKING
            DemIndicatorFailureCycleCounterThreshold = 1
            DemIndicatorHealingCycleCounterThreshold = 0
            DemIndicatorRef = DemIndicator0
          DemDebounceAlgorithmClass
            DemDebounceCounterBased: DemDebounceCounterBasedClassRef=DemDebounceCounterBasedClass0
        CANSM_E_BUS_OFF_FD_CAN2: DemEventConfirmationThreshold=1, DemEventId=46, DemEventKind=DEM_EVENT_KIND_BSW, DemFFPrestorageSupported=0
          DemIndicatorAttribute0 (DemIndicatorAttribute):
            DemIndicatorBehaviour = DEM_INDICATOR_BLINKING
            DemIndicatorHealingCycleCounterThreshold = 1
            DemIndicatorFailureCycleCounterThreshold = 1
            DemIndicatorRef = DemIndicator0
          DemDebounceAlgorithmClass
            DemDebounceCounterBased: DemDebounceCounterBasedClassRef=DemDebounceCounterBasedClass0
        CANSM_E_BUS_OFF_HS_CAN1: DemEventConfirmationThreshold=1, DemEventId=47, DemEventKind=DEM_EVENT_KIND_BSW, DemFFPrestorageSupported=0
          DemIndicatorAttribute0 (DemIndicatorAttribute):
            DemIndicatorBehaviour = DEM_INDICATOR_BLINKING
            DemIndicatorFailureCycleCounterThreshold = 1
            DemIndicatorHealingCycleCounterThreshold = 1
            DemIndicatorRef = DemIndicator0
          DemDebounceAlgorithmClass
            DemDebounceCounterBased: DemDebounceCounterBasedClassRef=DemDebounceCounterBasedClass0
        CANSM_E_BUS_OFF_Project: DemEventConfirmationThreshold=1, DemEventId=48, DemEventKind=DEM_EVENT_KIND_BSW, DemFFPrestorageSupported=0
          DemIndicatorAttribute0 (DemIndicatorAttribute):
            DemIndicatorFailureCycleCounterThreshold = 1
            DemIndicatorHealingCycleCounterThreshold = 1
            DemIndicatorBehaviour = DEM_INDICATOR_BLINKING
            DemIndicatorRef = DemIndicator0
          DemDebounceAlgorithmClass
            DemDebounceCounterBased: DemDebounceCounterBasedClassRef=DemDebounceCounterBasedClass0
        CANSM_E_BUS_OFF_LS_CAN1: DemEventConfirmationThreshold=1, DemEventId=49, DemEventKind=DEM_EVENT_KIND_BSW, DemFFPrestorageSupported=0
          DemIndicatorAttribute0 (DemIndicatorAttribute):
            DemIndicatorBehaviour = DEM_INDICATOR_BLINKING
            DemIndicatorFailureCycleCounterThreshold = 1
            DemIndicatorHealingCycleCounterThreshold = 1
            DemIndicatorRef = DemIndicator0
          DemDebounceAlgorithmClass
            DemDebounceCounterBased: DemDebounceCounterBasedClassRef=DemDebounceCounterBasedClass0
        CANSM_E_MODE_CHANGE_FD_CAN1: DemEventConfirmationThreshold=1, DemEventId=50, DemFFPrestorageSupported=0, DemEventKind=DEM_EVENT_KIND_BSW
          DemCallbackEventUdsStatusChanged0 (DemCallbackEventUdsStatusChanged)
          DemDebounceAlgorithmClass
            DemDebounceMonitorInternal
        CANSM_E_MODE_CHANGE_FD_CAN2: DemEventConfirmationThreshold=1, DemEventId=51, DemEventKind=DEM_EVENT_KIND_BSW, DemFFPrestorageSupported=0
          DemCallbackEventUdsStatusChanged0 (DemCallbackEventUdsStatusChanged)
          DemDebounceAlgorithmClass
            DemDebounceMonitorInternal
        CANSM_E_MODE_CHANGE_HS_CAN1: DemEventConfirmationThreshold=1, DemEventId=52, DemEventKind=DEM_EVENT_KIND_BSW, DemFFPrestorageSupported=0
          DemCallbackEventUdsStatusChanged0 (DemCallbackEventUdsStatusChanged)
          DemDebounceAlgorithmClass
            DemDebounceMonitorInternal
        CANSM_E_MODE_CHANGE_Project: DemEventConfirmationThreshold=1, DemEventId=53, DemEventKind=DEM_EVENT_KIND_BSW, DemFFPrestorageSupported=0
          DemCallbackEventUdsStatusChanged0 (DemCallbackEventUdsStatusChanged)
          DemDebounceAlgorithmClass
            DemDebounceMonitorInternal
        CANSM_E_MODE_CHANGE_LS_CAN1: DemEventConfirmationThreshold=1, DemEventId=54, DemEventKind=DEM_EVENT_KIND_BSW, DemFFPrestorageSupported=0
          DemCallbackEventUdsStatusChanged0 (DemCallbackEventUdsStatusChanged)
          DemDebounceAlgorithmClass
            DemDebounceMonitorInternal
        DEM_E_TEST_EVENT1: DemEventConfirmationThreshold=1, DemEventId=55, DemEventKind=DEM_EVENT_KIND_SWC, DemFFPrestorageSupported=1, DemDTCRef=UDS_DTC_0xDD01, DemEnableConditionGroupRef=DemEnableConditionGroup0, DemStorageConditionGroupRef=DemStorageConditionGroup0
          DemDebounceAlgorithmClass
            DemDebounceCounterBased: DemDebounceCounterBasedClassRef=DemDebounceCounterBasedClass1
          DemIndicatorAttribute0 (DemIndicatorAttribute):
            DemIndicatorBehaviour = DEM_INDICATOR_BLINKING
            DemIndicatorFailureCycleCounterThreshold = 1
            DemIndicatorHealingCycleCounterThreshold = 1
            DemIndicatorRef = DemIndicator0
          DemCallbackInitMForE
          DemCallbackEventUdsStatusChanged0 (DemCallbackEventUdsStatusChanged)
          DemCallbackClearEventAllowed: DemClearEventAllowedBehavior=DEM_NO_STATUS_BYTE_CHANGE
        DEM_E_TEST_EVENT2: DemEventConfirmationThreshold=1, DemEventId=56, DemEventKind=DEM_EVENT_KIND_SWC, DemFFPrestorageSupported=0, DemDTCRef=UDS_DTC_0xDD02, DemComponentClassRef=DemComponent1
          DemIndicatorAttribute0 (DemIndicatorAttribute):
            DemIndicatorBehaviour = DEM_INDICATOR_BLINKING
            DemIndicatorFailureCycleCounterThreshold = 1
            DemIndicatorHealingCycleCounterThreshold = 0
            DemIndicatorRef = DemIndicator1
          DemDebounceAlgorithmClass
            DemDebounceCounterBased: DemDebounceCounterBasedClassRef=DemDebounceCounterBasedClass1
        DEM_E_TEST_EVENT3: DemEventConfirmationThreshold=1, DemEventId=57, DemEventKind=DEM_EVENT_KIND_SWC, DemFFPrestorageSupported=0, DemDTCRef=UDS_DTC_0xDD03
          DemDebounceAlgorithmClass
            DemDebounceCounterBased: DemDebounceCounterBasedClassRef=DemDebounceCounterBasedClass1
        DEM_E_TEST_EVENT4: DemEventConfirmationThreshold=1, DemEventId=58, DemEventKind=DEM_EVENT_KIND_SWC, DemFFPrestorageSupported=0, DemDTCRef=UDS_DTC_0xDD04
          DemDebounceAlgorithmClass
            DemDebounceCounterBased: DemDebounceCounterBasedClassRef=DemDebounceCounterBasedClass1
          DemIndicatorAttribute0 (DemIndicatorAttribute):
            DemIndicatorBehaviour = DEM_INDICATOR_BLINKING
            DemIndicatorFailureCycleCounterThreshold = 1
            DemIndicatorHealingCycleCounterThreshold = 3
            DemIndicatorRef = DemIndicator0
        DEM_E_TEST_EVENT5: DemEventConfirmationThreshold=2, DemEventId=59, DemEventKind=DEM_EVENT_KIND_SWC, DemFFPrestorageSupported=1, DemDTCRef=UDS_DTC_0x400F01
          DemIndicatorAttribute0 (DemIndicatorAttribute):
            DemIndicatorHealingCycleCounterThreshold = 1
            DemIndicatorFailureCycleCounterThreshold = 1
            DemIndicatorBehaviour = DEM_INDICATOR_BLINKING
            DemIndicatorRef = DemIndicator0
          DemDebounceAlgorithmClass
            DemDebounceCounterBased: DemDebounceCounterBasedClassRef=DemDebounceCounterBasedClass1
        DEM_E_TEST_EVENT6: DemEventConfirmationThreshold=2, DemEventId=60, DemEventKind=DEM_EVENT_KIND_SWC, DemFFPrestorageSupported=0, DemDTCRef=UDS_DTC_0x400F01, DemComponentClassRef=DemComponent1
          DemIndicatorAttribute0 (DemIndicatorAttribute):
            DemIndicatorHealingCycleCounterThreshold = 1
            DemIndicatorFailureCycleCounterThreshold = 1
            DemIndicatorBehaviour = DEM_INDICATOR_BLINKING
            DemIndicatorRef = DemIndicator0
          DemDebounceAlgorithmClass
            DemDebounceCounterBased: DemDebounceCounterBasedClassRef=DemDebounceCounterBasedClass2
        ECUM_E_CONFIGURATION_DATA_INCONSISTENT: DemFFPrestorageSupported=0, DemEventConfirmationThreshold=1, DemEventId=61, DemEventKind=DEM_EVENT_KIND_BSW
          DemDebounceAlgorithmClass
            DemDebounceMonitorInternal
        WDGM_E_IMPROPER_CALLER: DemEventId=62, DemEventKind=DEM_EVENT_KIND_BSW, DemFFPrestorageSupported=0, DemEventConfirmationThreshold=1
          DemDebounceAlgorithmClass
            DemDebounceMonitorInternal
        ECUM_E_RAM_CHECK_FAILED: DemEventId=63, DemEventKind=DEM_EVENT_KIND_BSW, DemFFPrestorageSupported=0, DemEventConfirmationThreshold=1
          DemDebounceAlgorithmClass
            DemDebounceMonitorInternal
        ETHSM_E_LINK_DOWN: DemEventConfirmationThreshold=1, DemEventId=64, DemEventKind=DEM_EVENT_KIND_BSW, DemFFPrestorageSupported=0
          DemDebounceAlgorithmClass
            DemDebounceMonitorInternal
        ETHTRCV_E_ACCESS: DemEventConfirmationThreshold=1, DemEventId=65, DemEventKind=DEM_EVENT_KIND_BSW, DemFFPrestorageSupported=0
          DemDebounceAlgorithmClass
            DemDebounceMonitorInternal
        IOHWAB_E_BUSY: DemEventConfirmationThreshold=1, DemEventId=66, DemEventKind=DEM_EVENT_KIND_BSW, DemFFPrestorageSupported=0
          DemDebounceAlgorithmClass
            DemDebounceMonitorInternal
        IOHWAB_E_PROC_FAIL: DemEventConfirmationThreshold=1, DemEventId=67, DemEventKind=DEM_EVENT_KIND_BSW, DemFFPrestorageSupported=0
          DemDebounceAlgorithmClass
            DemDebounceMonitorInternal
        IOHWAB_E_SETUP_FAIL: DemEventConfirmationThreshold=1, DemEventId=68, DemEventKind=DEM_EVENT_KIND_BSW, DemFFPrestorageSupported=0
          DemDebounceAlgorithmClass
            DemDebounceMonitorInternal
        IOHWAB_E_WRONG_STATE: DemEventConfirmationThreshold=1, DemEventId=69, DemEventKind=DEM_EVENT_KIND_BSW, DemFFPrestorageSupported=0
          DemDebounceAlgorithmClass
            DemDebounceMonitorInternal
        IOHWAB_E_WRONG_SETTING: DemEventConfirmationThreshold=1, DemEventId=70, DemEventKind=DEM_EVENT_KIND_BSW, DemFFPrestorageSupported=0
          DemDebounceAlgorithmClass
            DemDebounceMonitorInternal
        IOHWAB_E_WRONG_PARAM: DemEventConfirmationThreshold=1, DemEventId=71, DemEventKind=DEM_EVENT_KIND_BSW, DemFFPrestorageSupported=0
          DemDebounceAlgorithmClass
            DemDebounceMonitorInternal
        NVM_E_INTEGRITY_FAILED: DemEventConfirmationThreshold=1, DemEventId=72, DemEventKind=DEM_EVENT_KIND_BSW, DemFFPrestorageSupported=0
          DemDebounceAlgorithmClass
            DemDebounceMonitorInternal
        NVM_E_LOSS_OF_REDUNDANCY: DemEventConfirmationThreshold=1, DemEventId=73, DemEventKind=DEM_EVENT_KIND_BSW, DemFFPrestorageSupported=0
          DemDebounceAlgorithmClass
            DemDebounceMonitorInternal
        NVM_E_QUEUE_OVERFLOW: DemEventConfirmationThreshold=1, DemEventId=74, DemEventKind=DEM_EVENT_KIND_BSW, DemFFPrestorageSupported=0
          DemDebounceAlgorithmClass
            DemDebounceMonitorInternal
        NVM_E_REQ_FAILED: DemEventConfirmationThreshold=1, DemEventId=75, DemEventKind=DEM_EVENT_KIND_BSW, DemFFPrestorageSupported=0
          DemDebounceAlgorithmClass
            DemDebounceMonitorInternal
        NVM_E_VERIFY_FAILED: DemEventConfirmationThreshold=1, DemEventId=76, DemEventKind=DEM_EVENT_KIND_BSW, DemFFPrestorageSupported=0
          DemDebounceAlgorithmClass
            DemDebounceMonitorInternal
        NVM_E_WRITE_PROTECTED: DemEventId=77, DemEventKind=DEM_EVENT_KIND_BSW, DemFFPrestorageSupported=0, DemEventConfirmationThreshold=1
          DemDebounceAlgorithmClass
            DemDebounceMonitorInternal
        NVM_E_WRONG_BLOCK_ID: DemEventConfirmationThreshold=1, DemEventId=78, DemFFPrestorageSupported=0, DemEventKind=DEM_EVENT_KIND_BSW
          DemDebounceAlgorithmClass
            DemDebounceMonitorInternal
        WDG_76_ACW_E_DISABLE_REJECTED: DemEventConfirmationThreshold=1, DemEventId=79, DemEventKind=DEM_EVENT_KIND_BSW, DemFFPrestorageSupported=0
          DemDebounceAlgorithmClass
            DemDebounceMonitorInternal
        WDG_76_ACW_E_MODE_FAILED: DemEventConfirmationThreshold=1, DemEventId=80, DemEventKind=DEM_EVENT_KIND_BSW, DemFFPrestorageSupported=0
          DemDebounceAlgorithmClass
            DemDebounceMonitorInternal
        ECUM_E_IMPROPER_CALLER: DemEventConfirmationThreshold=1, DemEventId=81, DemEventKind=DEM_EVENT_KIND_BSW, DemFFPrestorageSupported=0
          DemDebounceAlgorithmClass
            DemDebounceMonitorInternal
        WDGM_E_MONITORING: DemEventConfirmationThreshold=1, DemEventId=82, DemEventKind=DEM_EVENT_KIND_BSW, DemFFPrestorageSupported=0
          DemDebounceAlgorithmClass
            DemDebounceMonitorInternal
        WDGM_E_SET_MODE: DemEventConfirmationThreshold=1, DemEventId=83, DemEventKind=DEM_EVENT_KIND_BSW, DemFFPrestorageSupported=0
          DemDebounceAlgorithmClass
            DemDebounceMonitorInternal
        EEP_E_COMPARE_FAILED: DemEventConfirmationThreshold=1, DemEventId=84, DemEventKind=DEM_EVENT_KIND_BSW, DemFFPrestorageSupported=0
          DemDebounceAlgorithmClass
            DemDebounceMonitorInternal
        EEP_E_ERASE_FAILED: DemEventConfirmationThreshold=1, DemEventId=85, DemFFPrestorageSupported=0, DemEventKind=DEM_EVENT_KIND_BSW
          DemDebounceAlgorithmClass
            DemDebounceMonitorInternal
        EEP_E_READ_FAILED: DemEventConfirmationThreshold=1, DemEventId=86, DemEventKind=DEM_EVENT_KIND_BSW, DemFFPrestorageSupported=0
          DemDebounceAlgorithmClass
            DemDebounceMonitorInternal
        EEP_E_WRITE_FAILED: DemEventConfirmationThreshold=1, DemEventId=87, DemEventKind=DEM_EVENT_KIND_BSW, DemFFPrestorageSupported=0
          DemDebounceAlgorithmClass
            DemDebounceMonitorInternal
        DEM_E_TEST_EVENT7: DemEventConfirmationThreshold=1, DemEventId=88, DemEventKind=DEM_EVENT_KIND_SWC, DemFFPrestorageSupported=0, DemStorageConditionGroupRef=DemStorageConditionGroup1, DemDTCRef=UDS_DTC_0xDD07
          DemDebounceAlgorithmClass
            DemDebounceCounterBased: DemDebounceCounterBasedClassRef=DemDebounceCounterBasedClass1
        DEM_E_TEST_EVENT8: DemEventConfirmationThreshold=1, DemEventId=89, DemEventKind=DEM_EVENT_KIND_BSW, DemFFPrestorageSupported=0, DemDTCRef=UDS_DTC_0xDD07
          DemDebounceAlgorithmClass
            DemDebounceMonitorInternal
        DEM_E_TEST_EVENT9: DemEventConfirmationThreshold=1, DemEventId=90, DemEventKind=DEM_EVENT_KIND_SWC, DemFFPrestorageSupported=0, DemDTCRef=UDS_DTC_0xDD07
          DemDebounceAlgorithmClass
            DemDebounceCounterBased: DemDebounceCounterBasedClassRef=DemDebounceCounterBasedClass1
        DEM_E_TEST_EVENT10: DemEventConfirmationThreshold=1, DemEventId=91, DemEventKind=DEM_EVENT_KIND_SWC, DemFFPrestorageSupported=0, DemDTCRef=UDS_DTC_0x800F01
          DemDebounceAlgorithmClass
            DemDebounceCounterBased: DemDebounceCounterBasedClassRef=DemDebounceCounterBasedClass1
        DEM_E_TEST_EVENT11: DemEventConfirmationThreshold=1, DemEventId=92, DemEventKind=DEM_EVENT_KIND_SWC, DemFFPrestorageSupported=0, DemDTCRef=UDS_DTC_0xDD07
          DemDebounceAlgorithmClass
            DemDebounceCounterBased: DemDebounceCounterBasedClassRef=DemDebounceCounterBasedClass1
        DEM_E_TEST_EVENT12: DemEventConfirmationThreshold=1, DemEventId=93, DemEventKind=DEM_EVENT_KIND_SWC, DemFFPrestorageSupported=0, DemDTCRef=UDS_DTC_0xDD02
          DemDebounceAlgorithmClass
            DemDebounceCounterBased: DemDebounceCounterBasedClassRef=DemDebounceCounterBasedClass1
      12 x DemDTCAttributes, all with DemAgingAllowed=1, DemAgingCycleRef=DemOperationCycle0:
        DemDTCAttributes0: DemDTCPriority=2, DemDTCSignificance=DEM_EVENT_SIGNIFICANCE_OCCURRENCE, DemAgingCycleCounterThreshold=3, DemExtendedDataClassRef=ED_TEST_01, DemFreezeFrameClassRef=DemFreezeFrameClass0, DemMemoryDestinationRef=DemEventMemorySet0/DemPrimaryMemory, DemMemoryDestinationRef=DemEventMemorySet0/DemMirrorMemory
        DemDTCAttributes1: DemAgingCycleCounterThreshold=1, DemDTCPriority=2, DemExtendedDataClassRef=ED_TEST_02, DemFreezeFrameClassRef=DemFreezeFrameClass1, DemMemoryDestinationRef=DemEventMemorySet0/DemPrimaryMemory
        DemDTCAttributes2: DemAgingCycleCounterThreshold=2, DemDTCPriority=3, DemExtendedDataClassRef=ED_TEST_03, DemMemoryDestinationRef=DemEventMemorySet0/DemPrimaryMemory
        DemDTCAttributes3: DemAgingCycleCounterThreshold=1, DemDTCPriority=4, DemExtendedDataClassRef=ED_TEST_04, DemMemoryDestinationRef=DemEventMemorySet0/DemPrimaryMemory
        DemDTCAttributes4: DemAgingCycleCounterThreshold=1, DemDTCPriority=4, DemMemoryDestinationRef=DemEventMemorySet0/DemPrimaryMemory
        DemDTCAttributes5: DemAgingCycleCounterThreshold=1, DemDTCPriority=4, DemMemoryDestinationRef=DemEventMemorySet0/DemPrimaryMemory
        DemDTCAttributes6: DemAgingCycleCounterThreshold=2, DemDTCPriority=1, DemMemoryDestinationRef=DemEventMemorySet0/DemPrimaryMemory, DemMemoryDestinationRef=DemEventMemorySet0/DemMirrorMemory, DemExtendedDataClassRef=ED_TEST_01, DemFreezeFrameClassRef=DemFreezeFrameClass0
        DemDTCAttributes7: DemAgingCycleCounterThreshold=1, DemDTCPriority=1, DemMemoryDestinationRef=DEMUSERDEFINEDMEMORY0, DemMemoryDestinationRef=DemEventMemorySet1/DemMirrorMemory, DemFreezeFrameRecNumClassRef=DemFreezeFrameRecNumClass0
        DemDTCAttributes8: DemDTCPriority=1, DemAgingCycleCounterThreshold=1, DemMemoryDestinationRef=DemEventMemorySet0/DemPrimaryMemory
        DemDTCAttributes9: DemDTCPriority=2, DemAgingCycleCounterThreshold=1, DemMemoryDestinationRef=DemEventMemorySet0/DemPrimaryMemory
        DemDTCAttributes10: DemDTCPriority=3, DemAgingCycleCounterThreshold=1, DemMemoryDestinationRef=DemEventMemorySet0/DemPrimaryMemory
        DemDTCAttributes11: DemAgingCycleCounterThreshold=1, DemDTCPriority=1, DemMemoryDestinationRef=DemEventMemorySet1/DemPrimaryMemory, DemFreezeFrameClassRef=DemFreezeFrameClass0, DemFreezeFrameRecNumClassRef=DemFreezeFrameRecNumClass0, DemExtendedDataClassRef=ED_TEST_05
      9 x DemDTC:
        UDS_DTC_0xDD04: DemDTCFunctionalUnit=16, DemDTCSeverity=DEM_SEVERITY_MAINTENANCE_ONLY, DemNvStorageStrategy=DURING_SHUTDOWN, DemDtcValue=56580, DemDTCAttributesRef=DemDTCAttributes0
        UDS_DTC_0xDD03: DemDTCSeverity=DEM_SEVERITY_CHECK_IMMEDIATELY, DemDtcValue=56579, DemNvStorageStrategy=IMMEDIATE_AT_FIRST_OCCURRENCE, DemDTCAttributesRef=DemDTCAttributes1
        UDS_DTC_0xDD02: DemDTCSeverity=DEM_SEVERITY_CHECK_IMMEDIATELY, DemDtcValue=56578, DemNvStorageStrategy=IMMEDIATE_AT_FIRST_OCCURRENCE, DemDTCAttributesRef=DemDTCAttributes2
        UDS_DTC_0xDD01: DemDTCSeverity=DEM_SEVERITY_CHECK_IMMEDIATELY, DemNvStorageStrategy=IMMEDIATE_AT_FIRST_OCCURRENCE, DemDtcValue=56577, DemDTCAttributesRef=DemDTCAttributes0
        UDS_DTC_0xDD05: DemDtcValue=56581, DemDTCSeverity=DEM_SEVERITY_NO_SEVERITY, DemNvStorageStrategy=IMMEDIATE_AT_FIRST_OCCURRENCE, DemDTCAttributesRef=DemDTCAttributes4
        UDS_DTC_0xDD06: DemDTCSeverity=DEM_SEVERITY_NO_SEVERITY, DemNvStorageStrategy=IMMEDIATE_AT_FIRST_OCCURRENCE, DemDtcValue=56582, DemDTCAttributesRef=DemDTCAttributes5
        UDS_DTC_0x400F01: DemDTCSeverity=DEM_SEVERITY_CHECK_IMMEDIATELY, DemNvStorageStrategy=IMMEDIATE_AT_FIRST_OCCURRENCE, DemDtcValue=4198145, DemDTCAttributesRef=DemDTCAttributes6
        UDS_DTC_0x800F01: DemNvStorageStrategy=IMMEDIATE_AT_FIRST_OCCURRENCE, DemDTCSeverity=DEM_SEVERITY_CHECK_IMMEDIATELY, DemDtcValue=8392449, DemDTCAttributesRef=DemDTCAttributes7
        UDS_DTC_0xDD07: DemDTCSeverity=DEM_SEVERITY_CHECK_IMMEDIATELY, DemDtcValue=56583, DemNvStorageStrategy=IMMEDIATE_AT_FIRST_OCCURRENCE, DemDTCAttributesRef=DemDTCAttributes11
      3 x DemDebounceCounterBasedClass, all with DemDebounceCounterStorage=0:
        DemDebounceCounterBasedClass0: DemDebounceCounterJumpDownValue=0, DemDebounceCounterJumpUpValue=1, DemDebounceBehavior=DEM_DEBOUNCE_RESET, DemDebounceCounterDecrementStepSize=1, DemDebounceCounterIncrementStepSize=1, DemDebounceCounterFailedThreshold=8, DemDebounceCounterPassedThreshold=-1, DemDebounceCounterJumpDown=1, DemDebounceCounterJumpUp=1
        DemDebounceCounterBasedClass1: DemDebounceCounterJumpDownValue=0, DemDebounceCounterJumpUpValue=0, DemDebounceCounterDecrementStepSize=1, DemDebounceBehavior=DEM_DEBOUNCE_RESET, DemDebounceCounterFailedThreshold=1, DemDebounceCounterPassedThreshold=-1, DemDebounceCounterIncrementStepSize=1, DemDebounceCounterJumpDown=0, DemDebounceCounterJumpUp=0
        DemDebounceCounterBasedClass2: DemDebounceCounterJumpDownValue=-50, DemDebounceCounterJumpUpValue=50, DemDebounceBehavior=DEM_DEBOUNCE_FREEZE, DemDebounceCounterDecrementStepSize=125, DemDebounceCounterFailedThreshold=200, DemDebounceCounterIncrementStepSize=100, DemDebounceCounterJumpDown=1, DemDebounceCounterJumpUp=1, DemDebounceCounterPassedThreshold=-250
      DemMultiEventTriggering0 (DemMultiEventTriggering):
        DemMultiEventTriggeringMasterEventRef = DEM_E_TEST_EVENT9
        DemMultiEventTriggeringSlaveEventRef = DEM_E_TEST_EVENT10
        DemMultiEventTriggeringSlaveEventRef = DEM_E_TEST_EVENT11
      DemDtrs
      CANSM_E_MODE_REQUEST_TIMEOUT_HS_CAN1 (DemEventParameter):
        DemEventConfirmationThreshold = 1
        DemEventAvailable = 1
        DemEventId = 94
        DemEventKind = DEM_EVENT_KIND_BSW
        DemFFPrestorageSupported = 0
        DemOperationCycleRef = DemOperationCycle0
        DemDebounceAlgorithmClass
          DemDebounceCounterBased: DemDebounceCounterBasedClassRef=DemDebounceCounterBased_CanSM
      CANSM_E_MODE_REQUEST_TIMEOUT_FD_CAN1 (DemEventParameter):
        DemEventConfirmationThreshold = 1
        DemEventAvailable = 1
        DemEventId = 95
        DemEventKind = DEM_EVENT_KIND_BSW
        DemFFPrestorageInNvm = 0
        DemFFPrestorageSupported = 0
        DemOperationCycleRef = DemOperationCycle0
        DemDebounceAlgorithmClass
          DemDebounceCounterBased: DemDebounceCounterBasedClassRef=DemDebounceCounterBased_CanSM
      DemDebounceCounterBased_CanSM (DemDebounceCounterBasedClass):
        DemDebounceCounterJumpDownValue = 0
        DemDebounceCounterJumpUpValue = 0
        DemDebounceCounterStorage = 0
        DemDebounceBehavior = DEM_DEBOUNCE_RESET
        DemDebounceCounterDecrementStepSize = 1
        DemDebounceCounterFailedThreshold = 8
        DemDebounceCounterIncrementStepSize = 1
        DemDebounceCounterJumpDown = 1
        DemDebounceCounterPassedThreshold = -1
        DemDebounceCounterJumpUp = 0
      DemComponent1 (DemComponent): DemComponentId=1, DemComponentIgnoresPriority=0
      DemDebounceTimeBaseClass0 (DemDebounceTimeBaseClass): DemDebounceBehavior=DEM_DEBOUNCE_RESET, DemDebounceTimeFailedThreshold=20, DemDebounceTimePassedThreshold=40
      3 x DemEventParameter, all with DemEventConfirmationThreshold=1, DemEventAvailable=1, DemEventKind=DEM_EVENT_KIND_BSW, DemFFPrestorageSupported=0, DemOperationCycleRef=DemOperationCycle0:
        DEM_E_TEST_EVENT13: DemEventId=96, DemComponentPriority=1, DemDTCRef=UDS_DTC_0xDD07
          DemDebounceAlgorithmClass
            DemDebounceTimeBase: DemDebounceTimeBaseRef=DemDebounceTimeBaseClass0
        DEM_E_TEST_EVENT_SOMEIPXF_MALFORMED_MESSAGE: DemEventId=97
          DemDebounceAlgorithmClass
            DemDebounceTimeBase: DemDebounceTimeBaseRef=DemDebounceTimeBaseClass0
        DEM_E_TEST_EVENT_E2EXF_MALFORMED_MESSAGE: DemEventId=98
          DemDebounceAlgorithmClass
            DemDebounceTimeBase: DemDebounceTimeBaseRef=DemDebounceTimeBaseClass0
      DemDTCAttributes12 (DemDTCAttributes):
        DemAgingAllowed = 1
        DemAgingCycleCounterThreshold = 1
        DemDTCPriority = 1
        DemDTCSignificance = DEM_EVENT_SIGNIFICANCE_OCCURRENCE
        DemAgingCycleRef = DemOperationCycle0
        DemExtendedDataClassRef = ED_TEST_05
        DemFreezeFrameClassRef = DemFreezeFrameClass0
        DemFreezeFrameRecNumClassRef = DemFreezeFrameRecNumClass0
        DemMemoryDestinationRef = DemEventMemorySet1/DemPrimaryMemory
      6 x DemDTC, all with DemDTCSeverity=DEM_SEVERITY_CHECK_IMMEDIATELY, DemNvStorageStrategy=IMMEDIATE_AT_FIRST_OCCURRENCE, DemDTCAttributesRef=DemDTCAttributes12:
        UDS_DTC_0xDD08: DemDtcValue=56584
        UDS_DTC_0xDD09: DemDtcValue=56585
        UDS_DTC_0xDD0A: DemDtcValue=56586
        UDS_DTC_0xDD0B: DemDtcValue=56587
        UDS_DTC_0xDD0C: DemDtcValue=56588
        UDS_DTC_0xDD0D: DemDtcValue=56589
      9 x DemEventParameter, all with DemEventConfirmationThreshold=1, DemEventAvailable=1, DemEventKind=DEM_EVENT_KIND_BSW, DemFFPrestorageSupported=0, DemOperationCycleRef=DemOperationCycle0:
        DEM_E_TEST_EVENT14: DemEventId=99, DemDTCRef=UDS_DTC_0xDD08
          DemDebounceAlgorithmClass
            DemDebounceMonitorInternal
          DemIndicatorAttribute0 (DemIndicatorAttribute):
            DemIndicatorBehaviour = DEM_INDICATOR_CONTINUOUS
            DemIndicatorFailureCycleCounterThreshold = 1
            DemIndicatorHealingCycleCounterThreshold = 1
            DemIndicatorRef = DemIndicator2
          DemIndicatorAttribute1 (DemIndicatorAttribute):
            DemIndicatorBehaviour = DEM_INDICATOR_CONTINUOUS
            DemIndicatorFailureCycleCounterThreshold = 1
            DemIndicatorHealingCycleCounterThreshold = 1
            DemIndicatorRef = DemIndicator3
        DEM_E_TEST_EVENT15: DemEventId=100, DemDTCRef=UDS_DTC_0xDD09
          DemDebounceAlgorithmClass
            DemDebounceMonitorInternal
          DemIndicatorAttribute0 (DemIndicatorAttribute):
            DemIndicatorBehaviour = DEM_INDICATOR_CONTINUOUS
            DemIndicatorFailureCycleCounterThreshold = 1
            DemIndicatorHealingCycleCounterThreshold = 1
            DemIndicatorRef = DemIndicator2
          DemIndicatorAttribute1 (DemIndicatorAttribute):
            DemIndicatorBehaviour = DEM_INDICATOR_CONTINUOUS
            DemIndicatorFailureCycleCounterThreshold = 1
            DemIndicatorHealingCycleCounterThreshold = 1
            DemIndicatorRef = DemIndicator3
        DEM_E_TEST_EVENT16: DemEventId=101, DemDTCRef=UDS_DTC_0xDD0A
          DemDebounceAlgorithmClass
            DemDebounceMonitorInternal
          DemIndicatorAttribute0 (DemIndicatorAttribute):
            DemIndicatorBehaviour = DEM_INDICATOR_CONTINUOUS
            DemIndicatorFailureCycleCounterThreshold = 1
            DemIndicatorHealingCycleCounterThreshold = 1
            DemIndicatorRef = DemIndicator2
          DemIndicatorAttribute1 (DemIndicatorAttribute):
            DemIndicatorBehaviour = DEM_INDICATOR_CONTINUOUS
            DemIndicatorFailureCycleCounterThreshold = 1
            DemIndicatorHealingCycleCounterThreshold = 1
            DemIndicatorRef = DemIndicator3
        DEM_E_TEST_EVENT17: DemEventId=102, DemDTCRef=UDS_DTC_0xDD0B
          DemIndicatorAttribute0 (DemIndicatorAttribute):
            DemIndicatorBehaviour = DEM_INDICATOR_CONTINUOUS
            DemIndicatorFailureCycleCounterThreshold = 1
            DemIndicatorHealingCycleCounterThreshold = 1
            DemIndicatorRef = DemIndicator2
          DemIndicatorAttribute1 (DemIndicatorAttribute):
            DemIndicatorBehaviour = DEM_INDICATOR_CONTINUOUS
            DemIndicatorFailureCycleCounterThreshold = 1
            DemIndicatorHealingCycleCounterThreshold = 1
            DemIndicatorRef = DemIndicator3
          DemDebounceAlgorithmClass
            DemDebounceMonitorInternal
        DEM_E_TEST_EVENT18: DemEventId=103, DemDTCRef=UDS_DTC_0xDD0C
          DemIndicatorAttribute0 (DemIndicatorAttribute):
            DemIndicatorBehaviour = DEM_INDICATOR_CONTINUOUS
            DemIndicatorFailureCycleCounterThreshold = 1
            DemIndicatorHealingCycleCounterThreshold = 1
            DemIndicatorRef = DemIndicator2
          DemIndicatorAttribute1 (DemIndicatorAttribute):
            DemIndicatorBehaviour = DEM_INDICATOR_CONTINUOUS
            DemIndicatorFailureCycleCounterThreshold = 1
            DemIndicatorHealingCycleCounterThreshold = 1
            DemIndicatorRef = DemIndicator3
          DemDebounceAlgorithmClass
            DemDebounceMonitorInternal
        DEM_E_TEST_EVENT19: DemEventId=104, DemDTCRef=UDS_DTC_0xDD0D
          DemIndicatorAttribute0 (DemIndicatorAttribute):
            DemIndicatorBehaviour = DEM_INDICATOR_CONTINUOUS
            DemIndicatorFailureCycleCounterThreshold = 1
            DemIndicatorHealingCycleCounterThreshold = 1
            DemIndicatorRef = DemIndicator2
          DemIndicatorAttribute1 (DemIndicatorAttribute):
            DemIndicatorBehaviour = DEM_INDICATOR_CONTINUOUS
            DemIndicatorFailureCycleCounterThreshold = 1
            DemIndicatorHealingCycleCounterThreshold = 1
            DemIndicatorRef = DemIndicator3
          DemDebounceAlgorithmClass
            DemDebounceMonitorInternal
        DEM_E_TEST_EVENT20: DemEventId=105, DemDTCRef=UDS_DTC_0xDD0E
          DemIndicatorAttribute0 (DemIndicatorAttribute):
            DemIndicatorBehaviour = DEM_INDICATOR_CONTINUOUS
            DemIndicatorFailureCycleCounterThreshold = 1
            DemIndicatorHealingCycleCounterThreshold = 1
            DemIndicatorRef = DemIndicator2
          DemIndicatorAttribute1 (DemIndicatorAttribute):
            DemIndicatorBehaviour = DEM_INDICATOR_CONTINUOUS
            DemIndicatorFailureCycleCounterThreshold = 1
            DemIndicatorHealingCycleCounterThreshold = 1
            DemIndicatorRef = DemIndicator3
          DemDebounceAlgorithmClass
            DemDebounceMonitorInternal
        DEM_E_TEST_EVENT21: DemEventId=106, DemDTCRef=UDS_DTC_0xDD0F
          DemIndicatorAttribute0 (DemIndicatorAttribute):
            DemIndicatorBehaviour = DEM_INDICATOR_CONTINUOUS
            DemIndicatorFailureCycleCounterThreshold = 1
            DemIndicatorHealingCycleCounterThreshold = 1
            DemIndicatorRef = DemIndicator2
          DemIndicatorAttribute1 (DemIndicatorAttribute):
            DemIndicatorBehaviour = DEM_INDICATOR_CONTINUOUS
            DemIndicatorFailureCycleCounterThreshold = 1
            DemIndicatorHealingCycleCounterThreshold = 1
            DemIndicatorRef = DemIndicator3
          DemDebounceAlgorithmClass
            DemDebounceMonitorInternal
        DEM_E_TEST_EVENT22: DemEventId=107, DemDTCRef=UDS_DTC_0xDD0G
          DemIndicatorAttribute0 (DemIndicatorAttribute):
            DemIndicatorBehaviour = DEM_INDICATOR_CONTINUOUS
            DemIndicatorFailureCycleCounterThreshold = 1
            DemIndicatorHealingCycleCounterThreshold = 1
            DemIndicatorRef = DemIndicator2
          DemIndicatorAttribute1 (DemIndicatorAttribute):
            DemIndicatorBehaviour = DEM_INDICATOR_CONTINUOUS
            DemIndicatorFailureCycleCounterThreshold = 1
            DemIndicatorHealingCycleCounterThreshold = 1
            DemIndicatorRef = DemIndicator3
          DemDebounceAlgorithmClass
            DemDebounceMonitorInternal
      3 x DemDTC, all with DemDTCSeverity=DEM_SEVERITY_CHECK_IMMEDIATELY, DemNvStorageStrategy=IMMEDIATE_AT_FIRST_OCCURRENCE, DemDTCAttributesRef=DemDTCAttributes13:
        UDS_DTC_0xDD0E: DemDtcValue=56590
        UDS_DTC_0xDD0F: DemDtcValue=56591
        UDS_DTC_0xDD0G: DemDtcValue=56592
      DemDTCAttributes13 (DemDTCAttributes):
        DemAgingAllowed = 1
        DemAgingCycleCounterThreshold = 1
        DemDTCPriority = 1
        DemDTCSignificance = DEM_EVENT_SIGNIFICANCE_OCCURRENCE
        DemAgingCycleRef = DemOperationCycle0
        DemExtendedDataClassRef = ED_TEST_05
        DemFreezeFrameClassRef = DemFreezeFrameClass0
        DemFreezeFrameRecNumClassRef = DemFreezeFrameRecNumClass0
        DemMemoryDestinationRef = DemEventMemorySet1/DemPrimaryMemory
    DemGeneral:
      DemAgingRequiresTestedCycle = 1
      DemAvailabilitySupport = DEM_EVENT_AVAILABILITY
      DemBswErrorBufferSize = 25
      DemClearDTCBehavior = DEM_CLRRESP_NONVOLATILE_FINISH
      DemClearDTCLimitation = DEM_ALL_SUPPORTED_DTCS
      DemDataElementDefaultEndianness = BIG_ENDIAN
      DemDebounceTimeBasedSupport = 1
      DemDevErrorDetect = 1
      DemEventCombinationSupport = DEM_EVCOMB_ONRETRIEVAL
      DemMaxNumberPrestoredFF = 0
      DemOBDSupport = DEM_OBD_NO_OBD_SUPPORT
      DemResetConfirmedBitOnOverflow = 1
      DemStatusBitStorageTestFailed = 1
      DemStatusBitHandlingTestFailedSinceLastClear = DEM_STATUS_BIT_NORMAL
      DemSuppressionSupport = DEM_DTC_SUPPRESSION
      DemTaskTime = 0.01
      DemTriggerFiMReports = 1
      DemTriggerMonitorInitBeforeClearOk = 0
      DemVersionInfoApi = 1
      DemPTOSupport = 0
      DemDebounceCounterBasedSupport = 1
      DemGeneralInterfaceSupport = 1
      DemAgingRequiresNotFailedCycle = 1
      DemOBDEventMemorySetRef = DemEventMemorySet0
      DemStorageCondition0 (DemStorageCondition): DemStorageConditionStatus=1, DemStorageConditionId=0
      DemStorageCondition1 (DemStorageCondition): DemStorageConditionId=1, DemStorageConditionStatus=0, DemStorageConditionReplacementEventRef=DEM_E_TEST_EVENT8
      DemStorageConditionGroup0 (DemStorageConditionGroup): DemStorageConditionRef=DemStorageCondition0
      DemStorageConditionGroup1 (DemStorageConditionGroup): DemStorageConditionRef=DemStorageCondition1
      DemOperationCycle0 (DemOperationCycle): DemOperationCycleAutostart=0, DemOperationCycleId=0
      DemOperationCycle1 (DemOperationCycle): DemOperationCycleAutostart=0, DemOperationCycleId=1
      DemEventMemorySet0 (DemEventMemorySet): DemDtcStatusAvailabilityMask=143, DemMaxNumberEventEntryPermanent=4, DemTypeOfDTCSupported=DEM_DTC_TRANSLATION_SAE_J2012_DA_DTCFORMAT_04
        DemPrimaryMemory:
          DemEventMemoryEntryStorageTrigger = DEM_TRIGGER_ON_TEST_FAILED
          DemOccurrenceCounterProcessing = DEM_PROCESS_OCCCTR_TF
          DemTypeOfFreezeFrameRecordNumeration = DEM_FF_RECNUM_CALCULATED
          DemEnvironmentDataCapture = DEM_CAPTURE_ASYNCHRONOUS_TO_REPORTING
          DemEventDisplacementStrategy = DEM_DISPLACEMENT_FULL
          DemMaxNumberEventEntryPrimary = 3
          4 x DemGroupOfDTC:
            DEM_DTC_GROUP_POWERTRAIN_DTCS: DemGroupDTCs=256
            DEM_DTC_GROUP_CHASSIS_DTCS: DemGroupDTCs=4194559
            DEM_DTC_GROUP_BODY_DTCS: DemGroupDTCs=8388863
            DEM_DTC_GROUP_NETWORK_COM_DTCS: DemGroupDTCs=12583167
        DemIndicator0 (DemIndicator): DemIndicatorID=0
        DemIndicator1 (DemIndicator): DemIndicatorID=1
        DemClearDTCNotification0 (DemClearDTCNotification): DemClearDtcNotificationTime=FINISH
        DemMirrorMemory: DemMaxNumberEventEntryMirror=4
      DemEventMemorySet1 (DemEventMemorySet):
        DemDtcStatusAvailabilityMask = 143
        DemMaxNumberEventEntryPermanent = 4
        DemTypeOfDTCSupported = DEM_DTC_TRANSLATION_SAE_J2012_DA_DTCFORMAT_04
        DemAmberWarningLampIndicatorRef = DemIndicator2
        DemProtectLampIndicatorRef = DemIndicator4
        DemRedStopLampIndicatorRef = DemIndicator5
        DemPrimaryMemory:
          DemEventMemoryEntryStorageTrigger = DEM_TRIGGER_ON_TEST_FAILED
          DemEnvironmentDataCapture = DEM_CAPTURE_ASYNCHRONOUS_TO_REPORTING
          DemEventDisplacementStrategy = DEM_DISPLACEMENT_FULL
          DemMaxNumberEventEntryPrimary = 6
          DemOccurrenceCounterProcessing = DEM_PROCESS_OCCCTR_TF
          DemTypeOfFreezeFrameRecordNumeration = DEM_FF_RECNUM_CONFIGURED
          4 x DemGroupOfDTC:
            DEM_DTC_GROUP_POWERTRAIN_DTCS: DemGroupDTCs=256
            DEM_DTC_GROUP_CHASSIS_DTCS: DemGroupDTCs=4194559
            DEM_DTC_GROUP_BODY_DTCS: DemGroupDTCs=8388863
            DEM_DTC_GROUP_NETWORK_COM_DTCS: DemGroupDTCs=12583167
        DEMUSERDEFINEDMEMORY0 (DemUserDefinedMemory):
          DemEventMemoryEntryStorageTrigger = DEM_TRIGGER_ON_TEST_FAILED
          DemEnvironmentDataCapture = DEM_CAPTURE_ASYNCHRONOUS_TO_REPORTING
          DemEventDisplacementStrategy = DEM_DISPLACEMENT_NONE
          DemMaxNumberEventEntryUserDefined = 3
          DemOccurrenceCounterProcessing = DEM_PROCESS_OCCCTR_CDTC
          DemTypeOfFreezeFrameRecordNumeration = DEM_FF_RECNUM_CONFIGURED
          DemUserDefinedMemoryIdentifier = 1
        DemMirrorMemory: DemMaxNumberEventEntryMirror=3
        4 x DemIndicator:
          DemIndicator{2..5}: DemIndicatorID={2..5}
      DemClient0 (DemClient): DemClientFunctionality=DEM_CLIENT_USES_FULL_FUNCTIONALITY, DemClientUsesRte=1, DemClientId=0, DemEventMemorySetRef=DemEventMemorySet0
      DemClient1 (DemClient): DemClientFunctionality=DEM_CLIENT_USES_FULL_FUNCTIONALITY, DemClientUsesRte=1, DemClientId=1, DemEventMemorySetRef=DemEventMemorySet1
      DemEnableConditionGroup0 (DemEnableConditionGroup): DemEnableConditionRef=DemEnableCondition0
      DemEnableCondition0 (DemEnableCondition): DemEnableConditionId=0, DemEnableConditionStatus=1
      9 x DemDataElementClass:
        DE_0001
          DemExternalCSDataElementClass:
            DemDataElementProvideMonitorData = 0
            DemDataElementArraySize = 3
            DemDataElementDataType = UINT8_N
            DemDataElementUsePort = 1
            DemDataElementReadFnc = Rte_Call_DataServices_DE_0001_ReadData
        DE_0002
          DemExternalCSDataElementClass:
            DemDataElementProvideMonitorData = 0
            DemDataElementArraySize = 3
            DemDataElementUsePort = 1
            DemDataElementDataType = UINT8_N
            DemDataElementReadFnc = Rte_Call_DataServices_DE_0002_ReadData
        AgingCounter
          DemInternalDataElementClass: DemDataElementDataSize=1, DemInternalDataElement=DEM_AGINGCTR_UPCNT
        OccurrenceCounter
          DemInternalDataElementClass: DemInternalDataElement=DEM_OCCCTR, DemDataElementDataSize=1
        DE_0003
          DemExternalCSDataElementClass:
            DemDataElementProvideMonitorData = 0
            DemDataElementArraySize = 3
            DemDataElementDataType = UINT8_N
            DemDataElementUsePort = 1
            DemDataElementReadFnc = Rte_Call_DataServices_DE_0003_ReadData
        DE_0004
          DemExternalCSDataElementClass:
            DemDataElementProvideMonitorData = 0
            DemDataElementArraySize = 1
            DemDataElementDataType = UINT8_N
            DemDataElementUsePort = 1
            DemDataElementReadFnc = Rte_Call_DataServices_DE_0004_ReadData
        DE_0005
          DemExternalCSDataElementClass:
            DemDataElementProvideMonitorData = 0
            DemDataElementUsePort = 1
            DemDataElementArraySize = 3
            DemDataElementDataType = UINT8_N
            DemDataElementReadFnc = Rte_Call_DataServices_DE_0005_ReadData
        DE_0006
          DemExternalCSDataElementClass:
            DemDataElementProvideMonitorData = 0
            DemDataElementArraySize = 1
            DemDataElementDataType = UINT8_N
            DemDataElementUsePort = 1
            DemDataElementReadFnc = Rte_Call_DataServices_DE_0006_ReadData
        DE_0007
          DemInternalDataElementClass: DemDataElementDataSize=1, DemInternalDataElement=DEM_MONITOR_DATA_0
      DemDidClass0 (DemDidClass): DemDidIdentifier=0x4710, DemDidDataElementClassRef=DE_0001
      DemDidClass1 (DemDidClass): DemDidIdentifier=0x4711, DemDidDataElementClassRef=DE_0002
      5 x DemExtendedDataClass:
        ED_TEST_01: DemExtendedDataRecordClassRef=EDR_TEST_01
        ED_TEST_02: DemExtendedDataRecordClassRef=EDR_TEST_01, DemExtendedDataRecordClassRef=EDR_TEST_02
        ED_TEST_{03..05}: DemExtendedDataRecordClassRef=EDR_TEST_{03..05}
      5 x DemExtendedDataRecordClass, all with DemExtendedDataRecordUpdate=DEM_UPDATE_RECORD_YES, DemExtendedDataRecordTrigger=DEM_TRIGGER_ON_PASSED:
        EDR_TEST_01: DemExtendedDataRecordNumber=5, DemDataElementClassRef=OccurrenceCounter
        EDR_TEST_02: DemExtendedDataRecordNumber=6, DemDataElementClassRef=AgingCounter
        EDR_TEST_03: DemExtendedDataRecordNumber=1, DemDataElementClassRef=DE_0001
        EDR_TEST_04: DemExtendedDataRecordNumber=1, DemDataElementClassRef=DE_0002
        EDR_TEST_05: DemExtendedDataRecordNumber=7, DemDataElementClassRef=DE_0007
      DemFreezeFrameClass0 (DemFreezeFrameClass): DemDidClassRef=DemDidClass0
      DemFreezeFrameClass1 (DemFreezeFrameClass): DemDidClassRef=DemDidClass1
      14 x DemNvRamBlockId:
        DemManagementBlock_00: DemNvRamBlockIdRef=NvMBlock_DemNonVolatileData
        DemEventStatusNvRamBlock_00: DemNvRamBlockIdRef=NvMBlock_DemEventStatusNvRamBlock
        DemPrimaryEventMemory_00: DemNvRamBlockIdRef=NvMBlock_DemPrimaryEventMemoryEntry_0
        DemPrimaryEventMemory_01: DemNvRamBlockIdRef=NvMBlock_DemPrimaryEventMemoryEntry_1
        DemPrimaryEventMemory_02: DemNvRamBlockIdRef=NvMBlock_DemPrimaryEventMemoryEntry_2
        DemUserDefinedMemory_00: DemNvRamBlockIdRef=NvMBlock_DemUserDefinedEventMemoryEntry_0
        DemUserDefinedMemory_01: DemNvRamBlockIdRef=NvMBlock_DemUserDefinedEventMemoryEntry_1
        DemUserDefinedMemory_02: DemNvRamBlockIdRef=NvMBlock_DemUserDefinedEventMemoryEntry_2
        DemMirrorMemory_00: DemNvRamBlockIdRef=NvMBlock_DemMirrorEventMemory_0
        DemMirrorMemory_01: DemNvRamBlockIdRef=NvMBlock_DemMirrorEventMemory_1
        DemMirrorMemory_02: DemNvRamBlockIdRef=NvMBlock_DemMirrorEventMemory_2
        DemPermanentEventMemory_00: DemNvRamBlockIdRef=NvMBlock_DemPermanentEventMemory_0
        DemPermanentEventMemory_01: DemNvRamBlockIdRef=NvMBlock_DemPermanentEventMemory_1
        DemPermanentEventMemory_02: DemNvRamBlockIdRef=NvMBlock_DemPermanentEventMemory_2
      DemFreezeFrameRecordClass0 (DemFreezeFrameRecordClass): DemFreezeFrameRecordNumber=1, DemFreezeFrameRecordTrigger=DEM_TRIGGER_ON_CONFIRMED, DemFreezeFrameRecordUpdate=DEM_UPDATE_RECORD_YES
      DemFreezeFrameRecordClass1 (DemFreezeFrameRecordClass): DemFreezeFrameRecordNumber=2, DemFreezeFrameRecordTrigger=DEM_TRIGGER_ON_TEST_FAILED, DemFreezeFrameRecordUpdate=DEM_UPDATE_RECORD_YES
      DemFreezeFrameRecNumClass0 (DemFreezeFrameRecNumClass): DemFreezeFrameRecordClassRef=DemFreezeFrameRecordClass0
      DemFreezeFrameRecNumClass1 (DemFreezeFrameRecNumClass): DemFreezeFrameRecordClassRef=DemFreezeFrameRecordClass1, DemFreezeFrameRecordClassRef=DemFreezeFrameRecordClass0
      3 x DemDataElementClass:
        DE_0008
          DemExternalCSDataElementClass:
            DemDataElementProvideMonitorData = 0
            DemDataElementArraySize = 8
            DemDataElementDataType = UINT8_N
            DemDataElementReadFnc = Rte_Call_DataServices_DE_0008_ReadData
            DemDataElementUsePort = 1
        DE_0009
          DemExternalCSDataElementClass:
            DemDataElementProvideMonitorData = 0
            DemDataElementArraySize = 4
            DemDataElementDataType = UINT8_N
            DemDataElementReadFnc = Rte_Call_DataServices_DE_0009_ReadData
            DemDataElementUsePort = 1
        DE_0010
          DemExternalCSDataElementClass:
            DemDataElementProvideMonitorData = 0
            DemDataElementArraySize = 4
            DemDataElementDataType = UINT8_N
            DemDataElementReadFnc = Rte_Call_DataServices_DE_0010_ReadData
            DemDataElementUsePort = 1
