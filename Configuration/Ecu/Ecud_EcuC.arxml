AUTOSAR XML (schema 00047)
package /AUTOSAR
  module config EcuC: implementation-config-variant=VARIANT-POST-BUILD
    EcucConfigSet
      EcucPduCollection: category=TOOL_CONFIGURED, PduIdTypeEnum=UINT8, PduLengthTypeEnum=UINT8
        3 x MetaDataType:
          MetaDataType0
            MetaDataItem0 (MetaDataItem): MetaDataItemType=CAN_ID_32, MetaDataItemLength=1
          MetaDataType_ID32
            MetaDataItemCANID32 (MetaDataItem): MetaDataItemLength=4, MetaDataItemType=CAN_ID_32
          MetaDataType1
            MetaDataItem0 (MetaDataItem): MetaDataItemLength=4, MetaDataItemType=CAN_ID_32
        45 x Pdu, all with category=TOOL_CONFIGURED:
          Pdu_ISignalIPdu_LIN1_Master_Cmd: PduLength=5, SysTPduToFrameTriggeringRef=LinFrameTriggering_LIN1_Master_Cmd, SysTPduToPduTriggeringRef=PduTriggering_LIN1_Master_Cmd
          Pdu_ISignalIPdu_LIN1_FL_Sensor_Status: PduLength=6, SysTPduToFrameTriggeringRef=LinFrameTriggering_LIN1_FL_Sensor_Status, SysTPduToPduTriggeringRef=PduTriggering_LIN1_FL_Sensor_Status
          Pdu_ISignalIPdu_LIN1_FCL_Sensor_Status: PduLength=6, SysTPduToFrameTriggeringRef=LinFrameTriggering_LIN1_FCL_Sensor_Status, SysTPduToPduTriggeringRef=PduTriggering_LIN1_FCL_Sensor_Status
          Pdu_ISignalIPdu_LIN1_FCR_Sensor_Status: PduLength=6, SysTPduToFrameTriggeringRef=LinFrameTriggering_LIN1_FCR_Sensor_Status, SysTPduToPduTriggeringRef=PduTriggering_LIN1_FCR_Sensor_Status
          Pdu_ISignalIPdu_LIN1_FR_Sensor_Status: PduLength=6, SysTPduToFrameTriggeringRef=LinFrameTriggering_LIN1_FR_Sensor_Status, SysTPduToPduTriggeringRef=PduTriggering_LIN1_FR_Sensor_Status
          Pdu_ISignalIPdu_LIN1_RL_Sensor_Status: PduLength=6, SysTPduToFrameTriggeringRef=LinFrameTriggering_LIN1_RL_Sensor_Status, SysTPduToPduTriggeringRef=PduTriggering_LIN1_RL_Sensor_Status
          Pdu_ISignalIPdu_LIN1_RCL_Sensor_Status: PduLength=6, SysTPduToFrameTriggeringRef=LinFrameTriggering_LIN1_RCL_Sensor_Status, SysTPduToPduTriggeringRef=PduTriggering_LIN1_RCL_Sensor_Status
          Pdu_ISignalIPdu_LIN1_RCR_Sensor_Status: PduLength=6, SysTPduToFrameTriggeringRef=LinFrameTriggering_LIN1_RCR_Sensor_Status, SysTPduToPduTriggeringRef=PduTriggering_LIN1_RCR_Sensor_Status
          Pdu_ISignalIPdu_LIN1_RR_Sensor_Status: PduLength=6, SysTPduToFrameTriggeringRef=LinFrameTriggering_LIN1_RR_Sensor_Status, SysTPduToPduTriggeringRef=PduTriggering_LIN1_RR_Sensor_Status
          Pdu_ISignalIPdu_FD_CAN1_BSD_01_50ms_P11: PduLength=8, SysTPduToFrameTriggeringRef=FT_FD_CAN1_BSD_01_50ms_P11, SysTPduToPduTriggeringRef=PT_FD_CAN1_BSD_01_50ms_P11
          Pdu_ISignalIPdu_FD_CAN1_TCU_01_10ms_P11: PduLength=8, SysTPduToFrameTriggeringRef=FT_FD_CAN1_TCU_01_10ms_P11, SysTPduToPduTriggeringRef=PT_FD_CAN1_TCU_01_10ms_P11
          Pdu_NmPdu_FD_CAN1_NM_MDPS: PduLength=8, SysTPduToFrameTriggeringRef=FT_FD_CAN1_NM_MDPS, SysTPduToPduTriggeringRef=PT_FD_CAN1_NM_MDPS
          Pdu_NmPdu_FD_CAN1_NM_ECS: PduLength=8, SysTPduToFrameTriggeringRef=FT_FD_CAN1_NM_ECS, SysTPduToPduTriggeringRef=PT_FD_CAN1_NM_ECS
          Pdu_NmPdu_FD_CAN1_NM_CGW: PduLength=8, SysTPduToFrameTriggeringRef=FT_FD_CAN1_NM_CGW, SysTPduToPduTriggeringRef=PT_FD_CAN1_NM_CGW
          Pdu_ISignalIPdu_FD_CAN1_Normal_Msg_FD_TP_01_B: PduLength=64, SysTPduToFrameTriggeringRef=FT_FD_CAN1_Normal_Msg_FD_TP_01_B, SysTPduToPduTriggeringRef=PT_FD_CAN1_Normal_Msg_FD_TP_01_B
          Pdu_NPdu_FD_CAN1_Normal_Msg_FD_TP_01_B: PduLength=8, SysTPduToFrameTriggeringRef=FT_FD_CAN1_Normal_Msg_FD_TP_01_B
          Pdu_ISignalIPdu_FD_CAN1_Normal_Msg_FD_TP_01_A: PduLength=64, SysTPduToFrameTriggeringRef=FT_FD_CAN1_Normal_Msg_FD_TP_01_A, SysTPduToPduTriggeringRef=PT_FD_CAN1_Normal_Msg_FD_TP_01_A
          Pdu_NPdu_FD_CAN1_Normal_Msg_FD_TP_01_A: PduLength=64, SysTPduToFrameTriggeringRef=FT_FD_CAN1_Normal_Msg_FD_TP_01_A
          Pdu_ISignalIPdu_FD_CAN1_AFLS_01_100ms: PduLength=8, SysTPduToFrameTriggeringRef=FT_FD_CAN1_AFLS_01_100ms, SysTPduToPduTriggeringRef=PT_FD_CAN1_AFLS_01_100ms
          Pdu_ISignalIPdu_FD_CAN1_AHLS_01_300ms: PduLength=8, SysTPduToFrameTriggeringRef=FT_FD_CAN1_AHLS_01_300ms, SysTPduToPduTriggeringRef=PT_FD_CAN1_AHLS_01_300ms
          Pdu_ComMPdu_Rx_EIRA_CanNm: PduLength=4
          Pdu_ComMPdu_Tx_PncVector_FD_CAN1: PduLength=4
          Pdu_DcmIPdu_LIN1_MasterReq: PduLength=8, SysTPduToFrameTriggeringRef=LinFrameTriggering_LIN1_MasterReq, SysTPduToPduTriggeringRef=PduTriggering_LIN1_MasterReq
          Pdu_DcmIPdu_LIN1_SlaveResp: PduLength=8, SysTPduToFrameTriggeringRef=LinFrameTriggering_LIN1_SlaveResp, SysTPduToPduTriggeringRef=PduTriggering_LIN1_SlaveResp
          Pdu_DcmIPdu_FD_CAN1_Diag_Msg_TP_Phys_Res_FD_CAN1: PduLength=64, SysTPduToFrameTriggeringRef=FT_FD_CAN1_Diag_Msg_TP_Phys_Res_FD_CAN1, SysTPduToPduTriggeringRef=PT_FD_CAN1_Diag_Msg_TP_Phys_Res_FD_CAN1
          Pdu_NPdu_FD_CAN1_Diag_Msg_TP_Phys_Res_FD_CAN1: PduLength=8, SysTPduToFrameTriggeringRef=FT_FD_CAN1_Diag_Msg_TP_Phys_Res_FD_CAN1
          Pdu_DcmIPdu_FD_CAN1_Diag_Msg_TP_Phys_Req_FD_CAN1: PduLength=8, SysTPduToFrameTriggeringRef=FT_FD_CAN1_Diag_Msg_TP_Phys_Req_FD_CAN1, SysTPduToPduTriggeringRef=PT_FD_CAN1_Diag_Msg_TP_Phys_Req_FD_CAN1
          Pdu_NPdu_FD_CAN1_Diag_Msg_TP_Phys_Req_FD_CAN1: PduLength=8, SysTPduToFrameTriggeringRef=FT_FD_CAN1_Diag_Msg_TP_Phys_Req_FD_CAN1
          Pdu_DcmIPdu_FD_CAN1_Diag_Msg_TP_Func_FD_CAN1: PduLength=8, SysTPduToFrameTriggeringRef=FT_FD_CAN1_Diag_Msg_TP_Func_FD_CAN1, SysTPduToPduTriggeringRef=PT_FD_CAN1_Diag_Msg_TP_Func_FD_CAN1
          Pdu_NPdu_FD_CAN1_Diag_Msg_TP_Func_FD_CAN1: PduLength=8, SysTPduToFrameTriggeringRef=FT_FD_CAN1_Diag_Msg_TP_Func_FD_CAN1
          Pdu_ISignalIPdu_FD_CAN1_AtmResp: PduLength=8, SysTPduToFrameTriggeringRef=FT_FD_CAN1_AtmResp, SysTPduToPduTriggeringRef=PT_FD_CAN1_AtmResp
          Pdu_ISignalIPdu_FD_CAN1_AtmReq: PduLength=8, SysTPduToFrameTriggeringRef=FT_FD_CAN1_AtmReq, SysTPduToPduTriggeringRef=PT_FD_CAN1_AtmReq
          Pdu_ISignalIPdu_LIN2_Master_Cmd: PduLength=5, SysTPduToFrameTriggeringRef=LinFrameTriggering_LIN2_Master_Cmd, SysTPduToPduTriggeringRef=PduTriggering_LIN2_Master_Cmd
          Pdu_ISignalIPdu_LIN2_FL_Sensor_Status: PduLength=6, SysTPduToFrameTriggeringRef=LinFrameTriggering_LIN2_FL_Sensor_Status, SysTPduToPduTriggeringRef=PduTriggering_LIN2_FL_Sensor_Status
          Pdu_ISignalIPdu_LIN2_FCL_Sensor_Status: PduLength=6, SysTPduToFrameTriggeringRef=LinFrameTriggering_LIN2_FCL_Sensor_Status, SysTPduToPduTriggeringRef=PduTriggering_LIN2_FCL_Sensor_Status
          Pdu_ISignalIPdu_LIN2_FCR_Sensor_Status: PduLength=6, SysTPduToFrameTriggeringRef=LinFrameTriggering_LIN2_FCR_Sensor_Status, SysTPduToPduTriggeringRef=PduTriggering_LIN2_FCR_Sensor_Status
          Pdu_ISignalIPdu_LIN2_FR_Sensor_Status: PduLength=6, SysTPduToFrameTriggeringRef=LinFrameTriggering_LIN2_FR_Sensor_Status, SysTPduToPduTriggeringRef=PduTriggering_LIN2_FR_Sensor_Status
          Pdu_ISignalIPdu_LIN2_RL_Sensor_Status: PduLength=6, SysTPduToFrameTriggeringRef=LinFrameTriggering_LIN2_RL_Sensor_Status, SysTPduToPduTriggeringRef=PduTriggering_LIN2_RL_Sensor_Status
          Pdu_ISignalIPdu_LIN2_RCL_Sensor_Status: PduLength=6, SysTPduToFrameTriggeringRef=LinFrameTriggering_LIN2_RCL_Sensor_Status, SysTPduToPduTriggeringRef=PduTriggering_LIN2_RCL_Sensor_Status
          Pdu_ISignalIPdu_LIN2_RCR_Sensor_Status: PduLength=6, SysTPduToFrameTriggeringRef=LinFrameTriggering_LIN2_RCR_Sensor_Status, SysTPduToPduTriggeringRef=PduTriggering_LIN2_RCR_Sensor_Status
          Pdu_ISignalIPdu_LIN2_RR_Sensor_Status: PduLength=6, SysTPduToFrameTriggeringRef=LinFrameTriggering_LIN2_RR_Sensor_Status, SysTPduToPduTriggeringRef=PduTriggering_LIN2_RR_Sensor_Status
          Pdu_DcmIPdu_LIN2_MasterReq: PduLength=8, SysTPduToFrameTriggeringRef=LinFrameTriggering_LIN2_MasterReq, SysTPduToPduTriggeringRef=PduTriggering_LIN2_MasterReq
          Pdu_DcmIPdu_LIN2_SlaveResp: PduLength=8, SysTPduToFrameTriggeringRef=LinFrameTriggering_LIN2_SlaveResp, SysTPduToPduTriggeringRef=PduTriggering_LIN2_SlaveResp
          Pdu_ISignalIPdu_FD_CAN1_V_CGW_02_A: PduLength=8, SysTPduToFrameTriggeringRef=FT_FD_CAN1_V_CGW_02_A, SysTPduToPduTriggeringRef=PT_FD_CAN1_V_CGW_02_A
          Pdu_ISignalIPdu_FD_CAN1_V_CGW_01_B: PduLength=8, SysTPduToFrameTriggeringRef=FT_FD_CAN1_V_CGW_01_B, SysTPduToPduTriggeringRef=PT_FD_CAN1_V_CGW_01_B
    EcucHardware
      EcucCoreDefinition_Main (EcucCoreDefinition): EcucCoreId=0
    EcucPartitionCollection
      EcucPartition_Main (EcucPartition):
        EcucPartitionQmBswModuleExecution = 1
        EcucPartitionBswModuleExecution = 1
        PartitionCanBeRestarted = 0
        EcucPartitionBswModuleDistinguishedPartition = BswDistinguishedPartition_BswM
        EcucPartitionBswModuleDistinguishedPartition = BswDistinguishedPartition_CanCM
        EcucPartitionBswModuleDistinguishedPartition = BswDistinguishedPartition_CanIf
        EcucPartitionBswModuleDistinguishedPartition = BswDistinguishedPartition_CanNm
        EcucPartitionBswModuleDistinguishedPartition = BswDistinguishedPartition_CanSM
        EcucPartitionBswModuleDistinguishedPartition = BswDistinguishedPartition_CanTp
        EcucPartitionBswModuleDistinguishedPartition = BswDistinguishedPartition_CanTrcv
        EcucPartitionBswModuleDistinguishedPartition = BswDistinguishedPartition_Com
        EcucPartitionBswModuleDistinguishedPartition = BswDistinguishedPartition_ComM
        EcucPartitionBswModuleDistinguishedPartition = BswDistinguishedPartition_Crc
        EcucPartitionBswModuleDistinguishedPartition = BswDistinguishedPartition_CryIf
        EcucPartitionBswModuleDistinguishedPartition = BswDistinguishedPartition_Csm
        EcucPartitionBswModuleDistinguishedPartition = BswDistinguishedPartition_Dcm
        EcucPartitionBswModuleDistinguishedPartition = BswDistinguishedPartition_Dem
        EcucPartitionBswModuleDistinguishedPartition = BswDistinguishedPartition_Det
        EcucPartitionBswModuleDistinguishedPartition = BswDistinguishedPartition_Ea
        EcucPartitionBswModuleDistinguishedPartition = BswDistinguishedPartition_EcuM_Core0
        EcucPartitionBswModuleDistinguishedPartition = BswDistinguishedPartition_Eep
        EcucPartitionBswModuleDistinguishedPartition = BswDistinguishedPartition_FiM
        EcucPartitionBswModuleDistinguishedPartition = BswDistinguishedPartition_IoHwAb
        EcucPartitionBswModuleDistinguishedPartition = BswDistinguishedPartition_IpduM
        EcucPartitionBswModuleDistinguishedPartition = BswDistinguishedPartition_KeyM
        EcucPartitionBswModuleDistinguishedPartition = BswDistinguishedPartition_LinIf
        EcucPartitionBswModuleDistinguishedPartition = BswDistinguishedPartition_LinSM
        EcucPartitionBswModuleDistinguishedPartition = BswDistinguishedPartition_LinTrcv
        EcucPartitionBswModuleDistinguishedPartition = BswDistinguishedPartition_MemIf
        EcucPartitionBswModuleDistinguishedPartition = BswDistinguishedPartition_Nm
        EcucPartitionBswModuleDistinguishedPartition = BswDistinguishedPartition_NvM
        EcucPartitionBswModuleDistinguishedPartition = BswDistinguishedPartition_Os
        EcucPartitionBswModuleDistinguishedPartition = BswDistinguishedPartition_PduR
        EcucPartitionBswModuleDistinguishedPartition = BswDistinguishedPartition_StbM
        EcucPartitionBswModuleDistinguishedPartition = BswDistinguishedPartition_Tm
        EcucPartitionBswModuleDistinguishedPartition = BswDistinguishedPartition_Wdg_76_Acw
        EcucPartitionBswModuleDistinguishedPartition = BswDistinguishedPartition_WdgIf
        EcucPartitionBswModuleDistinguishedPartition = BswDistinguishedPartition_WdgM
        EcucPartitionSoftwareComponentInstanceRef = RootSwCompositionPrototype.App_Lin_LIN1
        EcucPartitionSoftwareComponentInstanceRef = RootSwCompositionPrototype.BswM
        EcucPartitionSoftwareComponentInstanceRef = RootSwCompositionPrototype.CDD_LIN
        EcucPartitionSoftwareComponentInstanceRef = RootSwCompositionPrototype.ComM
        EcucPartitionSoftwareComponentInstanceRef = RootSwCompositionPrototype.Csm
        EcucPartitionSoftwareComponentInstanceRef = RootSwCompositionPrototype.Dcm
        EcucPartitionSoftwareComponentInstanceRef = RootSwCompositionPrototype.Dem
        EcucPartitionSoftwareComponentInstanceRef = RootSwCompositionPrototype.DET
        EcucPartitionSoftwareComponentInstanceRef = RootSwCompositionPrototype.EcuM
        EcucPartitionSoftwareComponentInstanceRef = RootSwCompositionPrototype.FiM
        EcucPartitionSoftwareComponentInstanceRef = RootSwCompositionPrototype.IoHwAb
        EcucPartitionSoftwareComponentInstanceRef = RootSwCompositionPrototype.KeyM
        EcucPartitionSoftwareComponentInstanceRef = RootSwCompositionPrototype.NvM
        EcucPartitionSoftwareComponentInstanceRef = RootSwCompositionPrototype.Os_Master
        EcucPartitionSoftwareComponentInstanceRef = RootSwCompositionPrototype.StbM
        EcucPartitionSoftwareComponentInstanceRef = RootSwCompositionPrototype.SWC_AppMode
        EcucPartitionSoftwareComponentInstanceRef = RootSwCompositionPrototype.SWC_DiagnosticMonitor
        EcucPartitionSoftwareComponentInstanceRef = RootSwCompositionPrototype.SWC_DiagnosticService
        EcucPartitionSoftwareComponentInstanceRef = RootSwCompositionPrototype.SWC_E2EXf
        EcucPartitionSoftwareComponentInstanceRef = RootSwCompositionPrototype.SWC_WdgMTest
        EcucPartitionSoftwareComponentInstanceRef = RootSwCompositionPrototype.WdgM
    EcucPostBuildVariants: EcucPostBuildVariantRef=Variant_FL
