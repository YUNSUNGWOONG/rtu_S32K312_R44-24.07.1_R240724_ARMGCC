AUTOSAR XML (schema 00047)
package /AUTRON
  module config Crc: implementation-config-variant=VARIANT-PRE-COMPILE, module-description=BswImplementation_Crc
    CrcGeneral0 (CrcGeneral):
      Crc16Mode = CRC_16_RUNTIME
      Crc32Mode = CRC_32_RUNTIME
      Crc8H2FMode = CRC_8H2F_RUNTIME
      Crc8Mode = CRC_8_RUNTIME
      Crc16ARCMode = CRC_16_ARC_RUNTIME
      Crc32P4Mode = CRC_32P4_RUNTIME
      Crc64Mode = CRC_64_RUNTIME
