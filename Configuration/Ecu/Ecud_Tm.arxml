AUTOSAR XML (schema 00047)
package /AUTRON
  module config Tm: implementation-config-variant=VARIANT-PRE-COMPILE, module-description=BswImplementation_Tm
    TmGeneral:
      TmDevErrorDetect = 1
      TmEnablePredefTimer100us32bit = 1
      TmEnablePredefTimer1us16bit = 1
      TmEnablePredefTimer1us24bit = 1
      TmEnablePredefTimer1us32bit = 1
      TmVersionInfoApi = 1
      TmWaitLoopNumber = 10
      TmWaitLoop = 0
