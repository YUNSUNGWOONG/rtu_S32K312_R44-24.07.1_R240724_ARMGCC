AUTOSAR XML (schema 4-0-3)
package /AUTOSAR
  module config OsProfiler: implementation-config-variant=VARIANT-PRE-COMPILE, module-description=BswImplementation_OsProfiler
    OsProfilerGlobalConfig:
      ProfileEventCount = 20
      TimeIndexPeriod = 0.005
      EnableProfileIsr = 0
      EnableTimeIndex = 0
      NumberOfCores = 1
      TargetOperatingSystem = AUTRON_COMMON
      UpwardDirectionCount = 1
      EnableOsProfiler = 1
    3 x OsProfilerPeriodTaskConfig:
      OsTask_BSW_FG1_5ms_Com: PeriodTaskRef=OsTask_BSW_FG1_5ms_Com
      OsTask_BSW_FG1_10ms: PeriodTaskRef=OsTask_BSW_FG1_10ms
      OsTask_ASW_FG1_10ms: PeriodTaskRef=OsTask_ASW_FG1_10ms
    OsProfilerSpecificTargetConfig: XOSC=0
    OsProfilerCommonTargetConfig: StmAddress=0x40274000, StmMaxTick=0xFFFFFFFF, StmFrequency=60
