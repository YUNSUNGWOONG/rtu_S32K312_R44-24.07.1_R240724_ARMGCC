AUTOSAR XML (schema 4-3-0)
package /AUTRON
  module config Crypto_76_HaeModule: definition=Crypto, ecuc-def-edition=4.4.7, implementation-config-variant=VARIANT-PRE-COMPILE, module-description=BswImplementation_Crypto_76_HaeModule
    CryptoDriverObjects
      HaeCryptoLib (CryptoDriverObject):
        CryptoDriverObjectId = 0
        CryptoQueueSize = 10
        CryptoPrimitiveRef = HaeCryptoLib_Primitive_AesCmac_Generate
        CryptoPrimitiveRef = HaeCryptoLib_Primitive_AesCmac_Verify
        CryptoPrimitiveRef = HaeCryptoLib_Primitive_AesCtr_Decrypt
        CryptoPrimitiveRef = HaeCryptoLib_Primitive_AesCtr_Encrypt
        CryptoPrimitiveRef = HaeCryptoLib_Primitive_Pbkdf2HmacSha256
        CryptoPrimitiveRef = HaeCryptoLib_Primitive_RsassaPkcs15Sha160_Generate
        CryptoPrimitiveRef = HaeCryptoLib_Primitive_RsassaPkcs15Sha160_Verify
        CryptoPrimitiveRef = HaeCryptoLib_Primitive_RsassaPkcs15Sha256_Generate
        CryptoPrimitiveRef = HaeCryptoLib_Primitive_RsassaPkcs15Sha256_Verify
        CryptoPrimitiveRef = HaeCryptoLib_Primitive_Sha160
        CryptoPrimitiveRef = HaeCryptoLib_Primitive_Sha256
        CryptoPrimitiveRef = HaeCryptoLib_Primitive_HashDrbgSha256_Generate
        CryptoPrimitiveRef = HaeCryptoLib_Primitive_HashDrbgSha256_Seed
    CryptoGeneral: CryptoDevErrorDetect=true, CryptoInstanceId=1, CryptoVersionInfoApi=true, CryptoMainFunctionPeriod=0.1
    CryptoKeyElements
      8 x CryptoKeyElement, all with CryptoKeyElementAllowPartialAccess=0, CryptoKeyElementPersist=0, CryptoKeyElementFormat=CRYPTO_KE_FORMAT_BIN_OCTET, CryptoKeyElementReadAccess=CRYPTO_RA_ALLOWED, CryptoKeyElementWriteAccess=CRYPTO_WA_ALLOWED:
        CryptoKeyElement_RandomSeed_L9: CryptoKeyElementSize=4, CryptoKeyElementId=4, CryptoKeyElementInitValue=01 00 00 00
        CryptoKeyElement_Hash_Dummy_Fota: CryptoKeyElementId=1, CryptoKeyElementInitValue=00 00 00 00 00 00 00 00 00 00 00 00 00 00, CryptoKeyElementSize=32
        CryptoKeyElement_RSASSA_PKCS1_v1_5_Asims_Public_Key: CryptoKeyElementId=1, CryptoKeyElementSize=260
        CryptoKeyElement_Decr_AES_CTR_Key0_cipherkey: CryptoKeyElementId=1, CryptoKeyElementSize=16
        CryptoKeyElement_Decr_AES_CTR_Key0_iv: CryptoKeyElementId=5, CryptoKeyElementSize=16
        CryptoKeyElement_Decr_AES_CTR_Key1_cipherkey: CryptoKeyElementId=1, CryptoKeyElementSize=16
        CryptoKeyElement_Decr_AES_CTR_Key1_iv: CryptoKeyElementId=5, CryptoKeyElementSize=16
        CryptoKeyElement_MacVer_AES_CMAC_key: CryptoKeyElementId=1, CryptoKeyElementSize=16
    CryptoKeyTypes
      6 x CryptoKeyType:
        CryptoKeyType_RandomSeed_L9: CryptoKeyElementRef=CryptoKeyElement_RandomSeed_L9
        CryptoKeyType_Hash_Dummy_Fota: CryptoKeyElementRef=CryptoKeyElement_Hash_Dummy_Fota
        CryptoKeyType_RSASSA_PKCS1_v1_5_Asims_Public_Key: CryptoKeyElementRef=CryptoKeyElement_RSASSA_PKCS1_v1_5_Asims_Public_Key
        CryptoKeyType_Decr_AES_CTR_Key0_Type: CryptoKeyElementRef=CryptoKeyElement_Decr_AES_CTR_Key0_cipherkey, CryptoKeyElementRef=CryptoKeyElement_Decr_AES_CTR_Key0_iv
        CryptoKeyType_Decr_AES_CTR_Key1_Type: CryptoKeyElementRef=CryptoKeyElement_Decr_AES_CTR_Key1_cipherkey, CryptoKeyElementRef=CryptoKeyElement_Decr_AES_CTR_Key1_iv
        CryptoKeyType_MacVer_AES_CMAC_key_Type: CryptoKeyElementRef=CryptoKeyElement_MacVer_AES_CMAC_key
    CryptoKeys
      6 x CryptoKey:
        CryptoKey_RandomSeed_L9: CryptoKeyId=0, CryptoKeyTypeRef=CryptoKeyType_RandomSeed_L9
        CryptoKey_Hash_Dummy_Fota: CryptoKeyId=1, CryptoKeyTypeRef=CryptoKeyType_Hash_Dummy_Fota
        CryptoKey_RSASSA_PKCS1_v1_5_Asims_Public_Key: CryptoKeyId=2, CryptoKeyTypeRef=CryptoKeyType_RSASSA_PKCS1_v1_5_Asims_Public_Key
        CryptoKey_Decr_AES_CTR_Key0: CryptoKeyId=3, CryptoKeyTypeRef=CryptoKeyType_Decr_AES_CTR_Key0_Type
        CryptoKey_Decr_AES_CTR_Key1: CryptoKeyId=4, CryptoKeyTypeRef=CryptoKeyType_Decr_AES_CTR_Key1_Type
        CryptoKey_MacVer_AES_CMAC_key: CryptoKeyId=5, CryptoKeyTypeRef=CryptoKeyType_MacVer_AES_CMAC_key_Type
    HaeHsmPrimitives (CryptoPrimitives)
      42 x CryptoPrimitive:
        HaeHsm_Primitive_Sha160: CryptoPrimitiveAlgorithmFamily=CRYPTO_ALGOFAM_SHA1, CryptoPrimitiveAlgorithmMode=CRYPTO_ALGOMODE_NOT_SET, CryptoPrimitiveAlgorithmSecondaryFamily=CRYPTO_ALGOFAM_NOT_SET, CryptoPrimitiveService=HASH
        HaeHsm_Primitive_Sha256: CryptoPrimitiveAlgorithmFamily=CRYPTO_ALGOFAM_SHA2_256, CryptoPrimitiveAlgorithmMode=CRYPTO_ALGOMODE_NOT_SET, CryptoPrimitiveAlgorithmSecondaryFamily=CRYPTO_ALGOFAM_NOT_SET, CryptoPrimitiveService=HASH
        HaeHsm_Primitive_Sha512: CryptoPrimitiveAlgorithmFamily=CRYPTO_ALGOFAM_SHA2_512, CryptoPrimitiveAlgorithmMode=CRYPTO_ALGOMODE_NOT_SET, CryptoPrimitiveAlgorithmSecondaryFamily=CRYPTO_ALGOFAM_NOT_SET, CryptoPrimitiveService=HASH
        HaeHsm_Primitive_Sha512_224: CryptoPrimitiveAlgorithmFamily=CRYPTO_ALGOFAM_SHA2_512_224, CryptoPrimitiveAlgorithmMode=CRYPTO_ALGOMODE_NOT_SET, CryptoPrimitiveAlgorithmSecondaryFamily=CRYPTO_ALGOFAM_NOT_SET, CryptoPrimitiveService=HASH
        HaeHsm_Primitive_Sha512_256: CryptoPrimitiveAlgorithmFamily=CRYPTO_ALGOFAM_SHA2_512_256, CryptoPrimitiveAlgorithmMode=CRYPTO_ALGOMODE_NOT_SET, CryptoPrimitiveAlgorithmSecondaryFamily=CRYPTO_ALGOFAM_NOT_SET, CryptoPrimitiveService=HASH
        HaeHsm_Primitive_Shake256: CryptoPrimitiveAlgorithmFamily=CRYPTO_ALGOFAM_SHAKE256, CryptoPrimitiveAlgorithmMode=CRYPTO_ALGOMODE_NOT_SET, CryptoPrimitiveAlgorithmSecondaryFamily=CRYPTO_ALGOFAM_NOT_SET, CryptoPrimitiveService=HASH
        HaeHsm_Primitive_AesCmac_Gen: CryptoPrimitiveAlgorithmFamily=CRYPTO_ALGOFAM_AES, CryptoPrimitiveAlgorithmMode=CRYPTO_ALGOMODE_CMAC, CryptoPrimitiveAlgorithmSecondaryFamily=CRYPTO_ALGOFAM_NOT_SET, CryptoPrimitiveService=MAC_GENERATE
        HaeHsm_Primitive_HmacSha256_Gen: CryptoPrimitiveAlgorithmFamily=CRYPTO_ALGOFAM_SHA2_256, CryptoPrimitiveAlgorithmMode=CRYPTO_ALGOMODE_HMAC, CryptoPrimitiveAlgorithmSecondaryFamily=CRYPTO_ALGOFAM_NOT_SET, CryptoPrimitiveService=MAC_GENERATE
        HaeHsm_Primitive_AesCmac_Verify: CryptoPrimitiveAlgorithmFamily=CRYPTO_ALGOFAM_AES, CryptoPrimitiveAlgorithmMode=CRYPTO_ALGOMODE_CMAC, CryptoPrimitiveAlgorithmSecondaryFamily=CRYPTO_ALGOFAM_NOT_SET, CryptoPrimitiveService=MAC_VERIFY
        HaeHsm_Primitive_HmacSha256_Verify: CryptoPrimitiveAlgorithmFamily=CRYPTO_ALGOFAM_SHA2_256, CryptoPrimitiveAlgorithmMode=CRYPTO_ALGOMODE_HMAC, CryptoPrimitiveAlgorithmSecondaryFamily=CRYPTO_ALGOFAM_NOT_SET, CryptoPrimitiveService=MAC_VERIFY
        HaeHsm_Primitive_AesEncECB: CryptoPrimitiveAlgorithmFamily=CRYPTO_ALGOFAM_AES, CryptoPrimitiveAlgorithmMode=CRYPTO_ALGOMODE_ECB, CryptoPrimitiveAlgorithmSecondaryFamily=CRYPTO_ALGOFAM_NOT_SET, CryptoPrimitiveService=ENCRYPT
        HaeHsm_Primitive_AesEncCBC: CryptoPrimitiveAlgorithmFamily=CRYPTO_ALGOFAM_AES, CryptoPrimitiveAlgorithmMode=CRYPTO_ALGOMODE_CBC, CryptoPrimitiveAlgorithmSecondaryFamily=CRYPTO_ALGOFAM_NOT_SET, CryptoPrimitiveService=ENCRYPT
        HaeHsm_Primitive_AesEncCTR: CryptoPrimitiveAlgorithmFamily=CRYPTO_ALGOFAM_AES, CryptoPrimitiveAlgorithmMode=CRYPTO_ALGOMODE_CTR, CryptoPrimitiveAlgorithmSecondaryFamily=CRYPTO_ALGOFAM_NOT_SET, CryptoPrimitiveService=ENCRYPT
        HaeHsm_Primitive_AesEncOFB: CryptoPrimitiveAlgorithmFamily=CRYPTO_ALGOFAM_AES, CryptoPrimitiveAlgorithmMode=CRYPTO_ALGOMODE_OFB, CryptoPrimitiveAlgorithmSecondaryFamily=CRYPTO_ALGOFAM_NOT_SET, CryptoPrimitiveService=ENCRYPT
        HaeHsm_Primitive_AesEncGCM: CryptoPrimitiveAlgorithmFamily=CRYPTO_ALGOFAM_AES, CryptoPrimitiveAlgorithmMode=CRYPTO_ALGOMODE_GCM, CryptoPrimitiveAlgorithmSecondaryFamily=CRYPTO_ALGOFAM_NOT_SET, CryptoPrimitiveService=AEAD_ENCRYPT
        HaeHsm_Primitive_RsaPkcs1oaepEnc: CryptoPrimitiveAlgorithmFamily=CRYPTO_ALGOFAM_RSA, CryptoPrimitiveAlgorithmMode=CRYPTO_ALGOMODE_RSAES_OAEP, CryptoPrimitiveAlgorithmSecondaryFamily=CRYPTO_ALGOFAM_SHA2_256, CryptoPrimitiveService=ENCRYPT
        HaeHsm_Primitive_RsaPkcs1v15Enc: CryptoPrimitiveAlgorithmFamily=CRYPTO_ALGOFAM_RSA, CryptoPrimitiveAlgorithmMode=CRYPTO_ALGOMODE_RSAES_PKCS1_v1_5, CryptoPrimitiveAlgorithmSecondaryFamily=CRYPTO_ALGOFAM_NOT_SET, CryptoPrimitiveService=ENCRYPT
        HaeHsm_Primitive_AesDecECB: CryptoPrimitiveAlgorithmFamily=CRYPTO_ALGOFAM_AES, CryptoPrimitiveAlgorithmMode=CRYPTO_ALGOMODE_ECB, CryptoPrimitiveAlgorithmSecondaryFamily=CRYPTO_ALGOFAM_NOT_SET, CryptoPrimitiveService=DECRYPT
        HaeHsm_Primitive_AesDecCBC: CryptoPrimitiveAlgorithmFamily=CRYPTO_ALGOFAM_AES, CryptoPrimitiveAlgorithmMode=CRYPTO_ALGOMODE_CBC, CryptoPrimitiveAlgorithmSecondaryFamily=CRYPTO_ALGOFAM_NOT_SET, CryptoPrimitiveService=DECRYPT
        HaeHsm_Primitive_AesDecCTR: CryptoPrimitiveAlgorithmFamily=CRYPTO_ALGOFAM_AES, CryptoPrimitiveAlgorithmMode=CRYPTO_ALGOMODE_CTR, CryptoPrimitiveAlgorithmSecondaryFamily=CRYPTO_ALGOFAM_NOT_SET, CryptoPrimitiveService=DECRYPT
        HaeHsm_Primitive_AesDecOFB: CryptoPrimitiveAlgorithmFamily=CRYPTO_ALGOFAM_AES, CryptoPrimitiveAlgorithmMode=CRYPTO_ALGOMODE_OFB, CryptoPrimitiveAlgorithmSecondaryFamily=CRYPTO_ALGOFAM_NOT_SET, CryptoPrimitiveService=DECRYPT
        HaeHsm_Primitive_AesDecGCM: CryptoPrimitiveAlgorithmFamily=CRYPTO_ALGOFAM_AES, CryptoPrimitiveAlgorithmMode=CRYPTO_ALGOMODE_GCM, CryptoPrimitiveAlgorithmSecondaryFamily=CRYPTO_ALGOFAM_NOT_SET, CryptoPrimitiveService=AEAD_DECRYPT
        HaeHsm_Primitive_RsaPkcs1oaepDec: CryptoPrimitiveAlgorithmFamily=CRYPTO_ALGOFAM_RSA, CryptoPrimitiveAlgorithmMode=CRYPTO_ALGOMODE_RSAES_OAEP, CryptoPrimitiveAlgorithmSecondaryFamily=CRYPTO_ALGOFAM_SHA2_256, CryptoPrimitiveService=DECRYPT
        HaeHsm_Primitive_RsaPkcs1v15Dec: CryptoPrimitiveAlgorithmFamily=CRYPTO_ALGOFAM_RSA, CryptoPrimitiveAlgorithmMode=CRYPTO_ALGOMODE_RSAES_PKCS1_v1_5, CryptoPrimitiveAlgorithmSecondaryFamily=CRYPTO_ALGOFAM_NOT_SET, CryptoPrimitiveService=DECRYPT
        HaeHsm_Primitive_RsaPkcs1v15Sign: CryptoPrimitiveAlgorithmFamily=CRYPTO_ALGOFAM_RSA, CryptoPrimitiveAlgorithmMode=CRYPTO_ALGOMODE_RSASSA_PKCS1_v1_5, CryptoPrimitiveAlgorithmSecondaryFamily=CRYPTO_ALGOFAM_SHA2_256, CryptoPrimitiveService=SIGNATURE_GENERATE
        HaeHsm_Primitive_RsaPkcs1PssSign: CryptoPrimitiveAlgorithmFamily=CRYPTO_ALGOFAM_RSA, CryptoPrimitiveAlgorithmMode=CRYPTO_ALGOMODE_RSASSA_PSS, CryptoPrimitiveAlgorithmSecondaryFamily=CRYPTO_ALGOFAM_SHA2_256, CryptoPrimitiveService=SIGNATURE_GENERATE
        HaeHsm_Primitive_EccEcdsaSign: CryptoPrimitiveAlgorithmFamily=CRYPTO_ALGOFAM_ECCNIST, CryptoPrimitiveAlgorithmMode=CRYPTO_ALGOMODE_NOT_SET, CryptoPrimitiveAlgorithmSecondaryFamily=CRYPTO_ALGOFAM_SHA2_256, CryptoPrimitiveService=SIGNATURE_GENERATE
        HaeHsm_Primitive_EccEcdsaSignP521r1: CryptoPrimitiveAlgorithmFamily=CRYPTO_ALGOFAM_ECCNIST, CryptoPrimitiveAlgorithmMode=CRYPTO_ALGOMODE_NOT_SET, CryptoPrimitiveAlgorithmSecondaryFamily=CRYPTO_ALGOFAM_SHA2_512, CryptoPrimitiveService=SIGNATURE_GENERATE
        HaeHsm_Primitive_EccEddsaSignEd448: CryptoPrimitiveAlgorithmFamily=CRYPTO_ALGOFAM_ECCNIST, CryptoPrimitiveAlgorithmMode=CRYPTO_ALGOMODE_NOT_SET, CryptoPrimitiveAlgorithmSecondaryFamily=CRYPTO_ALGOFAM_SHAKE256, CryptoPrimitiveService=SIGNATURE_GENERATE
        HaeHsm_Primitive_Sha1_RsaPkcs1v15Verify: CryptoPrimitiveAlgorithmFamily=CRYPTO_ALGOFAM_RSA, CryptoPrimitiveAlgorithmMode=CRYPTO_ALGOMODE_RSASSA_PKCS1_v1_5, CryptoPrimitiveAlgorithmSecondaryFamily=CRYPTO_ALGOFAM_SHA1, CryptoPrimitiveService=SIGNATURE_VERIFY
        HaeHsm_Primitive_RsaPkcs1v15Verify: CryptoPrimitiveAlgorithmFamily=CRYPTO_ALGOFAM_RSA, CryptoPrimitiveAlgorithmMode=CRYPTO_ALGOMODE_RSASSA_PKCS1_v1_5, CryptoPrimitiveAlgorithmSecondaryFamily=CRYPTO_ALGOFAM_SHA2_256, CryptoPrimitiveService=SIGNATURE_VERIFY
        HaeHsm_Primitive_RsaPkcs1PssVerify: CryptoPrimitiveAlgorithmFamily=CRYPTO_ALGOFAM_RSA, CryptoPrimitiveAlgorithmMode=CRYPTO_ALGOMODE_RSASSA_PSS, CryptoPrimitiveAlgorithmSecondaryFamily=CRYPTO_ALGOFAM_SHA2_256, CryptoPrimitiveService=SIGNATURE_VERIFY
        HaeHsm_Primitive_EccEcdsaVerify: CryptoPrimitiveAlgorithmFamily=CRYPTO_ALGOFAM_ECCNIST, CryptoPrimitiveAlgorithmMode=CRYPTO_ALGOMODE_NOT_SET, CryptoPrimitiveAlgorithmSecondaryFamily=CRYPTO_ALGOFAM_SHA2_256, CryptoPrimitiveService=SIGNATURE_VERIFY
        HaeHsm_Primitive_EccEcdsaVerifyP521r1: CryptoPrimitiveAlgorithmFamily=CRYPTO_ALGOFAM_ECCNIST, CryptoPrimitiveAlgorithmMode=CRYPTO_ALGOMODE_NOT_SET, CryptoPrimitiveAlgorithmSecondaryFamily=CRYPTO_ALGOFAM_SHA2_512, CryptoPrimitiveService=SIGNATURE_VERIFY
        HaeHsm_Primitive_EccEddsaVerifyEd448: CryptoPrimitiveAlgorithmFamily=CRYPTO_ALGOFAM_ECCNIST, CryptoPrimitiveAlgorithmMode=CRYPTO_ALGOMODE_NOT_SET, CryptoPrimitiveAlgorithmSecondaryFamily=CRYPTO_ALGOFAM_SHAKE256, CryptoPrimitiveService=SIGNATURE_VERIFY
        HaeHsm_Primitive_PseudoRandomGenerate: CryptoPrimitiveAlgorithmFamily=CRYPTO_ALGOFAM_RNG, CryptoPrimitiveAlgorithmMode=CRYPTO_ALGOMODE_NOT_SET, CryptoPrimitiveAlgorithmSecondaryFamily=CRYPTO_ALGOFAM_NOT_SET, CryptoPrimitiveService=RANDOM
        HaeHsm_Primitive_TrueRandomGenerate: CryptoPrimitiveAlgorithmFamily=CRYPTO_ALGOFAM_RNG, CryptoPrimitiveAlgorithmMode=CRYPTO_ALGOMODE_CUSTOM, CryptoPrimitiveAlgorithmSecondaryFamily=CRYPTO_ALGOFAM_NOT_SET, CryptoPrimitiveService=RANDOM
        HaeHsm_Primitive_KeyDerive: CryptoPrimitiveAlgorithmFamily=CRYPTO_ALGOFAM_PBKDF2, CryptoPrimitiveAlgorithmMode=CRYPTO_ALGOMODE_NOT_SET, CryptoPrimitiveAlgorithmSecondaryFamily=CRYPTO_ALGOFAM_NOT_SET, CryptoPrimitiveService=KEY_DERIVE
        HaeHsm_Primitive_RsaPkcs3DHKeypairGen: CryptoPrimitiveAlgorithmFamily=CRYPTO_ALGOFAM_DH, CryptoPrimitiveAlgorithmMode=CRYPTO_ALGOMODE_NOT_SET, CryptoPrimitiveAlgorithmSecondaryFamily=CRYPTO_ALGOFAM_NOT_SET, CryptoPrimitiveService=KEY_EXCHANGECALCPUBVAL
        HaeHsm_Primitive_RsaPkcs3DHSharedValueGen: CryptoPrimitiveAlgorithmFamily=CRYPTO_ALGOFAM_DH, CryptoPrimitiveAlgorithmMode=CRYPTO_ALGOMODE_NOT_SET, CryptoPrimitiveAlgorithmSecondaryFamily=CRYPTO_ALGOFAM_NOT_SET, CryptoPrimitiveService=KEY_EXCHANGECALCSECRET
        HaeHsm_Primitive_EccEcdh: CryptoPrimitiveAlgorithmFamily=CRYPTO_ALGOFAM_DH, CryptoPrimitiveAlgorithmMode=CRYPTO_ALGOMODE_NOT_SET, CryptoPrimitiveAlgorithmSecondaryFamily=CRYPTO_ALGOFAM_ECCNIST, CryptoPrimitiveService=KEY_EXCHANGECALCSECRET
        HaeHsm_Primitive_KeySetValid: CryptoPrimitiveAlgorithmFamily=CRYPTO_ALGOFAM_NOT_SET, CryptoPrimitiveAlgorithmMode=CRYPTO_ALGOMODE_NOT_SET, CryptoPrimitiveAlgorithmSecondaryFamily=CRYPTO_ALGOFAM_NOT_SET, CryptoPrimitiveService=KEY_SETVALID
    HaeCryptoLibPrimitives (CryptoPrimitives)
      94 x CryptoPrimitive:
        HaeCryptoLib_Primitive_Sha160: CryptoPrimitiveAlgorithmFamily=CRYPTO_ALGOFAM_SHA1, CryptoPrimitiveAlgorithmMode=CRYPTO_ALGOMODE_NOT_SET, CryptoPrimitiveAlgorithmSecondaryFamily=CRYPTO_ALGOFAM_NOT_SET, CryptoPrimitiveService=HASH
        HaeCryptoLib_Primitive_Sha224: CryptoPrimitiveAlgorithmFamily=CRYPTO_ALGOFAM_SHA2_224, CryptoPrimitiveAlgorithmMode=CRYPTO_ALGOMODE_NOT_SET, CryptoPrimitiveAlgorithmSecondaryFamily=CRYPTO_ALGOFAM_NOT_SET, CryptoPrimitiveService=HASH
        HaeCryptoLib_Primitive_Sha256: CryptoPrimitiveAlgorithmFamily=CRYPTO_ALGOFAM_SHA2_256, CryptoPrimitiveAlgorithmMode=CRYPTO_ALGOMODE_NOT_SET, CryptoPrimitiveAlgorithmSecondaryFamily=CRYPTO_ALGOFAM_NOT_SET, CryptoPrimitiveService=HASH
        HaeCryptoLib_Primitive_Sha384: CryptoPrimitiveAlgorithmFamily=CRYPTO_ALGOFAM_SHA2_384, CryptoPrimitiveAlgorithmMode=CRYPTO_ALGOMODE_NOT_SET, CryptoPrimitiveAlgorithmSecondaryFamily=CRYPTO_ALGOFAM_NOT_SET, CryptoPrimitiveService=HASH
        HaeCryptoLib_Primitive_Sha512: CryptoPrimitiveAlgorithmFamily=CRYPTO_ALGOFAM_SHA2_512, CryptoPrimitiveAlgorithmMode=CRYPTO_ALGOMODE_NOT_SET, CryptoPrimitiveAlgorithmSecondaryFamily=CRYPTO_ALGOFAM_NOT_SET, CryptoPrimitiveService=HASH
        HaeCryptoLib_Primitive_Sha512_224: CryptoPrimitiveAlgorithmFamily=CRYPTO_ALGOFAM_SHA2_512_224, CryptoPrimitiveAlgorithmMode=CRYPTO_ALGOMODE_NOT_SET, CryptoPrimitiveAlgorithmSecondaryFamily=CRYPTO_ALGOFAM_NOT_SET, CryptoPrimitiveService=HASH
        HaeCryptoLib_Primitive_Sha512_256: CryptoPrimitiveAlgorithmFamily=CRYPTO_ALGOFAM_SHA2_512_256, CryptoPrimitiveAlgorithmMode=CRYPTO_ALGOMODE_NOT_SET, CryptoPrimitiveAlgorithmSecondaryFamily=CRYPTO_ALGOFAM_NOT_SET, CryptoPrimitiveService=HASH
        HaeCryptoLib_Primitive_Shake256: CryptoPrimitiveAlgorithmFamily=CRYPTO_ALGOFAM_SHAKE256, CryptoPrimitiveAlgorithmMode=CRYPTO_ALGOMODE_NOT_SET, CryptoPrimitiveAlgorithmSecondaryFamily=CRYPTO_ALGOFAM_NOT_SET, CryptoPrimitiveService=HASH
        HaeCryptoLib_Primitive_HmacSha160_Generate: CryptoPrimitiveAlgorithmFamily=CRYPTO_ALGOFAM_SHA1, CryptoPrimitiveAlgorithmMode=CRYPTO_ALGOMODE_HMAC, CryptoPrimitiveAlgorithmSecondaryFamily=CRYPTO_ALGOFAM_NOT_SET, CryptoPrimitiveService=MAC_GENERATE
        HaeCryptoLib_Primitive_HmacSha224_Generate: CryptoPrimitiveAlgorithmFamily=CRYPTO_ALGOFAM_SHA2_224, CryptoPrimitiveAlgorithmMode=CRYPTO_ALGOMODE_HMAC, CryptoPrimitiveAlgorithmSecondaryFamily=CRYPTO_ALGOFAM_NOT_SET, CryptoPrimitiveService=MAC_GENERATE
        HaeCryptoLib_Primitive_HmacSha256_Generate: CryptoPrimitiveAlgorithmFamily=CRYPTO_ALGOFAM_SHA2_256, CryptoPrimitiveAlgorithmMode=CRYPTO_ALGOMODE_HMAC, CryptoPrimitiveAlgorithmSecondaryFamily=CRYPTO_ALGOFAM_NOT_SET, CryptoPrimitiveService=MAC_GENERATE
        HaeCryptoLib_Primitive_HmacSha384_Generate: CryptoPrimitiveAlgorithmFamily=CRYPTO_ALGOFAM_SHA2_384, CryptoPrimitiveAlgorithmMode=CRYPTO_ALGOMODE_HMAC, CryptoPrimitiveAlgorithmSecondaryFamily=CRYPTO_ALGOFAM_NOT_SET, CryptoPrimitiveService=MAC_GENERATE
        HaeCryptoLib_Primitive_HmacSha512_Generate: CryptoPrimitiveAlgorithmFamily=CRYPTO_ALGOFAM_SHA2_512, CryptoPrimitiveAlgorithmMode=CRYPTO_ALGOMODE_HMAC, CryptoPrimitiveAlgorithmSecondaryFamily=CRYPTO_ALGOFAM_NOT_SET, CryptoPrimitiveService=MAC_GENERATE
        HaeCryptoLib_Primitive_HmacSha160_Verify: CryptoPrimitiveAlgorithmFamily=CRYPTO_ALGOFAM_SHA1, CryptoPrimitiveAlgorithmMode=CRYPTO_ALGOMODE_HMAC, CryptoPrimitiveAlgorithmSecondaryFamily=CRYPTO_ALGOFAM_NOT_SET, CryptoPrimitiveService=MAC_VERIFY
        HaeCryptoLib_Primitive_HmacSha224_Verify: CryptoPrimitiveAlgorithmFamily=CRYPTO_ALGOFAM_SHA2_224, CryptoPrimitiveAlgorithmMode=CRYPTO_ALGOMODE_HMAC, CryptoPrimitiveAlgorithmSecondaryFamily=CRYPTO_ALGOFAM_NOT_SET, CryptoPrimitiveService=MAC_VERIFY
        HaeCryptoLib_Primitive_HmacSha256_Verify: CryptoPrimitiveAlgorithmFamily=CRYPTO_ALGOFAM_SHA2_256, CryptoPrimitiveAlgorithmMode=CRYPTO_ALGOMODE_HMAC, CryptoPrimitiveAlgorithmSecondaryFamily=CRYPTO_ALGOFAM_NOT_SET, CryptoPrimitiveService=MAC_VERIFY
        HaeCryptoLib_Primitive_HmacSha384_Verify: CryptoPrimitiveAlgorithmFamily=CRYPTO_ALGOFAM_SHA2_384, CryptoPrimitiveAlgorithmMode=CRYPTO_ALGOMODE_HMAC, CryptoPrimitiveAlgorithmSecondaryFamily=CRYPTO_ALGOFAM_NOT_SET, CryptoPrimitiveService=MAC_VERIFY
        HaeCryptoLib_Primitive_HmacSha512_Verify: CryptoPrimitiveAlgorithmFamily=CRYPTO_ALGOFAM_SHA2_512, CryptoPrimitiveAlgorithmMode=CRYPTO_ALGOMODE_HMAC, CryptoPrimitiveAlgorithmSecondaryFamily=CRYPTO_ALGOFAM_NOT_SET, CryptoPrimitiveService=MAC_VERIFY
        HaeCryptoLib_Primitive_AesEcb_Encrypt: CryptoPrimitiveAlgorithmFamily=CRYPTO_ALGOFAM_AES, CryptoPrimitiveAlgorithmMode=CRYPTO_ALGOMODE_ECB, CryptoPrimitiveAlgorithmSecondaryFamily=CRYPTO_ALGOFAM_NOT_SET, CryptoPrimitiveService=ENCRYPT
        HaeCryptoLib_Primitive_AesEcb_Decrypt: CryptoPrimitiveAlgorithmFamily=CRYPTO_ALGOFAM_AES, CryptoPrimitiveAlgorithmMode=CRYPTO_ALGOMODE_ECB, CryptoPrimitiveAlgorithmSecondaryFamily=CRYPTO_ALGOFAM_NOT_SET, CryptoPrimitiveService=DECRYPT
        HaeCryptoLib_Primitive_AesCbc_Encrypt: CryptoPrimitiveAlgorithmFamily=CRYPTO_ALGOFAM_AES, CryptoPrimitiveAlgorithmMode=CRYPTO_ALGOMODE_CBC, CryptoPrimitiveAlgorithmSecondaryFamily=CRYPTO_ALGOFAM_NOT_SET, CryptoPrimitiveService=ENCRYPT
        HaeCryptoLib_Primitive_AesCbc_Decrypt: CryptoPrimitiveAlgorithmFamily=CRYPTO_ALGOFAM_AES, CryptoPrimitiveAlgorithmMode=CRYPTO_ALGOMODE_CBC, CryptoPrimitiveAlgorithmSecondaryFamily=CRYPTO_ALGOFAM_NOT_SET, CryptoPrimitiveService=DECRYPT
        HaeCryptoLib_Primitive_AesOfb_Encrypt: CryptoPrimitiveAlgorithmFamily=CRYPTO_ALGOFAM_AES, CryptoPrimitiveAlgorithmMode=CRYPTO_ALGOMODE_OFB, CryptoPrimitiveAlgorithmSecondaryFamily=CRYPTO_ALGOFAM_NOT_SET, CryptoPrimitiveService=ENCRYPT
        HaeCryptoLib_Primitive_AesOfb_Decrypt: CryptoPrimitiveAlgorithmFamily=CRYPTO_ALGOFAM_AES, CryptoPrimitiveAlgorithmMode=CRYPTO_ALGOMODE_OFB, CryptoPrimitiveAlgorithmSecondaryFamily=CRYPTO_ALGOFAM_NOT_SET, CryptoPrimitiveService=DECRYPT
        HaeCryptoLib_Primitive_AesCtr_Encrypt: CryptoPrimitiveAlgorithmFamily=CRYPTO_ALGOFAM_AES, CryptoPrimitiveAlgorithmMode=CRYPTO_ALGOMODE_CTR, CryptoPrimitiveAlgorithmSecondaryFamily=CRYPTO_ALGOFAM_NOT_SET, CryptoPrimitiveService=ENCRYPT
        HaeCryptoLib_Primitive_AesCtr_Decrypt: CryptoPrimitiveAlgorithmFamily=CRYPTO_ALGOFAM_AES, CryptoPrimitiveAlgorithmMode=CRYPTO_ALGOMODE_CTR, CryptoPrimitiveAlgorithmSecondaryFamily=CRYPTO_ALGOFAM_NOT_SET, CryptoPrimitiveService=DECRYPT
        HaeCryptoLib_Primitive_AesGcm_Encrypt: CryptoPrimitiveAlgorithmFamily=CRYPTO_ALGOFAM_AES, CryptoPrimitiveAlgorithmMode=CRYPTO_ALGOMODE_GCM, CryptoPrimitiveAlgorithmSecondaryFamily=CRYPTO_ALGOFAM_NOT_SET, CryptoPrimitiveService=AEAD_ENCRYPT
        HaeCryptoLib_Primitive_AesGcm_Decrypt: CryptoPrimitiveAlgorithmFamily=CRYPTO_ALGOFAM_AES, CryptoPrimitiveAlgorithmMode=CRYPTO_ALGOMODE_GCM, CryptoPrimitiveAlgorithmSecondaryFamily=CRYPTO_ALGOFAM_NOT_SET, CryptoPrimitiveService=AEAD_DECRYPT
        HaeCryptoLib_Primitive_AesCmac_Generate: CryptoPrimitiveAlgorithmFamily=CRYPTO_ALGOFAM_AES, CryptoPrimitiveAlgorithmMode=CRYPTO_ALGOMODE_CMAC, CryptoPrimitiveAlgorithmSecondaryFamily=CRYPTO_ALGOFAM_NOT_SET, CryptoPrimitiveService=MAC_GENERATE
        HaeCryptoLib_Primitive_AesCmac_Verify: CryptoPrimitiveAlgorithmFamily=CRYPTO_ALGOFAM_AES, CryptoPrimitiveAlgorithmMode=CRYPTO_ALGOMODE_CMAC, CryptoPrimitiveAlgorithmSecondaryFamily=CRYPTO_ALGOFAM_NOT_SET, CryptoPrimitiveService=MAC_VERIFY
        HaeCryptoLib_Primitive_AesGmac_Generate: CryptoPrimitiveAlgorithmFamily=CRYPTO_ALGOFAM_AES, CryptoPrimitiveAlgorithmMode=CRYPTO_ALGOMODE_GMAC, CryptoPrimitiveAlgorithmSecondaryFamily=CRYPTO_ALGOFAM_NOT_SET, CryptoPrimitiveService=MAC_GENERATE
        HaeCryptoLib_Primitive_AesGmac_Verify: CryptoPrimitiveAlgorithmFamily=CRYPTO_ALGOFAM_AES, CryptoPrimitiveAlgorithmMode=CRYPTO_ALGOMODE_GMAC, CryptoPrimitiveAlgorithmSecondaryFamily=CRYPTO_ALGOFAM_NOT_SET, CryptoPrimitiveService=MAC_VERIFY
        HaeCryptoLib_Primitive_Chacha20_Encrypt: CryptoPrimitiveAlgorithmMode=CRYPTO_ALGOMODE_20ROUNDS, CryptoPrimitiveAlgorithmFamily=CRYPTO_ALGOFAM_CHACHA, CryptoPrimitiveAlgorithmSecondaryFamily=CRYPTO_ALGOFAM_NOT_SET, CryptoPrimitiveService=ENCRYPT
        HaeCryptoLib_Primitive_Chacha20_Decrypt: CryptoPrimitiveAlgorithmMode=CRYPTO_ALGOMODE_20ROUNDS, CryptoPrimitiveAlgorithmFamily=CRYPTO_ALGOFAM_CHACHA, CryptoPrimitiveAlgorithmSecondaryFamily=CRYPTO_ALGOFAM_NOT_SET, CryptoPrimitiveService=DECRYPT
        HaeCryptoLib_Primitive_TdesEcb_Encrypt: CryptoPrimitiveAlgorithmFamily=CRYPTO_ALGOFAM_3DES, CryptoPrimitiveAlgorithmMode=CRYPTO_ALGOMODE_ECB, CryptoPrimitiveAlgorithmSecondaryFamily=CRYPTO_ALGOFAM_NOT_SET, CryptoPrimitiveService=ENCRYPT
        HaeCryptoLib_Primitive_TdesEcb_Decrypt: CryptoPrimitiveAlgorithmFamily=CRYPTO_ALGOFAM_3DES, CryptoPrimitiveAlgorithmMode=CRYPTO_ALGOMODE_ECB, CryptoPrimitiveAlgorithmSecondaryFamily=CRYPTO_ALGOFAM_NOT_SET, CryptoPrimitiveService=DECRYPT
        HaeCryptoLib_Primitive_TdesCbc_Encrypt: CryptoPrimitiveAlgorithmFamily=CRYPTO_ALGOFAM_3DES, CryptoPrimitiveAlgorithmMode=CRYPTO_ALGOMODE_CBC, CryptoPrimitiveAlgorithmSecondaryFamily=CRYPTO_ALGOFAM_NOT_SET, CryptoPrimitiveService=ENCRYPT
        HaeCryptoLib_Primitive_TdesCbc_Decrypt: CryptoPrimitiveAlgorithmFamily=CRYPTO_ALGOFAM_3DES, CryptoPrimitiveAlgorithmMode=CRYPTO_ALGOMODE_CBC, CryptoPrimitiveAlgorithmSecondaryFamily=CRYPTO_ALGOFAM_NOT_SET, CryptoPrimitiveService=DECRYPT
        HaeCryptoLib_Primitive_TdesCtr_Encrypt: CryptoPrimitiveAlgorithmFamily=CRYPTO_ALGOFAM_3DES, CryptoPrimitiveAlgorithmMode=CRYPTO_ALGOMODE_CTR, CryptoPrimitiveAlgorithmSecondaryFamily=CRYPTO_ALGOFAM_NOT_SET, CryptoPrimitiveService=ENCRYPT
        HaeCryptoLib_Primitive_TdesCtr_Decrypt: CryptoPrimitiveAlgorithmFamily=CRYPTO_ALGOFAM_3DES, CryptoPrimitiveAlgorithmMode=CRYPTO_ALGOMODE_CTR, CryptoPrimitiveAlgorithmSecondaryFamily=CRYPTO_ALGOFAM_NOT_SET, CryptoPrimitiveService=DECRYPT
        HaeCryptoLib_Primitive_TdesCmac_Generate: CryptoPrimitiveAlgorithmFamily=CRYPTO_ALGOFAM_3DES, CryptoPrimitiveAlgorithmMode=CRYPTO_ALGOMODE_CMAC, CryptoPrimitiveAlgorithmSecondaryFamily=CRYPTO_ALGOFAM_NOT_SET, CryptoPrimitiveService=MAC_GENERATE
        HaeCryptoLib_Primitive_TdesCmac_Verify: CryptoPrimitiveAlgorithmFamily=CRYPTO_ALGOFAM_3DES, CryptoPrimitiveAlgorithmMode=CRYPTO_ALGOMODE_CMAC, CryptoPrimitiveAlgorithmSecondaryFamily=CRYPTO_ALGOFAM_NOT_SET, CryptoPrimitiveService=MAC_VERIFY
        HaeCryptoLib_Primitive_RsaesOaepSha160_Encrypt: CryptoPrimitiveAlgorithmFamily=CRYPTO_ALGOFAM_RSA, CryptoPrimitiveAlgorithmMode=CRYPTO_ALGOMODE_RSAES_OAEP, CryptoPrimitiveAlgorithmSecondaryFamily=CRYPTO_ALGOFAM_SHA1, CryptoPrimitiveService=ENCRYPT
        HaeCryptoLib_Primitive_RsaesOaepSha160_Decrypt: CryptoPrimitiveAlgorithmFamily=CRYPTO_ALGOFAM_RSA, CryptoPrimitiveAlgorithmMode=CRYPTO_ALGOMODE_RSAES_OAEP, CryptoPrimitiveAlgorithmSecondaryFamily=CRYPTO_ALGOFAM_SHA1, CryptoPrimitiveService=DECRYPT
        HaeCryptoLib_Primitive_RsaesOaepSha224_Encrypt: CryptoPrimitiveAlgorithmFamily=CRYPTO_ALGOFAM_RSA, CryptoPrimitiveAlgorithmMode=CRYPTO_ALGOMODE_RSAES_OAEP, CryptoPrimitiveAlgorithmSecondaryFamily=CRYPTO_ALGOFAM_SHA2_224, CryptoPrimitiveService=ENCRYPT
        HaeCryptoLib_Primitive_RsaesOaepSha224_Decrypt: CryptoPrimitiveAlgorithmFamily=CRYPTO_ALGOFAM_RSA, CryptoPrimitiveAlgorithmMode=CRYPTO_ALGOMODE_RSAES_OAEP, CryptoPrimitiveAlgorithmSecondaryFamily=CRYPTO_ALGOFAM_SHA2_224, CryptoPrimitiveService=DECRYPT
        HaeCryptoLib_Primitive_RsaesOaepSha256_Encrypt: CryptoPrimitiveAlgorithmFamily=CRYPTO_ALGOFAM_RSA, CryptoPrimitiveAlgorithmMode=CRYPTO_ALGOMODE_RSAES_OAEP, CryptoPrimitiveAlgorithmSecondaryFamily=CRYPTO_ALGOFAM_SHA2_256, CryptoPrimitiveService=ENCRYPT
        HaeCryptoLib_Primitive_RsaesOaepSha256_Decrypt: CryptoPrimitiveAlgorithmFamily=CRYPTO_ALGOFAM_RSA, CryptoPrimitiveAlgorithmMode=CRYPTO_ALGOMODE_RSAES_OAEP, CryptoPrimitiveAlgorithmSecondaryFamily=CRYPTO_ALGOFAM_SHA2_256, CryptoPrimitiveService=DECRYPT
        HaeCryptoLib_Primitive_RsaesOaepSha384_Encrypt: CryptoPrimitiveAlgorithmFamily=CRYPTO_ALGOFAM_RSA, CryptoPrimitiveAlgorithmMode=CRYPTO_ALGOMODE_RSAES_OAEP, CryptoPrimitiveAlgorithmSecondaryFamily=CRYPTO_ALGOFAM_SHA2_384, CryptoPrimitiveService=ENCRYPT
        HaeCryptoLib_Primitive_RsaesOaepSha384_Decrypt: CryptoPrimitiveAlgorithmFamily=CRYPTO_ALGOFAM_RSA, CryptoPrimitiveAlgorithmMode=CRYPTO_ALGOMODE_RSAES_OAEP, CryptoPrimitiveAlgorithmSecondaryFamily=CRYPTO_ALGOFAM_SHA2_384, CryptoPrimitiveService=DECRYPT
        HaeCryptoLib_Primitive_RsaesOaepSha512_Encrypt: CryptoPrimitiveAlgorithmFamily=CRYPTO_ALGOFAM_RSA, CryptoPrimitiveAlgorithmMode=CRYPTO_ALGOMODE_RSAES_OAEP, CryptoPrimitiveAlgorithmSecondaryFamily=CRYPTO_ALGOFAM_SHA2_512, CryptoPrimitiveService=ENCRYPT
        HaeCryptoLib_Primitive_RsaesOaepSha512_Decrypt: CryptoPrimitiveAlgorithmFamily=CRYPTO_ALGOFAM_RSA, CryptoPrimitiveAlgorithmMode=CRYPTO_ALGOMODE_RSAES_OAEP, CryptoPrimitiveAlgorithmSecondaryFamily=CRYPTO_ALGOFAM_SHA2_512, CryptoPrimitiveService=DECRYPT
        HaeCryptoLib_Primitive_RsaesPkcs15_Encrypt: CryptoPrimitiveAlgorithmFamily=CRYPTO_ALGOFAM_RSA, CryptoPrimitiveAlgorithmMode=CRYPTO_ALGOMODE_RSAES_PKCS1_v1_5, CryptoPrimitiveAlgorithmSecondaryFamily=CRYPTO_ALGOFAM_NOT_SET, CryptoPrimitiveService=ENCRYPT
        HaeCryptoLib_Primitive_RsaesPkcs15_Decrypt: CryptoPrimitiveAlgorithmFamily=CRYPTO_ALGOFAM_RSA, CryptoPrimitiveAlgorithmMode=CRYPTO_ALGOMODE_RSAES_PKCS1_v1_5, CryptoPrimitiveAlgorithmSecondaryFamily=CRYPTO_ALGOFAM_NOT_SET, CryptoPrimitiveService=DECRYPT
        HaeCryptoLib_Primitive_RsassaPssSha160_Generate: CryptoPrimitiveAlgorithmFamily=CRYPTO_ALGOFAM_RSA, CryptoPrimitiveAlgorithmMode=CRYPTO_ALGOMODE_RSASSA_PSS, CryptoPrimitiveAlgorithmSecondaryFamily=CRYPTO_ALGOFAM_SHA1, CryptoPrimitiveService=SIGNATURE_GENERATE
        HaeCryptoLib_Primitive_RsassaPssSha160_Verify: CryptoPrimitiveAlgorithmFamily=CRYPTO_ALGOFAM_RSA, CryptoPrimitiveAlgorithmMode=CRYPTO_ALGOMODE_RSASSA_PSS, CryptoPrimitiveAlgorithmSecondaryFamily=CRYPTO_ALGOFAM_SHA1, CryptoPrimitiveService=SIGNATURE_VERIFY
        HaeCryptoLib_Primitive_RsassaPssSha224_Generate: CryptoPrimitiveAlgorithmFamily=CRYPTO_ALGOFAM_RSA, CryptoPrimitiveAlgorithmMode=CRYPTO_ALGOMODE_RSASSA_PSS, CryptoPrimitiveAlgorithmSecondaryFamily=CRYPTO_ALGOFAM_SHA2_224, CryptoPrimitiveService=SIGNATURE_GENERATE
        HaeCryptoLib_Primitive_RsassaPssSha224_Verify: CryptoPrimitiveAlgorithmFamily=CRYPTO_ALGOFAM_RSA, CryptoPrimitiveAlgorithmMode=CRYPTO_ALGOMODE_RSASSA_PSS, CryptoPrimitiveAlgorithmSecondaryFamily=CRYPTO_ALGOFAM_SHA2_224, CryptoPrimitiveService=SIGNATURE_VERIFY
        HaeCryptoLib_Primitive_RsassaPssSha256_Generate: CryptoPrimitiveAlgorithmMode=CRYPTO_ALGOMODE_RSASSA_PSS, CryptoPrimitiveAlgorithmFamily=CRYPTO_ALGOFAM_RSA, CryptoPrimitiveAlgorithmSecondaryFamily=CRYPTO_ALGOFAM_SHA2_256, CryptoPrimitiveService=SIGNATURE_GENERATE
        HaeCryptoLib_Primitive_RsassaPssSha256_Verify: CryptoPrimitiveAlgorithmMode=CRYPTO_ALGOMODE_RSASSA_PSS, CryptoPrimitiveAlgorithmFamily=CRYPTO_ALGOFAM_RSA, CryptoPrimitiveAlgorithmSecondaryFamily=CRYPTO_ALGOFAM_SHA2_256, CryptoPrimitiveService=SIGNATURE_VERIFY
        HaeCryptoLib_Primitive_RsassaPssSha384_Generate: CryptoPrimitiveAlgorithmMode=CRYPTO_ALGOMODE_RSASSA_PSS, CryptoPrimitiveAlgorithmFamily=CRYPTO_ALGOFAM_RSA, CryptoPrimitiveAlgorithmSecondaryFamily=CRYPTO_ALGOFAM_SHA2_384, CryptoPrimitiveService=SIGNATURE_GENERATE
        HaeCryptoLib_Primitive_RsassaPssSha384_Verify: CryptoPrimitiveAlgorithmMode=CRYPTO_ALGOMODE_RSASSA_PSS, CryptoPrimitiveAlgorithmFamily=CRYPTO_ALGOFAM_RSA, CryptoPrimitiveAlgorithmSecondaryFamily=CRYPTO_ALGOFAM_SHA2_384, CryptoPrimitiveService=SIGNATURE_VERIFY
        HaeCryptoLib_Primitive_RsassaPkcs15Sha160_Generate: CryptoPrimitiveAlgorithmMode=CRYPTO_ALGOMODE_RSASSA_PKCS1_v1_5, CryptoPrimitiveAlgorithmFamily=CRYPTO_ALGOFAM_RSA, CryptoPrimitiveAlgorithmSecondaryFamily=CRYPTO_ALGOFAM_SHA1, CryptoPrimitiveService=SIGNATURE_GENERATE
        HaeCryptoLib_Primitive_RsassaPkcs15Sha160_Verify: CryptoPrimitiveAlgorithmFamily=CRYPTO_ALGOFAM_RSA, CryptoPrimitiveAlgorithmMode=CRYPTO_ALGOMODE_RSASSA_PKCS1_v1_5, CryptoPrimitiveAlgorithmSecondaryFamily=CRYPTO_ALGOFAM_SHA1, CryptoPrimitiveService=SIGNATURE_VERIFY
        HaeCryptoLib_Primitive_RsassaPkcs15Sha224_Generate: CryptoPrimitiveAlgorithmMode=CRYPTO_ALGOMODE_RSASSA_PKCS1_v1_5, CryptoPrimitiveAlgorithmFamily=CRYPTO_ALGOFAM_RSA, CryptoPrimitiveAlgorithmSecondaryFamily=CRYPTO_ALGOFAM_SHA2_224, CryptoPrimitiveService=SIGNATURE_GENERATE
        HaeCryptoLib_Primitive_RsassaPkcs15Sha224_Verify: CryptoPrimitiveAlgorithmMode=CRYPTO_ALGOMODE_RSASSA_PKCS1_v1_5, CryptoPrimitiveAlgorithmFamily=CRYPTO_ALGOFAM_RSA, CryptoPrimitiveAlgorithmSecondaryFamily=CRYPTO_ALGOFAM_SHA2_224, CryptoPrimitiveService=SIGNATURE_VERIFY
        HaeCryptoLib_Primitive_RsassaPkcs15Sha256_Generate: CryptoPrimitiveAlgorithmMode=CRYPTO_ALGOMODE_RSASSA_PKCS1_v1_5, CryptoPrimitiveAlgorithmFamily=CRYPTO_ALGOFAM_RSA, CryptoPrimitiveAlgorithmSecondaryFamily=CRYPTO_ALGOFAM_SHA2_256, CryptoPrimitiveService=SIGNATURE_GENERATE
        HaeCryptoLib_Primitive_RsassaPkcs15Sha256_Verify: CryptoPrimitiveAlgorithmMode=CRYPTO_ALGOMODE_RSASSA_PKCS1_v1_5, CryptoPrimitiveAlgorithmFamily=CRYPTO_ALGOFAM_RSA, CryptoPrimitiveAlgorithmSecondaryFamily=CRYPTO_ALGOFAM_SHA2_256, CryptoPrimitiveService=SIGNATURE_VERIFY
        HaeCryptoLib_Primitive_RsassaPkcs15Sha384_Generate: CryptoPrimitiveAlgorithmMode=CRYPTO_ALGOMODE_RSASSA_PKCS1_v1_5, CryptoPrimitiveAlgorithmFamily=CRYPTO_ALGOFAM_RSA, CryptoPrimitiveAlgorithmSecondaryFamily=CRYPTO_ALGOFAM_SHA2_384, CryptoPrimitiveService=SIGNATURE_GENERATE
        HaeCryptoLib_Primitive_RsassaPkcs15Sha384_Verify: CryptoPrimitiveAlgorithmMode=CRYPTO_ALGOMODE_RSASSA_PKCS1_v1_5, CryptoPrimitiveAlgorithmFamily=CRYPTO_ALGOFAM_RSA, CryptoPrimitiveAlgorithmSecondaryFamily=CRYPTO_ALGOFAM_SHA2_384, CryptoPrimitiveService=SIGNATURE_VERIFY
        HaeCryptoLib_Primitive_RsassaPkcs15Sha512_Generate: CryptoPrimitiveAlgorithmMode=CRYPTO_ALGOMODE_RSASSA_PKCS1_v1_5, CryptoPrimitiveAlgorithmFamily=CRYPTO_ALGOFAM_RSA, CryptoPrimitiveAlgorithmSecondaryFamily=CRYPTO_ALGOFAM_SHA2_512, CryptoPrimitiveService=SIGNATURE_GENERATE
        HaeCryptoLib_Primitive_RsassaPkcs15Sha512_Verify: CryptoPrimitiveAlgorithmMode=CRYPTO_ALGOMODE_RSASSA_PKCS1_v1_5, CryptoPrimitiveAlgorithmFamily=CRYPTO_ALGOFAM_RSA, CryptoPrimitiveAlgorithmSecondaryFamily=CRYPTO_ALGOFAM_SHA2_512, CryptoPrimitiveService=SIGNATURE_VERIFY
        HaeCryptoLib_Primitive_EcdsaSha160_Generate: CryptoPrimitiveAlgorithmFamily=CRYPTO_ALGOFAM_ECCNIST, CryptoPrimitiveAlgorithmMode=CRYPTO_ALGOMODE_NOT_SET, CryptoPrimitiveAlgorithmSecondaryFamily=CRYPTO_ALGOFAM_SHA1, CryptoPrimitiveService=SIGNATURE_GENERATE
        HaeCryptoLib_Primitive_EcdsaSha160_Verify: CryptoPrimitiveAlgorithmFamily=CRYPTO_ALGOFAM_ECCNIST, CryptoPrimitiveAlgorithmMode=CRYPTO_ALGOMODE_NOT_SET, CryptoPrimitiveAlgorithmSecondaryFamily=CRYPTO_ALGOFAM_SHA1, CryptoPrimitiveService=SIGNATURE_VERIFY
        HaeCryptoLib_Primitive_EcdsaSha224_Generate: CryptoPrimitiveAlgorithmFamily=CRYPTO_ALGOFAM_ECCNIST, CryptoPrimitiveAlgorithmMode=CRYPTO_ALGOMODE_NOT_SET, CryptoPrimitiveAlgorithmSecondaryFamily=CRYPTO_ALGOFAM_SHA2_224, CryptoPrimitiveService=SIGNATURE_GENERATE
        HaeCryptoLib_Primitive_EcdsaSha224_Verify: CryptoPrimitiveAlgorithmFamily=CRYPTO_ALGOFAM_ECCNIST, CryptoPrimitiveAlgorithmMode=CRYPTO_ALGOMODE_NOT_SET, CryptoPrimitiveAlgorithmSecondaryFamily=CRYPTO_ALGOFAM_SHA2_224, CryptoPrimitiveService=SIGNATURE_VERIFY
        HaeCryptoLib_Primitive_EcdsaSha256_Generate: CryptoPrimitiveAlgorithmFamily=CRYPTO_ALGOFAM_ECCNIST, CryptoPrimitiveAlgorithmMode=CRYPTO_ALGOMODE_NOT_SET, CryptoPrimitiveAlgorithmSecondaryFamily=CRYPTO_ALGOFAM_SHA2_256, CryptoPrimitiveService=SIGNATURE_GENERATE
        HaeCryptoLib_Primitive_EcdsaSha256_Verify: CryptoPrimitiveAlgorithmFamily=CRYPTO_ALGOFAM_ECCNIST, CryptoPrimitiveAlgorithmMode=CRYPTO_ALGOMODE_NOT_SET, CryptoPrimitiveAlgorithmSecondaryFamily=CRYPTO_ALGOFAM_SHA2_256, CryptoPrimitiveService=SIGNATURE_VERIFY
        HaeCryptoLib_Primitive_EcdsaSha384_Generate: CryptoPrimitiveAlgorithmFamily=CRYPTO_ALGOFAM_ECCNIST, CryptoPrimitiveAlgorithmMode=CRYPTO_ALGOMODE_NOT_SET, CryptoPrimitiveAlgorithmSecondaryFamily=CRYPTO_ALGOFAM_SHA2_384, CryptoPrimitiveService=SIGNATURE_GENERATE
        HaeCryptoLib_Primitive_EcdsaSha384_Verify: CryptoPrimitiveAlgorithmFamily=CRYPTO_ALGOFAM_ECCNIST, CryptoPrimitiveAlgorithmMode=CRYPTO_ALGOMODE_NOT_SET, CryptoPrimitiveAlgorithmSecondaryFamily=CRYPTO_ALGOFAM_SHA2_384, CryptoPrimitiveService=SIGNATURE_VERIFY
        HaeCryptoLib_Primitive_EcdsaSha512_Generate: CryptoPrimitiveAlgorithmFamily=CRYPTO_ALGOFAM_ECCNIST, CryptoPrimitiveAlgorithmMode=CRYPTO_ALGOMODE_NOT_SET, CryptoPrimitiveAlgorithmSecondaryFamily=CRYPTO_ALGOFAM_SHA2_512, CryptoPrimitiveService=SIGNATURE_GENERATE
        HaeCryptoLib_Primitive_EcdsaSha512_Verify: CryptoPrimitiveAlgorithmFamily=CRYPTO_ALGOFAM_ECCNIST, CryptoPrimitiveAlgorithmMode=CRYPTO_ALGOMODE_NOT_SET, CryptoPrimitiveAlgorithmSecondaryFamily=CRYPTO_ALGOFAM_SHA2_512, CryptoPrimitiveService=SIGNATURE_VERIFY
        HaeCryptoLib_Primitive_EddsaEd448_Generate: CryptoPrimitiveAlgorithmFamily=CRYPTO_ALGOFAM_ECCNIST, CryptoPrimitiveAlgorithmMode=CRYPTO_ALGOMODE_NOT_SET, CryptoPrimitiveAlgorithmSecondaryFamily=CRYPTO_ALGOFAM_SHAKE256, CryptoPrimitiveService=SIGNATURE_GENERATE
        HaeCryptoLib_Primitive_EddsaEd448_Verify: CryptoPrimitiveAlgorithmFamily=CRYPTO_ALGOFAM_ECCNIST, CryptoPrimitiveAlgorithmMode=CRYPTO_ALGOMODE_NOT_SET, CryptoPrimitiveAlgorithmSecondaryFamily=CRYPTO_ALGOFAM_SHAKE256, CryptoPrimitiveService=SIGNATURE_VERIFY
        HaeCryptoLib_Primitive_Ecdh_CalcPubVal: CryptoPrimitiveAlgorithmFamily=CRYPTO_ALGOFAM_DH, CryptoPrimitiveAlgorithmMode=CRYPTO_ALGOMODE_NOT_SET, CryptoPrimitiveAlgorithmSecondaryFamily=CRYPTO_ALGOFAM_ECCNIST, CryptoPrimitiveService=KEY_EXCHANGECALCPUBVAL
        HaeCryptoLib_Primitive_Ecdh_CalcSecret: CryptoPrimitiveAlgorithmFamily=CRYPTO_ALGOFAM_DH, CryptoPrimitiveAlgorithmMode=CRYPTO_ALGOMODE_NOT_SET, CryptoPrimitiveAlgorithmSecondaryFamily=CRYPTO_ALGOFAM_ECCNIST, CryptoPrimitiveService=KEY_EXCHANGECALCSECRET
        HaeCryptoLib_Primitive_Dh_CalcPubVal: CryptoPrimitiveAlgorithmFamily=CRYPTO_ALGOFAM_DH, CryptoPrimitiveAlgorithmMode=CRYPTO_ALGOMODE_NOT_SET, CryptoPrimitiveAlgorithmSecondaryFamily=CRYPTO_ALGOFAM_NOT_SET, CryptoPrimitiveService=KEY_EXCHANGECALCPUBVAL
        HaeCryptoLib_Primitive_Dh_CalcSecret: CryptoPrimitiveAlgorithmFamily=CRYPTO_ALGOFAM_DH, CryptoPrimitiveAlgorithmMode=CRYPTO_ALGOMODE_NOT_SET, CryptoPrimitiveAlgorithmSecondaryFamily=CRYPTO_ALGOFAM_NOT_SET, CryptoPrimitiveService=KEY_EXCHANGECALCSECRET
        HaeCryptoLib_Primitive_Chacha20Poly1305_Encrypt: CryptoPrimitiveAlgorithmFamily=CRYPTO_ALGOFAM_CHACHA, CryptoPrimitiveAlgorithmMode=CRYPTO_ALGOMODE_20ROUNDS, CryptoPrimitiveAlgorithmSecondaryFamily=CRYPTO_ALGOFAM_POLY1305, CryptoPrimitiveService=AEAD_ENCRYPT
        HaeCryptoLib_Primitive_Chacha20Poly1305_Decrypt: CryptoPrimitiveAlgorithmFamily=CRYPTO_ALGOFAM_CHACHA, CryptoPrimitiveAlgorithmMode=CRYPTO_ALGOMODE_20ROUNDS, CryptoPrimitiveAlgorithmSecondaryFamily=CRYPTO_ALGOFAM_POLY1305, CryptoPrimitiveService=AEAD_DECRYPT
        HaeCryptoLib_Primitive_HashDrbgSha256_Generate: CryptoPrimitiveService=RANDOM, CryptoPrimitiveAlgorithmFamily=CRYPTO_ALGOFAM_RNG, CryptoPrimitiveAlgorithmMode=CRYPTO_ALGOMODE_NOT_SET, CryptoPrimitiveAlgorithmSecondaryFamily=CRYPTO_ALGOFAM_NOT_SET
        HaeCryptoLib_Primitive_HashDrbgSha256_Seed: CryptoPrimitiveAlgorithmFamily=CRYPTO_ALGOFAM_DRBG, CryptoPrimitiveAlgorithmMode=CRYPTO_ALGOMODE_NOT_SET, CryptoPrimitiveAlgorithmSecondaryFamily=CRYPTO_ALGOFAM_SHA2_256, CryptoPrimitiveService=RANDOMSEED
        HaeCryptoLib_Primitive_Pbkdf2HmacSha256: CryptoPrimitiveService=KEY_DERIVE, CryptoPrimitiveAlgorithmFamily=CRYPTO_ALGOFAM_PBKDF2, CryptoPrimitiveAlgorithmMode=CRYPTO_ALGOMODE_HMAC, CryptoPrimitiveAlgorithmSecondaryFamily=CRYPTO_ALGOFAM_SHA2_256
        HaeCryptoLib_Primitive_KeySetValid: CryptoPrimitiveService=KEY_SETVALID, CryptoPrimitiveAlgorithmFamily=CRYPTO_ALGOFAM_NOT_SET, CryptoPrimitiveAlgorithmMode=CRYPTO_ALGOMODE_NOT_SET, CryptoPrimitiveAlgorithmSecondaryFamily=CRYPTO_ALGOFAM_NOT_SET
