AUTOSAR XML (schema 4-3-0)
package /EcucModules
  module config Mem_76_Pfls: definition=Mem, ecuc-def-edition=4.4.7, implementation-config-variant=VARIANT-PRE-COMPILE, module-description=BswImplementation_Mem
    MemGeneral:
      MemDevErrorDetect = 1
      MemMainfunctionPeriod = 0.005
      MemUserIncludeFiles = Fota.h
      MemUserIncludeFiles = Mem_76_Pfls_User_Callouts.h
      MemProcessorSeries = S32K312
      MemUseNvm = 1
      MemDisableEccTrap = 0
      MemUseRamCode = 0
    MemPublishedInformation: MemErasedValue=0x00000000
    MemInstance0 (MemInstance): MemInstanceId=0
      MemSectorBatch0 (MemSectorBatch): MemNumberOfSectors=186, MemReadPageSize=1, MemWritePageSize=8, MemEraseSectorSize=8192, MemStartAddress=0x460000, MemSpecifiedEraseCycles=4294967295
      UserPreCalloutFunction0 (UserPreCalloutFunction): UserPreCalloutFunction=Mem_76_Pfls_CacheControlDisable_Callout
      UserPostCalloutFunction0 (UserPostCalloutFunction): UserPostCalloutFunction=Mem_76_Pfls_CacheControlEnable_Callout
