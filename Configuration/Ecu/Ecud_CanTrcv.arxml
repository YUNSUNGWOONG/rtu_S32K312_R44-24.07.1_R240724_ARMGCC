AUTOSAR XML (schema 00047)
package /AUTRON
  module config CanTrcv: implementation-config-variant=VARIANT-PRE-COMPILE, module-description=BswImplementation_CanTrcv
    CanTrcvConfigSet: CanTrcvSPICommRetries=0, CanTrcvSPICommTimeout=0
      CanTrcvChannel_FD_CAN1 (CanTrcvChannel):
        CanTrcvChannelUsed = 1
        CanTrcvControlsPowerSupply = 0
        CanTrcvInitState = CANTRCV_OP_MODE_STANDBY
        CanTrcvChannelId = 0
        CanTrcvMaxBaudrate = 1000
        CanTrcvSleepModeUsed = 0
        CanTrcvHwDevName = TJA1043
        CanTrcvWakeupByBusUsed = 0
        CanTrcvHwPnSupport = 1
        CanTrcvAccess
          CanTrcvDioAccess
            CanTrcvDioChannelAccess0 (CanTrcvDioChannelAccess): CanTrcvHardwareInterfaceName=STB, CanTrcvDioSymNameRef=DioChannel_PTC20
            CanTrcvDioChannelAccess_EN (CanTrcvDioChannelAccess): CanTrcvHardwareInterfaceName=EN, CanTrcvDioSymNameRef=DioChannel_PTC21
    CanTrcvGeneral:
      CanTrcvDevErrorDetect = 1
      CanTrcvWakeUpSupport = CANTRCV_WAKEUP_BY_POLLING
      CanTrcvVersionInfoApi = 1
      CanTrcvIndex = 0
      CanTrcvWaitTime = 0.0002
      CanTrcvMainFunctionPeriod = 0.005
      CanTrcvSpiLessAR42 = 0
