AUTOSAR XML (schema 00047)
package /AUTRON
  module config CanSM: implementation-config-variant=VARIANT-PRE-COMPILE, module-description=BswImplementation_CanSM
    CanSMConfiguration: CanSMModeRequestRepetitionMax=3, CanSMModeRequestRepetitionTime=0.03
      CanSMManagerNetwork_FD_CAN1 (CanSMManagerNetwork):
        category = TOOL_CONFIGURED
        CanSMEnableBusOffDelay = 0
        CanSMBorCounterL1ToL2 = 3
        CanSMBorTimeL1 = 0.96
        CanSMBorTimeL2 = 0.96
        CanSMBorTimeTxEnsured = 0.02
        CanSMBorTxConfirmationPolling = 0
        CanSMTransceiverId = CanIfTrcvCfg_FD_CAN1
        CanSMComMNetworkHandleRef = ComMChannel_FD_CAN1
        CanSMController_ECU1_FD_CAN1 (CanSMController): category=TOOL_CONFIGURED, CanSMControllerId=CanIfCtrlCfg_ECU1_FD_CAN1
        CanSMDemEventParameterRefs: CANSM_E_BUS_OFF=CANSM_E_BUS_OFF_FD_CAN1, CANSM_E_MODE_REQUEST_TIMEOUT=CANSM_E_MODE_REQUEST_TIMEOUT_FD_CAN1
    CanSMGeneral: CanSMDevErrorDetect=1, CanSMIcomSupport=0, CanSMMainFunctionTimePeriod=0.01, CanSMVersionInfoApi=1, CanSMPncSupport=1, CanSMTxOfflineActiveSupport=0
