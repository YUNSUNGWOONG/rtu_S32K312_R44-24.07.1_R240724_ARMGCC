AUTOSAR XML (schema 00047)
package /AUTRON
  module config FiM: ecuc-def-edition=4.4.0, implementation-config-variant=VARIANT-PRE-COMPILE, module-description=BswImplementation_FiM
    FiMConfigSet
      FiMFID0 (FiMFID): FiMFunctionId=0
      FiMFID1 (FiMFID): FiMFunctionId=1
      FiMInhibitionConfiguration0 (FiMInhibitionConfiguration): FiMInhInhibitionMask=FIM_NOT_TESTED, FiMInhFunctionIdRef=FiMFID0, FiMInhEventRef=DEM_E_TEST_EVENT1
      FiMInhibitionConfiguration1 (FiMInhibitionConfiguration): FiMInhInhibitionMask=FIM_TESTED_AND_FAILED, FiMInhFunctionIdRef=FiMFID1, FiMInhSumRef=FiMSummaryEvent0, FiMInhComponentRef=DemComponent1
      FiMSummaryEvent0 (FiMSummaryEvent): FiMInputEventRef=DEM_E_TEST_EVENT1, FiMInputEventRef=DEM_E_TEST_EVENT2
    FiMGeneral:
      FiMDevErrorDetect = 1
      FiMMainFunctionPeriod = 0.01
      FiMMaxEventsPerFidInhibitionConfiguration = 5
      FiMMaxFiMInhibitionConfigurations = 5
      FiMMaxInputEventsPerSummaryEvents = 3
      FiMMaxSumEventsPerFidInhibitionConfiguration = 3
      FiMMaxSummaryEvents = 3
      FiMVersionInfoApi = 1
      FiMAvailabilitySupport = 1
      FiMEventUpdateTriggeredByDem = 0
