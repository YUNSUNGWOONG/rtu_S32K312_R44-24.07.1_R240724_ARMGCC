AUTOSAR XML (schema 4-0-3)
package /Pwm
  module config Pwm: implementation-config-variant=VARIANT-POST-BUILD, module-description=BswImplementation_Pwm
    CommonPublishedInformation:
      ArReleaseMajorVersion = 4
      ArReleaseMinorVersion = 7
      ArReleaseRevisionVersion = 0
      ModuleId = 121
      SwMajorVersion = 3
      SwMinorVersion = 0
      SwPatchVersion = 0
      VendorId = 43
    PwmChannelConfigSet
      PwmChannel_PTA12 (PwmChannel):
        index = 0
        PwmChannelId = 0
        PwmDutycycleDefault = 16384
        PwmIdleState = PWM_LOW
        PwmPeriodDefault = 65534
        PwmPeriodInTicks = 1
        PwmPolarity = PWM_HIGH
        PwmChannelClass = PWM_FIXED_PERIOD
        PwmHwChannel = PwmEmiosChannels_0
        PwmMcuClockReferencePoint = McuClockReferencePoint_CORE_CLK
      PwmEmios_0 (PwmEmios): index=0, PwmHwInstance=Emios_1
        PwmEmiosChannels_0 (PwmEmiosChannels):
          index = 0
          EmiosChCounterBus = EMIOS_PWM_IP_BUS_BCDE
          EmiosChDeadtime = 0
          EmiosChDutyCycle = 32767
          EmiosChFlagGeneration = Trailing_Edge
          EmiosChFreeze = 0
          EmiosChId = CH_2
          EmiosChInterrupt = EMIOS_PWM_IP_INTERRUPT_REQUEST
          EmiosChMode = EMIOS_PWM_IP_MODE_OPWMB
          EmiosChOutputDisable = EMIOS_PWM_IP_OUTPUT_DISABLE_NONE
          EmiosChPeriod = 65534
          EmiosChPhaseShift = 0
          EmiosChPolarity = EMIOS_PWM_IP_ACTIVE_HIGH
          EmiosChPrescaler = EMIOS_PWM_IP_CLOCK_DIV_1
          EmiosChPrescalerAlternate = EMIOS_PWM_IP_CLOCK_DIV_1
          EmiosChPrescalerSource = EMIOS_PWM_IP_PS_SRC_PRESCALED_CLOCK
          EmiosChTrigger = 0
          PwmEmiosBusRef = EmiosMclMasterBus_1_CH0
          EmiosChIrqCallback: EmiosChIrqFunctionCallback=NULL_PTR, EmiosChIrqParameterCallback=NULL_PTR
    PwmConfigurationOfOptApiServices:
      PwmDeInitApi = 1
      PwmGetChannelStateApi = 0
      PwmGetOutputState = 0
      PwmSetChannelDeadTime = 0
      PwmSetChannelOutputApi = 0
      PwmSetCounterBusApi = 0
      PwmSetDutyCycle = 1
      PwmSetDutyCycle_NoUpdate = 0
      PwmSetDutyPhaseShift = 0
      PwmSetOutputToIdle = 1
      PwmSetPeriodAndDuty = 1
      PwmSetPeriodAndDuty_NoUpdate = 0
      PwmSetPhaseShift = 0
      PwmSetPhaseShift_NoUpdate = 0
      PwmSetTriggerDelayApi = 0
      PwmVersionInfoApi = 0
    PwmGeneral:
      PwmDevErrorDetect = 1
      PwmDutycycleUpdatedEndperiod = 1
      PwmEnableDualClockMode = 0
      PwmEnableUserModeSupport = 0
      PwmIndex = 0
      PwmMultiChannelSync = 0
      PwmMulticoreEnabled = 0
      PwmNotificationSupported = 1
      PwmPeriodUpdatedEndperiod = 1
