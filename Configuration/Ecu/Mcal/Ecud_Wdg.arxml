AUTOSAR XML (schema 4-0-3)
package /Wdg
  module config Wdg: implementation-config-variant=VARIANT-POST-BUILD, module-description=BswImplementation_Wdg
    CommonPublishedInformation:
      ArReleaseMajorVersion = 4
      ArReleaseMinorVersion = 7
      ArReleaseRevisionVersion = 0
      ModuleId = 102
      SwMajorVersion = 3
      SwMinorVersion = 0
      SwPatchVersion = 0
      VendorApiInfix = Instance0
      VendorId = 43
    WdgClockReferencePoint_0 (WdgClockReferencePoint): WdgClockReference=McuClockReferencePoint_FXOSC_CLK
    WdgGeneral:
      WdgCallbackNotification = NULL_PTR
      WdgDevErrorDetect = 1
      WdgDisableAllowed = 1
      WdgEnableClearResetRequest = 0
      WdgEnableDirectService = 0
      WdgEnableMultiCoreSupport = 0
      WdgEnableUserModeSupport = 0
      WdgIndex = 0
      WdgInitialTimeout = 4.0
      WdgMaxTimeout = 4.2
      WdgOsifTimeoutVal = 3000
      WdgRunArea = ROM
      WdgTimeoutMethod = OSIF_COUNTER_DUMMY
      WdgTriggerLocation = NULL_PTR
      WdgVersionInfoApi = 1
      AutosarExt: WdgDisableDemReportErrorStatus=1
    WdgPublishedInformation: WdgTriggerMode=WDG_BOTH
    WdgSettingsConfig: WdgDefaultMode=WDGIF_OFF_MODE, WdgInstance=SWT0, WdgInterruptContentEnable=1, WdgExternalTriggerCounterRef=GptChannelConfiguration_WdgTrig
      WdgSettingsFast:
        WdgClockSelection = OscillatorClock
        WdgClockValue = 16000
        WdgHardLockConfiguration = 0
        WdgKeyedService = 0
        WdgMasterAccessProtectionforMaster{0..7} = 1
        WdgOperationMode = ResetOnTimeOut
        WdgResetOnInvalidAccess = SystemReset
        WdgRunsInStopMode = 1
        WdgServiceKeyValue = 0
        WdgSoftLockConfiguration = 0
        WdgTimeoutPeriod = 0.1
        WdgWindowMode = 0
        WdgWindowPeriod = 0.0
        WdgRunsInDebugMode = 0
        WdgClkSrcRef = WdgClockReferencePoint_0
      WdgSettingsOff: WdgHardLockConfiguration=0, WdgSoftLockConfiguration=0
      WdgSettingsSlow:
        WdgClockSelection = OscillatorClock
        WdgClockValue = 16000
        WdgHardLockConfiguration = 0
        WdgKeyedService = 0
        WdgMasterAccessProtectionforMaster{0..7} = 1
        WdgOperationMode = ResetOnTimeOut
        WdgResetOnInvalidAccess = SystemReset
        WdgRunsInStopMode = 0
        WdgServiceKeyValue = 0
        WdgSoftLockConfiguration = 0
        WdgTimeoutPeriod = 0.5
        WdgWindowMode = 0
        WdgWindowPeriod = 0.0
        WdgRunsInDebugMode = 0
        WdgClkSrcRef = WdgClockReferencePoint_0
