AUTOSAR XML (schema 4-0-3)
package /Fee
  module config Fee: implementation-config-variant=VARIANT-PRE-COMPILE, module-description=BswImplementation_Fee
    CommonPublishedInformation:
      ArReleaseMajorVersion = 4
      ArReleaseMinorVersion = 4
      ArReleaseRevisionVersion = 0
      ModuleId = 21
      SwMajorVersion = 2
      SwMinorVersion = 0
      SwPatchVersion = 1
      VendorId = 43
    18 x FeeBlockConfiguration, all with FeeBlockAssignment=APPLICATION, FeeImmediateData=0, FeeNumberOfWriteCycles=0, FeeDeviceIndex=FlsGeneral:
      FeeBlock_ConfigID: FeeBlockNumber=4, FeeBlockSize=4, FeeClusterGroupRef=FeeClusterGroup_0
      FeeBlock_ConfigID_copy1: FeeBlockNumber=5, FeeBlockSize=4, FeeClusterGroupRef=FeeClusterGroup_1
      FeeBlock_DemNonVolatileData: FeeBlockNumber=8, FeeBlockSize=8, FeeClusterGroupRef=FeeClusterGroup_0
      FeeBlock_DemEventStatusNvRamBlock: FeeBlockSize=212, FeeBlockNumber=12, FeeClusterGroupRef=FeeClusterGroup_0
      FeeBlock_DemEventStatusNvRamBlock_copy1: FeeBlockSize=212, FeeBlockNumber=13, FeeClusterGroupRef=FeeClusterGroup_1
      FeeBlock_DemPrimaryEventMemoryEntry_0: FeeBlockNumber=16, FeeBlockSize=16, FeeClusterGroupRef=FeeClusterGroup_0
      FeeBlock_DemPrimaryEventMemoryEntry_1: FeeBlockNumber=20, FeeBlockSize=16, FeeClusterGroupRef=FeeClusterGroup_0
      FeeBlock_DemPrimaryEventMemoryEntry_2: FeeBlockNumber=24, FeeBlockSize=16, FeeClusterGroupRef=FeeClusterGroup_0
      FeeBlock_Test_Native_6: FeeBlockNumber=28, FeeBlockSize=7, FeeClusterGroupRef=FeeClusterGroup_0
      FeeBlock_DemUserDefinedEventMemoryEntry_0: FeeBlockNumber=32, FeeBlockSize=16, FeeClusterGroupRef=FeeClusterGroup_0
      FeeBlock_DemUserDefinedEventMemoryEntry_1: FeeBlockNumber=36, FeeBlockSize=16, FeeClusterGroupRef=FeeClusterGroup_0
      FeeBlock_DemUserDefinedEventMemoryEntry_2: FeeBlockNumber=40, FeeBlockSize=16, FeeClusterGroupRef=FeeClusterGroup_0
      FeeBlock_DemMirrorEventMemory_0: FeeBlockNumber=44, FeeBlockSize=16, FeeClusterGroupRef=FeeClusterGroup_0
      FeeBlock_DemMirrorEventMemory_1: FeeBlockNumber=48, FeeBlockSize=16, FeeClusterGroupRef=FeeClusterGroup_0
      FeeBlock_DemMirrorEventMemory_2: FeeBlockNumber=52, FeeBlockSize=16, FeeClusterGroupRef=FeeClusterGroup_0
      FeeBlock_DemPermanentEventMemory_0: FeeBlockNumber=56, FeeBlockSize=16, FeeClusterGroupRef=FeeClusterGroup_0
      FeeBlock_DemPermanentEventMemory_1: FeeBlockNumber=60, FeeBlockSize=16, FeeClusterGroupRef=FeeClusterGroup_0
      FeeBlock_DemPermanentEventMemory_2: FeeBlockNumber=64, FeeBlockSize=16, FeeClusterGroupRef=FeeClusterGroup_0
    FeeClusterGroup_0 (FeeClusterGroup)
      FeeCluster_0 (FeeCluster)
        3 x FeeSector:
          FeeSector_{0..2}: FeeSectorIndex={0..2}, FeeSectorRef=FlsSector_{0..2}
      FeeCluster_1 (FeeCluster)
        3 x FeeSector:
          FeeSector_3: FeeSectorIndex=0, FeeSectorRef=FlsSector_3
          FeeSector_4: FeeSectorIndex=1, FeeSectorRef=FlsSector_4
          FeeSector_5: FeeSectorIndex=2, FeeSectorRef=FlsSector_5
    FeeClusterGroup_1 (FeeClusterGroup)
      FeeCluster_0 (FeeCluster)
        3 x FeeSector:
          FeeSector_6: FeeSectorIndex=0, FeeSectorRef=FlsSector_6
          FeeSector_7: FeeSectorIndex=1, FeeSectorRef=FlsSector_7
          FeeSector_8: FeeSectorIndex=2, FeeSectorRef=FlsSector_8
      FeeCluster_1 (FeeCluster)
        FeeSector_9 (FeeSector): FeeSectorIndex=0, FeeSectorRef=FlsSector_9
        FeeSector_10 (FeeSector): FeeSectorIndex=1, FeeSectorRef=FlsSector_10
    FeeGeneral:
      FeeBlockAlwaysAvailable = 1
      FeeConfigAssignment = APPLICATION
      FeeDataBufferSize = 128
      FeeDevErrorDetect = 1
      FeeEnableUserModeSupport = 0
      FeeLegacyEraseMode = 0
      FeeMainFunctionPeriod = 0.005
      FeeMarkEmptyBlocksInvalid = 1
      FeeMaximumNumberBlocks = 20
      FeeNvmJobEndNotification = NvM_JobEndNotification
      FeeNvmJobErrorNotification = NvM_JobErrorNotification
      FeePollingMode = 0
      FeeSectorEraseRetries = 3
      FeeSectorRetirement = 0
      FeeSetModeSupported = 1
      FeeSwapForeignBlocksEnabled = 0
      FeeVersionInfoApi = 1
      FeeVirtualPageSize = 16
    FeePublishedInformation: FeeBlockOverhead=0, FeePageOverhead=0
