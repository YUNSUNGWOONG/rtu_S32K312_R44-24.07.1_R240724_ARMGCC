AUTOSAR XML (schema 4-0-3)
package /Adc
  module config Adc: implementation-config-variant=VARIANT-POST-BUILD, module-description=BswImplementation_Adc
    AdcConfigSet
      AdcHwUnit_0 (AdcHwUnit):
        index = 0
        AdcAltHighSpeedEnable = 0
        AdcAltPowerDownDelay = 15
        AdcAltPrescale = 2
        AdcAutoClockOff = 0
        AdcBypassSampling = 0
        AdcCalibrationPrescale = 2
        AdcHighSpeedEnable = 0
        AdcHwUnitBypassResolution = 0
        AdcHwUnitDmaClearSource = DMA_REQ_CLEAR_ON_ACK
        AdcHwUnitId = ADC0
        AdcHwUnitOverwriteEn = 1
        AdcHwUnitResolution = RESOLUTION_14
        AdcHwUnitUsrGain = 0
        AdcHwUnitUsrOffset = 0
        AdcLogicalUnitId = 0
        AdcMuxDelay = 15
        AdcPowerDownDelay = 15
        AdcPresamplingInternalSignal{0..2} = VREFL
        AdcSarHwUnitVref = 53
        AdcTransferType = ADC_INTERRUPT
        4 x AdcChannel, all with AdcEnablePresampling=0, AdcEnableThresholds=0, AdcWdogNotification=NULL_PTR:
          AdcChannel_PTA1: AdcLogicalChannelId=0, AdcChannelName=S9_ChanNum33, AdcChannelId=33
          AdcChannel_PTA9: index=0, AdcChannelId=7, AdcChannelName=P7_ChanNum7, AdcLogicalChannelId=1
          AdcChannel_PTC11: index=2, AdcChannelId=41, AdcChannelName=S17_ChanNum41, AdcLogicalChannelId=2
          AdcChannel_PTD21: index=3, AdcChannelId=47, AdcChannelName=S23_ChanNum47, AdcLogicalChannelId=3
        4 x AdcGroup, all with AdcGroupAccessMode=ADC_ACCESS_MODE_SINGLE, AdcGroupConversionMode=ADC_CONV_MODE_ONESHOT, AdcGroupConversionType=ADC_CONV_TYPE_NORMAL, AdcGroupTriggSrc=ADC_TRIGG_SRC_SW, AdcStreamingBufferMode=ADC_STREAM_BUFFER_LINEAR, AdcEnableOptimizeDmaStreamingGroups=0, AdcEnableHalfInterrupt=0, AdcStreamingNumSamples=1, AdcStreamResultGroup=0, AdcEnableChDisableChGroup=0, AdcWithoutDma=0, AdcExtDMAChanEnable=0, AdcExtraNotification=NULL_PTR, AdcWithoutInterrupts=1:
          AdcGroup_PTA1: AdcGroupId=0, AdcNotification=NULL_PTR, AdcGroupDefinition=AdcChannel_PTA1
            AdcAlternateGroupConvTimings:
              AdcGroupAltHardwareAverageEnable = 0
              AdcGroupAltHardwareAverageSelect = SAMPLES_4
              AdcAltGroupSamplingDuration{0..2} = 22
            AdcGroupConversionConfiguration: AdcGroupHardwareAverageEnable=0, AdcGroupHardwareAverageSelect=SAMPLES_4, AdcSamplingDuration0=22, AdcSamplingDuration1=22, AdcSamplingDuration2=22
          AdcGroup_PTC11: index=1, AdcGroupId=1, AdcNotification=NULL_PTR, AdcGroupDefinition=AdcChannel_PTC11, AdcGroupHwTriggerSource=(unset)
            AdcAlternateGroupConvTimings:
              AdcAltGroupSamplingDuration{0..2} = 22
              AdcGroupAltHardwareAverageEnable = 0
              AdcGroupAltHardwareAverageSelect = SAMPLES_4
            AdcGroupConversionConfiguration: AdcGroupHardwareAverageEnable=0, AdcGroupHardwareAverageSelect=SAMPLES_4, AdcSamplingDuration0=22, AdcSamplingDuration1=22, AdcSamplingDuration2=22
          AdcGroup_PTA9: index=0, AdcGroupId=2, AdcNotification=NULL_PTR, AdcGroupDefinition=AdcChannel_PTA9, AdcGroupHwTriggerSource=(unset)
            AdcAlternateGroupConvTimings:
              AdcAltGroupSamplingDuration{0..2} = 22
              AdcGroupAltHardwareAverageEnable = 0
              AdcGroupAltHardwareAverageSelect = SAMPLES_4
            AdcGroupConversionConfiguration: AdcGroupHardwareAverageEnable=0, AdcGroupHardwareAverageSelect=SAMPLES_4, AdcSamplingDuration0=22, AdcSamplingDuration1=22, AdcSamplingDuration2=22
          AdcGroup_PTD21: index=3, AdcGroupId=3, AdcGroupDefinition=AdcChannel_PTD21, AdcGroupHwTriggerSource=(unset)
            AdcAlternateGroupConvTimings:
              AdcAltGroupSamplingDuration{0..2} = 22
              AdcGroupAltHardwareAverageEnable = 0
              AdcGroupAltHardwareAverageSelect = SAMPLES_4
            AdcGroupConversionConfiguration: AdcGroupHardwareAverageEnable=0, AdcGroupHardwareAverageSelect=SAMPLES_4, AdcSamplingDuration0=22, AdcSamplingDuration1=22, AdcSamplingDuration2=22
      AdcHwUnit_1 (AdcHwUnit):
        index = 1
        AdcAltHighSpeedEnable = 0
        AdcAltPowerDownDelay = 15
        AdcAltPrescale = 2
        AdcAutoClockOff = 0
        AdcBypassSampling = 0
        AdcCalibrationPrescale = 2
        AdcHighSpeedEnable = 0
        AdcHwUnitBypassResolution = 0
        AdcHwUnitDmaClearSource = DMA_REQ_CLEAR_ON_ACK
        AdcHwUnitId = ADC1
        AdcHwUnitOverwriteEn = 1
        AdcHwUnitResolution = RESOLUTION_14
        AdcHwUnitUsrGain = 0
        AdcHwUnitUsrOffset = 0
        AdcLogicalUnitId = 1
        AdcMuxDelay = 15
        AdcPowerDownDelay = 15
        AdcPresamplingInternalSignal{0..2} = VREFL
        AdcSarHwUnitVref = 53
        AdcTransferType = ADC_INTERRUPT
        AdcChannel_PTA11 (AdcChannel):
          index = 0
          AdcChannelId = 34
          AdcChannelName = S10_ChanNum34
          AdcEnablePresampling = 0
          AdcEnableThresholds = 0
          AdcLogicalChannelId = 0
          AdcWdogNotification = NULL_PTR
        AdcChannel_PTD24 (AdcChannel): AdcLogicalChannelId=1, AdcChannelName=S20_ChanNum44, AdcChannelId=44, AdcEnablePresampling=0, AdcEnableThresholds=0
        AdcGroup_PTA11 (AdcGroup):
          index = 0
          AdcEnableChDisableChGroup = 0
          AdcEnableHalfInterrupt = 0
          AdcEnableOptimizeDmaStreamingGroups = 0
          AdcExtDMAChanEnable = 0
          AdcExtraNotification = NULL_PTR
          AdcGroupAccessMode = ADC_ACCESS_MODE_SINGLE
          AdcGroupConversionMode = ADC_CONV_MODE_ONESHOT
          AdcGroupConversionType = ADC_CONV_TYPE_NORMAL
          AdcGroupId = 4
          AdcGroupTriggSrc = ADC_TRIGG_SRC_SW
          AdcStreamResultGroup = 0
          AdcStreamingBufferMode = ADC_STREAM_BUFFER_LINEAR
          AdcStreamingNumSamples = 1
          AdcWithoutDma = 0
          AdcWithoutInterrupts = 0
          AdcNotification = NULL_PTR
          AdcGroupDefinition = AdcChannel_PTA11
          AdcGroupHwTriggerSource = (unset)
          AdcAlternateGroupConvTimings:
            AdcAltGroupSamplingDuration{0..2} = 22
            AdcGroupAltHardwareAverageEnable = 0
            AdcGroupAltHardwareAverageSelect = SAMPLES_4
          AdcGroupConversionConfiguration: AdcGroupHardwareAverageEnable=0, AdcGroupHardwareAverageSelect=SAMPLES_4, AdcSamplingDuration0=22, AdcSamplingDuration1=22, AdcSamplingDuration2=22
        AdcGroup_PTD24 (AdcGroup):
          AdcGroupAccessMode = ADC_ACCESS_MODE_SINGLE
          AdcGroupConversionMode = ADC_CONV_MODE_ONESHOT
          AdcGroupConversionType = ADC_CONV_TYPE_NORMAL
          AdcGroupId = 5
          AdcGroupTriggSrc = ADC_TRIGG_SRC_SW
          AdcStreamingBufferMode = ADC_STREAM_BUFFER_LINEAR
          AdcEnableOptimizeDmaStreamingGroups = 0
          AdcEnableHalfInterrupt = 0
          AdcStreamingNumSamples = 1
          AdcStreamResultGroup = 0
          AdcEnableChDisableChGroup = 0
          AdcWithoutInterrupts = 0
          AdcWithoutDma = 0
          AdcExtDMAChanEnable = 0
          AdcNotification = NULL_PTR
          AdcExtraNotification = NULL_PTR
          AdcGroupDefinition = AdcChannel_PTD24
          AdcGroupConversionConfiguration: AdcGroupHardwareAverageEnable=0, AdcGroupHardwareAverageSelect=SAMPLES_4, AdcSamplingDuration0=22, AdcSamplingDuration1=22, AdcSamplingDuration2=22
          AdcAlternateGroupConvTimings:
            AdcGroupAltHardwareAverageEnable = 0
            AdcGroupAltHardwareAverageSelect = SAMPLES_4
            AdcAltGroupSamplingDuration{0..2} = 22
    AdcGeneral:
      AdcDeInitApi = 1
      AdcDevErrorDetect = 1
      AdcEnableLimitCheck = 0
      AdcEnableQueuing = 1
      AdcEnableStartStopGroupApi = 1
      AdcGrpNotifCapability = 1
      AdcHwTriggerApi = 0
      AdcPriorityImplementation = ADC_PRIORITY_NONE
      AdcPriorityQueueMaxDepth = 1
      AdcReadGroupApi = 1
      AdcResultAlignment = ADC_ALIGN_RIGHT
      AdcVersionInfoApi = 1
    4 x AdcInterrupt:
      AdcInterrupt_0: AdcInterruptEnable=0, AdcInterruptSource=ADC0_EOC
      AdcInterrupt_1: AdcInterruptEnable=0, AdcInterruptSource=ADC0_WD
      AdcInterrupt_2: AdcInterruptEnable=1, AdcInterruptSource=ADC1_EOC
      AdcInterrupt_3: AdcInterruptEnable=0, AdcInterruptSource=ADC1_WD
    AdcPublishedInformation: AdcChannelValueSigned=0, AdcGroupFirstChannelFixed=0, AdcMaxChannelResolution=14
    AutosarExt:
      AdcBypassAbortChainCheck = 0
      AdcConvTimeOnce = 0
      AdcCtuHardwareTriggerOptimization = 0
      AdcEnableCalibration = 0
      AdcEnableChDisableChApi = 0
      AdcEnableCtuControlModeApi = 0
      AdcEnableCtuTrigAutosarExtApi = 0
      AdcEnableDmaTransferMode = 0
      AdcEnableDualClockMode = 0
      AdcEnableGroupDependentChannelNames = 0
      AdcEnableGroupStreamingResultReorder = 0
      AdcEnableInitialNotification = 0
      AdcEnableReadRawDataApi = 0
      AdcEnableSelfTest = 0
      AdcEnableSetChannel = 0
      AdcEnableThresholdConfigurationApi = 0
      AdcEnableUserModeSupport = 0
      AdcEnableWatchdogApi = 0
      AdcGetInjectedConvStatusApi = 0
      AdcMulticoreSupport = 0
      AdcOptimizeDmaStreamingGroups = 0
      AdcOptimizeOneShotHwTriggerConversions = 0
      AdcPreSamplingOnce = 1
      AdcSarEnableTempsenseApi = 0
      AdcSarIpDevErrorDetect = 0
      AdcSarPowerOnTempSense = 0
      AdcSarTempSenseVsupply = 53
      AdcSetHwUnitPowerModeApi = 0
      AdcTimeoutMethod = OSIF_COUNTER_DUMMY
      AdcTimeoutVal = 100000
      AdcUseHardwareNormalGroups = 0
      AdcUseSoftwareInjectedGroups = 0
      BctuIpDevErrorDetect = 0
      CtuEnableDmaTransferMode = 0
    CommonPublishedInformation:
      ArReleaseMajorVersion = 4
      ArReleaseMinorVersion = 7
      ArReleaseRevisionVersion = 0
      ModuleId = 123
      SwMajorVersion = 3
      SwMinorVersion = 0
      SwPatchVersion = 0
      VendorApiInfix = 
      VendorId = 43
