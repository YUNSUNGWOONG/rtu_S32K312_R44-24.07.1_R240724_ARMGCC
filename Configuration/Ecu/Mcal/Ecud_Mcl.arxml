AUTOSAR XML (schema 4-0-3)
package /Mcl
  module config Mcl: implementation-config-variant=VARIANT-POST-BUILD, module-description=BswImplementation_Mcl, post-build-variant-used=true
    CommonPublishedInformation:
      ArReleaseMajorVersion = 4
      ArReleaseMinorVersion = 7
      ArReleaseRevisionVersion = 0
      ModuleId = 255
      SwMajorVersion = 3
      SwMinorVersion = 0
      SwPatchVersion = 0
      VendorId = 43
    MclConfig
      EmiosCommon_0 (EmiosCommon): index=0, EmiosMclClkDivVal=16, EmiosMclEnableFreezState=1, EmiosMclEnableGlobalTimeBase=1, EmiosMclInstances=EMIOS_0
        EmiosMclMasterBus_0_CH0 (EmiosMclMasterBus):
          index = 0
          EmiosMclChannelAllowDebugMode = 1
          EmiosMclDefaultPeriod = 65535
          EmiosMclFirstOffsetValue = 0
          EmiosMclMasterBusAltPrescaler = DIV_1
          EmiosMclMasterBusModeType = MCB_UP_COUNTER
          EmiosMclMasterBusPrescaler = DIV_12
          EmiosMclMasterBusNumber = EMIOS_CH_0
          EmiosMclPwmExclusiveAccess = 0
      EmiosCommon_1 (EmiosCommon): index=1, EmiosMclClkDivVal=16, EmiosMclEnableFreezState=1, EmiosMclEnableGlobalTimeBase=1, EmiosMclInstances=EMIOS_1
        EmiosMclMasterBus_1_CH0 (EmiosMclMasterBus):
          index = 0
          EmiosMclChannelAllowDebugMode = 1
          EmiosMclDefaultPeriod = 65534
          EmiosMclFirstOffsetValue = 0
          EmiosMclMasterBusAltPrescaler = DIV_1
          EmiosMclMasterBusModeType = MCB_UP_COUNTER
          EmiosMclMasterBusPrescaler = DIV_12
          EmiosMclMasterBusNumber = EMIOS_CH_0
          EmiosMclPwmExclusiveAccess = 1
    MclGeneral: MclEnableDevErrorDetect=1, MclEnableMulticoreSupport=0, MclEnableUserModeSupport=0, MclEnableVirtualAddressMappingSupport=0, Mcl_VersionInfoApi=0
      MclCache: MclEnableCache=0
      MclDma: MclEnableDma=0
      MclEmiosCommon: MclEnableEmiosCommon=1
      MclFlexioCommon: MclEnableFlexioCommon=0
      MclLcuConfig: MclEnableLcu=0, MclEnableLcuAsyncFunc=0, MclEnableLcuSyncFunc=0
      MclTrgMux: MclEnableTrgMux=0
