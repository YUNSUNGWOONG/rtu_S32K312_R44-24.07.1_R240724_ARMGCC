AUTOSAR XML (schema 4-0-3)
package /Can_43_FLEXCAN
  module config Can: implementation-config-variant=VARIANT-POST-BUILD, module-description=BswImplementation_Can
    CanConfigSet
      ECU1_FD_CAN1 (CanController):
        category = TOOL_CONFIGURED
        CanControllerId = 0
        CanControllerActivation = 1
        CanClockFromBus = 1
        CanLoopBackMode = 0
        CanTrippleSamplingEnable = 0
        CanControllerFdISO = 1
        CanControllerEdgeFilter = 0
        CanWakeupProcessing = INTERRUPT
        CanBusoffProcessing = INTERRUPT
        CanWakeupSupport = 0
        CanControllerBaseAddress = 1076903936
        CanAutoBusOffRecovery = 1
        CanHwChannel = FLEXCAN_0
        CanTxProcessing = INTERRUPT
        CanRxProcessing = INTERRUPT
        CanControllerPrExcEn = 0
        CanWakeupFunctionalityAPI = 0
        CanCpuClockRef = McuClockReferencePoint_FLEXCAN_PE_CLK0_2
        CanControllerDefaultBaudrate = CanControllerBaudrateConfig
        CanControllerBaudrateConfig:
          category = TOOL_CONFIGURED
          CanControllerPrescallerAlternate = 1
          CanControllerPrescaller = 1
          CanControllerBaudRate = 500
          CanControllerSyncSeg = 1
          CanBusLength = 40
          CanTxArbitrationStartDelay = 12
          CanControllerSeg2 = 8
          CanPropDelayTranceiver = 150.0
          CanControllerSeg1 = 16
          CanBaudrateTypeSuport = NORMAL_CBT
          CanControllerSyncJumpWidth = 8
          CanControllerPropSeg = 15
          CanControllerBaudRateConfigID = 0
          CanAdvancedSetting = 0
          ECU1_FD_CAN1_CanControllerFdBaudrateConfig (CanControllerFdBaudrateConfig):
            category = TOOL_CONFIGURED
            CanControllerSeg2 = 5
            CanControllerSeg1 = 7
            CanControllerFdSyncSeg = 1
            CanControllerFdBaudRate = 1000.0
            CanControllerSyncJumpWidth = 4
            CanControllerPrescallerAlternateFd = 1
            CanControllerTxBitRateSwitch = 1
            CanControllerPropSeg = 7
            CanControllerFdPrescaller = 1
        ECU1_FD_CAN1_CanRAMBlock (CanRamBlock): category=TOOL_CONFIGURED
          ECU1_FD_CAN1_CanRamBlockUnified (CanRamBlockUnified): category=TOOL_CONFIGURED, CanBlockUnifiedPayloadLength=CAN_8_BYTES_PAYLOAD
      14 x CanHardwareObject, all with category=TOOL_CONFIGURED, CanHwObjectCount=1, CanIdType=STANDARD, CanControllerRef=ECU1_FD_CAN1:
        IN_HwObj_ECU1_FD_CAN1_0x205_FD_CAN1_V_CGW_02_A: CanObjectType=RECEIVE, CanHandleType=FULL, CanObjectId=0
          CanHwFilter0 (CanHwFilter): category=TOOL_CONFIGURED, CanHwFilterMask=2047, CanHwFilterCode=517
        IN_HwObj_ECU1_FD_CAN1_0x18c_FD_CAN1_BSD_01_50ms_P11: CanObjectType=RECEIVE, CanHandleType=FULL, CanObjectId=1
          CanHwFilter0 (CanHwFilter): category=TOOL_CONFIGURED, CanHwFilterMask=2047, CanHwFilterCode=396
        IN_HwObj_ECU1_FD_CAN1_0x7df_FD_CAN1_Diag_Msg_TP_Func_FD_CAN1: CanObjectType=RECEIVE, CanHandleType=FULL, CanObjectId=2
          CanHwFilter0 (CanHwFilter): category=TOOL_CONFIGURED, CanHwFilterMask=2047, CanHwFilterCode=2015
        IN_HwObj_ECU1_FD_CAN1_0x650_FD_CAN1_AtmReq: CanObjectType=RECEIVE, CanHandleType=FULL, CanObjectId=3
          CanHwFilter0 (CanHwFilter): category=TOOL_CONFIGURED, CanHwFilterMask=2047, CanHwFilterCode=1616
        IN_HwObj_0x500_0x57f_ECU1_FD_CAN1_NM_Message: CanObjectType=RECEIVE, CanHandleType=BASIC, CanObjectId=4
          CanHwFilter0 (CanHwFilter): category=TOOL_CONFIGURED, CanHwFilterMask=1920, CanHwFilterCode=1280
        IN_HwObj_0x748_0x77e_ECU1_FD_CAN1: CanObjectType=RECEIVE, CanHandleType=BASIC, CanObjectId=5
          CanHwFilter0 (CanHwFilter): category=TOOL_CONFIGURED, CanHwFilterMask=1993, CanHwFilterCode=1864
        OUT_HwObj_ECU1_FD_CAN1_0x760_FD_CAN1_Diag_Msg_TP_Phys_Res_FD_CAN1: CanObjectType=TRANSMIT, CanHandleType=FULL, CanObjectId=6
        OUT_HwObj_ECU1_FD_CAN1_0x75a_FD_CAN1_Normal_Msg_FD_TP_01_A: CanObjectType=TRANSMIT, CanHandleType=FULL, CanObjectId=7
        OUT_HwObj_ECU1_FD_CAN1_0x651_FD_CAN1_AtmResp: CanObjectType=TRANSMIT, CanHandleType=FULL, CanObjectId=8
        OUT_HwObj_ECU1_FD_CAN1_0x502_FD_CAN1_NM_CGW: CanObjectType=TRANSMIT, CanHandleType=FULL, CanObjectId=9
        OUT_HwObj_ECU1_FD_CAN1_0x400_FD_CAN1_AHLS_01_300ms: CanObjectType=TRANSMIT, CanHandleType=FULL, CanObjectId=10
        OUT_HwObj_ECU1_FD_CAN1_0x2b0_FD_CAN1_AFLS_01_100ms: CanObjectType=TRANSMIT, CanHandleType=FULL, CanObjectId=11
        OUT_HwObj_ECU1_FD_CAN1_0x202_FD_CAN1_V_CGW_01_B: CanObjectType=TRANSMIT, CanHandleType=FULL, CanObjectId=12
        OUT_HwObj_ECU1_FD_CAN1_0x42_FD_CAN1_TCU_01_10ms_P11: CanObjectType=TRANSMIT, CanHandleType=FULL, CanObjectId=13
    CanGeneral:
      CanDevErrorDetect = 1
      CanEnableDualClockMode = 0
      CanEnableUserModeSupport = 0
      CanGlobalTimeSupport = 0
      CanIndex = 0
      CanMBCountExtensionSupport = 1
      CanMainFunctionModePeriod = 0.005
      CanMulticoreSupport = 0
      CanMultiplexedTransmission = 1
      CanPublicIcomSupport = 0
      CanTimeoutDuration = 1.0
      CanTimeoutMethod = OSIF_COUNTER_DUMMY
      CanVersionInfoApi = 0
      CanEnableSecurityEventReporting = 0
      CanMainFunctionRWPeriods: category=TOOL_CONFIGURED, CanMainFunctionPeriod=0.001
    CommonPublishedInformation:
      ArReleaseMajorVersion = 4
      ArReleaseMinorVersion = 4
      ArReleaseRevisionVersion = 0
      ModuleId = 80
      SwMajorVersion = 2
      SwMinorVersion = 0
      SwPatchVersion = 1
      VendorId = 43
      VendorApiInfix = FLEXCAN
