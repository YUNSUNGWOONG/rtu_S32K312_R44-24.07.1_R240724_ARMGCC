AUTOSAR XML (schema 4-0-3)
package /Resource
  module config Resource
    CommonPublishedInformation:
      ArReleaseMajorVersion = 4
      ArReleaseMinorVersion = 7
      ArReleaseRevisionVersion = 0
      ModuleId = 0
      SwMajorVersion = 3
      SwMinorVersion = 0
      SwPatchVersion = 0
      VendorId = 43
    ResourceGeneral: ResourceSubderivative=s32k312_mqfp172, ARM_CoreArchitecture=ARM_M_ARCH
