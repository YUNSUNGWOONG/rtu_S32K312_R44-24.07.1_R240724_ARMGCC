AUTOSAR XML (schema 4-0-3)
package /Lin_43_LPUART_FLEXIO
  module config Lin: implementation-config-variant=VARIANT-POST-BUILD, module-description=BswImplementation_Lin
    AutosarExt: LinDisableDemReportErrorStatus=1, LinEnableUserModeSupport=0, LinFrameTimeoutDisable=1
    CommonPublishedInformation:
      ArReleaseMajorVersion = 4
      ArReleaseMinorVersion = 7
      ArReleaseRevisionVersion = 0
      ModuleId = 82
      SwMajorVersion = 3
      SwMinorVersion = 0
      SwPatchVersion = 0
      VendorId = 43
    LinDemEventParameterRefs: LIN_E_TIMEOUT=LIN_E_TIMEOUT
    LinGeneral: LinDevErrorDetect=1, LinIndex=0, LinMulticoreSupport=0, LinTimeoutDuration=1000, LinTimeoutMethod=OSIF_COUNTER_DUMMY, LinVersionInfoApi=0
    LinGlobalConfig
      LinChannel_LIN1 (LinChannel):
        category = TOOL_CONFIGURED
        BreakLength = BL_13
        DetectedBreakLength = BL_11
        LinChannelBaudRate = 19200
        LinChannelId = 0
        LinChannelWakeupSupport = 0
        LinHeaderTimeout = 44
        LinHwChannel = LPUART_IP_0
        LinNodeType = MASTER
        LinResponseTimeout = 14
        LinClockRef = McuClockReferencePoint_AIPS_SLOW_CLK
      LinChannel_LIN2 (LinChannel):
        category = TOOL_CONFIGURED
        LinChannelBaudRate = 19200
        LinChannelId = 1
        LinNodeType = MASTER
        DetectedBreakLength = BL_11
        LinHeaderTimeout = 44
        LinHwChannel = LPUART_IP_5
        LinChannelWakeupSupport = 0
        BreakLength = BL_13
        LinResponseTimeout = 14
        LinClockRef = McuClockReferencePoint_AIPS_SLOW_CLK
