AUTOSAR XML (schema 4-0-3)
package /Base
  module config BaseNXP: implementation-config-variant=VARIANT-PRE-COMPILE, module-description=BswImplementation_Base
    CommonPublishedInformation:
      ArReleaseMajorVersion = 4
      ArReleaseMinorVersion = 7
      ArReleaseRevisionVersion = 0
      ModuleId = 0
      SwMajorVersion = 3
      SwMinorVersion = 0
      SwPatchVersion = 0
      VendorId = 43
    OsIfGeneral: OsIfDevErrorDetect=0, OsIfEnableUserModeSupport=0, OsIfInstanceId=0, OsIfMulticoreSupport=0, OsIfUseCustomTimer=0, OsIfUseSystemTimer=0
      OsIfOperatingSystemType
        OsIfOperatingSystemType (OsIfAutosarOsType)
