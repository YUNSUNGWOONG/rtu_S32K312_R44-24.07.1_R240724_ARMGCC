AUTOSAR XML (schema 4-0-3)
package /Icu
  module config Icu: implementation-config-variant=VARIANT-POST-BUILD, module-description=BswImplementation_Icu
    CommonPublishedInformation:
      ArReleaseMajorVersion = 4
      ArReleaseMinorVersion = 7
      ArReleaseRevisionVersion = 0
      ModuleId = 122
      SwMajorVersion = 3
      SwMinorVersion = 0
      SwPatchVersion = 0
      VendorId = 43
    IcuAutosarExt:
      IcuEnableDualClockMode = 0
      IcuGetCaptureRegisterValueApi = 0
      IcuGetInputLevelApi = 0
      IcuOverflowNotificationApi = 0
      IcuSupportSAICModeApi = 1
      IcuWkpuStandbyWakeupSupport = 0
      IcuSetInitialCounterValue = 0
      IcuSetMaxCounterValue = 0
    IcuConfigSet: IcuMaxChannel=5
      4 x IcuChannel, all with IcuDMAChannelEnable=0, IcuDefaultStartEdge=ICU_RISING_EDGE, IcuOverflowNotification=NULL_PTR, IcuWakeupCapability=0:
        IcuChannel_EdgeCounter: index=0, IcuChannelId=0, IcuMeasurementMode=ICU_MODE_EDGE_COUNTER, IcuChannelRef=IcueMiosChannels_PTB13
        IcuChannel_EdgeDetect: index=1, IcuChannelId=1, IcuMeasurementMode=ICU_MODE_SIGNAL_EDGE_DETECT, IcuChannelRef=IcueMiosChannels_PTB14
          IcuSignalEdgeDetection: IcuSignalNotification=IcuSignalEdgeDetection_Cbk
        IcuChannel_SignalMeasurement: index=2, IcuChannelId=2, IcuMeasurementMode=ICU_MODE_SIGNAL_MEASUREMENT, IcuChannelRef=IcueMiosChannels_PTB15
          IcuSignalMeasurement: IcuSignalMeasurementProperty=ICU_DUTY_CYCLE
        IcuChannel_Timestamp: index=3, IcuChannelId=3, IcuMeasurementMode=ICU_MODE_TIMESTAMP, IcuChannelRef=IcueMiosChannels_PTA17
          IcuTimestampMeasurement: IcuTimestampMeasurementProperty=ICU_CIRCULAR_BUFFER, IcuTimestampNotification=IcuTimestampMeasurement_Cbk
      5 x IcuHwInterruptConfigList, all with IcuIsrEnable=1:
        IcuHwInterruptConfigList_0: index=4, IcuIsrHwId=WKPU_CH_19
        IcuHwInterruptConfigList_1: IcuIsrHwId=EMIOS_0_CH_1
        IcuHwInterruptConfigList_2: index=0, IcuIsrHwId=EMIOS_0_CH_2
        IcuHwInterruptConfigList_3: index=1, IcuIsrHwId=EMIOS_0_CH_3
        IcuHwInterruptConfigList_4: index=2, IcuIsrHwId=EMIOS_0_CH_6
      IcueMios_0 (IcueMios): IcueMiosModule=0
        4 x IcueMiosChannels, all with IcuEmiosBusSelect=EMIOS_ICU_BUS_DIVERSE, IcuEmiosDigitalFilter=EMIOS_DIGITAL_FILTER_BYPASSED, IcuEmiosFreeze=0, IcuEmiosPrescaler=EMIOS_PRESCALER_DIVIDE_1, IcuEmiosPrescaler_Alternate=EMIOS_PRESCALER_DIVIDE_1, IcuSignalMeasureWithoutInterrupt=0, IcuEmiosBusRef=EmiosMclMasterBus_0_CH0:
          IcueMiosChannels_PTB13: index=0, IcuSubModeforMeasurement=SAIC, IcueMiosChannel=1
          IcueMiosChannels_PTB14: index=1, IcuSubModeforMeasurement=SAIC, IcueMiosChannel=2
          IcueMiosChannels_PTB15: IcueMiosChannel=3, IcuSubModeforMeasurement=IPWM
          IcueMiosChannels_PTA17: IcueMiosChannel=4, IcuSubModeforMeasurement=IPM
      IcuChannel_FD_CAN1_RX (IcuChannel):
        index = 4
        IcuChannelId = 4
        IcuDMAChannelEnable = 0
        IcuDefaultStartEdge = ICU_FALLING_EDGE
        IcuMeasurementMode = ICU_MODE_SIGNAL_EDGE_DETECT
        IcuOverflowNotification = NULL_PTR
        IcuWakeupCapability = 1
        IcuChannelRef = IcuWkpuChannels_FD_CAN1_RX
        IcuSignalEdgeDetection: IcuSignalNotification=CheckWakeup_FD_CAN1_RX
        IcuWakeup: IcuChannelWakeupInfo=ECUM_WKSOURCE_FD_CAN1_RX
      IcuWkpu0 (IcuWkpu)
        IcuWkpuChannels_FD_CAN1_RX (IcuWkpuChannels): IcuWkpuChannel=19, Icu_EXT_ISR_WIFERDigitalFilter=0, IcuWKPU_ISR_WIPUER=0
    IcuGeneral: IcuDevErrorDetect=1, IcuEnableUserModeSupport=0, IcuMulticoreSupport=0, IcuReportWakeupSource=1
    IcuOptionalApis:
      IcuDeInitApi = 1
      IcuDisableWakeupApi = 1
      IcuEdgeCountApi = 1
      IcuEdgeDetectApi = 1
      IcuEnableWakeupApi = 1
      IcuGetDutyCycleValuesApi = 1
      IcuGetInputStateApi = 1
      IcuGetTimeElapsedApi = 1
      IcuGetVersionInfoApi = 1
      IcuSetModeApi = 1
      IcuSignalMeasurementApi = 1
      IcuTimestampApi = 1
      IcuWakeupFunctionalityApi = 1
