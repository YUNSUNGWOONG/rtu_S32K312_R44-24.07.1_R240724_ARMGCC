AUTOSAR XML (schema 4-0-3)
package /Crypto
  module config Crypto: implementation-config-variant=VARIANT-PRE-COMPILE, module-description=BswImplementation_Crypto_43
    CommonPublishedInformation:
      ArReleaseMajorVersion = 4
      ArReleaseMinorVersion = 7
      ArReleaseRevisionVersion = 0
      ModuleId = 114
      SwMajorVersion = 3
      SwMinorVersion = 0
      SwPatchVersion = 0
      VendorId = 43
    CryptoDriverObjects
      HaeHSE (CryptoDriverObject):
        CryptoDriverObjectId = 0
        CryptoQueueSize = 3
        MuInstance = MU_0
        CryptoPrimitiveType = CRYPTO_SYMMETRIC_ALGORITHMS
        CryptoPrimitiveRef = Hash_Sha256
        CryptoPrimitiveRef = EncryptAES_ECB/EncryptAES_ECB
        CryptoPrimitiveRef = DecryptAES_ECB/DecryptAES_ECB
        CryptoPrimitiveRef = MacGen_Sha256_HMAC_Key
        CryptoPrimitiveRef = MacVer_Sha256_HMAC_Key
    CryptoGeneral:
      CryptoDevErrorDetect = 1
      CryptoVersionInfoApi = 0
      CryptoInstanceId = 0
      CryptoMulticoreSupport = 0
      HseFwType = STANDARD
      HseIpDevErrorDetect = 0
      CryptoTimeoutMethod = OSIF_COUNTER_DUMMY
      CryptoTimeoutDuration = 1000000000
      CryptoJobKeyManagement = 0
      CryptoEnableRedirection = 0
      CryptoEnableFeedHseDesc = 0
      CryptoEnableTLS12KeyDeriveSupport = 0
      CryptoEnableUserModeSupport = 0
      CryptoAsyncJobProcessMethod = INTERRUPT
      CryptoAlternateJobKeyMapping = 1
    CryptoKeyElements
      24 x CryptoKeyElement, all with CryptoKeyElementFormat=CRYPTO_KE_FORMAT_BIN_OCTET, CryptoKeyElementPersist=0, CryptoKeyElementWriteAccess=CRYPTO_WA_ALLOWED, EncryptedKeyImport=0, AuthenticatedKeyImport=0, HseKeyCounter=0, HseSMRFlags=0, HseEccCurveId=ECC_CURVE_NONE, EncryptedImportHseKeySlot=0, AuthenticatedImportHseKeySlot=0, EncryptedExportHseKeySlot=0, AuthenticatedExportPublicKey=0, AuthenticatedExportHseKeySlot=0:
        Dummy: CryptoKeyElementAllowPartialAccess=0, CryptoKeyElementId=1, CryptoKeyElementReadAccess=CRYPTO_RA_ALLOWED, CryptoKeyElementSize=32, UseHseKey=1, HseKeySlot=0, EncryptedHseKeyBitLen=128, HseKeyCatalogGroupRef=RamKeyCatalog0
          AuthenticationScheme
            MacScheme
              Scheme
                CMAC: CipherAlgorithm=ALGO_NULL
          CipherScheme
            SymmetricCipher: HseCipherAlgo=ALGO_NULL, HseCipherBlockMode=BLOCK_MODE_NULL
          ExportAuthenticationScheme
            ExportMacScheme
              ExportScheme
                CMAC: ExportCipherAlgorithm=ALGO_NULL
          ExportCipherScheme
            ExportSymmetricCipher: ExportHseCipherAlgo=ALGO_NULL, ExportHseCipherBlockMode=BLOCK_MODE_NULL
          HseKeyFlags0 (HseKeyFlags): HseKeyFlag=USAGE_ENCRYPT
          KeyContainer: KeyContainerLength=0, pKeyContainer=0
        PBKDF2_Source_Key_Password: CryptoKeyElementAllowPartialAccess=0, CryptoKeyElementId=1, CryptoKeyElementReadAccess=CRYPTO_RA_ALLOWED, CryptoKeyElementSize=16, EncryptedHseKeyBitLen=128, HseKeySlot=0, UseHseKey=1, HseKeyCatalogGroupRef=RamKeyCatalog1
          HseKeyFlags0 (HseKeyFlags): HseKeyFlag=USAGE_ENCRYPT
          HseKeyFlags1 (HseKeyFlags): HseKeyFlag=USAGE_DERIVE
          KeyContainer: KeyContainerLength=0, pKeyContainer=0
        PBKDF2_Source_Key_Salt: CryptoKeyElementAllowPartialAccess=1, CryptoKeyElementId=13, CryptoKeyElementReadAccess=CRYPTO_RA_ALLOWED, CryptoKeyElementSize=48, EncryptedHseKeyBitLen=384, HseKeySlot=0, UseHseKey=0
          KeyContainer: KeyContainerLength=0, pKeyContainer=0
        PBKDF2_Source_Key_Iteration: CryptoKeyElementAllowPartialAccess=1, CryptoKeyElementId=14, CryptoKeyElementReadAccess=CRYPTO_RA_ALLOWED, CryptoKeyElementSize=4, EncryptedHseKeyBitLen=16, HseKeySlot=0, UseHseKey=0
          KeyContainer: KeyContainerLength=0, pKeyContainer=0
        PBKDF2_Target_Key: CryptoKeyElementAllowPartialAccess=0, CryptoKeyElementId=1, CryptoKeyElementReadAccess=CRYPTO_RA_ALLOWED, CryptoKeyElementSize=32, EncryptedHseKeyBitLen=256, HseKeySlot=0, UseHseKey=1, HseKeyCatalogGroupRef=RamKeyCatalog2
          HseKeyFlags0 (HseKeyFlags): HseKeyFlag=USAGE_ENCRYPT
          KeyContainer: KeyContainerLength=0, pKeyContainer=0
        PBKDF2_Source_Key_Algorithm: CryptoKeyElementAllowPartialAccess=0, CryptoKeyElementId=15, CryptoKeyElementInitValue=24, CryptoKeyElementReadAccess=CRYPTO_RA_ALLOWED, CryptoKeyElementSize=1, EncryptedHseKeyBitLen=8, HseKeySlot=0, UseHseKey=0
          KeyContainer: KeyContainerLength=0, pKeyContainer=0
        PBKDF2_Source_Key_Algorithm_Secondary: CryptoKeyElementAllowPartialAccess=0, CryptoKeyElementId=100, CryptoKeyElementInitValue=03, CryptoKeyElementReadAccess=CRYPTO_RA_ALLOWED, CryptoKeyElementSize=1, EncryptedHseKeyBitLen=8, HseKeySlot=0, UseHseKey=0
          KeyContainer: KeyContainerLength=0, pKeyContainer=0
        PBKDF2_Extracted_Key: CryptoKeyElementAllowPartialAccess=1, CryptoKeyElementId=1, CryptoKeyElementReadAccess=CRYPTO_RA_ALLOWED, CryptoKeyElementSize=16, EncryptedHseKeyBitLen=128, HseKeySlot=0, UseHseKey=1, HseKeyCatalogGroupRef=RamKeyCatalog3
          HseKeyFlags0 (HseKeyFlags): HseKeyFlag=USAGE_ENCRYPT
          KeyContainer: KeyContainerLength=0, pKeyContainer=0
        PBKDF2_ExtractedKey: CryptoKeyElementAllowPartialAccess=1, CryptoKeyElementId=1, CryptoKeyElementReadAccess=CRYPTO_RA_ENCRYPTED, CryptoKeyElementSize=32, EncryptedHseKeyBitLen=256, HseKeySlot=0, UseHseKey=1, EncryptedKeyExport=1, AuthenticatedExportHseKeyCatalogGroupRef=NvmKeyCatalog_AES, EncryptedExportHseKeyCatalogGroupRef=NvmKeyCatalog_AES, HseKeyCatalogGroupRef=RamKeyCatalog_PBKDF2
          ExportAuthenticationScheme
            ExportMacScheme
              ExportScheme
                CMAC: ExportCipherAlgorithm=ALGO_AES
          ExportCipherScheme
            ExportSymmetricCipher: ExportHseCipherAlgo=ALGO_AES, ExportHseCipherBlockMode=BLOCK_MODE_ECB
          HseKeyFlags0 (HseKeyFlags): HseKeyFlag=USAGE_ENCRYPT
          HseKeyFlags1 (HseKeyFlags): HseKeyFlag=ACCESS_EXPORTABLE
          KeyContainer: KeyContainerLength=0, pKeyContainer=0
        PBKDF2_ExtractedKey_forExport: CryptoKeyElementAllowPartialAccess=0, CryptoKeyElementId=99, CryptoKeyElementReadAccess=CRYPTO_RA_ALLOWED, CryptoKeyElementSize=32, EncryptedHseKeyBitLen=256, HseKeySlot=0, UseHseKey=0, EncryptedKeyExport=0
          KeyContainer: KeyContainerLength=0, pKeyContainer=0
        PBKDF2_Encrypt_Key: CryptoKeyElementAllowPartialAccess=0, CryptoKeyElementId=1, CryptoKeyElementReadAccess=CRYPTO_RA_ALLOWED, CryptoKeyElementSize=16, EncryptedHseKeyBitLen=128, HseKeySlot=0, UseHseKey=1, HseKeyCatalogGroupRef=NvmKeyCatalog_AES
          3 x HseKeyFlags:
            HseKeyFlags0: HseKeyFlag=USAGE_KEY_PROVISION
            HseKeyFlags1: HseKeyFlag=USAGE_ENCRYPT
            HseKeyFlags2: HseKeyFlag=USAGE_SIGN
          KeyContainer: KeyContainerLength=0, pKeyContainer=0
        PBKDF2_Decrypt_Key: CryptoKeyElementAllowPartialAccess=0, CryptoKeyElementId=1, CryptoKeyElementReadAccess=CRYPTO_RA_ALLOWED, CryptoKeyElementSize=16, EncryptedHseKeyBitLen=128, HseKeySlot=1, UseHseKey=1, HseKeyCatalogGroupRef=NvmKeyCatalog_AES
          HseKeyFlags0 (HseKeyFlags): HseKeyFlag=USAGE_DECRYPT
          HseKeyFlags1 (HseKeyFlags): HseKeyFlag=USAGE_VERIFY
          KeyContainer: KeyContainerLength=0, pKeyContainer=0
        PBKDF2_Source_Key_PSK0: CryptoKeyElementAllowPartialAccess=0, CryptoKeyElementId=1, CryptoKeyElementReadAccess=CRYPTO_RA_ALLOWED, CryptoKeyElementSize=16, EncryptedHseKeyBitLen=128, HseKeySlot=0, UseHseKey=1, HseKeyCatalogGroupRef=NvmKeyCatalog_Tier_PSK
          HseKeyFlags0 (HseKeyFlags): HseKeyFlag=USAGE_ENCRYPT
          HseKeyFlags1 (HseKeyFlags): HseKeyFlag=USAGE_DERIVE
          KeyContainer: KeyContainerLength=0, pKeyContainer=0
        PBKDF2_Source_Key_PSK1: CryptoKeyElementAllowPartialAccess=0, CryptoKeyElementId=1, CryptoKeyElementReadAccess=CRYPTO_RA_ALLOWED, CryptoKeyElementSize=16, EncryptedHseKeyBitLen=128, HseKeySlot=1, UseHseKey=1, HseKeyCatalogGroupRef=NvmKeyCatalog_Tier_PSK
          HseKeyFlags0 (HseKeyFlags): HseKeyFlag=USAGE_ENCRYPT
          HseKeyFlags1 (HseKeyFlags): HseKeyFlag=USAGE_DERIVE
          KeyContainer: KeyContainerLength=0, pKeyContainer=0
        PBKDF2_Source_Key_PSK2: CryptoKeyElementAllowPartialAccess=0, CryptoKeyElementId=1, CryptoKeyElementReadAccess=CRYPTO_RA_ALLOWED, CryptoKeyElementSize=16, EncryptedHseKeyBitLen=128, HseKeySlot=2, UseHseKey=1, HseKeyCatalogGroupRef=NvmKeyCatalog_Tier_PSK
          HseKeyFlags0 (HseKeyFlags): HseKeyFlag=USAGE_ENCRYPT
          HseKeyFlags1 (HseKeyFlags): HseKeyFlag=USAGE_DERIVE
          KeyContainer: KeyContainerLength=0, pKeyContainer=0
        PBKDF2_Source_Key_PSK3: CryptoKeyElementAllowPartialAccess=0, CryptoKeyElementId=1, CryptoKeyElementReadAccess=CRYPTO_RA_ALLOWED, CryptoKeyElementSize=16, EncryptedHseKeyBitLen=128, HseKeySlot=3, UseHseKey=1, HseKeyCatalogGroupRef=NvmKeyCatalog_Tier_PSK
          HseKeyFlags0 (HseKeyFlags): HseKeyFlag=USAGE_ENCRYPT
          HseKeyFlags1 (HseKeyFlags): HseKeyFlag=USAGE_DERIVE
          KeyContainer: KeyContainerLength=0, pKeyContainer=0
        PBKDF2_Source_Key_PSK4: CryptoKeyElementAllowPartialAccess=0, CryptoKeyElementId=1, CryptoKeyElementReadAccess=CRYPTO_RA_ALLOWED, CryptoKeyElementSize=16, EncryptedHseKeyBitLen=128, HseKeySlot=4, UseHseKey=1, HseKeyCatalogGroupRef=NvmKeyCatalog_Tier_PSK
          HseKeyFlags0 (HseKeyFlags): HseKeyFlag=USAGE_ENCRYPT
          HseKeyFlags1 (HseKeyFlags): HseKeyFlag=USAGE_DERIVE
          KeyContainer: KeyContainerLength=0, pKeyContainer=0
        PBKDF2_Source_Key_PSK5: CryptoKeyElementAllowPartialAccess=0, CryptoKeyElementId=1, CryptoKeyElementReadAccess=CRYPTO_RA_ALLOWED, CryptoKeyElementSize=16, EncryptedHseKeyBitLen=128, HseKeySlot=5, UseHseKey=1, HseKeyCatalogGroupRef=NvmKeyCatalog_Tier_PSK
          HseKeyFlags0 (HseKeyFlags): HseKeyFlag=USAGE_ENCRYPT
          HseKeyFlags1 (HseKeyFlags): HseKeyFlag=USAGE_DERIVE
          KeyContainer: KeyContainerLength=0, pKeyContainer=0
        PBKDF2_Source_Key_PSK6: CryptoKeyElementAllowPartialAccess=0, CryptoKeyElementId=1, CryptoKeyElementReadAccess=CRYPTO_RA_ALLOWED, CryptoKeyElementSize=16, EncryptedHseKeyBitLen=128, HseKeySlot=6, UseHseKey=1, HseKeyCatalogGroupRef=NvmKeyCatalog_Tier_PSK
          HseKeyFlags0 (HseKeyFlags): HseKeyFlag=USAGE_ENCRYPT
          HseKeyFlags1 (HseKeyFlags): HseKeyFlag=USAGE_DERIVE
          KeyContainer: KeyContainerLength=0, pKeyContainer=0
        PBKDF2_Source_Key_PSK7: CryptoKeyElementAllowPartialAccess=0, CryptoKeyElementId=1, CryptoKeyElementReadAccess=CRYPTO_RA_ALLOWED, CryptoKeyElementSize=16, EncryptedHseKeyBitLen=128, HseKeySlot=7, UseHseKey=1, HseKeyCatalogGroupRef=NvmKeyCatalog_Tier_PSK
          HseKeyFlags0 (HseKeyFlags): HseKeyFlag=USAGE_ENCRYPT
          HseKeyFlags1 (HseKeyFlags): HseKeyFlag=USAGE_DERIVE
          KeyContainer: KeyContainerLength=0, pKeyContainer=0
        PBKDF2_Source_Key_PSK8: CryptoKeyElementAllowPartialAccess=0, CryptoKeyElementId=1, CryptoKeyElementReadAccess=CRYPTO_RA_ALLOWED, CryptoKeyElementSize=16, EncryptedHseKeyBitLen=128, HseKeySlot=8, UseHseKey=1, HseKeyCatalogGroupRef=NvmKeyCatalog_Tier_PSK
          HseKeyFlags0 (HseKeyFlags): HseKeyFlag=USAGE_ENCRYPT
          HseKeyFlags1 (HseKeyFlags): HseKeyFlag=USAGE_DERIVE
          KeyContainer: KeyContainerLength=0, pKeyContainer=0
        PBKDF2_Source_Key_PSK9: CryptoKeyElementAllowPartialAccess=0, CryptoKeyElementId=1, CryptoKeyElementReadAccess=CRYPTO_RA_ALLOWED, CryptoKeyElementSize=16, EncryptedHseKeyBitLen=128, HseKeySlot=9, UseHseKey=1, HseKeyCatalogGroupRef=NvmKeyCatalog_Tier_PSK
          HseKeyFlags0 (HseKeyFlags): HseKeyFlag=USAGE_ENCRYPT
          HseKeyFlags1 (HseKeyFlags): HseKeyFlag=USAGE_DERIVE
          KeyContainer: KeyContainerLength=0, pKeyContainer=0
        MacGen_Sha256_HMAC_key: AuthenticatedKeyExport=0, CryptoKeyElementAllowPartialAccess=0, CryptoKeyElementId=1, CryptoKeyElementReadAccess=CRYPTO_RA_ALLOWED, CryptoKeyElementSize=32, EncryptedHseKeyBitLen=256, EncryptedKeyExport=0, HseKeySlot=0, UseHseKey=1, HseKeyCatalogGroupRef=NvmKeyCatalog_Sha256_HMAC
          HseKeyFlags0 (HseKeyFlags): HseKeyFlag=USAGE_SIGN
          KeyContainer: KeyContainerLength=0, pKeyContainer=0
        MacVer_Sha256_HMAC_key: AuthenticatedKeyExport=0, CryptoKeyElementAllowPartialAccess=0, CryptoKeyElementId=1, CryptoKeyElementReadAccess=CRYPTO_RA_ALLOWED, CryptoKeyElementSize=32, EncryptedHseKeyBitLen=256, EncryptedKeyExport=0, HseKeySlot=1, UseHseKey=1, HseKeyCatalogGroupRef=NvmKeyCatalog_Sha256_HMAC
          HseKeyFlags0 (HseKeyFlags): HseKeyFlag=USAGE_VERIFY
          KeyContainer: KeyContainerLength=0, pKeyContainer=0
    CryptoKeyTypes
      19 x CryptoKeyType:
        Dummy: CryptoKeyElementRef=CryptoKeyElements/Dummy
        PBKDF2_Source_Key: CryptoKeyElementRef=PBKDF2_Source_Key_Iteration, CryptoKeyElementRef=PBKDF2_Source_Key_Password, CryptoKeyElementRef=PBKDF2_Source_Key_Salt, CryptoKeyElementRef=PBKDF2_Source_Key_Algorithm, CryptoKeyElementRef=PBKDF2_Source_Key_Algorithm_Secondary
        PBKDF2_Target_Key: CryptoKeyElementRef=CryptoKeyElements/PBKDF2_Target_Key
        PBKDF2_Extracted_Key: CryptoKeyElementRef=CryptoKeyElements/PBKDF2_Extracted_Key
        PBKDF2_ExtractedKey: CryptoKeyElementRef=CryptoKeyElements/PBKDF2_ExtractedKey, CryptoKeyElementRef=PBKDF2_ExtractedKey_forExport
        PBKDF2_Encrypt_Key: CryptoKeyElementRef=CryptoKeyElements/PBKDF2_Encrypt_Key
        PBKDF2_Decrypt_Key: CryptoKeyElementRef=CryptoKeyElements/PBKDF2_Decrypt_Key
        PBKDF2_Source_Key_PSK{0..9}: CryptoKeyElementRef=PBKDF2_Source_Key_Algorithm, CryptoKeyElementRef=PBKDF2_Source_Key_Algorithm_Secondary, CryptoKeyElementRef=PBKDF2_Source_Key_Iteration, CryptoKeyElementRef=PBKDF2_Source_Key_Salt, CryptoKeyElementRef=CryptoKeyElements/PBKDF2_Source_Key_PSK{0..9}
        MacGen_Sha256_HMAC_key: CryptoKeyElementRef=CryptoKeyElements/MacGen_Sha256_HMAC_key
        MacVer_Sha256_HMAC_key: CryptoKeyElementRef=CryptoKeyElements/MacVer_Sha256_HMAC_key
    CryptoKeys
      25 x CryptoKey:
        Dummy: CryptoKeyId=0, CryptoKeyTypeRef=CryptoKeyTypes/Dummy
        Dummy2: CryptoKeyId=1, CryptoKeyTypeRef=CryptoKeyTypes/Dummy
        PBKDF2_Source_Key: CryptoKeyId=2, CryptoKeyTypeRef=CryptoKeyTypes/PBKDF2_Source_Key
        PBKDF2_Target_Key: CryptoKeyId=3, CryptoKeyTypeRef=CryptoKeyTypes/PBKDF2_Target_Key
        PBKDF2_Extracted_Key: CryptoKeyId=4, CryptoKeyTypeRef=CryptoKeyTypes/PBKDF2_Extracted_Key
        PBKDF2_ExtractedKey: CryptoKeyId=5, CryptoKeyTypeRef=CryptoKeyTypes/PBKDF2_ExtractedKey
        PBKDF2_Encrypt_Key: CryptoKeyId=6, CryptoKeyTypeRef=CryptoKeyTypes/PBKDF2_Encrypt_Key
        PBKDF2_Decrypt_Key: CryptoKeyId=7, CryptoKeyTypeRef=CryptoKeyTypes/PBKDF2_Decrypt_Key
        PBKDF2_Source_Key_PSK0: CryptoKeyId=8, CryptoKeyTypeRef=CryptoKeyTypes/PBKDF2_Source_Key_PSK0
        PBKDF2_Source_Key_PSK1: CryptoKeyId=9, CryptoKeyTypeRef=CryptoKeyTypes/PBKDF2_Source_Key_PSK1
        PBKDF2_Source_Key_PSK2: CryptoKeyId=10, CryptoKeyTypeRef=CryptoKeyTypes/PBKDF2_Source_Key_PSK2
        PBKDF2_Source_Key_PSK3: CryptoKeyId=11, CryptoKeyTypeRef=CryptoKeyTypes/PBKDF2_Source_Key_PSK3
        PBKDF2_Source_Key_PSK4: CryptoKeyId=12, CryptoKeyTypeRef=CryptoKeyTypes/PBKDF2_Source_Key_PSK4
        PBKDF2_Source_Key_PSK5: CryptoKeyId=13, CryptoKeyTypeRef=CryptoKeyTypes/PBKDF2_Source_Key_PSK5
        PBKDF2_Source_Key_PSK6: CryptoKeyId=14, CryptoKeyTypeRef=CryptoKeyTypes/PBKDF2_Source_Key_PSK6
        PBKDF2_Source_Key_PSK7: CryptoKeyId=15, CryptoKeyTypeRef=CryptoKeyTypes/PBKDF2_Source_Key_PSK7
        PBKDF2_Source_Key_PSK8: CryptoKeyId=16, CryptoKeyTypeRef=CryptoKeyTypes/PBKDF2_Source_Key_PSK8
        PBKDF2_Source_Key_PSK9: CryptoKeyId=17, CryptoKeyTypeRef=CryptoKeyTypes/PBKDF2_Source_Key_PSK9
        Dummy3: CryptoKeyId=18, CryptoKeyTypeRef=CryptoKeyTypes/Dummy
        Dummy4: CryptoKeyId=19, CryptoKeyTypeRef=CryptoKeyTypes/Dummy
        Dummy5: CryptoKeyId=20, CryptoKeyTypeRef=CryptoKeyTypes/Dummy
        Dummy6: CryptoKeyId=21, CryptoKeyTypeRef=CryptoKeyTypes/Dummy
        Dummy7: CryptoKeyId=22, CryptoKeyTypeRef=CryptoKeyTypes/Dummy
        MacGen_Sha256_HMAC_key: CryptoKeyId=23, CryptoKeyTypeRef=CryptoKeyTypes/MacGen_Sha256_HMAC_key
        MacVer_Sha256_HMAC_key: CryptoKeyId=24, CryptoKeyTypeRef=CryptoKeyTypes/MacVer_Sha256_HMAC_key
    6 x CryptoPrimitives:
      Hash_Sha_256
        Hash_Sha256 (CryptoPrimitive):
          CryptoPrimitiveAlgorithmFamily = CRYPTO_ALGOFAM_SHA2_256
          CryptoPrimitiveAlgorithmMode = CRYPTO_ALGOMODE_NOT_SET
          CryptoPrimitiveAlgorithmSecondaryFamily = CRYPTO_ALGOFAM_NOT_SET
          CryptoPrimitiveService = HASH
      RNG
        RNG (CryptoPrimitive):
          CryptoPrimitiveAlgorithmFamily = CRYPTO_ALGOFAM_RNG
          CryptoPrimitiveAlgorithmMode = CRYPTO_ALGOMODE_CTRDRBG
          CryptoPrimitiveAlgorithmSecondaryFamily = CRYPTO_ALGOFAM_NOT_SET
          CryptoPrimitiveService = RANDOM
      EncryptAES_ECB
        EncryptAES_ECB (CryptoPrimitive):
          CryptoPrimitiveAlgorithmFamily = CRYPTO_ALGOFAM_AES
          CryptoPrimitiveAlgorithmMode = CRYPTO_ALGOMODE_ECB
          CryptoPrimitiveAlgorithmSecondaryFamily = CRYPTO_ALGOFAM_NOT_SET
          CryptoPrimitiveService = ENCRYPT
      DecryptAES_ECB
        DecryptAES_ECB (CryptoPrimitive):
          CryptoPrimitiveAlgorithmFamily = CRYPTO_ALGOFAM_AES
          CryptoPrimitiveAlgorithmMode = CRYPTO_ALGOMODE_ECB
          CryptoPrimitiveAlgorithmSecondaryFamily = CRYPTO_ALGOFAM_NOT_SET
          CryptoPrimitiveService = DECRYPT
      MacGenerate
        MacGen_Sha256_HMAC_Key (CryptoPrimitive):
          CryptoPrimitiveAlgorithmFamily = CRYPTO_ALGOFAM_SHA2_256
          CryptoPrimitiveAlgorithmMode = CRYPTO_ALGOMODE_HMAC
          CryptoPrimitiveAlgorithmSecondaryFamily = CRYPTO_ALGOFAM_NOT_SET
          CryptoPrimitiveService = MAC_GENERATE
      MacVerify
        MacVer_Sha256_HMAC_Key (CryptoPrimitive):
          CryptoPrimitiveAlgorithmFamily = CRYPTO_ALGOFAM_SHA2_256
          CryptoPrimitiveAlgorithmMode = CRYPTO_ALGOMODE_HMAC
          CryptoPrimitiveAlgorithmSecondaryFamily = CRYPTO_ALGOFAM_NOT_SET
          CryptoPrimitiveService = MAC_VERIFY
    5 x NvmKeyCatalog, all with KeyOwner=OWNER_CUST:
      NvmKeyCatalog0: KeyType=AES, NumOfKeySlots=10, MaxKeyBitLen=128
        MuMask0 (MuMask): MU=MU_0
      NvmKeyCatalog_AES: KeyType=AES, NumOfKeySlots=2, MaxKeyBitLen=128
        MuMask0 (MuMask): MU=MU_0
      NvmKeyCatalog_FST_PSK: KeyType=AES, MaxKeyBitLen=128, NumOfKeySlots=10
        MuMask0 (MuMask): MU=MU_0
      NvmKeyCatalog_Sha256_HMAC: KeyType=HMAC, MaxKeyBitLen=256, NumOfKeySlots=2
        MuMask0 (MuMask): MU=MU_0
      NvmKeyCatalog_Tier_PSK: KeyType=AES, NumOfKeySlots=10, MaxKeyBitLen=128
        MuMask0 (MuMask): MU=MU_0
    5 x RamKeyCatalog, all with KeyOwner=OWNER_ANY:
      RamKeyCatalog0: KeyType=AES, NumOfKeySlots=3, MaxKeyBitLen=128
        MuMask0 (MuMask): MU=MU_0
      RamKeyCatalog1: KeyType=AES, NumOfKeySlots=3, MaxKeyBitLen=128
        MuMask0 (MuMask): MU=MU_0
      RamKeyCatalog2: KeyType=SHARED_SECRET, NumOfKeySlots=3, MaxKeyBitLen=256
        MuMask0 (MuMask): MU=MU_0
      RamKeyCatalog3: KeyType=AES, NumOfKeySlots=3, MaxKeyBitLen=128
        MuMask0 (MuMask): MU=MU_0
      RamKeyCatalog_PBKDF2: KeyType=AES, NumOfKeySlots=4, MaxKeyBitLen=256
        MuMask0 (MuMask): MU=MU_0
