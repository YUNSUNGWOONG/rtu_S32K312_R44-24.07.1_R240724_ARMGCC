AUTOSAR XML (schema 4-0-3)
package /Port
  module config Port: implementation-config-variant=VARIANT-POST-BUILD, module-description=BswImplementation_Port
    CommonPublishedInformation:
      ArReleaseMajorVersion = 4
      ArReleaseMinorVersion = 7
      ArReleaseRevisionVersion = 0
      ModuleId = 124
      SwMajorVersion = 3
      SwMinorVersion = 0
      SwPatchVersion = 0
      VendorId = 43
    PortConfigSet
      NotUsedPortPin: PortPinDirection=PORT_PIN_IN, PortPinLevelValue=PORT_PIN_LEVEL_LOW, PortPinPue=1, PortPinPus=0
      5 x PortContainer:
        PortContainer_A: PortNumberOfPortPins=29
          29 x PortPin, all with ImcrPdacSlot=VIRTUAL_WRAPPER_PDAC0, MscrPdacSlot=VIRTUAL_WRAPPER_PDAC0, OBEGroupSelect=NO_OBE_GROUP, PortPinDirectionChangeable=1, PortPinDse=0, PortPinIfe=0, PortPinInitialMode=PORT_GPIO_MODE, PortPinInvertControl=0, PortPinLevelValue=PORT_PIN_LEVEL_LOW, PortPinModeChangeable=1, PortPinPke=0, PortPinPue=0, PortPinPus=0, PortPinSafeMode=0, PortPinSiul2Instance=SIUL2_0, PortPinSlewRate=FASTEST_SETTING:
            PortPin_PTA0: PortPinDirection=PORT_PIN_OUT, PortPinId=1, PortPinMode=EMIOS_0_EMIOS_0_CH_17_Y_OUT, PortPinPcr=0, PortPinWithReadBack=0
            PortPin_PTA1: PortPinDirection=PORT_PIN_IN, PortPinId=2, PortPinMode=ADC0_ADC0_S9_IN, PortPinPcr=1, PortPinWithReadBack=0
            PortPin_PTA2: PortPinDirection=PORT_PIN_IN, PortPinId=3, PortPinMode=GPIO, PortPinPcr=2, PortPinWithReadBack=0
            PortPin_PTA3: PortPinDirection=PORT_PIN_IN, PortPinId=4, PortPinMode=GPIO, PortPinPcr=3, PortPinWithReadBack=0
            PortPin_PTA4: PortPinDirection=PORT_PIN_OUT, PortPinId=5, PortPinMode=JTAG_JTAG_TMS_SWD_DIO_INOUT, PortPinPcr=4, PortPinWithReadBack=0
            PortPin_PTA5: PortPinDirection=PORT_PIN_IN, PortPinId=6, PortPinMode=SYSTEM_RESET_B_IN, PortPinPcr=5, PortPinWithReadBack=0
            PortPin_PTA6: PortPinDirection=PORT_PIN_IN, PortPinId=7, PortPinMode=CAN0_CAN0_RX_IN, PortPinPcr=6, PortPinWithReadBack=0
            PortPin_PTA7: PortPinDirection=PORT_PIN_OUT, PortPinId=8, PortPinMode=CAN0_CAN0_TX_OUT, PortPinPcr=7, PortPinWithReadBack=0
            PortPin_PTA8: PortPinDirection=PORT_PIN_IN, PortPinId=9, PortPinMode=GPIO, PortPinPcr=8, PortPinWithReadBack=0
            PortPin_PTA9: PortPinDirection=PORT_PIN_IN, PortPinId=10, PortPinMode=ADC0_ADC0_P7_IN, PortPinPcr=9, PortPinWithReadBack=0
            PortPin_PTA10: PortPinDirection=PORT_PIN_OUT, PortPinId=11, PortPinMode=JTAG_TRACENOETM_JTAG_TDO_TRACENOETM_SWO_OUT, PortPinPcr=10, PortPinWithReadBack=0
            PortPin_PTA11: PortPinDirection=PORT_PIN_OUT, PortPinId=12, PortPinMode=ADC1_ADC1_S10_IN, PortPinPcr=11, PortPinWithReadBack=0
            PortPin_PTA12: PortPinDirection=PORT_PIN_IN, PortPinId=13, PortPinMode=EMIOS_1_EMIOS_1_CH_2_H_OUT, PortPinPcr=12, PortPinWithReadBack=0
            PortPin_PTA13: PortPinDirection=PORT_PIN_IN, PortPinId=14, PortPinMode=GPIO, PortPinPcr=13, PortPinWithReadBack=0
            PortPin_PTA14: PortPinDirection=PORT_PIN_IN, PortPinId=15, PortPinMode=GPIO, PortPinPcr=14, PortPinWithReadBack=0
            PortPin_PTA15: PortPinDirection=PORT_PIN_IN, PortPinId=16, PortPinMode=GPIO, PortPinPcr=15, PortPinWithReadBack=0
            PortPin_PTA16: PortPinDirection=PORT_PIN_IN, PortPinId=17, PortPinMode=GPIO, PortPinPcr=16, PortPinWithReadBack=0
            PortPin_PTA17: PortPinDirection=PORT_PIN_IN, PortPinId=18, PortPinMode=EMIOS_0_EMIOS_0_CH_6_G_IN, PortPinPcr=17, PortPinWithReadBack=0
            PortPin_PTA18: PortPinDirection=PORT_PIN_IN, PortPinId=19, PortPinMode=GPIO, PortPinPcr=18, PortPinWithReadBack=0
            PortPin_PTA19: PortPinDirection=PORT_PIN_OUT, PortPinId=20, PortPinMode=GPIO, PortPinPcr=19, PortPinWithReadBack=1
            PortPin_PTA20: PortPinDirection=PORT_PIN_OUT, PortPinId=21, PortPinMode=GPIO, PortPinPcr=20, PortPinWithReadBack=1
            PortPin_PTA21: PortPinDirection=PORT_PIN_IN, PortPinId=22, PortPinMode=GPIO, PortPinPcr=21, PortPinWithReadBack=0
            PortPin_PTA24: PortPinDirection=PORT_PIN_IN, PortPinId=23, PortPinMode=GPIO, PortPinPcr=24, PortPinWithReadBack=0
            PortPin_PTA25: PortPinDirection=PORT_PIN_IN, PortPinId=24, PortPinMode=GPIO, PortPinPcr=25, PortPinWithReadBack=0
            PortPin_PTA27: PortPinDirection=PORT_PIN_IN, PortPinId=25, PortPinMode=GPIO, PortPinPcr=27, PortPinWithReadBack=0
            PortPin_PTA28: PortPinDirection=PORT_PIN_IN, PortPinId=26, PortPinMode=GPIO, PortPinPcr=28, PortPinWithReadBack=0
            PortPin_PTA29: PortPinDirection=PORT_PIN_OUT, PortPinId=27, PortPinMode=GPIO, PortPinPcr=29, PortPinWithReadBack=0
            PortPin_PTA30: PortPinDirection=PORT_PIN_OUT, PortPinId=28, PortPinMode=GPIO, PortPinPcr=30, PortPinWithReadBack=0
            PortPin_PTA31: PortPinDirection=PORT_PIN_OUT, PortPinId=29, PortPinMode=GPIO, PortPinPcr=31, PortPinWithReadBack=0
        PortContainer_B: PortNumberOfPortPins=29
          29 x PortPin, all with ImcrPdacSlot=VIRTUAL_WRAPPER_PDAC0, MscrPdacSlot=VIRTUAL_WRAPPER_PDAC0, OBEGroupSelect=NO_OBE_GROUP, PortPinDirectionChangeable=1, PortPinDse=0, PortPinIfe=0, PortPinInitialMode=PORT_GPIO_MODE, PortPinInvertControl=0, PortPinLevelValue=PORT_PIN_LEVEL_LOW, PortPinModeChangeable=1, PortPinPke=0, PortPinPue=0, PortPinPus=0, PortPinSafeMode=0, PortPinSiul2Instance=SIUL2_0, PortPinSlewRate=FASTEST_SETTING, PortPinWithReadBack=0:
            PortPin_PTB0: PortPinDirection=PORT_PIN_IN, PortPinId=30, PortPinMode=LPUART0_LPUART0_RX_IN, PortPinPcr=32
            PortPin_PTB1: PortPinDirection=PORT_PIN_OUT, PortPinId=31, PortPinMode=LPUART0_LPUART0_TX_OUT, PortPinPcr=33
            PortPin_PTB2: PortPinDirection=PORT_PIN_IN, PortPinId=32, PortPinMode=GPIO, PortPinPcr=34
            PortPin_PTB3: PortPinDirection=PORT_PIN_IN, PortPinId=33, PortPinMode=GPIO, PortPinPcr=35
            PortPin_PTB4: PortPinDirection=PORT_PIN_IN, PortPinId=34, PortPinMode=GPIO, PortPinPcr=36
            PortPin_PTB5: PortPinDirection=PORT_PIN_IN, PortPinId=35, PortPinMode=GPIO, PortPinPcr=37
            PortPin_PTB8: PortPinDirection=PORT_PIN_IN, PortPinId=36, PortPinMode=GPIO, PortPinPcr=40
            PortPin_PTB9: PortPinDirection=PORT_PIN_IN, PortPinId=37, PortPinMode=GPIO, PortPinPcr=41
            PortPin_PTB10: PortPinDirection=PORT_PIN_IN, PortPinId=38, PortPinMode=GPIO, PortPinPcr=42
            PortPin_PTB11: PortPinDirection=PORT_PIN_IN, PortPinId=39, PortPinMode=GPIO, PortPinPcr=43
            PortPin_PTB12: PortPinDirection=PORT_PIN_IN, PortPinId=40, PortPinMode=GPIO, PortPinPcr=44
            PortPin_PTB13: PortPinDirection=PORT_PIN_IN, PortPinId=41, PortPinMode=EMIOS_0_EMIOS_0_CH_1_G_IN, PortPinPcr=45
            PortPin_PTB14: PortPinDirection=PORT_PIN_IN, PortPinId=42, PortPinMode=EMIOS_0_EMIOS_0_CH_2_G_IN, PortPinPcr=46
            PortPin_PTB15: PortPinDirection=PORT_PIN_IN, PortPinId=43, PortPinMode=EMIOS_0_EMIOS_0_CH_3_G_IN, PortPinPcr=47
            PortPin_PTB16: PortPinDirection=PORT_PIN_IN, PortPinId=44, PortPinMode=GPIO, PortPinPcr=48
            PortPin_PTB17: PortPinDirection=PORT_PIN_IN, PortPinId=45, PortPinMode=GPIO, PortPinPcr=49
            PortPin_PTB18: PortPinDirection=PORT_PIN_IN, PortPinId=46, PortPinMode=GPIO, PortPinPcr=50
            PortPin_PTB19: PortPinDirection=PORT_PIN_IN, PortPinId=47, PortPinMode=GPIO, PortPinPcr=51
            PortPin_PTB20: PortPinDirection=PORT_PIN_IN, PortPinId=48, PortPinMode=GPIO, PortPinPcr=52
            PortPin_PTB21: PortPinDirection=PORT_PIN_IN, PortPinId=49, PortPinMode=GPIO, PortPinPcr=53
            PortPin_PTB22: PortPinDirection=PORT_PIN_IN, PortPinId=50, PortPinMode=GPIO, PortPinPcr=54
            PortPin_PTB23: PortPinDirection=PORT_PIN_IN, PortPinId=51, PortPinMode=GPIO, PortPinPcr=55
            PortPin_PTB24: PortPinDirection=PORT_PIN_IN, PortPinId=52, PortPinMode=GPIO, PortPinPcr=56
            PortPin_PTB25: PortPinDirection=PORT_PIN_IN, PortPinId=53, PortPinMode=GPIO, PortPinPcr=57
            PortPin_PTB26: PortPinDirection=PORT_PIN_IN, PortPinId=54, PortPinMode=GPIO, PortPinPcr=58
            PortPin_PTB27: PortPinDirection=PORT_PIN_OUT, PortPinId=55, PortPinMode=LPUART5_LPUART5_TX_OUT, PortPinPcr=59
            PortPin_PTB28: PortPinDirection=PORT_PIN_IN, PortPinId=56, PortPinMode=LPUART5_LPUART5_RX_IN, PortPinPcr=60
            PortPin_PTB29: PortPinDirection=PORT_PIN_IN, PortPinId=57, PortPinMode=GPIO, PortPinPcr=61
            PortPin_PTB30: PortPinDirection=PORT_PIN_IN, PortPinId=58, PortPinMode=GPIO, PortPinPcr=62
        PortContainer_C: PortNumberOfPortPins=31
          31 x PortPin, all with ImcrPdacSlot=VIRTUAL_WRAPPER_PDAC0, MscrPdacSlot=VIRTUAL_WRAPPER_PDAC0, OBEGroupSelect=NO_OBE_GROUP, PortPinDirection=PORT_PIN_IN, PortPinDirectionChangeable=1, PortPinDse=0, PortPinIfe=0, PortPinInitialMode=PORT_GPIO_MODE, PortPinInvertControl=0, PortPinLevelValue=PORT_PIN_LEVEL_LOW, PortPinModeChangeable=1, PortPinPke=0, PortPinPue=0, PortPinPus=0, PortPinSafeMode=0, PortPinSiul2Instance=SIUL2_0, PortPinSlewRate=FASTEST_SETTING, PortPinWithReadBack=0:
            PortPin_PTC0: PortPinId=59, PortPinMode=GPIO, PortPinPcr=64
            PortPin_PTC1: PortPinId=60, PortPinMode=GPIO, PortPinPcr=65
            PortPin_PTC2: PortPinId=61, PortPinMode=GPIO, PortPinPcr=66
            PortPin_PTC3: PortPinId=62, PortPinMode=GPIO, PortPinPcr=67
            PortPin_PTC4: PortPinId=63, PortPinMode=JTAG_JTAG_TCK_SWD_CLK_IN, PortPinPcr=68
            PortPin_PTC5: PortPinId=64, PortPinMode=JTAG_JTAG_TDI_IN, PortPinPcr=69
            PortPin_PTC6: PortPinId=65, PortPinMode=GPIO, PortPinPcr=70
            PortPin_PTC7: PortPinId=66, PortPinMode=GPIO, PortPinPcr=71
            PortPin_PTC8: PortPinId=67, PortPinMode=GPIO, PortPinPcr=72
            PortPin_PTC9: PortPinId=68, PortPinMode=GPIO, PortPinPcr=73
            PortPin_PTC10: PortPinId=69, PortPinMode=GPIO, PortPinPcr=74
            PortPin_PTC11: PortPinId=70, PortPinMode=ADC0_ADC0_S17_IN, PortPinPcr=75
            PortPin_PTC12: PortPinId=71, PortPinMode=GPIO, PortPinPcr=76
            PortPin_PTC13: PortPinId=72, PortPinMode=GPIO, PortPinPcr=77
            PortPin_PTC14: PortPinId=73, PortPinMode=GPIO, PortPinPcr=78
            PortPin_PTC15: PortPinId=74, PortPinMode=GPIO, PortPinPcr=79
            PortPin_PTC16: PortPinId=75, PortPinMode=GPIO, PortPinPcr=80
            PortPin_PTC17: PortPinId=76, PortPinMode=GPIO, PortPinPcr=81
            PortPin_PTC18: PortPinId=77, PortPinMode=GPIO, PortPinPcr=82
            PortPin_PTC19: PortPinId=78, PortPinMode=GPIO, PortPinPcr=83
            PortPin_PTC20: PortPinId=79, PortPinMode=GPIO, PortPinPcr=84
            PortPin_PTC21: PortPinId=80, PortPinMode=GPIO, PortPinPcr=85
            PortPin_PTC23: PortPinId=81, PortPinMode=GPIO, PortPinPcr=87
            PortPin_PTC24: PortPinId=82, PortPinMode=GPIO, PortPinPcr=88
            PortPin_PTC25: PortPinId=83, PortPinMode=GPIO, PortPinPcr=89
            PortPin_PTC26: PortPinId=84, PortPinMode=GPIO, PortPinPcr=90
            PortPin_PTC27: PortPinId=85, PortPinMode=GPIO, PortPinPcr=91
            PortPin_PTC28: PortPinId=86, PortPinMode=GPIO, PortPinPcr=92
            PortPin_PTC29: PortPinId=87, PortPinMode=GPIO, PortPinPcr=93
            PortPin_PTC30: PortPinId=88, PortPinMode=GPIO, PortPinPcr=94
            PortPin_PTC31: PortPinId=89, PortPinMode=GPIO, PortPinPcr=95
        PortContainer_D: PortNumberOfPortPins=30
          30 x PortPin, all with ImcrPdacSlot=VIRTUAL_WRAPPER_PDAC0, MscrPdacSlot=VIRTUAL_WRAPPER_PDAC0, OBEGroupSelect=NO_OBE_GROUP, PortPinDirectionChangeable=1, PortPinDse=0, PortPinIfe=0, PortPinInitialMode=PORT_GPIO_MODE, PortPinInvertControl=0, PortPinLevelValue=PORT_PIN_LEVEL_LOW, PortPinModeChangeable=1, PortPinPke=0, PortPinPue=0, PortPinPus=0, PortPinSafeMode=0, PortPinSiul2Instance=SIUL2_0, PortPinSlewRate=FASTEST_SETTING, PortPinWithReadBack=0:
            PortPin_PTD0: PortPinDirection=PORT_PIN_IN, PortPinId=90, PortPinMode=GPIO, PortPinPcr=96
            PortPin_PTD1: PortPinDirection=PORT_PIN_IN, PortPinId=91, PortPinMode=GPIO, PortPinPcr=97
            PortPin_PTD2: PortPinDirection=PORT_PIN_IN, PortPinId=92, PortPinMode=GPIO, PortPinPcr=98
            PortPin_PTD3: PortPinDirection=PORT_PIN_IN, PortPinId=93, PortPinMode=GPIO, PortPinPcr=99
            PortPin_PTD4: PortPinDirection=PORT_PIN_IN, PortPinId=94, PortPinMode=GPIO, PortPinPcr=100
            PortPin_PTD5: PortPinDirection=PORT_PIN_IN, PortPinId=95, PortPinMode=GPIO, PortPinPcr=101
            PortPin_PTD6: PortPinDirection=PORT_PIN_IN, PortPinId=96, PortPinMode=GPIO, PortPinPcr=102
            PortPin_PTD7: PortPinDirection=PORT_PIN_IN, PortPinId=97, PortPinMode=GPIO, PortPinPcr=103
            PortPin_PTD8: PortPinDirection=PORT_PIN_IN, PortPinId=98, PortPinMode=GPIO, PortPinPcr=104
            PortPin_PTD9: PortPinDirection=PORT_PIN_IN, PortPinId=99, PortPinMode=GPIO, PortPinPcr=105
            PortPin_PTD10: PortPinDirection=PORT_PIN_OUT, PortPinId=100, PortPinMode=GPIO, PortPinPcr=106
            PortPin_PTD11: PortPinDirection=PORT_PIN_OUT, PortPinId=101, PortPinMode=GPIO, PortPinPcr=107
            PortPin_PTD12: PortPinDirection=PORT_PIN_OUT, PortPinId=102, PortPinMode=GPIO, PortPinPcr=108
            PortPin_PTD13: PortPinDirection=PORT_PIN_IN, PortPinId=103, PortPinMode=GPIO, PortPinPcr=109
            PortPin_PTD14: PortPinDirection=PORT_PIN_IN, PortPinId=104, PortPinMode=GPIO, PortPinPcr=110
            PortPin_PTD15: PortPinDirection=PORT_PIN_IN, PortPinId=105, PortPinMode=GPIO, PortPinPcr=111
            PortPin_PTD16: PortPinDirection=PORT_PIN_IN, PortPinId=106, PortPinMode=GPIO, PortPinPcr=112
            PortPin_PTD17: PortPinDirection=PORT_PIN_IN, PortPinId=107, PortPinMode=GPIO, PortPinPcr=113
            PortPin_PTD18: PortPinDirection=PORT_PIN_IN, PortPinId=108, PortPinMode=GPIO, PortPinPcr=114
            PortPin_PTD20: PortPinDirection=PORT_PIN_IN, PortPinId=109, PortPinMode=GPIO, PortPinPcr=116
            PortPin_PTD21: PortPinDirection=PORT_PIN_IN, PortPinId=110, PortPinMode=ADC0_ADC0_S23_IN, PortPinPcr=117
            PortPin_PTD22: PortPinDirection=PORT_PIN_IN, PortPinId=111, PortPinMode=GPIO, PortPinPcr=118
            PortPin_PTD23: PortPinDirection=PORT_PIN_IN, PortPinId=112, PortPinMode=GPIO, PortPinPcr=119
            PortPin_PTD24: PortPinDirection=PORT_PIN_IN, PortPinId=113, PortPinPcr=120, PortPinMode=ADC1_ADC1_S20_IN
            PortPin_PTD26: PortPinDirection=PORT_PIN_IN, PortPinId=114, PortPinMode=GPIO, PortPinPcr=122
            PortPin_PTD27: PortPinDirection=PORT_PIN_IN, PortPinId=115, PortPinMode=GPIO, PortPinPcr=123
            PortPin_PTD28: PortPinDirection=PORT_PIN_IN, PortPinId=116, PortPinMode=GPIO, PortPinPcr=124
            PortPin_PTD29: PortPinDirection=PORT_PIN_IN, PortPinId=117, PortPinMode=GPIO, PortPinPcr=125
            PortPin_PTD30: PortPinDirection=PORT_PIN_IN, PortPinId=118, PortPinMode=GPIO, PortPinPcr=126
            PortPin_PTD31: PortPinDirection=PORT_PIN_IN, PortPinId=119, PortPinMode=GPIO, PortPinPcr=127
        PortContainer_E: PortNumberOfPortPins=26
          26 x PortPin, all with ImcrPdacSlot=VIRTUAL_WRAPPER_PDAC0, MscrPdacSlot=VIRTUAL_WRAPPER_PDAC0, OBEGroupSelect=NO_OBE_GROUP, PortPinDirectionChangeable=1, PortPinDse=0, PortPinIfe=0, PortPinInitialMode=PORT_GPIO_MODE, PortPinInvertControl=0, PortPinLevelValue=PORT_PIN_LEVEL_LOW, PortPinModeChangeable=1, PortPinPke=0, PortPinPue=0, PortPinPus=0, PortPinSafeMode=0, PortPinSiul2Instance=SIUL2_0, PortPinSlewRate=FASTEST_SETTING, PortPinWithReadBack=0:
            PortPin_PTE0: PortPinDirection=PORT_PIN_IN, PortPinId=120, PortPinMode=GPIO, PortPinPcr=128
            PortPin_PTE1: PortPinDirection=PORT_PIN_IN, PortPinId=121, PortPinMode=GPIO, PortPinPcr=129
            PortPin_PTE2: PortPinDirection=PORT_PIN_IN, PortPinId=122, PortPinMode=GPIO, PortPinPcr=130
            PortPin_PTE3: PortPinDirection=PORT_PIN_IN, PortPinId=123, PortPinMode=GPIO, PortPinPcr=131
            PortPin_PTE4: PortPinDirection=PORT_PIN_IN, PortPinId=124, PortPinMode=GPIO, PortPinPcr=132
            PortPin_PTE5: PortPinDirection=PORT_PIN_IN, PortPinId=125, PortPinMode=GPIO, PortPinPcr=133
            PortPin_PTE6: PortPinDirection=PORT_PIN_IN, PortPinId=126, PortPinMode=GPIO, PortPinPcr=134
            PortPin_PTE7: PortPinDirection=PORT_PIN_IN, PortPinId=127, PortPinMode=EMIOS_0_EMIOS_0_CH_7_G_IN, PortPinPcr=135
            PortPin_PTE8: PortPinDirection=PORT_PIN_IN, PortPinId=128, PortPinMode=GPIO, PortPinPcr=136
            PortPin_PTE9: PortPinDirection=PORT_PIN_IN, PortPinId=129, PortPinMode=GPIO, PortPinPcr=137
            PortPin_PTE10: PortPinDirection=PORT_PIN_IN, PortPinId=130, PortPinMode=GPIO, PortPinPcr=138
            PortPin_PTE11: PortPinDirection=PORT_PIN_IN, PortPinId=131, PortPinMode=GPIO, PortPinPcr=139
            PortPin_PTE12: PortPinDirection=PORT_PIN_IN, PortPinId=132, PortPinMode=GPIO, PortPinPcr=140
            PortPin_PTE13: PortPinDirection=PORT_PIN_IN, PortPinId=133, PortPinMode=GPIO, PortPinPcr=141
            PortPin_PTE14: PortPinDirection=PORT_PIN_IN, PortPinId=134, PortPinMode=GPIO, PortPinPcr=142
            PortPin_PTE15: PortPinDirection=PORT_PIN_IN, PortPinId=135, PortPinMode=GPIO, PortPinPcr=143
            PortPin_PTE16: PortPinDirection=PORT_PIN_IN, PortPinId=136, PortPinMode=GPIO, PortPinPcr=144
            PortPin_PTE17: PortPinDirection=PORT_PIN_IN, PortPinId=137, PortPinMode=GPIO, PortPinPcr=145
            PortPin_PTE18: PortPinDirection=PORT_PIN_IN, PortPinId=138, PortPinMode=GPIO, PortPinPcr=146
            PortPin_PTE19: PortPinDirection=PORT_PIN_IN, PortPinId=139, PortPinMode=GPIO, PortPinPcr=147
            PortPin_PTE21: PortPinDirection=PORT_PIN_IN, PortPinId=140, PortPinMode=GPIO, PortPinPcr=149
            PortPin_PTE22: PortPinDirection=PORT_PIN_IN, PortPinId=141, PortPinMode=GPIO, PortPinPcr=150
            PortPin_PTE23: PortPinDirection=PORT_PIN_OUT, PortPinId=142, PortPinMode=GPIO, PortPinPcr=151
            PortPin_PTE24: PortPinDirection=PORT_PIN_IN, PortPinId=143, PortPinMode=GPIO, PortPinPcr=152
            PortPin_PTE25: PortPinDirection=PORT_PIN_IN, PortPinId=144, PortPinMode=GPIO, PortPinPcr=153
            PortPin_PTE26: PortPinDirection=PORT_PIN_IN, PortPinId=145, PortPinMode=GPIO, PortPinPcr=154
    PortGeneral:
      PortDevErrorDetect = 1
      PortEnableUserModeSupport = 0
      PortMulticoreSupport = 0
      PortResetPinModeApi = 0
      PortSetAsUnusedPinApi = 0
      PortSetPinDirectionApi = 1
      PortSetPinModeApi = 1
      PortSetPinModeDoesNotTouchGpioLevel = 0
      PortTspcSupport = 0
      PortVersionInfoApi = 1
      SIUL2PortIPDevErrorDetect = 1
      SignalInversionConfigEnable = 0
      VirtWrapperSupport = 0
