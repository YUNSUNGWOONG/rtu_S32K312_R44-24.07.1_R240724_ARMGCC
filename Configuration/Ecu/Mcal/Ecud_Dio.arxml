AUTOSAR XML (schema 4-0-3)
package /Dio
  module config Dio: implementation-config-variant=VARIANT-PRE-COMPILE, module-description=BswImplementation_Dio
    CommonPublishedInformation:
      ArReleaseMajorVersion = 4
      ArReleaseMinorVersion = 7
      ArReleaseRevisionVersion = 0
      ModuleId = 120
      SwMajorVersion = 3
      SwMinorVersion = 0
      SwPatchVersion = 0
      VendorId = 43
    DioConfig
      10 x DioPort:
        DioPort_AL: DioPortId=0
          16 x DioChannel, all with PDACSlot=VIRTUAL_WRAPPER_PDAC0:
            DioChannel_PTA{0..15}: DioChannelId={0..15}
        DioPort_AH: DioPortId=1
          13 x DioChannel, all with PDACSlot=VIRTUAL_WRAPPER_PDAC0:
            DioChannel_PTA16: DioChannelId=0
            DioChannel_PTA17: DioChannelId=1
            DioChannel_PTA18: DioChannelId=2
            DioChannel_PTA19: DioChannelId=3
            DioChannel_PTA20: DioChannelId=4
            DioChannel_PTA21: DioChannelId=5
            DioChannel_PTA24: DioChannelId=8
            DioChannel_PTA25: DioChannelId=9
            DioChannel_PTA27: DioChannelId=11
            DioChannel_PTA28: DioChannelId=12
            DioChannel_PTA29: DioChannelId=13
            DioChannel_PTA30: DioChannelId=14
            DioChannel_PTA31: DioChannelId=15
        DioPort_BL: DioPortId=2
          14 x DioChannel, all with PDACSlot=VIRTUAL_WRAPPER_PDAC0:
            DioChannel_PTB{0..5}: DioChannelId={0..5}
            DioChannel_PTB{8..15}: DioChannelId={8..15}
        DioPort_BH: DioPortId=3
          15 x DioChannel, all with PDACSlot=VIRTUAL_WRAPPER_PDAC0:
            DioChannel_PTB16: DioChannelId=0
            DioChannel_PTB17: DioChannelId=1
            DioChannel_PTB18: DioChannelId=2
            DioChannel_PTB19: DioChannelId=3
            DioChannel_PTB20: DioChannelId=4
            DioChannel_PTB21: DioChannelId=5
            DioChannel_PTB22: DioChannelId=6
            DioChannel_PTB23: DioChannelId=7
            DioChannel_PTB24: DioChannelId=8
            DioChannel_PTB25: DioChannelId=9
            DioChannel_PTB26: DioChannelId=10
            DioChannel_PTB27: DioChannelId=11
            DioChannel_PTB28: DioChannelId=12
            DioChannel_PTB29: DioChannelId=13
            DioChannel_PTB30: DioChannelId=14
        DioPort_CL: DioPortId=4
          16 x DioChannel, all with PDACSlot=VIRTUAL_WRAPPER_PDAC0:
            DioChannel_PTC{0..15}: DioChannelId={0..15}
        DioPort_CH: DioPortId=5
          15 x DioChannel, all with PDACSlot=VIRTUAL_WRAPPER_PDAC0:
            DioChannel_PTC16: DioChannelId=0
            DioChannel_PTC17: DioChannelId=1
            DioChannel_PTC18: DioChannelId=2
            DioChannel_PTC19: DioChannelId=3
            DioChannel_PTC20: DioChannelId=4
            DioChannel_PTC21: DioChannelId=5
            DioChannel_PTC23: DioChannelId=7
            DioChannel_PTC24: DioChannelId=8
            DioChannel_PTC25: DioChannelId=9
            DioChannel_PTC26: DioChannelId=10
            DioChannel_PTC27: DioChannelId=11
            DioChannel_PTC28: DioChannelId=12
            DioChannel_PTC29: DioChannelId=13
            DioChannel_PTC30: DioChannelId=14
            DioChannel_PTC31: DioChannelId=15
        DioPort_DL: DioPortId=6
          16 x DioChannel, all with PDACSlot=VIRTUAL_WRAPPER_PDAC0:
            DioChannel_PTD{0..15}: DioChannelId={0..15}
        DioPort_DH: DioPortId=7
          14 x DioChannel, all with PDACSlot=VIRTUAL_WRAPPER_PDAC0:
            DioChannel_PTD16: DioChannelId=0
            DioChannel_PTD17: DioChannelId=1
            DioChannel_PTD18: DioChannelId=2
            DioChannel_PTD20: DioChannelId=4
            DioChannel_PTD21: DioChannelId=5
            DioChannel_PTD22: DioChannelId=6
            DioChannel_PTD23: DioChannelId=7
            DioChannel_PTD24: DioChannelId=8
            DioChannel_PTD26: DioChannelId=10
            DioChannel_PTD27: DioChannelId=11
            DioChannel_PTD28: DioChannelId=12
            DioChannel_PTD29: DioChannelId=13
            DioChannel_PTD30: DioChannelId=14
            DioChannel_PTD31: DioChannelId=15
        DioPort_EL: DioPortId=8
          16 x DioChannel, all with PDACSlot=VIRTUAL_WRAPPER_PDAC0:
            DioChannel_PTE{0..15}: DioChannelId={0..15}
        DioPort_EH: DioPortId=9
          10 x DioChannel, all with PDACSlot=VIRTUAL_WRAPPER_PDAC0:
            DioChannel_PTE16: DioChannelId=0
            DioChannel_PTE17: DioChannelId=1
            DioChannel_PTE18: DioChannelId=2
            DioChannel_PTE19: DioChannelId=3
            DioChannel_PTE21: DioChannelId=5
            DioChannel_PTE22: DioChannelId=6
            DioChannel_PTE23: DioChannelId=7
            DioChannel_PTE24: DioChannelId=8
            DioChannel_PTE25: DioChannelId=9
            DioChannel_PTE26: DioChannelId=10
    DioGeneral:
      DioDevErrorDetect = 1
      DioEnableUserModeSupport = 0
      DioFlipChannelApi = 0
      DioMaskedWritePortApi = 0
      DioMulticoreSupport = 0
      DioReadZeroForUndefinedPortPins = 0
      DioReversePortBits = 0
      DioVersionInfoApi = 0
      DioVirtWrapperSupport = 0
      SIUL2DioIPDevErrorDetect = 0
