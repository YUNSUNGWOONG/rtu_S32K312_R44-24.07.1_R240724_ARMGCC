AUTOSAR XML (schema 4-0-3)
package /Fls
  module config Fls: implementation-config-variant=VARIANT-POST-BUILD, module-description=BswImplementation_Fls
    AutosarExt:
      FlsBlock4PipeSelect = FLS_COMMAND_PIPE_0
      FlsDataErrorSuppression = 1
      FlsDomainID = 0
      FlsEnableUserModeSupport = 0
      FlsExternalSectorsConfigured = 0
      FlsInternalSectorsConfigured = 1
      FlsMCoreEnable = 0
      FlsMCoreJobSemaphoreChannelNo = 0
      FlsMCoreQJobSemaphoreChannelNo = 0
      FlsQspiLockLUT = 0
      FlsSynchronizeCache = 0
      FlsUsesAlterInterface = 0
    CommonPublishedInformation:
      ArReleaseMajorVersion = 4
      ArReleaseMinorVersion = 7
      ArReleaseRevisionVersion = 0
      ModuleId = 92
      SwMajorVersion = 3
      SwMinorVersion = 0
      SwPatchVersion = 0
      VendorApiInfix = 
      VendorId = 43
    FlsConfigSet:
      FlsAcErase = 541253376
      FlsAcErasePointer = NULL_PTR
      FlsAcWrite = 541253376
      FlsAcWritePointer = NULL_PTR
      FlsCallCycle = 0.2
      FlsDefaultMode = MEMIF_MODE_FAST
      FlsJobEndNotification = Fee_JobEndNotification
      FlsJobErrorNotification = Fee_JobErrorNotification
      FlsMaxReadFastMode = 48
      FlsMaxReadNormalMode = 24
      FlsMaxWriteFastMode = 256
      FlsMaxWriteNormalMode = 128
      FlsProtection = 0
      FlsSectorList
        11 x FlsSector, all with FlsHwCh=FLS_CH_INTERN, FlsNumberOfSectors=1, FlsPageSize=8, FlsPageWriteAsynch=0, FlsSectorEraseAsynch=1, FlsSectorHwAddress=0, FlsSectorSize=8192:
          FlsSector_0: FlsSectorIndex=0, FlsSectorStartaddress=0, FlsPhysicalSector=FLS_DATA_ARRAY_0_BLOCK_2_S000
          FlsSector_1: FlsPhysicalSector=FLS_DATA_ARRAY_0_BLOCK_2_S001, FlsSectorIndex=1, FlsSectorStartaddress=8192
          FlsSector_2: FlsPhysicalSector=FLS_DATA_ARRAY_0_BLOCK_2_S002, FlsSectorIndex=2, FlsSectorStartaddress=16384
          FlsSector_3: FlsPhysicalSector=FLS_DATA_ARRAY_0_BLOCK_2_S003, FlsSectorIndex=3, FlsSectorStartaddress=24576
          FlsSector_4: FlsPhysicalSector=FLS_DATA_ARRAY_0_BLOCK_2_S004, FlsSectorIndex=4, FlsSectorStartaddress=32768
          FlsSector_5: FlsPhysicalSector=FLS_DATA_ARRAY_0_BLOCK_2_S005, FlsSectorIndex=5, FlsSectorStartaddress=40960
          FlsSector_6: FlsPhysicalSector=FLS_DATA_ARRAY_0_BLOCK_2_S006, FlsSectorIndex=6, FlsSectorStartaddress=49152
          FlsSector_7: FlsPhysicalSector=FLS_DATA_ARRAY_0_BLOCK_2_S007, FlsSectorIndex=7, FlsSectorStartaddress=57344
          FlsSector_8: FlsPhysicalSector=FLS_DATA_ARRAY_0_BLOCK_2_S008, FlsSectorIndex=8, FlsSectorStartaddress=65536
          FlsSector_9: FlsPhysicalSector=FLS_DATA_ARRAY_0_BLOCK_2_S009, FlsSectorIndex=9, FlsSectorStartaddress=73728
          FlsSector_10: FlsPhysicalSector=FLS_DATA_ARRAY_0_BLOCK_2_S010, FlsSectorIndex=10, FlsSectorStartaddress=81920
    FlsGeneral:
      FlsAbortTimeout = 32767
      FlsAcLoadOnJobStart = 0
      FlsAsyncEraseTimeout = 2147483647
      FlsAsyncWriteTimeout = 2147483647
      FlsBaseAddress = 0
      FlsBlankCheckApi = 0
      FlsCancelApi = 1
      FlsCleanCacheAfterLoadAc = 0
      FlsCompareApi = 1
      FlsDevErrorDetect = 1
      FlsDriverIndex = 0
      FlsECCCheck = 1
      FlsECCHandlingProtectionHook = 0
      FlsEnableCheckCfgCrc = 0
      FlsEnableDevAssert = 0
      FlsEraseVerificationEnabled = 1
      FlsGetJobResultApi = 1
      FlsGetStatusApi = 1
      FlsMCoreArbitrationTimeout = 32767
      FlsMCoreInitTimeout = 32767
      FlsMaxEraseBlankCheck = 256
      FlsQspiAsyncEraseTimeout = 2147483647
      FlsQspiAsyncWriteTimeout = 2147483647
      FlsQspiCommandCompleteTimeout = 1
      FlsQspiDllLockTimeout = 2147483647
      FlsQspiFlashInitTimeout = 1
      FlsQspiIpTimeoutOsifCounterType = OSIF_COUNTER_DUMMY
      FlsQspiResetTimeout = 1
      FlsQspiSoftwareResetDelay = 11
      FlsQspiSyncEraseTimeout = 2147483647
      FlsQspiSyncReadTimeout = 2147483647
      FlsQspiSyncWriteTimeout = 2147483647
      FlsQspiTxBufferResetDelay = 0
      FlsQspiWriteEnableRetries = 3
      FlsSetModeApi = 1
      FlsSyncEraseTimeout = 2147483647
      FlsSyncWriteTimeout = 2147483647
      FlsTimeoutMethod = OSIF_COUNTER_DUMMY
      FlsTimeoutSupervisionEnabled = 0
      FlsTotalSize = 131072
      FlsUseInterrupts = 0
      FlsVersionInfoApi = 1
      FlsWriteVerificationEnabled = 1
    FlsPublishedInformation:
      FlsAcLocationErase = 0
      FlsAcLocationWrite = 0
      FlsAcSizeErase = 0
      FlsAcSizeWrite = 0
      FlsECCValue = 1427461397
      FlsEraseTime = 5.0
      FlsErasedValue = 4294967295
      FlsExpectedHwId = 0
      FlsSpecifiedEraseCycles = 1000
      FlsWriteTime = 5.0E-4
