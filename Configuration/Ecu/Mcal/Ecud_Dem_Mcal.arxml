AUTOSAR XML (schema 4-0-3)
package /Dem
  module config Dem: implementation-config-variant=VARIANT-POST-BUILD
    CommonPublishedInformation:
      ArReleaseMajorVersion = 4
      ArReleaseMinorVersion = 7
      ArReleaseRevisionVersion = 0
      ModuleId = 54
      SwMajorVersion = 3
      SwMinorVersion = 0
      SwPatchVersion = 0
      VendorId = 43
    DemConfigSet
      8 x DemEventParameter, all with DemEventFailureCycleCounterThreshold=0, DemEventAvailable=1, DemEventKind=DEM_EVENT_KIND_BSW, DemFFPrestorageSupported=1, DemOperationCycleRef=DemOperationCycle0:
        LIN_E_TIMEOUT: DemEventId=1
          DemDebounceAlgorithmClass
            DemDebounceCounterBased: DemDebounceCounterBasedClassRef=DemDebounceCounterBasedClass0
        MCU_E_TIMEOUT_FAILURE: DemEventId=2
          DemDebounceAlgorithmClass
            DemDebounceCounterBased: DemDebounceCounterBasedClassRef=DemDebounceCounterBasedClass0
        MCU_E_CLOCKMUXSWITCH_FAILURE: DemEventId=3
          DemDebounceAlgorithmClass
            DemDebounceCounterBased: DemDebounceCounterBasedClassRef=DemDebounceCounterBasedClass0
        MCU_E_INVALIDFXOSC_CONFIG: DemEventId=4
          DemDebounceAlgorithmClass
            DemDebounceCounterBased: DemDebounceCounterBasedClassRef=DemDebounceCounterBasedClass0
        MCU_E_CLOCK_FAILURE: DemEventId=5
          DemDebounceAlgorithmClass
            DemDebounceCounterBased: DemDebounceCounterBasedClassRef=DemDebounceCounterBasedClass0
        SPI_E_HARDWARE_ERROR: DemEventId=6
          DemDebounceAlgorithmClass
            DemDebounceCounterBased: DemDebounceCounterBasedClassRef=DemDebounceCounterBasedClass0
        WDG_E_DISABLE_REJECTED: DemEventId=7
          DemDebounceAlgorithmClass
            DemDebounceCounterBased: DemDebounceCounterBasedClassRef=DemDebounceCounterBasedClass0
        WDG_E_MODE_FAILED: DemEventId=8
          DemDebounceAlgorithmClass
            DemDebounceCounterBased: DemDebounceCounterBasedClassRef=DemDebounceCounterBasedClass0
      DemDebounceCounterBasedClass0 (DemDebounceCounterBasedClass):
        DemDebounceCounterJumpDownValue = 0
        DemDebounceCounterJumpUpValue = 0
        DemDebounceCounterStorage = 0
        DemDebounceBehavior = DEM_DEBOUNCE_RESET
        DemDebounceCounterDecrementStepSize = 10
        DemDebounceCounterFailedThreshold = 10
        DemDebounceCounterIncrementStepSize = 10
        DemDebounceCounterPassedThreshold = -1
        DemDebounceCounterJumpUp = 0
        DemDebounceCounterJumpDown = 0
    DemGeneral:
      DemAgingCycleCounterProcessing = DEM_PROCESS_AGINGCTR_EXTERN
      DemAgingRequieresTestedCycle = 1
      DemAvailabilitySupport = DEM_NO_AVAILABILITY
      DemClearDTCBehavior = DEM_CLRRESP_VOLATILE
      DemClearDTCLimitation = DEM_ALL_SUPPORTED_DTCS
      DemDataElementDefaultEndianness = BIG_ENDIAN
      DemDebounceCounterBasedSupport = 0
      DemDebounceTimeBasedSupport = 0
      DemDevErrorDetect = 1
      DemDtcStatusAvailabilityMask = 0
      DemEventCombinationSupport = DEM_EVCOMB_DISABLED
      DemEventDisplacementStrategy = DEM_DISPLACEMENT_NONE
      DemEventMemoryEntryStorageTrigger = DEM_TRIGGER_ON_CONFIRMED
      DemGeneralInterfaceSupport = 1
      DemMaxNumberEventEntryPermanent = 0
      DemMaxNumberPrestoredFF = 0
      DemOBDSupport = DEM_OBD_NO_OBD_SUPPORT
      DemOccurrenceCounterProcessing = DEM_PROCESS_OCCCTR_CDTC
      DemOperationCycleStatusStorage = 0
      DemPTOSupport = 0
      DemResetConfirmedBitOnOverflow = 1
      DemStatusBitHandlingTestFailedSinceLastClear = DEM_STATUS_BIT_AGING_AND_DISPLACEMENT
      DemStatusBitStorageTestFailed = 0
      DemSuppressionSupport = DEM_NO_SUPPRESSION
      DemTaskTime = 0.1
      DemTriggerDcmReports = 1
      DemTriggerDltReports = 1
      DemTriggerFiMReports = 0
      DemTriggerMonitorInitBeforeClearOk = 0
      DemTypeOfDTCSupported = DEM_DTC_TRANSLATION_ISO11992_4
      DemTypeOfFreezeFrameRecordNumeration = DEM_FF_RECNUM_CALCULATED
      DemVersionInfoApi = 1
      DemPrimaryMemory: DemMaxNumberEventEntryPrimary=1
      DemOperationCycle0 (DemOperationCycle): DemOperationCycleAutomaticEnd=0, DemOperationCycleAutostart=0, DemOperationCycleType=DEM_OPCYC_TIME
