AUTOSAR XML (schema 4-0-3)
package /EcuM
  module config EcuM: implementation-config-variant=VARIANT-POST-BUILD
    CommonPublishedInformation:
      ArReleaseMajorVersion = 4
      ArReleaseMinorVersion = 7
      ArReleaseRevisionVersion = 0
      ModuleId = 10
      SwMajorVersion = 3
      SwMinorVersion = 0
      SwPatchVersion = 0
      VendorApiInfix = 43
    EcuMConfiguration
      EcuMCommonConfiguration: EcuMConfigConsistencyHash=1
        EcuMDefaultShutdownTarget: EcuMDefaultState=EcuMStateReset
        4 x EcuMWakeupSource, all with EcuMWakeupSourcePolling=0, EcuMResetReasonRef=MCU_RESET_UNDEFINED:
          ECUM_WKSOURCE_FD_CAN1_RX: EcuMWakeupSourceId=6
          ECUM_WKSOURCE_FD_CAN1_RX_POLL: EcuMWakeupSourceId=7
          ECUM_WKSOURCE_LIN1_RX: EcuMWakeupSourceId=8
          ECUM_WKSOURCE_LIN2_RX: EcuMWakeupSourceId=9
    EcuMGeneral: EcuMDevErrorDetect=1, EcuMIncludeDet=0, EcuMMainFunctionPeriod=0.01, EcuMVersionInfoApi=0
