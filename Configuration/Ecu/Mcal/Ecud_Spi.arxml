AUTOSAR XML (schema 4-0-3)
package /Spi
  module config Spi: implementation-config-variant=VARIANT-PRE-COMPILE, module-description=BswImplementation_Spi
    CommonPublishedInformation:
      ArReleaseMajorVersion = 4
      ArReleaseMinorVersion = 7
      ArReleaseRevisionVersion = 0
      ModuleId = 83
      SwMajorVersion = 3
      SwMinorVersion = 0
      SwPatchVersion = 0
      VendorId = 43
    SpiAutosarExt:
      SpiAllowBigSizeCollections = 0
      SpiDisableDemReportErrorStatus = 1
      SpiEnableDmaFastTransferSupport = 0
      SpiEnableHWUnitAsyncMode = 1
      SpiEnableUserModeSupport = 0
      SpiFlexioEnable = 0
      SpiHalfDuplexModeSupport = 0
      SpiJobStartNotificationEnable = 0
    SpiDemEventParameterRefs: SPI_E_HARDWARE_ERROR=SPI_E_HARDWARE_ERROR
    SpiDriver
      3 x SpiChannel, all with SpiChannelType=IB, SpiDataWidth=8, SpiEbMaxLength=1, SpiIbNBuffers=8, SpiTransferStart=MSB:
        EEP_ADDR_CH: SpiChannelId=0
        EEP_CMD_CH: SpiChannelId=1
        EEP_DATA_CH: SpiChannelId=2
      SpiExternalDevice_0 (SpiExternalDevice):
        SpiBaudrate = 1000000.0
        SpiCsBehavior = CS_KEEP_ASSERTED
        SpiCsIdentifier = PCS0
        SpiCsPolarity = LOW
        SpiDataShiftEdge = LEADING
        SpiDeviceHalfDuplexSupport = 0
        SpiEnableCs = 1
        SpiHwUnit = CSIB0
        SpiShiftClockIdleLevel = HIGH
        SpiTimeClk2Cs = 1.0E-6
        SpiTimeCs2Clk = 1.0E-6
        SpiTimeCs2Cs = 1.0E-6
        SpiCsSelection = CS_VIA_PERIPHERAL_ENGINE
      3 x SpiJob, all with SpiJobPriority=0, SpiDeviceAssignment=SpiExternalDevice_0:
        EEP_JOB_CMD: SpiJobId=0
          SpiChannelList_0 (SpiChannelList): SpiChannelIndex=0, SpiChannelAssignment=EEP_CMD_CH
        EEP_JOB_DATA: SpiJobId=1
          3 x SpiChannelList:
            SpiChannelList0: SpiChannelIndex=0, SpiChannelAssignment=EEP_CMD_CH
            SpiChannelList1: SpiChannelIndex=1, SpiChannelAssignment=EEP_ADDR_CH
            SpiChannelList2: SpiChannelIndex=2, SpiChannelAssignment=EEP_DATA_CH
        EEP_JOB_STAT: SpiJobId=2
          SpiChannelList0 (SpiChannelList): SpiChannelIndex=0, SpiChannelAssignment=EEP_CMD_CH
          SpiChannelList1 (SpiChannelList): SpiChannelIndex=1, SpiChannelAssignment=EEP_DATA_CH
      3 x SpiSequence, all with SpiEnableDmaFastTransfer=0, SpiInterruptibleSequence=0:
        EEP_SEQ_CMD: SpiSequenceId=0, SpiJobAssignment=EEP_JOB_CMD
        EEP_SEQ_DATA: SpiSequenceId=1, SpiJobAssignment=EEP_JOB_DATA
        EEP_SEQ_STAT: SpiSequenceId=2, SpiJobAssignment=EEP_JOB_STAT
    SpiGeneral:
      SpiCancelApi = 1
      SpiChannelBuffersAllowed = 0
      SpiDevErrorDetect = 1
      SpiGlobalDmaEnable = 0
      SpiHwStatusApi = 1
      SpiInterruptibleSeqAllowed = 0
      SpiLevelDelivered = 2
      SpiMulticoreSupport = 0
      SpiSupportConcurrentSyncTransmit = 0
      SpiTimeoutMethod = OSIF_COUNTER_DUMMY
      SpiTransmitTimeout = 50000
      SpiVersionInfoApi = 1
      SpiPhyUnit_0 (SpiPhyUnit):
        SpiPhyUnitAsyncUseDma = 0
        SpiPhyUnitMapping = LPSPI_0
        SpiPhyUnitMode = SPI_MASTER
        SpiPhyUnitSync = 0
        SpiPinConfiguration = 0
        SpiSamplePoint = 0
        SpiPhyUnitClockRef = McuClockReferencePoint_AIPS_PLAT_CLK
    SpiPublishedInformation: SpiMaxHwUnit=0
