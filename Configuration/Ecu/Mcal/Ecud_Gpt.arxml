AUTOSAR XML (schema 4-0-3)
package /Gpt
  module config Gpt: implementation-config-variant=VARIANT-POST-BUILD, module-description=BswImplementation_Gpt
    CommonPublishedInformation:
      ArReleaseMajorVersion = 4
      ArReleaseMinorVersion = 7
      ArReleaseRevisionVersion = 0
      ModuleId = 100
      SwMajorVersion = 3
      SwMinorVersion = 0
      SwPatchVersion = 0
      VendorId = 43
    GptAutosarExt: ChainModeApi=0, GptChangeNextTimeoutValueApi=0, GptEnableDualClockMode=0, GptEnableUserModeSupport=0, GptStandbyWakeupSupport=0
    GptChannelConfigSet
      5 x GptChannelConfiguration, all with GptEnableWakeup=0:
        GptChannelConfiguration_STM: index=0, GptChannelId=0, GptChannelMode=GPT_CH_MODE_ONESHOT, GptChannelTickFrequency=1.2E8, GptChannelTickValueMax=4294967295, GptHwIp=STM, GptChannelClkSrcRef=GptClockReferencePoint_CORE_CLK, GptModuleRef=GptStmChannels_STM
        GptChannelConfiguration_WdgTrig: index=1, GptChannelId=1, GptChannelMode=GPT_CH_MODE_CONTINUOUS, GptChannelTickFrequency=3.0E7, GptChannelTickValueMax=4294967295, GptHwIp=PIT, GptNotification=Wdg_Cbk_GptNotification0, GptChannelClkSrcRef=GptClockReferencePoint_AIPS_SLOW_CLK, GptModuleRef=GptPitChannels_WdgTrig
        GptChannelConfiguration_WdgExt: index=2, GptChannelId=2, GptChannelMode=GPT_CH_MODE_ONESHOT, GptChannelTickFrequency=3.0E7, GptChannelTickValueMax=4294967295, GptHwIp=PIT, GptNotification=Wdg_76_Acw_Cbk_GptNotification, GptChannelClkSrcRef=GptClockReferencePoint_AIPS_SLOW_CLK, GptModuleRef=GptPitChannels_WdgExt
        GptChannelConfiguration_OsDebug: index=4, GptChannelId=3, GptChannelMode=GPT_CH_MODE_ONESHOT, GptChannelTickFrequency=1.2E8, GptChannelTickValueMax=65535, GptHwIp=EMIOS, GptChannelClkSrcRef=GptClockReferencePoint_CORE_CLK, GptModuleRef=GptEmiosChannels_OsDebug
        GptChannelConfiguration_Test: index=5, GptChannelId=4, GptChannelMode=GPT_CH_MODE_CONTINUOUS, GptChannelTickFrequency=1.2E8, GptChannelTickValueMax=65535, GptHwIp=EMIOS, GptNotification=GptChannelConfiguration_IoHwAbTest_Cbk, GptChannelClkSrcRef=GptClockReferencePoint_CORE_CLK, GptModuleRef=GptEmiosChannels_Test
      GptPit_0 (GptPit): GptPitModule=PIT_0, PitFreezeEnable=1
        GptPitChannels_WdgTrig (GptPitChannels): index=0, ChainMode=0, GptPitChannel=CH_0
      GptPit_1 (GptPit): GptPitModule=PIT_1, PitFreezeEnable=1
        GptPitChannels_WdgExt (GptPitChannels): index=0, ChainMode=0, GptPitChannel=CH_0
      GptStm_0 (GptStm): GptStmAlternatePrescaler=1, GptStmModule=STM_0, GptStmPrescaler=1, StmFreezeEnable=1
        GptStmChannels_STM (GptStmChannels): index=0, GptStmChannel=CH_0, StmAbsoluteCounting=0
      GptEmios0 (GptEmios): GptEmiosModule=EMIOS_0
        GptEmiosChannels_OsDebug (GptEmiosChannels): GptEmiosChannel=CH_8, EmiosFreezeEnable=0, GptEmiosPrescaler=1, GptEmiosAlternatePrescaler=1
        GptEmiosChannels_Test (GptEmiosChannels): GptEmiosChannel=CH_16, EmiosFreezeEnable=0, GptEmiosPrescaler=1, GptEmiosAlternatePrescaler=1
    GptConfigurationOfOptApiServices:
      GptDeinitApi = 1
      GptEnableDisableNotificationApi = 1
      GptPredefTimerFunctionalityApi = 1
      GptTimeElapsedApi = 1
      GptTimeRemainingApi = 1
      GptVersionInfoApi = 0
      GptWakeupFunctionalityApi = 1
    GptDriverConfiguration:
      GptDevErrorDetect = 1
      GptMulticoreSupport = 0
      GptPredefTimer100us32bitEnable = 0
      GptPredefTimer1usEnablingGrade = GPT_PREDEF_TIMER_1US_DISABLED
      GptReportWakeupSource = 1
      GptTimeoutDuration = 800
      GptTimeoutMethod = OSIF_COUNTER_DUMMY
      GptClockReferencePoint_AIPS_SLOW_CLK (GptClockReferencePoint): GptClockReference=McuClockReferencePoint_AIPS_SLOW_CLK
      GptClockReferencePoint_CORE_CLK (GptClockReferencePoint): GptClockReference=McuClockReferencePoint_CORE_CLK
    32 x GptHwConfiguration:
      GptHwConfiguration_0: index=0, GptChannelIsUsed=1, GptIsrEnable=1, GptIsrHwId=STM_0_CH_0
      GptHwConfiguration_{1..3}: index={1..3}, GptChannelIsUsed=0, GptIsrEnable=0, GptIsrHwId=STM_0_CH_{1..3}
      GptHwConfiguration_4: index=8, GptChannelIsUsed=0, GptIsrEnable=0, GptIsrHwId=PIT_0_CH_RTI
      GptHwConfiguration_5: index=9, GptChannelIsUsed=1, GptIsrEnable=1, GptIsrHwId=PIT_0_CH_0
      GptHwConfiguration_6: index=10, GptChannelIsUsed=0, GptIsrEnable=0, GptIsrHwId=PIT_0_CH_1
      GptHwConfiguration_7: index=11, GptChannelIsUsed=0, GptIsrEnable=0, GptIsrHwId=PIT_0_CH_2
      GptHwConfiguration_8: index=12, GptChannelIsUsed=0, GptIsrEnable=0, GptIsrHwId=PIT_0_CH_3
      GptHwConfiguration_9: index=13, GptChannelIsUsed=1, GptIsrEnable=1, GptIsrHwId=PIT_1_CH_0
      GptHwConfiguration_10: index=14, GptChannelIsUsed=0, GptIsrEnable=0, GptIsrHwId=PIT_1_CH_1
      GptHwConfiguration_11: index=15, GptChannelIsUsed=0, GptIsrEnable=0, GptIsrHwId=PIT_1_CH_2
      GptHwConfiguration_12: index=16, GptChannelIsUsed=0, GptIsrEnable=0, GptIsrHwId=PIT_1_CH_3
      GptHwConfiguration_13: index=21, GptChannelIsUsed=0, GptIsrEnable=0, GptIsrHwId=EMIOS_0_CH_0
      GptHwConfiguration_14: index=22, GptChannelIsUsed=0, GptIsrEnable=0, GptIsrHwId=EMIOS_0_CH_1
      GptHwConfiguration_15: index=23, GptChannelIsUsed=0, GptIsrEnable=0, GptIsrHwId=EMIOS_0_CH_2
      GptHwConfiguration_16: index=24, GptChannelIsUsed=0, GptIsrEnable=0, GptIsrHwId=EMIOS_0_CH_3
      GptHwConfiguration_17: index=25, GptChannelIsUsed=0, GptIsrEnable=0, GptIsrHwId=EMIOS_0_CH_4
      GptHwConfiguration_18: index=26, GptChannelIsUsed=0, GptIsrEnable=0, GptIsrHwId=EMIOS_0_CH_5
      GptHwConfiguration_19: index=27, GptChannelIsUsed=0, GptIsrEnable=0, GptIsrHwId=EMIOS_0_CH_6
      GptHwConfiguration_20: index=28, GptChannelIsUsed=1, GptIsrEnable=1, GptIsrHwId=EMIOS_0_CH_7
      GptHwConfiguration_21: index=29, GptChannelIsUsed=1, GptIsrEnable=1, GptIsrHwId=EMIOS_0_CH_8
      GptHwConfiguration_22: index=30, GptChannelIsUsed=1, GptIsrEnable=1, GptIsrHwId=EMIOS_0_CH_16
      GptHwConfiguration_23: index=31, GptChannelIsUsed=0, GptIsrEnable=0, GptIsrHwId=EMIOS_0_CH_22
      GptHwConfiguration_24: index=32, GptChannelIsUsed=0, GptIsrEnable=0, GptIsrHwId=EMIOS_0_CH_23
      GptHwConfiguration_25: index=33, GptChannelIsUsed=0, GptIsrEnable=0, GptIsrHwId=EMIOS_1_CH_0
      GptHwConfiguration_26: index=34, GptChannelIsUsed=0, GptIsrEnable=0, GptIsrHwId=EMIOS_1_CH_8
      GptHwConfiguration_27: index=35, GptChannelIsUsed=0, GptIsrEnable=0, GptIsrHwId=EMIOS_1_CH_16
      GptHwConfiguration_28: index=36, GptChannelIsUsed=0, GptIsrEnable=0, GptIsrHwId=EMIOS_1_CH_22
      GptHwConfiguration_29: index=37, GptChannelIsUsed=0, GptIsrEnable=0, GptIsrHwId=EMIOS_1_CH_23
      GptHwConfiguration_30: index=43, GptChannelIsUsed=0, GptIsrEnable=0, GptIsrHwId=RTC_0_CH_0
      GptHwConfiguration_31: index=44, GptChannelIsUsed=0, GptIsrEnable=0, GptIsrHwId=STM_0_PREDEF
    GptPredefTimerConfiguration
