AUTOSAR XML (schema 4-0-3)
package /AUTOSAR
  module config Os: implementation-config-variant=VARIANT-PRE-COMPILE, module-description=BswImplementation_Os
    7 x OsAlarm, all with OsAlarmCounterRef=OsCounter_Main:
      OsAlarm_BSW_5ms_Com
        OsAlarmAction
          OsAlarmActivateTask: OsAlarmActivateTaskRef=OsTask_BSW_FG1_5ms_Com
      OsAlarm_BSW_10ms
        OsAlarmAction
          OsAlarmActivateTask: OsAlarmActivateTaskRef=OsTask_BSW_FG1_10ms
      OsAlarm_ASW_10ms
        OsAlarmAction
          OsAlarmActivateTask: OsAlarmActivateTaskRef=OsTask_ASW_FG1_10ms
      OsAlarm_ASW_100ms
        OsAlarmAction
          OsAlarmActivateTask: OsAlarmActivateTaskRef=OsTask_ASW_FG1_100ms
      OsAlarm_BSW_Mem_Process
        OsAlarmAction
          OsAlarmSetEvent: OsAlarmSetEventRef=OsEvent_BSW_Mem_Process, OsAlarmSetEventTaskRef=OsTask_BSW_Mem_Process
      OsAlarm_BSW_BG_KeyM_Main
        OsAlarmAction
          OsAlarmSetEvent: OsAlarmSetEventRef=OsEvent_BSW_KeyM_Main, OsAlarmSetEventTaskRef=OsTask_BSW_BG_KeyM_Main
      OsAlarm_BSW_BG_Crypto_Main
        OsAlarmAction
          OsAlarmSetEvent: OsAlarmSetEventRef=OsEvent_BSW_Crypto_Main, OsAlarmSetEventTaskRef=OsTask_BSW_BG_Crypto_Main
    OsAppMode0 (OsAppMode)
    OsApplication0 (OsApplication):
      category = TOOL_CONFIGURED
      OsApplicationCoreAssignment = 0
      OsTrusted = 1
      OsApplicationStackSize = 4096
      OsTrustedApplicationDelayTimingViolationCall = 0
      OsTrustedApplicationWithProtection = 0
      OsAppAlarmRef = OsAlarm_ASW_100ms
      OsAppAlarmRef = OsAlarm_ASW_10ms
      OsAppAlarmRef = OsAlarm_BG_Fota
      OsAppAlarmRef = OsAlarm_BSW_10ms
      OsAppAlarmRef = OsAlarm_BSW_5ms_Com
      OsAppAlarmRef = OsAlarm_BSW_BG_Crypto_Main
      OsAppCounterRef = OsCounter_Main
      OsAppIsrRef = Adc_Sar_0_Isr
      OsAppTaskRef = OsTask_ASW_FG1_100ms
      OsAppTaskRef = OsTask_ASW_FG1_10ms
      OsAppTaskRef = OsTask_BSW_FG1_10ms
      OsAppTaskRef = OsTask_BSW_Init
      OsAppTaskRef = OsTask_BSW_Mem_Process
      OsAppTaskRef = OsTask_BSW_FG1_5ms_Com
      OsAppTaskRef = OsTask_BSW_FG3_ComMModeRequest
      OsAppTaskRef = OsTask_BSW_BG_KeyM_Main
      OsAppTaskRef = OsTask_BSW_BG_Crypto_Main
      OsAppTaskRef = OsTask_BSW_FG3_BswM_Action_Main
      OsAppTaskRef = OsTask_BSW_FG2_LinScheduleRequest
      OsAppResourceRef = OsResource_FG1
      OsAppResourceRef = OsResource_FG2
      OsAppIsrRef = Adc_Sar_1_Isr
      OsAppAlarmRef = OsAlarm_BSW_BG_KeyM_Main
      OsAppIsrRef = CAN0_ORED_0_31_MB_IRQHandler
      OsAppIsrRef = CAN0_ORED_32_63_MB_IRQHandler
      OsAppIsrRef = CAN0_ORED_IRQHandler
      OsAppIsrRef = EMIOS0_1_IRQ
      OsAppIsrRef = EMIOS0_4_IRQ
      OsAppIsrRef = EMIOS0_5_IRQ
      OsAppIsrRef = EMIOS1_5_IRQ
      OsAppIsrRef = LPUART0_LIN_IP_RxTx_IRQHandler
      OsAppIsrRef = Mu_Ip_Mu0_OredGP_Isr
      OsAppIsrRef = Mu_Ip_Mu0_OredRx_Isr
      OsAppIsrRef = Mu_Ip_Mu1_OredGP_Isr
      OsApplicationCoreRef = EcucCoreDefinition_Main
      OsAppResourceRef = OsResource_BG
      OsAppIsrRef = Mu_Ip_Mu1_OredRx_Isr
      OsAppIsrRef = PIT_0_ISR
      OsAppIsrRef = PIT_1_ISR
      OsAppIsrRef = STM_0_ISR
      OsAppIsrRef = LPUART5_LIN_IP_RxTx_IRQHandler
      OsAppIsrRef = WKPU_EXT_IRQ_SINGLE_ISR
      OsAppTaskRef = OsTask_BSW_BG_Fota
      OsAppAlarmRef = OsAlarm_BSW_Mem_Process
      OsApplicationHooks0 (OsApplicationHooks): OsAppStartupHook=0, OsAppShutdownHook=0, OsAppErrorHook=0
    OsCounter_Main (OsCounter):
      OsCounterMaxAllowedValue = 0xFFFFFFFF
      OsCounterMinCycle = 1
      OsCounterTicksPerBase = 1
      OsCounterType = HARDWARE
      OsSecondsPerTick = 0.00125
      OsDrivingInterrupt = SYSTICK(0xE000ED23)
    4 x OsEvent:
      OsEvent_BSW_Mem_Process: OsEventMask=0x00000001
      OsEvent_BSW_KeyM_Main: OsEventMask=0x00004000
      OsEvent_BSW_Crypto_Main: OsEventMask=0x00008000
      OsEvent_BSW_BswM_Action_Main: OsEventMask=0x00010000
    19 x OsIsr, all with OsIsrCategory=CATEGORY_2, OsIsrHardwarePriority=3, OsIsrStackSize=800:
      Adc_Sar_0_Isr: OsIsrName=ADC0_IRQn(0xE000E4B4)
      Adc_Sar_1_Isr: OsIsrName=ADC1_IRQn(0xE000E4B5)
      CAN0_ORED_0_31_MB_IRQHandler: OsIsrName=FlexCAN0_1_IRQn(0xE000E46E)
      CAN0_ORED_32_63_MB_IRQHandler: OsIsrName=FlexCAN0_2_IRQn(0xE000E46F)
      CAN0_ORED_IRQHandler: OsIsrName=FlexCAN0_0_IRQn(0xE000E46D)
      EMIOS0_1_IRQ: OsIsrName=EMIOS0_1_IRQn(0xE000E43E)
      EMIOS0_4_IRQ: OsIsrName=EMIOS0_4_IRQn(0xE000E441)
      EMIOS0_5_IRQ: OsIsrName=EMIOS0_5_IRQn(0xE000E442)
      EMIOS1_5_IRQ: OsIsrName=EMIOS1_5_IRQn(0xE000E44A)
      LPUART0_LIN_IP_RxTx_IRQHandler: OsIsrName=LPUART0_IRQn(0xE000E48D)
      Mu_Ip_Mu0_OredGP_Isr: OsIsrName=HSE_MU0_ORED_IRQn(0xE000E4C2)
      Mu_Ip_Mu0_OredRx_Isr: OsIsrName=HSE_MU0_RX_IRQn(0xE000E4C1)
      Mu_Ip_Mu1_OredGP_Isr: OsIsrName=HSE_MU1_ORED_IRQn(0xE000E4C5)
      Mu_Ip_Mu1_OredRx_Isr: OsIsrName=HSE_MU1_RX_IRQn(0xE000E4C4)
      PIT_0_ISR: OsIsrName=PIT0_IRQn(0xE000E460)
      PIT_1_ISR: OsIsrName=PIT1_IRQn(0xE000E461)
      STM_0_ISR: OsIsrName=STM0_IRQn(0xE000E427)
      LPUART5_LIN_IP_RxTx_IRQHandler: OsIsrName=LPUART5_IRQn(0xE000E492)
      WKPU_EXT_IRQ_SINGLE_ISR: OsIsrName=WKPU_IRQn(0xE000E453)
    OsOS:
      OsNumberOfCores = 1
      OsScalabilityClass = SC1
      OsStackMonitoring = 1
      OsStatus = EXTENDED
      OsUseGetServiceId = 1
      OsUseParameterAccess = 1
      OsUseResScheduler = 1
      OsStackFrame = StackFrame8
      OsSystemTimerClock = 120
      OsProcessorSeries = S32K31x
      OsUserStackSize = 4096
      OsProcessor = S32K312
      OsFullReadAccess = 0
      OsFpuSupport = 1
      OsHooks: OsErrorHook=1, OsPostTaskHook=0, OsPreTaskHook=0, OsProtectionHook=0, OsShutdownHook=1, OsStartupHook=1, OsProfilingHook=1
      OsDebug: ORTI=1
    3 x OsResource, all with OsResourceProperty=INTERNAL:
      OsResource_FG1
      OsResource_FG2
      OsResource_BG
    12 x OsTask, all with OsTaskActivation=1, OsTaskSchedule=FULL:
      OsTask_BSW_FG3_ComMModeRequest: OsTaskPriority=254
      OsTask_BSW_FG3_BswM_Action_Main: OsTaskPriority=253, OsTaskStackSize=4000, OsTaskEventRef=OsEvent_BSW_BswM_Action_Main
        OsTaskAutostart: OsTaskAppModeRef=OsAppMode0
      OsTask_BSW_FG2_LinScheduleRequest: OsTaskPriority=219, OsTaskResourceRef=OsResource_FG2
      OsTask_BSW_FG1_5ms_Com: OsTaskPriority=197, OsTaskResourceRef=OsResource_FG1
      OsTask_BSW_FG1_10ms: OsTaskPriority=180, OsTaskResourceRef=OsResource_FG1
      OsTask_ASW_FG1_10ms: OsTaskPriority=140, OsTaskResourceRef=OsResource_FG1
      OsTask_ASW_FG1_100ms: OsTaskPriority=116, OsTaskResourceRef=OsResource_FG1
      OsTask_BSW_Init: OsTaskPriority=99
        OsTaskAutostart: OsTaskAppModeRef=OsAppMode0
      OsTask_BSW_Mem_Process: OsTaskPriority=90, OsTaskStackSize=2000, OsTaskEventRef=OsEvent_BSW_Mem_Process
      OsTask_BSW_BG_Crypto_Main: OsTaskPriority=20, OsTaskStackSize=4000, OsTaskEventRef=OsEvent_BSW_Crypto_Main, OsTaskResourceRef=OsResource_BG
      OsTask_BSW_BG_KeyM_Main: OsTaskPriority=20, OsTaskStackSize=4000, OsTaskEventRef=OsEvent_BSW_KeyM_Main, OsTaskResourceRef=OsResource_BG
      OsTask_BSW_BG_Fota: OsTaskPriority=20, OsTaskStackSize=4000, OsTaskEventRef=OsEvent_BG_Fota, OsTaskResourceRef=OsResource_BG
    OsAlarm_BG_Fota (OsAlarm): OsAlarmCounterRef=OsCounter_Main
      OsAlarmAction
        OsAlarmSetEvent: OsAlarmSetEventRef=OsEvent_BG_Fota, OsAlarmSetEventTaskRef=OsTask_BSW_BG_Fota
    OsEvent_BG_Fota (OsEvent): OsEventMask=0x2000
