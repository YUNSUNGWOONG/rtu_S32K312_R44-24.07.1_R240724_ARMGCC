VERSION ""

NS_ :

BS_:

BU_: ECS Dummy CGW MFC SPAS ESC BSD SCC SAS MDPS HUD CLU

BO_ 165 ESC_02_10ms: 32 ESC
 SG_ ESC_Crc2Val : 0|12@1+ (1,0) [0|0] ""  Dummy,CGW
 SG_ ESC_AlvCnt2Val : 12|4@1+ (1,0) [0|0] ""  Dummy,CGW
 SG_ ESC_LatAccelVal : 16|11@1+ (0.01,-10.23) [0|0] "m/s^2"  Dummy,CGW
 SG_ ESC_LatAccelDiagSta : 27|2@1+ (1,0) [0|0] ""  Dummy,CGW
 SG_ ESC_LatAccelSpdSta : 29|2@1+ (1,0) [0|0] ""  Dummy,CGW
 SG_ ESC_LongAccelSpdVal : 32|11@1+ (0.01,-10.23) [0|0] "m/s^2"  Dummy,CGW
 SG_ ESC_LongAccelDiagSta : 43|2@1+ (1,0) [0|0] ""  Dummy,CGW
 SG_ ESC_LongAccelSpdSta : 45|2@1+ (1,0) [0|0] ""  Dummy,CGW
 SG_ ESC_YawRtVal : 48|13@1+ (0.01,-40.95) [0|0] "˚/s"  Dummy,CGW
 SG_ ESC_YawRtDiagSta : 61|2@1+ (1,0) [0|0] ""  Dummy,CGW
 SG_ ESC_YawRtSta : 64|2@1+ (1,0) [0|0] ""  Dummy,CGW

BO_ 325 ESC_03_20ms: 32 ESC
 SG_ ESC_Crc3Val : 0|12@1+ (1,0) [0|0] ""  Dummy,CGW
 SG_ ESC_AlvCnt3Val : 12|4@1+ (1,0) [0|0] ""  Dummy,CGW
 SG_ ESC_AccelBasisVal : 16|11@1+ (0.01,-10.23) [0|0] "m/s^2"  Dummy,CGW
 SG_ ESC_VehAccelVal : 32|11@1+ (0.01,-10.23) [0|0] "m/s^2"  Dummy,CGW
 SG_ ESC_StdStillVal : 43|2@1+ (1,0) [0|0] ""  Dummy,CGW
 SG_ ESC_BrkLtReq : 48|2@1+ (1,0) [0|0] ""  Dummy,CGW
 SG_ ESC_DclEnblReq : 50|2@1+ (1,0) [0|0] ""  Dummy,CGW
 SG_ ESC_OvrrdeReq : 52|2@1+ (1,0) [0|0] ""  Dummy,CGW
 SG_ ESC_PrkBrkActvSta : 54|2@1+ (1,0) [0|0] ""  Dummy,CGW
 SG_ ESC_DiffBrkFuncSta : 56|2@1+ (1,0) [0|0] ""  Dummy,CGW
 SG_ ESC_DrvBrkActvSta : 58|2@1+ (1,0) [0|0] ""  Dummy,CGW
 SG_ ESC_DrvBrkSta : 60|2@1+ (1,0) [0|0] ""  Dummy,CGW
 SG_ AEB_EquipSta : 62|2@1+ (1,0) [0|0] ""  Dummy,CGW
 SG_ VSM_ConfSwSta : 64|2@1+ (1,0) [0|0] ""  Dummy,CGW
 SG_ VSM_CodedSta : 66|2@1+ (1,0) [0|0] ""  Dummy,CGW
 SG_ VSM_AvlblSta : 68|2@1+ (1,0) [0|0] ""  Dummy,CGW
 SG_ VSM_HndShkSta : 70|2@1+ (1,0) [0|0] ""  Dummy,CGW
 SG_ SCC_TqIntrvntnVal : 72|8@1+ (0.390625,0) [0|0] "%"  Dummy,CGW
 SG_ SCC_OptTyp : 80|2@1+ (1,0) [0|0] ""  Dummy,CGW
 SG_ SCC_EnblReq : 82|2@1+ (1,0) [0|0] ""  Dummy,CGW
 SG_ SCC_TqReq : 84|2@1+ (1,0) [0|0] ""  Dummy,CGW
 SG_ SCC_ReqLimSta : 86|2@1+ (1,0) [0|0] ""  Dummy,CGW

BO_ 1216 CAL_SAS_01_00ms: 32 ESC
 SG_ CAL_SAS_Crc1Val : 0|12@1+ (1,0) [0|0] ""  Dummy
 SG_ CAL_SAS_AlvCnt1Val : 12|4@1+ (1,0) [0|0] ""  Dummy
 SG_ SAS_CmdCodWrdVal : 16|4@1+ (1,0) [0|0] ""  Dummy
 SG_ SAS_CANIdVal : 20|11@1+ (1,0) [0|0] ""  Dummy

BO_ 277 WHL_01_20ms: 32 ESC
 SG_ WHL_Crc1Val : 0|12@1+ (1,0) [0|0] ""  Dummy,CGW
 SG_ WHL_AlvCnt1Val : 12|4@1+ (1,0) [0|0] ""  Dummy,CGW
 SG_ WHL_PlsFLSta : 16|8@1+ (0.5,0) [0|0] "pulse count"  Dummy,CGW
 SG_ WHL_PlsFRSta : 24|8@1+ (0.5,0) [0|0] "pulse count"  Dummy,CGW
 SG_ WHL_PlsRLSta : 32|8@1+ (0.5,0) [0|0] "pulse count"  Dummy,CGW
 SG_ WHL_PlsRRSta : 40|8@1+ (0.5,0) [0|0] "pulse count"  Dummy,CGW
 SG_ WHL_DirFLSta : 48|2@1+ (1,0) [0|0] ""  Dummy,CGW
 SG_ WHL_DirFRSta : 50|2@1+ (1,0) [0|0] ""  Dummy,CGW
 SG_ WHL_DirRLSta : 52|2@1+ (1,0) [0|0] ""  Dummy,CGW
 SG_ WHL_DirRRSta : 54|2@1+ (1,0) [0|0] ""  Dummy,CGW
 SG_ WHL_SpdFLVal : 64|14@1+ (0.03125,0) [0|0] "km/h"  Dummy,CGW
 SG_ WHL_SpdFRVal : 80|14@1+ (0.03125,0) [0|0] "km/h"  Dummy,CGW
 SG_ WHL_SpdRLVal : 96|14@1+ (0.03125,0) [0|0] "km/h"  Dummy,CGW
 SG_ WHL_SpdRRVal : 112|14@1+ (0.03125,0) [0|0] "km/h"  Dummy,CGW

BO_ 117 IVSS_01_10ms: 32 ESC
 SG_ IVSS_Crc1Val : 0|12@1+ (1,0) [0|0] ""  Dummy
 SG_ IVSS_AlvCnt1Val : 12|4@1+ (1,0) [0|0] ""  Dummy
 SG_ IVSS_EcsFLNrmlCurrReq : 16|8@1+ (0.5,0) [0|0] "%"  Dummy
 SG_ IVSS_EcsFRNrmlCurrReq : 24|8@1+ (0.5,0) [0|0] "%"  Dummy
 SG_ IVSS_EcsRLNrmlCurrReq : 32|8@1+ (0.5,0) [0|0] "%"  Dummy
 SG_ IVSS_EcsRRNrmlCurrReq : 40|8@1+ (0.5,0) [0|0] "%"  Dummy
 SG_ IVSS_EcsActvSta : 48|2@1+ (1,0) [0|0] ""  Dummy
 SG_ IVSS_EcsDfctvSta : 50|2@1+ (1,0) [0|0] ""  Dummy
 SG_ IVSS_EmsModSta : 56|2@1+ (1,0) [0|0] ""  Dummy
 SG_ IVSS_TcuModSta : 58|2@1+ (1,0) [0|0] ""  Dummy
 SG_ IVSS_MdpsModSta : 60|2@1+ (1,0) [0|0] ""  Dummy
 SG_ IVSS_EcsModSta : 62|2@1+ (1,0) [0|0] ""  Dummy
 SG_ IVSS_EscModSta : 64|2@1+ (1,0) [0|0] ""  Dummy
 SG_ IVSS_AwdModSta : 66|2@1+ (1,0) [0|0] ""  Dummy
 SG_ IVSS_SmrtShftModSta : 72|2@1+ (1,0) [0|0] ""  Dummy
 SG_ IVSS_DrvngModSta : 74|3@1+ (1,0) [0|0] ""  Dummy
 SG_ IVSS_PtModDis : 80|2@1+ (1,0) [0|0] ""  Dummy
 SG_ IVSS_MdpsModDis : 82|2@1+ (1,0) [0|0] ""  Dummy
 SG_ IVSS_EcsModDis : 84|2@1+ (1,0) [0|0] ""  Dummy
 SG_ IVSS_AwdModDis : 86|2@1+ (1,0) [0|0] ""  Dummy
 SG_ IVSS_EmsModFltSta : 88|2@1+ (1,0) [0|0] ""  Dummy
 SG_ IVSS_TcuModFltSta : 90|2@1+ (1,0) [0|0] ""  Dummy
 SG_ IVSS_MdpsModFltSta : 92|2@1+ (1,0) [0|0] ""  Dummy
 SG_ IVSS_EcsModFltSta : 94|2@1+ (1,0) [0|0] ""  Dummy
 SG_ IVSS_EscModFltSta : 96|2@1+ (1,0) [0|0] ""  Dummy
 SG_ IVSS_AwdModFltSta : 98|2@1+ (1,0) [0|0] ""  Dummy
 SG_ IVSS_DrvngModFltSta : 100|4@1+ (1,0) [0|0] ""  Dummy

BO_ 394 BSD_01_50ms: 32 BSD
 SG_ TCU_VgisInhbtReq_Copy_1 : 190|2@1+ (1,0) [0|0] ""  CGW
 SG_ TCU_VehSpdKphVal_Copy_1 : 88|8@1+ (1,0) [0|0] "km/h"  CGW
 SG_ TCU_TrgtGearSta_Copy_1 : 60|4@1+ (1,0) [0|0] ""  CGW
 SG_ TCU_TqRdctnPcVal_Copy_1 : 32|16@1+ (0.390625,0) [0|0] "%"  CGW
 SG_ TCU_TqCnvrtrSta_Copy_1 : 54|2@1+ (1,0) [0|0] ""  CGW
 SG_ TCU_SprtyIndxSta_Copy_1 : 147|5@1+ (1,0) [0|0] ""  CGW
 SG_ TCU_SmrtShftSta_Copy_1 : 158|2@1+ (1,0) [0|0] ""  CGW
 SG_ TCU_ShftPtrnSta_Copy_1 : 186|4@1+ (1,0) [0|0] ""  CGW
 SG_ TCU_NetrlCtrlSta_Copy_1 : 184|2@1+ (1,0) [0|0] ""  CGW
 SG_ TCU_GearStepTyp_Copy_1 : 48|4@1+ (1,0) [0|0] ""  CGW
 SG_ TCU_GearSlctDis_Copy_1 : 24|4@1+ (1,0) [0|0] ""  CGW
 SG_ TCU_GearShftSta_Copy_1 : 52|2@1+ (1,0) [0|0] ""  CGW
 SG_ TCU_GearLmpBlnkngReq_Copy_1 : 130|2@1+ (1,0) [0|0] ""  CGW
 SG_ TCU_FuelCutInhbtReq_Copy_1 : 132|2@1+ (1,0) [0|0] ""  CGW
 SG_ TCU_EngRpmDisSta_Copy_1 : 128|2@1+ (1,0) [0|3] ""  CGW
 SG_ TCU_EngRpmDis_Copy_1 : 112|16@1+ (0.25,0) [0|0] "rpm"  CGW
 SG_ TCU_DrvngModDis_Copy_1 : 152|3@1+ (1,0) [0|0] ""  CGW
 SG_ TCU_DcmlVehSpdKphVal_Copy_1 : 96|8@1+ (0.0078125,0) [0|0] "km/h"  CGW
 SG_ TCU_CurrGearSta_Copy_1 : 56|4@1+ (1,0) [0|0] ""  CGW
 SG_ TCU_Crc1Val_Copy_1 : 0|16@1+ (1,0) [0|65535] ""  CGW
 SG_ TCU_CluTrgtGearSta_Copy_1 : 64|4@1+ (1,0) [0|0] ""  CGW
 SG_ TCU_AlvCnt1Val_Copy_1 : 16|8@1+ (1,0) [0|255] ""  CGW
 SG_ TCH_EngTrgtGearSta_Copy_1 : 68|4@1+ (1,0) [0|0] ""  CGW

BO_ 368 SCC_01_20ms: 32 SCC
 SG_ SCC_Crc1Val : 0|12@1+ (1,0) [0|0] ""  Dummy,CGW
 SG_ SCC_AlvCnt1Val : 12|4@1+ (1,0) [0|0] ""  Dummy,CGW
 SG_ SCC_ObjDstVal : 16|11@1+ (0.1,0) [0|0] "m"  Dummy,CGW
 SG_ SCC_ObjRelSpdVal : 28|12@1+ (0.1,-170) [0|0] "m/s"  Dummy,CGW
 SG_ SCC_ObjLatPosVal : 40|9@1+ (0.1,-20) [0|0] "m"  Dummy,CGW
 SG_ SCC_SysFlrSta : 56|2@1+ (1,0) [0|0] ""  Dummy,CGW
 SG_ SCC_MainOnOffSta : 58|2@1+ (1,0) [0|0] ""  Dummy,CGW
 SG_ SCC_OpSta : 60|2@1+ (1,0) [0|0] ""  Dummy,CGW
 SG_ SCC_TakeoverReq : 62|2@1+ (1,0) [0|0] ""  Dummy,CGW
 SG_ SCC_InfoDis : 64|3@1+ (1,0) [0|0] ""  Dummy,CGW
 SG_ SCC_DrvAlrtDis : 67|2@1+ (1,0) [0|0] ""  Dummy,CGW
 SG_ SCC_ObjDetSta : 72|2@1+ (1,0) [0|0] ""  Dummy,CGW
 SG_ SCC_HeadwayDstSetVal : 74|3@1+ (1,0) [0|0] ""  Dummy,CGW
 SG_ SCC_EquipSta : 78|2@1+ (1,0) [0|0] ""  Dummy,CGW
 SG_ SCC_TrgtSpdSetVal : 80|8@1+ (1,0) [0|0] "km/h or MPH"  Dummy,CGW
 SG_ SCC_NaviCamOpSta : 96|2@1+ (1,0) [0|0] ""  Dummy,CGW
 SG_ SCC_NaviCamOnOffSta : 98|2@1+ (1,0) [0|0] ""  Dummy,CGW
 SG_ SCC_AccelReqVal : 104|11@1+ (0.01,-10.23) [0|0] "m/s^2"  Dummy,CGW
 SG_ SCC_VehStpReq : 115|2@1+ (1,0) [0|0] ""  Dummy,CGW
 SG_ SCC_SnstvtyModRetVal : 117|3@1+ (1,0) [0|0] ""  Dummy,CGW

BO_ 229 SAS_01_10ms: 32 SAS
 SG_ SAS_Crc1Val : 0|12@1+ (1,0) [0|0] ""  Dummy,CGW
 SG_ SAS_AlvCnt1Val : 12|4@1+ (1,0) [0|0] ""  Dummy,CGW
 SG_ SAS_AnglVal : 16|16@1+ (1,0) [0|0] ""  Dummy,CGW
 SG_ SAS_SpdVal : 32|8@1+ (1,0) [0|0] ""  Dummy,CGW
 SG_ SAS_IntSta : 40|8@1+ (1,0) [0|0] ""  Dummy,CGW

BO_ 170 MDPS_01_10ms: 32 MDPS
 SG_ MDPS_Crc1Val : 0|12@1+ (1,0) [0|0] ""  Dummy,CGW
 SG_ MDPS_AlvCnt1Val : 12|4@1+ (1,0) [0|0] ""  Dummy,CGW
 SG_ MDPS_WrngLmpSta : 16|3@1+ (1,0) [0|0] ""  Dummy,CGW
 SG_ MDPS_Typ : 19|3@1+ (1,0) [0|0] ""  Dummy,CGW
 SG_ MDPS_EngIdleRpmReq : 22|2@1+ (1,0) [0|0] ""  Dummy,CGW
 SG_ MDPS_VsmPlgInSta : 24|2@1+ (1,0) [0|0] "flag"  Dummy,CGW
 SG_ MDPS_DfctvSta : 26|2@1+ (1,0) [0|0] ""  Dummy,CGW
 SG_ MDPS_SigErrSta : 28|2@1+ (1,0) [0|0] ""  Dummy,CGW
 SG_ MDPS_SpasPlugInSta : 32|2@1+ (1,0) [0|0] ""  Dummy,CGW
 SG_ MDPS_SpasModeSta : 34|4@1+ (1,0) [0|0] ""  Dummy,CGW
 SG_ MDPS_LkasPlgInSta : 40|2@1+ (1,0) [0|0] ""  Dummy,CGW
 SG_ MDPS_LkasToiActvSta : 42|2@1+ (1,0) [0|0] ""  Dummy,CGW
 SG_ MDPS_ToiUnblSta : 44|2@1+ (1,0) [0|0] ""  Dummy,CGW
 SG_ MDPS_ToiFltSta : 46|2@1+ (1,0) [0|0] ""  Dummy,CGW
 SG_ MDPS_LkasFailSta : 48|2@1+ (1,0) [0|0] ""  Dummy,CGW
 SG_ MDPS_FlxStrSta : 56|3@1+ (1,0) [0|0] ""  Dummy,CGW
 SG_ MDPS_FlxStrDis : 59|2@1+ (1,0) [0|0] ""  Dummy,CGW
 SG_ MDPS_CurrModVal : 61|3@1+ (1,0) [0|0] ""  Dummy,CGW
 SG_ MDPS_OutTqVal : 64|12@1+ (0.1,-204.8) [0|0] ""  Dummy,CGW
 SG_ MDPS_StrTqSnsrVal : 80|13@1+ (0.005,-20.48) [0|0] "Nm"  Dummy,CGW
 SG_ MDPS_StrAnglVal : 96|16@1- (0.1,0) [0|0] "Deg"  Dummy,CGW

BO_ 586 HUD_01_100ms: 32 HUD
 SG_ HUD_Crc1Val : 0|12@1+ (1,0) [0|0] ""  Dummy
 SG_ HUD_AlvCnt1Val : 12|4@1+ (1,0) [0|0] ""  Dummy
 SG_ HUD_HghtSta : 16|5@1+ (1,0) [0|0] ""  Dummy
 SG_ HUD_PbackSta : 24|3@1+ (1,0) [0|0] ""  Dummy
 SG_ HUD_BrgtnsSta : 32|5@1+ (1,0) [0|0] ""  Dummy
 SG_ HUD_RotatSta : 40|5@1+ (1,0) [0|0] ""  Dummy

BO_ 378 CLU_01_20ms: 32 CLU
 SG_ CLU_Crc1Val : 0|16@1+ (1,0) [0|65535] ""  Dummy,CGW
 SG_ CLU_AlvCnt1Val : 16|8@1+ (1,0) [0|255] ""  Dummy,CGW
 SG_ CLU_PrtyBitSta : 16|2@1+ (1,0) [0|0] "pulse count"  Dummy
 SG_ CLU_PasDisTyp : 24|2@1+ (1,0) [0|0] ""  Dummy,CGW
 SG_ CLU_DtntOutSta : 26|2@1+ (1,0) [0|0] ""  Dummy,CGW
 SG_ CLU_SpdUnitTyp : 28|2@1+ (1,0) [0|0] ""  Dummy,CGW
 SG_ CLU_DisSpdDcmlVal : 30|2@1+ (0.125,0) [0|0] ""  Dummy,CGW
 SG_ CLU_CrsMainSwSta : 32|3@1+ (1,0) [0|0] ""  Dummy,CGW
 SG_ CLU_RhstaLvlSta : 35|5@1+ (1,0) [0|0] ""  Dummy,CGW
 SG_ CLU_DisSpdVal : 40|9@1+ (0.5,0) [0|0] "km/h or MPH"  Dummy,CGW

BO_ 469 CLU_02_100ms: 32 CLU
 SG_ CLU_Crc2Val : 0|12@1+ (1,0) [0|0] ""  Dummy,CGW
 SG_ CLU_AlvCnt2Val : 12|4@1+ (1,0) [0|0] ""  Dummy,CGW
 SG_ CLU_DrvModSwSta : 24|2@1+ (1,0) [0|0] ""  Dummy,CGW
 SG_ CLU_DrvngModSwSta : 26|3@1+ (1,0) [0|0] ""  Dummy,CGW
 SG_ CLU_SRSWrngLmpSta : 29|3@1+ (1,0) [0|0] ""  Dummy,CGW
 SG_ CLU_DTEVal : 32|10@1+ (1,0) [0|0] ""  Dummy,CGW
 SG_ CLU_AltLSta : 42|2@1+ (1,0) [0|0] ""  Dummy,CGW
 SG_ CLU_SndTyp : 44|2@1- (1,0) [0|0] ""  Dummy,CGW
 SG_ CLU_TripUnitSta : 46|2@1+ (1,0) [0|0] ""  Dummy,CGW
 SG_ CLU_AvgFuelCnsmptnVal : 48|10@1+ (0.1,0) [0|0] ""  Dummy,CGW
 SG_ CLU_AvgFuelCnsmptnUnitSta : 58|2@1+ (1,0) [0|0] ""  Dummy,CGW
 SG_ CLU_LoFuelWrngSta : 60|2@1+ (1,0) [0|0] ""  Dummy,CGW
 SG_ CLU_RefuelDetSta : 62|2@1+ (1,0) [0|0] ""  Dummy,CGW
 SG_ CLU_FuelLvlDisVal : 64|5@1+ (1,0) [0|0] ""  Dummy,CGW
 SG_ CLU_LngSta : 72|5@1+ (1,0) [0|0] ""  Dummy,CGW
 SG_ CLU_OdoVal : 80|24@1+ (0.1,0) [0|0] "km"  Dummy,CGW

BO_ 778 CLU_03_200ms: 32 CLU
 SG_ CLU_Crc3Val : 0|12@1+ (1,0) [0|0] ""  Dummy
 SG_ CLU_AlvCnt3Val : 12|4@1+ (1,0) [0|0] ""  Dummy
 SG_ VCRM_CluDISWrngSta : 16|2@1+ (1,0) [0|0] ""  Dummy
 SG_ VCRM_CluFuelConsmptnUnitSta : 18|2@1+ (1,0) [0|0] ""  Dummy
 SG_ VCRM_CluGearPosPopupSta : 20|2@1+ (1,0) [0|0] ""  Dummy
 SG_ VCRM_CluMFSWPopupSta : 22|2@1+ (1,0) [0|0] ""  Dummy
 SG_ VCRM_CluSrvRmndrSta : 24|2@1+ (1,0) [0|0] ""  Dummy
 SG_ VCRM_CluSpdmtrSta : 26|2@1+ (1,0) [0|0] ""  Dummy
 SG_ VCRM_CluStrWhlAlignSta : 28|2@1+ (1,0) [0|0] ""  Dummy
 SG_ VCRM_CluWlcmSndSta : 30|2@1+ (1,0) [0|0] ""  Dummy
 SG_ VCRM_CluDisGrpSta : 32|4@1+ (1,0) [0|0] ""  Dummy
 SG_ VCRM_CluDisModSta : 36|4@1+ (1,0) [0|0] ""  Dummy
 SG_ VCRM_CluAvgFuelCnsmptnAutoRstSta : 40|3@1+ (1,0) [0|0] ""  Dummy
 SG_ VCRM_CluTxtSizeSta : 43|3@1+ (1,0) [0|0] ""  Dummy
 SG_ VCRM_CluLngSetSta : 48|6@1+ (1,0) [0|0] ""  Dummy
 SG_ VCRM_CluSrvRmndrDaySta : 56|7@1+ (1,0) [0|0] ""  Dummy
 SG_ VCRM_CluSrvRmndrDstSta : 64|10@1+ (1,0) [0|0] ""  Dummy
 SG_ VCRM_CluVcAlrmVolSta : 74|3@1+ (1,0) [0|0] ""  Dummy

BO_ 1194 CLU_04_00ms: 32 CLU
 SG_ CLU_Crc4Val : 0|12@1+ (1,0) [0|0] ""  Dummy
 SG_ CLU_AlvCnt4Val : 12|4@1+ (1,0) [0|0] ""  Dummy
 SG_ USM_HudBrgtnsDnReq : 16|2@1+ (1,0) [0|0] ""  Dummy
 SG_ USM_HudBrgtnsUpReq : 18|2@1+ (1,0) [0|0] ""  Dummy
 SG_ USM_HudFntClrReq : 20|2@1+ (1,0) [0|0] ""  Dummy
 SG_ USM_HudFntSizeReq : 22|2@1+ (1,0) [0|0] ""  Dummy
 SG_ USM_HudHghtDnReq : 24|2@1+ (1,0) [0|0] ""  Dummy
 SG_ USM_HudHghtUpReq : 26|2@1+ (1,0) [0|0] ""  Dummy
 SG_ USM_HudRotatDnReq : 28|2@1+ (1,0) [0|0] ""  Dummy
 SG_ USM_HudRotatUpReq : 30|2@1+ (1,0) [0|0] ""  Dummy
 SG_ USM_HudDisReq : 32|2@1+ (1,0) [0|0] ""  Dummy
 SG_ USM_HudInfoTBTReq : 34|2@1+ (1,0) [0|0] ""  Dummy
 SG_ USM_HudInfoDISReq : 36|2@1+ (1,0) [0|0] ""  Dummy
 SG_ USM_HudInfoSCCReq : 38|2@1+ (1,0) [0|0] ""  Dummy
 SG_ USM_HudInfoCCReq : 40|2@1+ (1,0) [0|0] ""  Dummy
 SG_ USM_HudInfoLDWSReq : 42|2@1+ (1,0) [0|0] ""  Dummy
 SG_ USM_HudInfoBSDReq : 44|2@1+ (1,0) [0|0] ""  Dummy

BO_ 1184 CLU_05_00ms: 32 CLU
 SG_ CLU_Crc5Val : 0|12@1+ (1,0) [0|0] ""  Dummy,CGW
 SG_ CLU_AlvCnt5Val : 12|4@1+ (1,0) [0|0] ""  Dummy,CGW
 SG_ USM_AutoDrLkSetReq : 16|3@1+ (1,0) [0|0] ""  Dummy,CGW
 SG_ USM_AutoDrUnlckSetReq : 19|3@1+ (1,0) [0|0] ""  Dummy,CGW
 SG_ USM_HLmpEscrtSetReq : 22|2@1+ (1,0) [0|0] ""  Dummy,CGW
 SG_ USM_DrLkSndSetReq : 24|3@1+ (1,0) [0|0] ""  Dummy,CGW
 SG_ USM_FcwModSetReq : 27|3@1+ (1,0) [0|0] ""  Dummy,CGW
 SG_ USM_FcwSetReq : 30|2@1+ (1,0) [0|0] ""  Dummy,CGW
 SG_ USM_SmrtTrnkSetReq : 32|3@1+ (1,0) [0|0] ""  Dummy,CGW
 SG_ USM_MdLmpSetReq : 35|3@1+ (1,0) [0|0] ""  Dummy,CGW
 SG_ USM_HrnAnswerBckSetReq : 38|2@1+ (1,0) [0|0] ""  Dummy,CGW
 SG_ USM_OneTouchTrplTrnSetReq : 40|3@1+ (1,0) [0|0] ""  Dummy,CGW
 SG_ USM_PasSpkrVolLvlSetReq : 43|3@1+ (1,0) [0|0] ""  Dummy,CGW
 SG_ USM_BsdSndWarnSetReq : 46|2@1+ (1,0) [0|0] ""  Dummy,CGW
 SG_ USM_PsmSetReq : 48|3@1+ (1,0) [0|0] ""  Dummy,CGW
 SG_ USM_SccDrvSetReq : 51|3@1+ (1,0) [0|0] ""  Dummy,CGW
 SG_ USM_LkasSetReq : 54|2@1+ (1,0) [0|0] ""  Dummy,CGW
 SG_ USM_PtgmSetReq : 56|2@1+ (1,0) [0|0] ""  Dummy,CGW
 SG_ USM_RctaSetReq : 58|2@1+ (1,0) [0|0] ""  Dummy,CGW
 SG_ USM_RcwSetReq : 60|2@1+ (1,0) [0|0] ""  Dummy,CGW
 SG_ USM_SccAebSetReq : 62|2@1+ (1,0) [0|0] ""  Dummy,CGW
 SG_ USM_SccNAviCamSetReq : 64|2@1+ (1,0) [0|0] ""  Dummy,CGW
 SG_ USM_SccNaviCurveSetReq : 66|2@1+ (1,0) [0|0] ""  Dummy,CGW
 SG_ USM_ScmSetReq : 68|2@1+ (1,0) [0|0] ""  Dummy,CGW
 SG_ USM_OSTempUnitSetReq : 70|2@1+ (1,0) [0|0] ""  Dummy,CGW
 SG_ USM_TfrChgSetReq : 72|2@1+ (1,0) [0|0] ""  Dummy,CGW
 SG_ USM_TwoTrnUnlckSetReq : 74|2@1+ (1,0) [0|0] ""  Dummy,CGW
 SG_ USM_WlcmLtSetReq : 76|2@1+ (1,0) [0|0] ""  Dummy,CGW

BO_ 1189 CLU_06_00ms: 32 CLU
 SG_ CLU_Crc6Val : 0|12@1+ (1,0) [0|0] ""  Dummy,CGW
 SG_ CLU_AlvCnt6Val : 12|4@1+ (1,0) [0|0] ""  Dummy,CGW
 SG_ USM_AAsstSetReq : 16|3@1+ (1,0) [0|0] ""  Dummy,CGW
 SG_ USM_Aeb1stWrngSetReq : 19|3@1+ (1,0) [0|0] ""  Dummy,CGW
 SG_ USM_ECoastSetReq : 22|2@1+ (1,0) [0|0] ""  Dummy,CGW
 SG_ USM_AutoLtSnsbltySetReq : 24|3@1+ (1,0) [0|0] ""  Dummy,CGW
 SG_ USM_HealthcareIMSModReq : 27|3@1+ (1,0) [0|0] ""  Dummy,CGW
 SG_ USM_ECoastingWrngSndSetReq : 30|2@1+ (1,0) [0|0] ""  Dummy,CGW
 SG_ USM_MdLmpBrgtnsSetReq : 32|3@1+ (1,0) [0|0] ""  Dummy,CGW
 SG_ USM_TirePrsrUnitSetReq : 35|3@1+ (1,0) [0|0] ""  Dummy,CGW
 SG_ USM_FuelGdRstReq : 38|2@1+ (1,0) [0|0] ""  Dummy,CGW
 SG_ USM_HealthcareIMSHghtSetReq : 40|4@1+ (1,0) [0|0] ""  Dummy,CGW
 SG_ USM_HealthcareIMSSitHghtSetReq : 44|4@1+ (1,0) [0|0] ""  Dummy,CGW
 SG_ USM_HealthcareIMSWghtSetReq : 48|4@1+ (1,0) [0|0] ""  Dummy,CGW
 SG_ USM_MdLmpClrSetReq : 52|4@1+ (1,0) [0|0] ""  Dummy,CGW
 SG_ USM_HADSetReq : 56|2@1+ (1,0) [0|0] ""  Dummy,CGW
 SG_ USM_RrWiperRevSetReq : 58|2@1+ (1,0) [0|0] ""  Dummy,CGW
 SG_ USM_SlifSetReq : 60|2@1+ (1,0) [0|0] ""  Dummy,CGW
 SG_ USM_StaRstReq : 62|2@1+ (1,0) [0|0] ""  Dummy,CGW
 SG_ USM_RrWpcSetReq : 64|2@1+ (1,0) [0|0] ""  Dummy,CGW
 SG_ USM_WpcSetReq : 66|2@1+ (1,0) [0|0] ""  Dummy,CGW

BO_ 373 AWD_01_20ms: 32 CGW
 SG_ AWD_ErrCodeVal : 20|8@1+ (1,0) [0|0] ""  Dummy
 SG_ AWD_OpModLkSta : 60|2@1+ (1,0) [0|0] ""  Dummy
 SG_ AWD_SysOpSta : 174|8@1+ (1,0) [0|0] ""  Dummy

BO_ 149 EMS_01_10ms: 32 CGW
 SG_ ENG_EngSpdErrSta : 16|2@1+ (1,0) [0|0] ""  Dummy
 SG_ ENG_MafErrSta : 18|2@1+ (1,0) [0|0] ""  Dummy
 SG_ ENG_EngSpdVal : 20|16@1+ (0.25,0) [0|0] "rpm"  Dummy
 SG_ ENG_CrctEngTqVal : 36|8@1+ (0.390625,0) [0|0] "%"  Dummy
 SG_ ENG_IndTqVal : 60|8@1+ (0.390625,0) [0|0] "%"  Dummy
 SG_ ENG_IsgSta : 87|3@1+ (1,0) [0|0] ""  Dummy
 SG_ ENG_OilLvlSta : 90|2@1+ (1,0) [0|0] ""  Dummy
 SG_ ENG_GearShftUpDis : 102|2@1+ (1,0) [0|0] ""  Dummy
 SG_ ENG_GearShftDnDis : 104|2@1+ (1,0) [0|0] ""  Dummy
 SG_ ENG_DsrGearPosDis : 106|4@1+ (1,0) [0|0] ""  Dummy
 SG_ ENG_SldFuncSta : 110|2@1+ (1,0) [0|0] ""  Dummy
 SG_ ENG_IsgBzrReq : 116|2@1+ (1,0) [0|0] ""  Dummy
 SG_ ENG_Isg2Sta : 126|2@1+ (2,0) [0|0] ""  Dummy
 SG_ ENG_IgnOnSta : 128|2@1+ (1,0) [0|0] ""  Dummy
 SG_ ENG_FuelCutOffSta : 132|2@1+ (1,0) [0|0] ""  Dummy
 SG_ ENG_VehSpdLimVal : 138|8@1+ (1,0) [0|0] "km/h"  Dummy
 SG_ ENG_VehSpdVal : 146|8@1+ (1,0) [0|0] "km/h"  Dummy
 SG_ ENG_FuelCnsmptVal : 162|16@1+ (0.128,0) [0|0] "ul"  Dummy
 SG_ ENG_VehSpdHiVal : 188|12@1+ (0.0625,0) [0|0] "km/h"  Dummy
 SG_ ENG_LnchCntrlSta : 200|3@1+ (1,0) [0|0] ""  Dummy

BO_TX_BU_ 394 : CLU,Dummy,BSD;
BA_DEF_ BO_  "NmAsrMessage" ENUM  "No","Yes";
BA_DEF_ BO_  "GenMsgCycleTime" INT 0 2000;
BA_DEF_ BO_  "GenMsgSendType" ENUM  "Cyclic","NoMsgSendType";
BA_DEF_ BO_  "GenMsgCycleTimeFast" INT 0 500;
BA_DEF_ BO_  "GenMsgDelayTime" INT 0 20;
BA_DEF_ BO_  "GenMsgILSupport" ENUM  "No","Yes";
BA_DEF_ BO_  "GenMsgNrOfRepetition" INT 0 3;
BA_DEF_ BO_  "VFrameFormat" ENUM  "StandardCAN","ExtendedCAN","reserved","reserved","reserved","reserved","reserved","reserved","reserved","reserved","reserved","reserved","reserved","reserved","StandardCAN_FD","ExtendedCAN_FD";
BA_DEF_ SG_  "SignalLongName" STRING ;
BA_DEF_ SG_  "UserSigValidity" ENUM  "B+","ACC","IG","IG1","IG2","IG3","IG1 or IG2","IG1 or IG3","Undef";
BA_DEF_ SG_  "GenSigTimeoutTime" INT 0 7000;
BA_DEF_ SG_  "UsrSigTimeoutValue" STRING ;
BA_DEF_ SG_  "UsrSigPurpose" ENUM  "Undef","FN","DIAG","DEV","NM";
BA_DEF_ SG_  "GenSigStartValue" INT 0 1215752192;
BA_DEF_ SG_  "NetworkRequest" ENUM  "Yes","No";
BA_DEF_ SG_  "NetworkRequestHoldingTime" INT 0 65535;
BA_DEF_ SG_  "Description" STRING ;
BA_DEF_ SG_  "Version" STRING ;
BA_DEF_ SG_  "GenSigEnvVarType" ENUM  "Int","Float","Undef";
BA_DEF_ SG_  "GenSigSendType" ENUM  "OnChangeWithRepetition","OnWriteWithRepetition","NoSigSendType";
BA_DEF_ SG_  "GwSigLatencyTime" INT 0 65536;
BA_DEF_ SG_  "GwSigMissingSourceType" ENUM  "Undef","OldValue","DefaultValue","InitialValue";
BA_DEF_ SG_  "RoutingFactor" INT 1 1215752192;
BA_DEF_ SG_  "RoutingFactorMM" INT 1 1215752192;
BA_DEF_DEF_  "NmAsrMessage" "No";
BA_DEF_DEF_  "GenMsgCycleTime" 200;
BA_DEF_DEF_  "GenMsgSendType" "NoMsgSendType";
BA_DEF_DEF_  "GenMsgCycleTimeFast" 40;
BA_DEF_DEF_  "GenMsgDelayTime" 20;
BA_DEF_DEF_  "GenMsgILSupport" "Yes";
BA_DEF_DEF_  "GenMsgNrOfRepetition" 3;
BA_DEF_DEF_  "VFrameFormat" "StandardCAN";
BA_DEF_DEF_  "SignalLongName" "";
BA_DEF_DEF_  "UserSigValidity" "IG";
BA_DEF_DEF_  "GenSigTimeoutTime" 500;
BA_DEF_DEF_  "UsrSigTimeoutValue" "Undef";
BA_DEF_DEF_  "UsrSigPurpose" "FN";
BA_DEF_DEF_  "GenSigStartValue" 0;
BA_DEF_DEF_  "NetworkRequest" "No";
BA_DEF_DEF_  "NetworkRequestHoldingTime" 5.03070881554866E-316;
BA_DEF_DEF_  "Description" "";
BA_DEF_DEF_  "Version" "";
BA_DEF_DEF_  "GenSigEnvVarType" "Undef";
BA_DEF_DEF_  "GenSigSendType" "NoSigSendType";
BA_DEF_DEF_  "GwSigLatencyTime" 40;
BA_DEF_DEF_  "GwSigMissingSourceType" "Undef";
BA_DEF_DEF_  "RoutingFactor" 1;
BA_DEF_DEF_  "RoutingFactorMM" 1;
BA_ "GenMsgSendType" BO_ 165 0;
BA_ "GenMsgCycleTime" BO_ 165 10;
BA_ "VFrameFormat" BO_ 165 14;
BA_ "GenMsgSendType" BO_ 325 0;
BA_ "GenMsgCycleTime" BO_ 325 20;
BA_ "VFrameFormat" BO_ 325 14;
BA_ "GenMsgCycleTime" BO_ 1216 0;
BA_ "VFrameFormat" BO_ 1216 14;
BA_ "GenMsgSendType" BO_ 277 0;
BA_ "GenMsgCycleTime" BO_ 277 20;
BA_ "VFrameFormat" BO_ 277 14;
BA_ "GenMsgSendType" BO_ 117 0;
BA_ "GenMsgCycleTime" BO_ 117 10;
BA_ "VFrameFormat" BO_ 117 14;
BA_ "GenMsgSendType" BO_ 394 0;
BA_ "GenMsgCycleTime" BO_ 394 50;
BA_ "VFrameFormat" BO_ 394 14;
BA_ "GenMsgSendType" BO_ 368 0;
BA_ "GenMsgCycleTime" BO_ 368 20;
BA_ "VFrameFormat" BO_ 368 14;
BA_ "GenMsgSendType" BO_ 229 0;
BA_ "GenMsgCycleTime" BO_ 229 10;
BA_ "VFrameFormat" BO_ 229 14;
BA_ "GenMsgSendType" BO_ 170 0;
BA_ "GenMsgCycleTime" BO_ 170 10;
BA_ "VFrameFormat" BO_ 170 14;
BA_ "GenMsgSendType" BO_ 586 0;
BA_ "GenMsgCycleTime" BO_ 586 100;
BA_ "VFrameFormat" BO_ 586 14;
BA_ "GenMsgSendType" BO_ 378 0;
BA_ "GenMsgCycleTime" BO_ 378 20;
BA_ "VFrameFormat" BO_ 378 14;
BA_ "GenMsgSendType" BO_ 469 0;
BA_ "GenMsgCycleTime" BO_ 469 100;
BA_ "VFrameFormat" BO_ 469 14;
BA_ "GenMsgSendType" BO_ 778 0;
BA_ "VFrameFormat" BO_ 778 14;
BA_ "GenMsgCycleTime" BO_ 1194 0;
BA_ "VFrameFormat" BO_ 1194 14;
BA_ "GenMsgCycleTime" BO_ 1184 0;
BA_ "VFrameFormat" BO_ 1184 14;
BA_ "GenMsgCycleTime" BO_ 1189 0;
BA_ "VFrameFormat" BO_ 1189 14;
BA_ "GenMsgSendType" BO_ 373 0;
BA_ "GenMsgCycleTime" BO_ 373 20;
BA_ "VFrameFormat" BO_ 373 14;
BA_ "GenMsgSendType" BO_ 149 0;
BA_ "GenMsgCycleTime" BO_ 149 10;
BA_ "VFrameFormat" BO_ 149 14;
BA_ "Version" SG_ 165 ESC_Crc2Val "1.0";
BA_ "GenSigStartValue" SG_ 165 ESC_Crc2Val 4095;
BA_ "UsrSigTimeoutValue" SG_ 165 ESC_Crc2Val "";
BA_ "UserSigValidity" SG_ 165 ESC_Crc2Val 3;
BA_ "SignalLongName" SG_ 165 ESC_Crc2Val "ESC_Crc2Value";
BA_ "Version" SG_ 165 ESC_AlvCnt2Val "1.0";
BA_ "UsrSigTimeoutValue" SG_ 165 ESC_AlvCnt2Val "";
BA_ "UserSigValidity" SG_ 165 ESC_AlvCnt2Val 3;
BA_ "SignalLongName" SG_ 165 ESC_AlvCnt2Val "ESC_AliveCounter2Value";
BA_ "Version" SG_ 165 ESC_LatAccelVal "1.0";
BA_ "Description" SG_ 165 ESC_LatAccelVal "This signal indicates lateral acceleration speed information.";
BA_ "UsrSigTimeoutValue" SG_ 165 ESC_LatAccelVal "";
BA_ "UserSigValidity" SG_ 165 ESC_LatAccelVal 3;
BA_ "SignalLongName" SG_ 165 ESC_LatAccelVal "ESC_LateralAccelerationValue";
BA_ "Version" SG_ 165 ESC_LatAccelDiagSta "1.0";
BA_ "Description" SG_ 165 ESC_LatAccelDiagSta "This signal indicates self-diagnosis mode of lateral acceleration signal. During system check, lateral acceleration speed information cannot be sent(not available) and this bit should be set to 1.";
BA_ "GenSigStartValue" SG_ 165 ESC_LatAccelDiagSta 1;
BA_ "UsrSigTimeoutValue" SG_ 165 ESC_LatAccelDiagSta "";
BA_ "UserSigValidity" SG_ 165 ESC_LatAccelDiagSta 3;
BA_ "SignalLongName" SG_ 165 ESC_LatAccelDiagSta "ESC_LateralAccelerationDiagnosticStatus";
BA_ "Version" SG_ 165 ESC_LatAccelSpdSta "1.0";
BA_ "Description" SG_ 165 ESC_LatAccelSpdSta "This signal indicates validity of LAT_ACCEL signal. If acceleration signal is invalid, this signal shall be set to 1.";
BA_ "GenSigStartValue" SG_ 165 ESC_LatAccelSpdSta 1;
BA_ "UsrSigTimeoutValue" SG_ 165 ESC_LatAccelSpdSta "";
BA_ "UserSigValidity" SG_ 165 ESC_LatAccelSpdSta 3;
BA_ "SignalLongName" SG_ 165 ESC_LatAccelSpdSta "ESC_LateralAccelerationSpeedStatus";
BA_ "Version" SG_ 165 ESC_LongAccelSpdVal "1.0";
BA_ "Description" SG_ 165 ESC_LongAccelSpdVal "This signal indicates longitudinal acceleration speed information. 

This signal is offset calibrated value that can cover minimum ±0.07G range offset by installation. 

If calibration process is missed or failed, then this signal send 0x7FF data as err";
BA_ "UsrSigTimeoutValue" SG_ 165 ESC_LongAccelSpdVal "";
BA_ "UserSigValidity" SG_ 165 ESC_LongAccelSpdVal 3;
BA_ "SignalLongName" SG_ 165 ESC_LongAccelSpdVal "ESC_LongitudinalAccelerationSpeedValue";
BA_ "Version" SG_ 165 ESC_LongAccelDiagSta "1.0";
BA_ "Description" SG_ 165 ESC_LongAccelDiagSta "This signal indicates self-diagnosis mode of longitudinal acceleration signal. During system check, longitudinal acceleration speed information cannot be sent(not available) and this bit should be set to 1.";
BA_ "GenSigStartValue" SG_ 165 ESC_LongAccelDiagSta 1;
BA_ "UsrSigTimeoutValue" SG_ 165 ESC_LongAccelDiagSta "";
BA_ "UserSigValidity" SG_ 165 ESC_LongAccelDiagSta 3;
BA_ "SignalLongName" SG_ 165 ESC_LongAccelDiagSta "ESC_LongitudinalAccelerationDiagnosticStatus";
BA_ "Version" SG_ 165 ESC_LongAccelSpdSta "1.0";
BA_ "Description" SG_ 165 ESC_LongAccelSpdSta "This signal indicates validity of LONG_ACCEL signal. If acceleration signal is invalid, this signal shall be set to 1.";
BA_ "GenSigStartValue" SG_ 165 ESC_LongAccelSpdSta 1;
BA_ "UsrSigTimeoutValue" SG_ 165 ESC_LongAccelSpdSta "";
BA_ "UserSigValidity" SG_ 165 ESC_LongAccelSpdSta 3;
BA_ "SignalLongName" SG_ 165 ESC_LongAccelSpdSta "ESC_LongitudinalAccelerationSpeedStatus";
BA_ "Version" SG_ 165 ESC_YawRtVal "1.0";
BA_ "Description" SG_ 165 ESC_YawRtVal "The yaw rate signal provides information about the lateral motion of a vehicle and is used to calculate the curvature of the current vehicle trajectory. This signal is essential to SCC control in curves or during lane changes. If the demanded requirement";
BA_ "UsrSigTimeoutValue" SG_ 165 ESC_YawRtVal "";
BA_ "UserSigValidity" SG_ 165 ESC_YawRtVal 3;
BA_ "SignalLongName" SG_ 165 ESC_YawRtVal "ESC_YawRateValue";
BA_ "Version" SG_ 165 ESC_YawRtDiagSta "1.0";
BA_ "Description" SG_ 165 ESC_YawRtDiagSta "This signal indicates self-diagnosis mode of yaw rate sensor. During system check, yaw rate information cannot be sent(not available) and this bit should be set to 1.";
BA_ "GenSigStartValue" SG_ 165 ESC_YawRtDiagSta 1;
BA_ "UsrSigTimeoutValue" SG_ 165 ESC_YawRtDiagSta "";
BA_ "UserSigValidity" SG_ 165 ESC_YawRtDiagSta 3;
BA_ "SignalLongName" SG_ 165 ESC_YawRtDiagSta "ESC_YawRateSensorDiagnosisStatus";
BA_ "Version" SG_ 165 ESC_YawRtSta "1.0";
BA_ "Description" SG_ 165 ESC_YawRtSta "This signal indicates validity of YAW_RATE signal. If yaw rate sensor signal is invalid, this signal shall be set to 1.";
BA_ "GenSigStartValue" SG_ 165 ESC_YawRtSta 1;
BA_ "UsrSigTimeoutValue" SG_ 165 ESC_YawRtSta "";
BA_ "UserSigValidity" SG_ 165 ESC_YawRtSta 3;
BA_ "SignalLongName" SG_ 165 ESC_YawRtSta "ESC_YawRateStatus";
BA_ "Version" SG_ 325 ESC_Crc3Val "1.0";
BA_ "GenSigStartValue" SG_ 325 ESC_Crc3Val 4095;
BA_ "UsrSigTimeoutValue" SG_ 325 ESC_Crc3Val "";
BA_ "UserSigValidity" SG_ 325 ESC_Crc3Val 3;
BA_ "SignalLongName" SG_ 325 ESC_Crc3Val "ESC_Crc3Value";
BA_ "Version" SG_ 325 ESC_AlvCnt3Val "1.0";
BA_ "UsrSigTimeoutValue" SG_ 325 ESC_AlvCnt3Val "";
BA_ "UserSigValidity" SG_ 325 ESC_AlvCnt3Val 3;
BA_ "SignalLongName" SG_ 325 ESC_AlvCnt3Val "ESC_AliveCounter3Value";
BA_ "Version" SG_ 325 ESC_AccelBasisVal "1.0";
BA_ "Description" SG_ 325 ESC_AccelBasisVal "This value is used to initialize the acceleration control when SCC is engaged or after driver override.";
BA_ "UsrSigTimeoutValue" SG_ 325 ESC_AccelBasisVal "";
BA_ "UserSigValidity" SG_ 325 ESC_AccelBasisVal 3;
BA_ "SignalLongName" SG_ 325 ESC_AccelBasisVal "ESC_AccelerationBasisValue";
BA_ "Version" SG_ 325 ESC_VehAccelVal "1.0";
BA_ "Description" SG_ 325 ESC_VehAccelVal "The vehicle acceleration ACCEL_REF_ACC displays the feedback signal for the inner acceleration control loop since it is the SCC-internal acceleration command value. In addition this signal is used to calculate the target object acceleration. If the requi";
BA_ "UsrSigTimeoutValue" SG_ 325 ESC_VehAccelVal "";
BA_ "UserSigValidity" SG_ 325 ESC_VehAccelVal 3;
BA_ "SignalLongName" SG_ 325 ESC_VehAccelVal "ESC_VehicleAccelerationValue";
BA_ "Version" SG_ 325 ESC_StdStillVal "1.0";
BA_ "Description" SG_ 325 ESC_StdStillVal "If an ESC uses active wheel speed sensors, wheel speeds down to 0 Km/h can be measured. And at 0 Km/h a StandStill flag is set in the ESC. This signal is used in the offset determination of the yaw rate and shall indicate that the vehicle has come to a c";
BA_ "UsrSigTimeoutValue" SG_ 325 ESC_StdStillVal "";
BA_ "UserSigValidity" SG_ 325 ESC_StdStillVal 3;
BA_ "SignalLongName" SG_ 325 ESC_StdStillVal "ESC_StandStillValue";
BA_ "Version" SG_ 325 ESC_BrkLtReq "1.0";
BA_ "Description" SG_ 325 ESC_BrkLtReq "Flag from TCS which activates the illumination of the brake lights during automatic braking.";
BA_ "UsrSigTimeoutValue" SG_ 325 ESC_BrkLtReq "";
BA_ "UserSigValidity" SG_ 325 ESC_BrkLtReq 3;
BA_ "SignalLongName" SG_ 325 ESC_BrkLtReq "ESC_BrakeLightRequest";
BA_ "Version" SG_ 325 ESC_DclEnblReq "1.0";
BA_ "Description" SG_ 325 ESC_DclEnblReq "This signal enables the deceleration control to accept command values axvCv from SCC. This flag is complementary to the ACC_REQ flag if SCC is in active mode.";
BA_ "UsrSigTimeoutValue" SG_ 325 ESC_DclEnblReq "";
BA_ "UserSigValidity" SG_ 325 ESC_DclEnblReq 3;
BA_ "SignalLongName" SG_ 325 ESC_DclEnblReq "ESC_DecelerationEnableRequest";
BA_ "Version" SG_ 325 ESC_OvrrdeReq "1.0";
BA_ "Description" SG_ 325 ESC_OvrrdeReq "This signal indicates that acceleration or deceleration value of driver’s requirement is greater than SCC setting value.";
BA_ "UsrSigTimeoutValue" SG_ 325 ESC_OvrrdeReq "";
BA_ "UserSigValidity" SG_ 325 ESC_OvrrdeReq 3;
BA_ "SignalLongName" SG_ 325 ESC_OvrrdeReq "ESC_OverrideRequest";
BA_ "Version" SG_ 325 ESC_PrkBrkActvSta "1.0";
BA_ "Description" SG_ 325 ESC_PrkBrkActvSta "This signal indicates whether the parking brake is activated or not.";
BA_ "UsrSigTimeoutValue" SG_ 325 ESC_PrkBrkActvSta "";
BA_ "UserSigValidity" SG_ 325 ESC_PrkBrkActvSta 3;
BA_ "SignalLongName" SG_ 325 ESC_PrkBrkActvSta "ESC_ParkingBrakeActiveStatus";
BA_ "Version" SG_ 325 ESC_DiffBrkFuncSta "1.0";
BA_ "Description" SG_ 325 ESC_DiffBrkFuncSta "This is ESC status for Differential brake function.";
BA_ "UsrSigTimeoutValue" SG_ 325 ESC_DiffBrkFuncSta "";
BA_ "UserSigValidity" SG_ 325 ESC_DiffBrkFuncSta 3;
BA_ "SignalLongName" SG_ 325 ESC_DiffBrkFuncSta "ESC_DifferentialBrakeFunctionStatus";
BA_ "Version" SG_ 325 ESC_DrvBrkActvSta "1.0";
BA_ "Description" SG_ 325 ESC_DrvBrkActvSta "This signal indicates that a driver is pressing the brake pedal or not.";
BA_ "UsrSigTimeoutValue" SG_ 325 ESC_DrvBrkActvSta "";
BA_ "UserSigValidity" SG_ 325 ESC_DrvBrkActvSta 3;
BA_ "SignalLongName" SG_ 325 ESC_DrvBrkActvSta "ESC_DriverBrakingActiveStatus";
BA_ "Version" SG_ 325 ESC_DrvBrkSta "1.0";
BA_ "Description" SG_ 325 ESC_DrvBrkSta "This signal indicates flag from ESC to SCC to indicate the driver braking state";
BA_ "UsrSigTimeoutValue" SG_ 325 ESC_DrvBrkSta "";
BA_ "UserSigValidity" SG_ 325 ESC_DrvBrkSta 3;
BA_ "SignalLongName" SG_ 325 ESC_DrvBrkSta "ESC_DriverBrakingStatus";
BA_ "Version" SG_ 325 AEB_EquipSta "1.0";
BA_ "Description" SG_ 325 AEB_EquipSta "AEB Equipment Status";
BA_ "UsrSigTimeoutValue" SG_ 325 AEB_EquipSta "";
BA_ "UserSigValidity" SG_ 325 AEB_EquipSta 3;
BA_ "SignalLongName" SG_ 325 AEB_EquipSta "AEB_EquipmentStatus";
BA_ "Version" SG_ 325 VSM_ConfSwSta "1.0";
BA_ "Description" SG_ 325 VSM_ConfSwSta "Switch state which is to configure change VSM2 configuration.";
BA_ "UsrSigTimeoutValue" SG_ 325 VSM_ConfSwSta "";
BA_ "UserSigValidity" SG_ 325 VSM_ConfSwSta 3;
BA_ "SignalLongName" SG_ 325 VSM_ConfSwSta "VSM_ConfigureSwitchStatus";
BA_ "Version" SG_ 325 VSM_CodedSta "1.0";
BA_ "Description" SG_ 325 VSM_CodedSta "This signal indicates flag which tells if ESC is coded for VSM or not.";
BA_ "UsrSigTimeoutValue" SG_ 325 VSM_CodedSta "";
BA_ "UserSigValidity" SG_ 325 VSM_CodedSta 3;
BA_ "SignalLongName" SG_ 325 VSM_CodedSta "VSM_CodedStatus";
BA_ "Version" SG_ 325 VSM_AvlblSta "1.0";
BA_ "Description" SG_ 325 VSM_AvlblSta "This signal indicates state signal from ESC to SCC which tells if ESC is “not available”, “available”,

“Temporarily not available” or “permanently not available”.";
BA_ "UsrSigTimeoutValue" SG_ 325 VSM_AvlblSta "";
BA_ "UserSigValidity" SG_ 325 VSM_AvlblSta 3;
BA_ "SignalLongName" SG_ 325 VSM_AvlblSta "VSM_AvailableStatus";
BA_ "Version" SG_ 325 VSM_HndShkSta "1.0";
BA_ "Description" SG_ 325 VSM_HndShkSta "This signal indicates flag from ESC to SCC which tells if ESC is ok or not.";
BA_ "UsrSigTimeoutValue" SG_ 325 VSM_HndShkSta "";
BA_ "UserSigValidity" SG_ 325 VSM_HndShkSta 3;
BA_ "SignalLongName" SG_ 325 VSM_HndShkSta "VSM_HandshakeStatus";
BA_ "Version" SG_ 325 SCC_TqIntrvntnVal "1.0";
BA_ "Description" SG_ 325 SCC_TqIntrvntnVal "The indicated torque command TQI_ACC is the basic control path to the engine power control. This command has the same priority in the torque-structure than the driver’s demand torque. The maximum value of either TQI_ACC or the driver torque is selected ";
BA_ "UsrSigTimeoutValue" SG_ 325 SCC_TqIntrvntnVal "";
BA_ "UserSigValidity" SG_ 325 SCC_TqIntrvntnVal 3;
BA_ "SignalLongName" SG_ 325 SCC_TqIntrvntnVal "SCC_TorqueInterventionValue";
BA_ "Version" SG_ 325 SCC_OptTyp "1.0";
BA_ "Description" SG_ 325 SCC_OptTyp "This value is used for SCC is equipped or not.";
BA_ "UsrSigTimeoutValue" SG_ 325 SCC_OptTyp "";
BA_ "UserSigValidity" SG_ 325 SCC_OptTyp 3;
BA_ "SignalLongName" SG_ 325 SCC_OptTyp "SCC_OptionType";
BA_ "Version" SG_ 325 SCC_EnblReq "1.0";
BA_ "Description" SG_ 325 SCC_EnblReq "This signal is set by the safety logic in the TCS/ESC. The safety logic shall monitor the following:

1. A temporary failure in the vehicle does not allow SCC (Brakes are overheated, etc…). 

SCC is disabled reversible.

2. SCC communication failure (ti";
BA_ "UsrSigTimeoutValue" SG_ 325 SCC_EnblReq "";
BA_ "UserSigValidity" SG_ 325 SCC_EnblReq 3;
BA_ "SignalLongName" SG_ 325 SCC_EnblReq "SCC_EnableRequest";
BA_ "Version" SG_ 325 SCC_TqReq "1.0";
BA_ "Description" SG_ 325 SCC_TqReq "When it is set, the signal indicates that ESC requests engine torque control for SCC. When the signal is set, EMS should not conduct fuel-cut off control unless it is required to prevent the damage of the engine and the related components.";
BA_ "UsrSigTimeoutValue" SG_ 325 SCC_TqReq "";
BA_ "UserSigValidity" SG_ 325 SCC_TqReq 3;
BA_ "SignalLongName" SG_ 325 SCC_TqReq "SCC_TorqueRequest";
BA_ "Version" SG_ 325 SCC_ReqLimSta "1.0";
BA_ "Description" SG_ 325 SCC_ReqLimSta "Due to limitaion of the actuators the acceleration or deceleration request from SCC can not be processed or only partly. 



Examples:

1. SCC is requesting more acceleration than the engine can deliver.

2. SCC is requesting deceleration on a low μ sur";
BA_ "UsrSigTimeoutValue" SG_ 325 SCC_ReqLimSta "";
BA_ "UserSigValidity" SG_ 325 SCC_ReqLimSta 3;
BA_ "SignalLongName" SG_ 325 SCC_ReqLimSta "SCC_RequestLimitedStatus";
BA_ "Version" SG_ 1216 CAL_SAS_Crc1Val "1.0";
BA_ "GenSigStartValue" SG_ 1216 CAL_SAS_Crc1Val 4095;
BA_ "UsrSigTimeoutValue" SG_ 1216 CAL_SAS_Crc1Val "";
BA_ "GenSigTimeoutTime" SG_ 1216 CAL_SAS_Crc1Val 0;
BA_ "UserSigValidity" SG_ 1216 CAL_SAS_Crc1Val 3;
BA_ "SignalLongName" SG_ 1216 CAL_SAS_Crc1Val "CAL_SAS_Crc1Value";
BA_ "GenSigSendType" SG_ 1216 CAL_SAS_Crc1Val 0;
BA_ "Version" SG_ 1216 CAL_SAS_AlvCnt1Val "1.0";
BA_ "UsrSigTimeoutValue" SG_ 1216 CAL_SAS_AlvCnt1Val "";
BA_ "GenSigTimeoutTime" SG_ 1216 CAL_SAS_AlvCnt1Val 0;
BA_ "UserSigValidity" SG_ 1216 CAL_SAS_AlvCnt1Val 3;
BA_ "SignalLongName" SG_ 1216 CAL_SAS_AlvCnt1Val "CAL_SAS_AliveCounter1Value";
BA_ "GenSigSendType" SG_ 1216 CAL_SAS_AlvCnt1Val 0;
BA_ "Version" SG_ 1216 SAS_CmdCodWrdVal "1.0";
BA_ "Description" SG_ 1216 SAS_CmdCodWrdVal "Command information regarding the steering angle sensor’s calibration/de-calibration

If the SAS_CAL(SAS1) flag is not set (=0) the calibration message will be accepted without preceding de-calibration procedure. 

If the SAS_CAL flag is set (=1) it is ";
BA_ "UsrSigTimeoutValue" SG_ 1216 SAS_CmdCodWrdVal "";
BA_ "GenSigTimeoutTime" SG_ 1216 SAS_CmdCodWrdVal 0;
BA_ "UserSigValidity" SG_ 1216 SAS_CmdCodWrdVal 3;
BA_ "SignalLongName" SG_ 1216 SAS_CmdCodWrdVal "SAS_CommandCodeWordValue";
BA_ "GenSigSendType" SG_ 1216 SAS_CmdCodWrdVal 0;
BA_ "Version" SG_ 1216 SAS_CANIdVal "1.0";
BA_ "Description" SG_ 1216 SAS_CANIdVal "This signal indicates SAS1-CAN transmit identifier";
BA_ "GenSigStartValue" SG_ 1216 SAS_CANIdVal 688;
BA_ "UsrSigTimeoutValue" SG_ 1216 SAS_CANIdVal "";
BA_ "GenSigTimeoutTime" SG_ 1216 SAS_CANIdVal 0;
BA_ "UserSigValidity" SG_ 1216 SAS_CANIdVal 3;
BA_ "SignalLongName" SG_ 1216 SAS_CANIdVal "SAS_CANIdentifierValue";
BA_ "GenSigSendType" SG_ 1216 SAS_CANIdVal 0;
BA_ "Version" SG_ 277 WHL_Crc1Val "1.0";
BA_ "GenSigStartValue" SG_ 277 WHL_Crc1Val 4095;
BA_ "UsrSigTimeoutValue" SG_ 277 WHL_Crc1Val "";
BA_ "UserSigValidity" SG_ 277 WHL_Crc1Val 3;
BA_ "SignalLongName" SG_ 277 WHL_Crc1Val "WHL_Crc1Value";
BA_ "Version" SG_ 277 WHL_AlvCnt1Val "1.0";
BA_ "UsrSigTimeoutValue" SG_ 277 WHL_AlvCnt1Val "";
BA_ "UserSigValidity" SG_ 277 WHL_AlvCnt1Val 3;
BA_ "SignalLongName" SG_ 277 WHL_AlvCnt1Val "WHL_AliveCounter1Value";
BA_ "Version" SG_ 277 WHL_PlsFLSta "1.0";
BA_ "Description" SG_ 277 WHL_PlsFLSta "This signal indicates accumulated pulse counter of ABS/ESC wheel speed sensor (FL/FR/RL/RR)

Receiver unit uses this signal for calculation of vehicle movement distance.

Requested resolution of this signal is 0.5 pulses and refer to below (wheel sensor ";
BA_ "UsrSigTimeoutValue" SG_ 277 WHL_PlsFLSta "";
BA_ "UserSigValidity" SG_ 277 WHL_PlsFLSta 3;
BA_ "SignalLongName" SG_ 277 WHL_PlsFLSta "WHL_PulseFrontLeftStatus";
BA_ "Version" SG_ 277 WHL_PlsFRSta "1.0";
BA_ "Description" SG_ 277 WHL_PlsFRSta "This signal indicates accumulated pulse counter of ABS/ESC wheel speed sensor (FL/FR/RL/RR)

Receiver unit uses this signal for calculation of vehicle movement distance.

Requested resolution of this signal is 0.5 pulses and refer to below (wheel sensor ";
BA_ "UsrSigTimeoutValue" SG_ 277 WHL_PlsFRSta "";
BA_ "UserSigValidity" SG_ 277 WHL_PlsFRSta 3;
BA_ "SignalLongName" SG_ 277 WHL_PlsFRSta "WHL_PulseFrontRightStatus";
BA_ "Version" SG_ 277 WHL_PlsRLSta "1.0";
BA_ "Description" SG_ 277 WHL_PlsRLSta "This signal indicates accumulated pulse counter of ABS/ESC wheel speed sensor (FL/FR/RL/RR)

Receiver unit uses this signal for calculation of vehicle movement distance.

Requested resolution of this signal is 0.5 pulses and refer to below (wheel sensor ";
BA_ "UsrSigTimeoutValue" SG_ 277 WHL_PlsRLSta "";
BA_ "UserSigValidity" SG_ 277 WHL_PlsRLSta 3;
BA_ "SignalLongName" SG_ 277 WHL_PlsRLSta "WHL_PulseRearLeftStatus";
BA_ "Version" SG_ 277 WHL_PlsRRSta "1.0";
BA_ "Description" SG_ 277 WHL_PlsRRSta "This signal indicates accumulated pulse counter of ABS/ESC wheel speed sensor (FL/FR/RL/RR)

Receiver unit uses this signal for calculation of vehicle movement distance.

Requested resolution of this signal is 0.5 pulses and refer to below (wheel sensor ";
BA_ "UsrSigTimeoutValue" SG_ 277 WHL_PlsRRSta "";
BA_ "UserSigValidity" SG_ 277 WHL_PlsRRSta 3;
BA_ "SignalLongName" SG_ 277 WHL_PlsRRSta "WHL_PulseRearRightStatus";
BA_ "Version" SG_ 277 WHL_DirFLSta "1.0";
BA_ "Description" SG_ 277 WHL_DirFLSta "This signal is used to check the moving direction of WHL_PUL_FL signal.";
BA_ "UsrSigTimeoutValue" SG_ 277 WHL_DirFLSta "";
BA_ "UserSigValidity" SG_ 277 WHL_DirFLSta 3;
BA_ "SignalLongName" SG_ 277 WHL_DirFLSta "WHL_DirectionFrontLeftStatus";
BA_ "Version" SG_ 277 WHL_DirFRSta "1.0";
BA_ "Description" SG_ 277 WHL_DirFRSta "This signal is used to check the moving direction of WHL_PUL_FR signal.";
BA_ "UsrSigTimeoutValue" SG_ 277 WHL_DirFRSta "";
BA_ "UserSigValidity" SG_ 277 WHL_DirFRSta 3;
BA_ "SignalLongName" SG_ 277 WHL_DirFRSta "WHL_DirectionFrontRightStatus";
BA_ "Version" SG_ 277 WHL_DirRLSta "1.0";
BA_ "Description" SG_ 277 WHL_DirRLSta "This signal is used to check the moving direction of WHL_PUL_RL signal.";
BA_ "UsrSigTimeoutValue" SG_ 277 WHL_DirRLSta "";
BA_ "UserSigValidity" SG_ 277 WHL_DirRLSta 3;
BA_ "SignalLongName" SG_ 277 WHL_DirRLSta "WHL_DirectionRearLeftStatus";
BA_ "Version" SG_ 277 WHL_DirRRSta "1.0";
BA_ "Description" SG_ 277 WHL_DirRRSta "This signal is used to check the moving direction of WHL_PUL_RR signal.";
BA_ "UsrSigTimeoutValue" SG_ 277 WHL_DirRRSta "";
BA_ "UserSigValidity" SG_ 277 WHL_DirRRSta 3;
BA_ "SignalLongName" SG_ 277 WHL_DirRRSta "WHL_DirectionRearRightStatus";
BA_ "Version" SG_ 277 WHL_SpdFLVal "1.0";
BA_ "Description" SG_ 277 WHL_SpdFLVal "This signal provides the wheel velocity of each wheel and have 14 bits length and a resolution of 0.03125 km/h.(This resolution is higher than that of signal in TCS5).

In case of failure of one wheel speed sensor, the value 3FFFH is used as error identi";
BA_ "UsrSigTimeoutValue" SG_ 277 WHL_SpdFLVal "";
BA_ "UserSigValidity" SG_ 277 WHL_SpdFLVal 3;
BA_ "SignalLongName" SG_ 277 WHL_SpdFLVal "WHL_SpeedFrontLeftValue";
BA_ "Version" SG_ 277 WHL_SpdFRVal "1.0";
BA_ "Description" SG_ 277 WHL_SpdFRVal "This signal provides the wheel velocity of each wheel and have 14 bits length and a resolution of 0.03125 km/h.(This resolution is higher than that of signal in TCS5).

In case of failure of one wheel speed sensor, the value 3FFFH is used as error identi";
BA_ "UsrSigTimeoutValue" SG_ 277 WHL_SpdFRVal "";
BA_ "UserSigValidity" SG_ 277 WHL_SpdFRVal 3;
BA_ "SignalLongName" SG_ 277 WHL_SpdFRVal "WHL_SpeedFrontRightValue";
BA_ "Version" SG_ 277 WHL_SpdRLVal "1.0";
BA_ "Description" SG_ 277 WHL_SpdRLVal "This signal provides the wheel velocity of each wheel and have 14 bits length and a resolution of 0.03125 km/h.(This resolution is higher than that of signal in TCS5).

In case of failure of one wheel speed sensor, the value 3FFFH is used as error identi";
BA_ "UsrSigTimeoutValue" SG_ 277 WHL_SpdRLVal "";
BA_ "UserSigValidity" SG_ 277 WHL_SpdRLVal 3;
BA_ "SignalLongName" SG_ 277 WHL_SpdRLVal "WHL_SpeedRearLeftValue";
BA_ "Version" SG_ 277 WHL_SpdRRVal "1.0";
BA_ "Description" SG_ 277 WHL_SpdRRVal "This signal provides the wheel velocity of each wheel and have 14 bits length and a resolution of 0.03125 km/h.(This resolution is higher than that of signal in TCS5).

In case of failure of one wheel speed sensor, the value 3FFFH is used as error identi";
BA_ "UsrSigTimeoutValue" SG_ 277 WHL_SpdRRVal "";
BA_ "UserSigValidity" SG_ 277 WHL_SpdRRVal 3;
BA_ "SignalLongName" SG_ 277 WHL_SpdRRVal "WHL_SpeedRearRightValue";
BA_ "Version" SG_ 117 IVSS_Crc1Val "1.0";
BA_ "GenSigStartValue" SG_ 117 IVSS_Crc1Val 4095;
BA_ "UsrSigTimeoutValue" SG_ 117 IVSS_Crc1Val "";
BA_ "UserSigValidity" SG_ 117 IVSS_Crc1Val 3;
BA_ "SignalLongName" SG_ 117 IVSS_Crc1Val "IVSS_Crc1Value";
BA_ "Version" SG_ 117 IVSS_AlvCnt1Val "1.0";
BA_ "UsrSigTimeoutValue" SG_ 117 IVSS_AlvCnt1Val "";
BA_ "UserSigValidity" SG_ 117 IVSS_AlvCnt1Val 3;
BA_ "SignalLongName" SG_ 117 IVSS_AlvCnt1Val "IVSS_AliveCounter1Value";
BA_ "Version" SG_ 117 IVSS_EcsFLNrmlCurrReq "1.0";
BA_ "Description" SG_ 117 IVSS_EcsFLNrmlCurrReq "IVSS Request Normalized Current to ECS FL (%)

0~100%=00h~C8h (C9h~FFh=100%)

(PH)=0.5*(HEX) [%]

- 0%: Full Soft

- 100%: Full Hard

After IGN status is changed from ON to OFF, It is necessary to maintain transmitting this message for 3 minutes.";
BA_ "UsrSigTimeoutValue" SG_ 117 IVSS_EcsFLNrmlCurrReq "";
BA_ "UserSigValidity" SG_ 117 IVSS_EcsFLNrmlCurrReq 3;
BA_ "SignalLongName" SG_ 117 IVSS_EcsFLNrmlCurrReq "IVSS_EcsFrontLeftNormalizedCurrentRequest";
BA_ "Version" SG_ 117 IVSS_EcsFRNrmlCurrReq "1.0";
BA_ "Description" SG_ 117 IVSS_EcsFRNrmlCurrReq "IVSS Request Normalized Current to ECS FR (%)

0~100%=00h~C8h (C9h~FFh=100%)

(PH)=0.5*(HEX) [%]

- 0%: Full Soft

- 100%: Full Hard

After IGN status is changed from ON to OFF, It is necessary to maintain transmitting this message for 3 minutes.";
BA_ "UsrSigTimeoutValue" SG_ 117 IVSS_EcsFRNrmlCurrReq "";
BA_ "UserSigValidity" SG_ 117 IVSS_EcsFRNrmlCurrReq 3;
BA_ "SignalLongName" SG_ 117 IVSS_EcsFRNrmlCurrReq "IVSS_EcsFrontRightNormalizedCurrentRequest";
BA_ "Version" SG_ 117 IVSS_EcsRLNrmlCurrReq "1.0";
BA_ "Description" SG_ 117 IVSS_EcsRLNrmlCurrReq "IVSS Request Normalized Current to ECS RL (%)

0~100%=00h~C8h (C9h~FFh=100%)

(PH)=0.5*(HEX) [%]

- 0%: Full Soft

- 100%: Full Hard

After IGN status is changed from ON to OFF, It is necessary to maintain transmitting this message for 3 minutes.";
BA_ "UsrSigTimeoutValue" SG_ 117 IVSS_EcsRLNrmlCurrReq "";
BA_ "UserSigValidity" SG_ 117 IVSS_EcsRLNrmlCurrReq 3;
BA_ "SignalLongName" SG_ 117 IVSS_EcsRLNrmlCurrReq "IVSS_EcsRearLeftNormalizedCurrentRequest";
BA_ "Version" SG_ 117 IVSS_EcsRRNrmlCurrReq "1.0";
BA_ "Description" SG_ 117 IVSS_EcsRRNrmlCurrReq "IVSS Request Normalized Current to ECS RR (%)

0~100%=00h~C8h (C9h~FFh=100%)

(PH)=0.5*(HEX) [%]

- 0%: Full Soft

- 100%: Full Hard

After IGN status is changed from ON to OFF, It is necessary to maintain transmitting this message for 3 minutes.";
BA_ "UsrSigTimeoutValue" SG_ 117 IVSS_EcsRRNrmlCurrReq "";
BA_ "UserSigValidity" SG_ 117 IVSS_EcsRRNrmlCurrReq 3;
BA_ "SignalLongName" SG_ 117 IVSS_EcsRRNrmlCurrReq "IVSS_EcsRearRightNormalizedCurrentRequest";
BA_ "Version" SG_ 117 IVSS_EcsActvSta "1.0";
BA_ "Description" SG_ 117 IVSS_EcsActvSta "IVSS Activation Flag

After IGN status is changed from ON to OFF, It is necessary to maintain transmitting this message for 3 minutes.";
BA_ "UsrSigTimeoutValue" SG_ 117 IVSS_EcsActvSta "";
BA_ "UserSigValidity" SG_ 117 IVSS_EcsActvSta 3;
BA_ "SignalLongName" SG_ 117 IVSS_EcsActvSta "IVSS_EcsActivationStatus";
BA_ "Version" SG_ 117 IVSS_EcsDfctvSta "1.0";
BA_ "Description" SG_ 117 IVSS_EcsDfctvSta "Information regarding to the IVSS 'defective' indication

After IGN status is changed from ON to OFF, It is necessary to maintain transmitting this message for 3 minutes.";
BA_ "UsrSigTimeoutValue" SG_ 117 IVSS_EcsDfctvSta "";
BA_ "UserSigValidity" SG_ 117 IVSS_EcsDfctvSta 3;
BA_ "SignalLongName" SG_ 117 IVSS_EcsDfctvSta "IVSS_EcsDefectiveStatus";
BA_ "Version" SG_ 117 IVSS_EmsModSta "1.0";
BA_ "Description" SG_ 117 IVSS_EmsModSta "This Signal is the request on mode transition for Controlling the Driving Mode

This message is for “EPB (Electric Parking Brake)” system applied vehicle only.";
BA_ "UsrSigTimeoutValue" SG_ 117 IVSS_EmsModSta "";
BA_ "UserSigValidity" SG_ 117 IVSS_EmsModSta 3;
BA_ "SignalLongName" SG_ 117 IVSS_EmsModSta "IVSS_EmsModeStatus";
BA_ "Version" SG_ 117 IVSS_TcuModSta "1.0";
BA_ "Description" SG_ 117 IVSS_TcuModSta "This Signal is the request on mode transition for Controlling the Driving Mode";
BA_ "UsrSigTimeoutValue" SG_ 117 IVSS_TcuModSta "";
BA_ "UserSigValidity" SG_ 117 IVSS_TcuModSta 3;
BA_ "SignalLongName" SG_ 117 IVSS_TcuModSta "IVSS_TcuModeStatus";
BA_ "Version" SG_ 117 IVSS_MdpsModSta "1.0";
BA_ "Description" SG_ 117 IVSS_MdpsModSta "This Signal is the request on mode transition for Controlling the Driving Mode";
BA_ "UsrSigTimeoutValue" SG_ 117 IVSS_MdpsModSta "";
BA_ "UserSigValidity" SG_ 117 IVSS_MdpsModSta 3;
BA_ "SignalLongName" SG_ 117 IVSS_MdpsModSta "IVSS_MdpsModeStatus";
BA_ "Version" SG_ 117 IVSS_EcsModSta "1.0";
BA_ "Description" SG_ 117 IVSS_EcsModSta "This Signal is the request on mode transition for Controlling the Driving Mode

This signal is for the vehicle equipped with individual mode.";
BA_ "UsrSigTimeoutValue" SG_ 117 IVSS_EcsModSta "";
BA_ "UserSigValidity" SG_ 117 IVSS_EcsModSta 3;
BA_ "SignalLongName" SG_ 117 IVSS_EcsModSta "IVSS_EcsModeStatus";
BA_ "Version" SG_ 117 IVSS_EscModSta "1.0";
BA_ "Description" SG_ 117 IVSS_EscModSta "This Signal is the request on mode transition for Controlling the Driving Mode

This message is for “EPB (Electric Parking Brake)” system applied vehicle only.";
BA_ "UsrSigTimeoutValue" SG_ 117 IVSS_EscModSta "";
BA_ "UserSigValidity" SG_ 117 IVSS_EscModSta 3;
BA_ "SignalLongName" SG_ 117 IVSS_EscModSta "IVSS_EscModeStatus";
BA_ "Version" SG_ 117 IVSS_AwdModSta "1.0";
BA_ "Description" SG_ 117 IVSS_AwdModSta "This Signal is the request on mode transition for Controlling the Driving Mode

This signal is for the vehicle equipped with individual mode.";
BA_ "UsrSigTimeoutValue" SG_ 117 IVSS_AwdModSta "";
BA_ "UserSigValidity" SG_ 117 IVSS_AwdModSta 3;
BA_ "SignalLongName" SG_ 117 IVSS_AwdModSta "IVSS_AwdModeStatus";
BA_ "Version" SG_ 117 IVSS_SmrtShftModSta "1.0";
BA_ "Description" SG_ 117 IVSS_SmrtShftModSta "This signal is a smart shift mode flag.";
BA_ "UsrSigTimeoutValue" SG_ 117 IVSS_SmrtShftModSta "";
BA_ "UserSigValidity" SG_ 117 IVSS_SmrtShftModSta 3;
BA_ "SignalLongName" SG_ 117 IVSS_SmrtShftModSta "IVSS_SmartShiftModeStatus";
BA_ "Version" SG_ 117 IVSS_DrvngModSta "1.0";
BA_ "Description" SG_ 117 IVSS_DrvngModSta "This signal is feedback state of driving mode for Cluster/AVN

This message is for DMIC(Driving Mode Integrated Control)";
BA_ "UsrSigTimeoutValue" SG_ 117 IVSS_DrvngModSta "";
BA_ "UserSigValidity" SG_ 117 IVSS_DrvngModSta 3;
BA_ "SignalLongName" SG_ 117 IVSS_DrvngModSta "IVSS_DrivingModeStatus";
BA_ "Version" SG_ 117 IVSS_PtModDis "1.0";
BA_ "Description" SG_ 117 IVSS_PtModDis "This signal is for Powertrain(ENG/TM) mode state in the individual mode";
BA_ "UsrSigTimeoutValue" SG_ 117 IVSS_PtModDis "";
BA_ "UserSigValidity" SG_ 117 IVSS_PtModDis 3;
BA_ "SignalLongName" SG_ 117 IVSS_PtModDis "IVSS_PtModeDisplay";
BA_ "Version" SG_ 117 IVSS_MdpsModDis "1.0";
BA_ "Description" SG_ 117 IVSS_MdpsModDis "This signal is for MDPS mode state in the individual mode";
BA_ "UsrSigTimeoutValue" SG_ 117 IVSS_MdpsModDis "";
BA_ "UserSigValidity" SG_ 117 IVSS_MdpsModDis 3;
BA_ "SignalLongName" SG_ 117 IVSS_MdpsModDis "IVSS_MdpsModeDisplay";
BA_ "Version" SG_ 117 IVSS_EcsModDis "1.0";
BA_ "Description" SG_ 117 IVSS_EcsModDis "This signal is for ECS mode state in the individual mode.";
BA_ "UsrSigTimeoutValue" SG_ 117 IVSS_EcsModDis "";
BA_ "UserSigValidity" SG_ 117 IVSS_EcsModDis 3;
BA_ "SignalLongName" SG_ 117 IVSS_EcsModDis "IVSS_EcsModeDisplay";
BA_ "Version" SG_ 117 IVSS_AwdModDis "1.0";
BA_ "Description" SG_ 117 IVSS_AwdModDis "This signal is for 4WD mode state in the individual mode.

This signal is for the vehicle equipped with individual mode";
BA_ "UsrSigTimeoutValue" SG_ 117 IVSS_AwdModDis "";
BA_ "UserSigValidity" SG_ 117 IVSS_AwdModDis 3;
BA_ "SignalLongName" SG_ 117 IVSS_AwdModDis "IVSS_AwdModeDisplay";
BA_ "Version" SG_ 117 IVSS_EmsModFltSta "1.0";
BA_ "Description" SG_ 117 IVSS_EmsModFltSta "This signal is for engine mode fault status. The fault condition, here, complies with warning lamp 'On' condition for engine system in the cluster. From this signal, AVN can deactivate engine mode selection menu in the individual mode.

This message is f";
BA_ "UsrSigTimeoutValue" SG_ 117 IVSS_EmsModFltSta "";
BA_ "UserSigValidity" SG_ 117 IVSS_EmsModFltSta 3;
BA_ "SignalLongName" SG_ 117 IVSS_EmsModFltSta "IVSS_EmsModeFaultStatus";
BA_ "Version" SG_ 117 IVSS_TcuModFltSta "1.0";
BA_ "Description" SG_ 117 IVSS_TcuModFltSta "This signal is for transmission mode fault status. The fault condition, here, complies with warning lamp 'On' condition for transmission system in the cluster. From this signal, AVN can deactivate transmission mode selection menu in the individual mode.";
BA_ "UsrSigTimeoutValue" SG_ 117 IVSS_TcuModFltSta "";
BA_ "UserSigValidity" SG_ 117 IVSS_TcuModFltSta 3;
BA_ "SignalLongName" SG_ 117 IVSS_TcuModFltSta "IVSS_TcuModeFaultStatus";
BA_ "Version" SG_ 117 IVSS_MdpsModFltSta "1.0";
BA_ "Description" SG_ 117 IVSS_MdpsModFltSta "This signal is for MDPS mode fault status. The fault condition, here, complies with warning lamp 'On' condition for MDPS system in the cluster. From this signal, AVN can deactivate MDPS mode selection menu in the individual mode.";
BA_ "UsrSigTimeoutValue" SG_ 117 IVSS_MdpsModFltSta "";
BA_ "UserSigValidity" SG_ 117 IVSS_MdpsModFltSta 3;
BA_ "SignalLongName" SG_ 117 IVSS_MdpsModFltSta "IVSS_MdpsModeFaultStatus";
BA_ "Version" SG_ 117 IVSS_EcsModFltSta "1.0";
BA_ "Description" SG_ 117 IVSS_EcsModFltSta "This signal is for ECS mode fault status. The fault condition, here, complies with warning lamp 'On' condition for ECS system in the cluster. From this signal, AVN can deactivate ECS mode selection menu in the individual mode.



This signal is for the S";
BA_ "UsrSigTimeoutValue" SG_ 117 IVSS_EcsModFltSta "";
BA_ "UserSigValidity" SG_ 117 IVSS_EcsModFltSta 3;
BA_ "SignalLongName" SG_ 117 IVSS_EcsModFltSta "IVSS_EcsModeFaultStatus";
BA_ "Version" SG_ 117 IVSS_EscModFltSta "1.0";
BA_ "Description" SG_ 117 IVSS_EscModFltSta "This signal is for ESC mode fault status. The fault condition, here, complies with warning lamp 'On' condition for ESC system in the cluster. From this signal, AVN can deactivate ESC mode selection menu in the individual mode.



This message is for “EP";
BA_ "UsrSigTimeoutValue" SG_ 117 IVSS_EscModFltSta "";
BA_ "UserSigValidity" SG_ 117 IVSS_EscModFltSta 3;
BA_ "SignalLongName" SG_ 117 IVSS_EscModFltSta "IVSS_EscModeFaultStatus";
BA_ "Version" SG_ 117 IVSS_AwdModFltSta "1.0";
BA_ "Description" SG_ 117 IVSS_AwdModFltSta "This signal is for 4WD mode fault status. The fault condition, here, complies with warning lamp 'On' condition for 4WD system in the cluster. From this signal, AVN can deactivate 4WD mode selection menu in the individual mode.



This signal is for the v";
BA_ "UsrSigTimeoutValue" SG_ 117 IVSS_AwdModFltSta "";
BA_ "UserSigValidity" SG_ 117 IVSS_AwdModFltSta 3;
BA_ "SignalLongName" SG_ 117 IVSS_AwdModFltSta "IVSS_AwdModeFaultStatus";
BA_ "Version" SG_ 117 IVSS_DrvngModFltSta "1.0";
BA_ "Description" SG_ 117 IVSS_DrvngModFltSta "This signal is for driving mode fault status. From this signal, AVN can deactivate any driving mode in mode selection menu. MDPS or ECS fault can deactivate sport mode. Engine or transmission fault can make comfort(normal) mode only available.

This mess";
BA_ "UsrSigTimeoutValue" SG_ 117 IVSS_DrvngModFltSta "";
BA_ "UserSigValidity" SG_ 117 IVSS_DrvngModFltSta 3;
BA_ "SignalLongName" SG_ 117 IVSS_DrvngModFltSta "IVSS_DrivingModeFaultStatus";
BA_ "SignalLongName" SG_ 394 TCU_VgisInhbtReq_Copy_1 "TCU_VgisInhibitionRequest";
BA_ "UserSigValidity" SG_ 394 TCU_VgisInhbtReq_Copy_1 3;
BA_ "UsrSigTimeoutValue" SG_ 394 TCU_VgisInhbtReq_Copy_1 "";
BA_ "Description" SG_ 394 TCU_VgisInhbtReq_Copy_1 "TCU requests ECU to inhibit the VGIS fuction from changing its status.";
BA_ "Version" SG_ 394 TCU_VgisInhbtReq_Copy_1 "1.0";
BA_ "SignalLongName" SG_ 394 TCU_VehSpdKphVal_Copy_1 "TCU_VehicleSpeedKphValue";
BA_ "UserSigValidity" SG_ 394 TCU_VehSpdKphVal_Copy_1 3;
BA_ "UsrSigTimeoutValue" SG_ 394 TCU_VehSpdKphVal_Copy_1 "";
BA_ "Description" SG_ 394 TCU_VehSpdKphVal_Copy_1 "The vehicle speed calculated by TCU is transferred. 

If a vehicle has no vehicle speed sensor, no wheel speed sensor and no ABS(TCS/ESC) then it is impossible for an EMS to calculate veficle speed. In this case a TCU should calculate vehicle speed and s";
BA_ "Version" SG_ 394 TCU_VehSpdKphVal_Copy_1 "1.0";
BA_ "SignalLongName" SG_ 394 TCU_TrgtGearSta_Copy_1 "TCU_TargetGearStatus";
BA_ "UserSigValidity" SG_ 394 TCU_TrgtGearSta_Copy_1 3;
BA_ "UsrSigTimeoutValue" SG_ 394 TCU_TrgtGearSta_Copy_1 "";
BA_ "Description" SG_ 394 TCU_TrgtGearSta_Copy_1 "CF_Tcu_TarGr informs about the speed, which is currently engaged in the gearbox, or, in case of a gear change (SWI_GS), which speed is reached.



Note: Gear changes covering more than one speed are also possible.

In the P and N positions, the frictiona";
BA_ "Version" SG_ 394 TCU_TrgtGearSta_Copy_1 "1.0";
BA_ "SignalLongName" SG_ 394 TCU_TqRdctnPcVal_Copy_1 "TCU_TorqueReductionPcValue";
BA_ "UserSigValidity" SG_ 394 TCU_TqRdctnPcVal_Copy_1 3;
BA_ "UsrSigTimeoutValue" SG_ 394 TCU_TqRdctnPcVal_Copy_1 "";
BA_ "GenSigStartValue" SG_ 394 TCU_TqRdctnPcVal_Copy_1 255;
BA_ "Description" SG_ 394 TCU_TqRdctnPcVal_Copy_1 "The TCU requests a torque reduction via the signal TQI_TCU to the EMS. 

The requested torque TQI_TCU refers to a maximum torque TQ_STND. This conversion into a physical quantity provides a range of TQ_STND of 0..99.6094%.



TQI_TCU is not relevant to R";
BA_ "Version" SG_ 394 TCU_TqRdctnPcVal_Copy_1 "1.0";
BA_ "SignalLongName" SG_ 394 TCU_TqCnvrtrSta_Copy_1 "TCU_TorqueConverterStatus";
BA_ "UserSigValidity" SG_ 394 TCU_TqCnvrtrSta_Copy_1 3;
BA_ "UsrSigTimeoutValue" SG_ 394 TCU_TqCnvrtrSta_Copy_1 "";
BA_ "Description" SG_ 394 TCU_TqCnvrtrSta_Copy_1 "Status converter clutch



There is no specific phase relationship between the output and any other signal.";
BA_ "Version" SG_ 394 TCU_TqCnvrtrSta_Copy_1 "1.0";
BA_ "SignalLongName" SG_ 394 TCU_SprtyIndxSta_Copy_1 "TCU_SportyIndexStatus";
BA_ "UserSigValidity" SG_ 394 TCU_SprtyIndxSta_Copy_1 3;
BA_ "UsrSigTimeoutValue" SG_ 394 TCU_SprtyIndxSta_Copy_1 "";
BA_ "Description" SG_ 394 TCU_SprtyIndxSta_Copy_1 "Sporty index based on the driver's driving behaviour";
BA_ "Version" SG_ 394 TCU_SprtyIndxSta_Copy_1 "1.0";
BA_ "SignalLongName" SG_ 394 TCU_SmrtShftSta_Copy_1 "TCU_SmartShiftStatus";
BA_ "UserSigValidity" SG_ 394 TCU_SmrtShftSta_Copy_1 3;
BA_ "UsrSigTimeoutValue" SG_ 394 TCU_SmrtShftSta_Copy_1 "";
BA_ "Description" SG_ 394 TCU_SmrtShftSta_Copy_1 "Information of SmartShift";
BA_ "Version" SG_ 394 TCU_SmrtShftSta_Copy_1 "1.0";
BA_ "SignalLongName" SG_ 394 TCU_ShftPtrnSta_Copy_1 "TCU_ShiftPatternStatus";
BA_ "UserSigValidity" SG_ 394 TCU_ShftPtrnSta_Copy_1 3;
BA_ "UsrSigTimeoutValue" SG_ 394 TCU_ShftPtrnSta_Copy_1 "";
BA_ "Description" SG_ 394 TCU_ShftPtrnSta_Copy_1 "It is an ID of current shift pattern which is being used by TCU.

The ID is assigned for each TCU.";
BA_ "Version" SG_ 394 TCU_ShftPtrnSta_Copy_1 "1.0";
BA_ "SignalLongName" SG_ 394 TCU_NetrlCtrlSta_Copy_1 "TCU_NeutralControlStatus";
BA_ "UserSigValidity" SG_ 394 TCU_NetrlCtrlSta_Copy_1 3;
BA_ "UsrSigTimeoutValue" SG_ 394 TCU_NetrlCtrlSta_Copy_1 "";
BA_ "Description" SG_ 394 TCU_NetrlCtrlSta_Copy_1 "This signal indicates the status of Neutral Control.";
BA_ "Version" SG_ 394 TCU_NetrlCtrlSta_Copy_1 "1.0";
BA_ "SignalLongName" SG_ 394 TCU_GearStepTyp_Copy_1 "TCU_GearStepType";
BA_ "UserSigValidity" SG_ 394 TCU_GearStepTyp_Copy_1 3;
BA_ "UsrSigTimeoutValue" SG_ 394 TCU_GearStepTyp_Copy_1 "";
BA_ "Description" SG_ 394 TCU_GearStepTyp_Copy_1 "This signal indicates number of gear steps of step type automatic transmission(A/T) or Dual Clutch Transmission(DCT). A vehicle can have A/T or DCT variant according to its option, for example 4-speed A/T or 5-speed A/T can be equipped in the same kind o";
BA_ "Version" SG_ 394 TCU_GearStepTyp_Copy_1 "1.0";
BA_ "SignalLongName" SG_ 394 TCU_GearSlctDis_Copy_1 "TCU_GearSelectDisplay";
BA_ "UserSigValidity" SG_ 394 TCU_GearSlctDis_Copy_1 3;
BA_ "UsrSigTimeoutValue" SG_ 394 TCU_GearSlctDis_Copy_1 "";
BA_ "GenSigStartValue" SG_ 394 TCU_GearSlctDis_Copy_1 9;
BA_ "Description" SG_ 394 TCU_GearSlctDis_Copy_1 "Position (P, R, N..), which was identified by the gear selector.

In case the gear selector is in a intermediate position, the last clear recognized position is used.

There is no specific phase relationship between the output and any other signal.";
BA_ "Version" SG_ 394 TCU_GearSlctDis_Copy_1 "1.0";
BA_ "SignalLongName" SG_ 394 TCU_GearShftSta_Copy_1 "TCU_GearShiftStatus";
BA_ "UserSigValidity" SG_ 394 TCU_GearShftSta_Copy_1 3;
BA_ "UsrSigTimeoutValue" SG_ 394 TCU_GearShftSta_Copy_1 "";
BA_ "Description" SG_ 394 TCU_GearShftSta_Copy_1 "SWI_GS indicates whether a gear change is being executed in the gearbox.



Note : Gear change means a gear shift at D-range and Garage shift(PRND).";
BA_ "Version" SG_ 394 TCU_GearShftSta_Copy_1 "1.0";
BA_ "SignalLongName" SG_ 394 TCU_GearLmpBlnkngReq_Copy_1 "TCU_GearLampBlinkingRequest";
BA_ "UserSigValidity" SG_ 394 TCU_GearLmpBlnkngReq_Copy_1 3;
BA_ "UsrSigTimeoutValue" SG_ 394 TCU_GearLmpBlnkngReq_Copy_1 "";
BA_ "Description" SG_ 394 TCU_GearLmpBlnkngReq_Copy_1 "Cluster controls blinking of Gear lamp receiving the request signal from TCU.";
BA_ "Version" SG_ 394 TCU_GearLmpBlnkngReq_Copy_1 "1.0";
BA_ "SignalLongName" SG_ 394 TCU_FuelCutInhbtReq_Copy_1 "TCU_FuelCutInhibitionRequest";
BA_ "UserSigValidity" SG_ 394 TCU_FuelCutInhbtReq_Copy_1 3;
BA_ "UsrSigTimeoutValue" SG_ 394 TCU_FuelCutInhbtReq_Copy_1 "";
BA_ "Description" SG_ 394 TCU_FuelCutInhbtReq_Copy_1 "During coast down shifting, EMS may cut off fuel injection and as a result, a driver can feel bad shift feeling. In this case, to enhance shift quality, TCU needs inhibition of fuel cut off control.

This signal indicates inhibition of engine fuel cut of";
BA_ "Version" SG_ 394 TCU_FuelCutInhbtReq_Copy_1 "1.0";
BA_ "SignalLongName" SG_ 394 TCU_EngRpmDisSta_Copy_1 "TCU_EngineRpmDisplayStatus";
BA_ "UserSigValidity" SG_ 394 TCU_EngRpmDisSta_Copy_1 3;
BA_ "UsrSigTimeoutValue" SG_ 394 TCU_EngRpmDisSta_Copy_1 "";
BA_ "Description" SG_ 394 TCU_EngRpmDisSta_Copy_1 "Flag for Engine RPM(from TCU) Display on Cluster, Only when this flag is set to 1, Cluster shall display the Engine RPM from TCU";
BA_ "Version" SG_ 394 TCU_EngRpmDisSta_Copy_1 "1.0";
BA_ "SignalLongName" SG_ 394 TCU_EngRpmDis_Copy_1 "TCU_EngineRpmDisplay";
BA_ "UserSigValidity" SG_ 394 TCU_EngRpmDis_Copy_1 3;
BA_ "UsrSigTimeoutValue" SG_ 394 TCU_EngRpmDis_Copy_1 "";
BA_ "Description" SG_ 394 TCU_EngRpmDis_Copy_1 "Engine RPM from TCU (Only for the display on Cluster)";
BA_ "Version" SG_ 394 TCU_EngRpmDis_Copy_1 "1.0";
BA_ "SignalLongName" SG_ 394 TCU_DrvngModDis_Copy_1 "TCU_DrivingModeDisplay";
BA_ "UserSigValidity" SG_ 394 TCU_DrvngModDis_Copy_1 3;
BA_ "UsrSigTimeoutValue" SG_ 394 TCU_DrvngModDis_Copy_1 "";
BA_ "Description" SG_ 394 TCU_DrvngModDis_Copy_1 "Driving mode display by TCU";
BA_ "Version" SG_ 394 TCU_DrvngModDis_Copy_1 "1.0";
BA_ "SignalLongName" SG_ 394 TCU_DcmlVehSpdKphVal_Copy_1 "TCU_VehicleSpeedDecimalKphValue";
BA_ "UserSigValidity" SG_ 394 TCU_DcmlVehSpdKphVal_Copy_1 3;
BA_ "UsrSigTimeoutValue" SG_ 394 TCU_DcmlVehSpdKphVal_Copy_1 "";
BA_ "Description" SG_ 394 TCU_DcmlVehSpdKphVal_Copy_1 "The signal VS_TCU_DECIAMAL means the value which is below decimal point of the vehicle speed.

For instance, if a vehicle speed is 13.75Km/h, VS_TCU means 13Km/h and VS_TCU_DECIMAL means 0.75Km/h.



Example)   VS_TCU = 13,  VS_TCU_DECIAMAL  = 96

Vehicl";
BA_ "Version" SG_ 394 TCU_DcmlVehSpdKphVal_Copy_1 "1.0";
BA_ "SignalLongName" SG_ 394 TCU_CurrGearSta_Copy_1 "TCU_CurrentGearStatus";
BA_ "UserSigValidity" SG_ 394 TCU_CurrGearSta_Copy_1 3;
BA_ "UsrSigTimeoutValue" SG_ 394 TCU_CurrGearSta_Copy_1 "";
BA_ "Description" SG_ 394 TCU_CurrGearSta_Copy_1 "CUR_GR indicates the gear speed which is currently engaged in the gearbox.";
BA_ "Version" SG_ 394 TCU_CurrGearSta_Copy_1 "1.0";
BA_ "SignalLongName" SG_ 394 TCU_Crc1Val_Copy_1 "TCU_Crc1Value";
BA_ "UserSigValidity" SG_ 394 TCU_Crc1Val_Copy_1 3;
BA_ "UsrSigTimeoutValue" SG_ 394 TCU_Crc1Val_Copy_1 "";
BA_ "GenSigStartValue" SG_ 394 TCU_Crc1Val_Copy_1 4095;
BA_ "Description" SG_ 394 TCU_Crc1Val_Copy_1 "(PH) = 10H-(Least significant nibbles of (Byte0 + Byte1 + Byte2 + Byte3+ Byte4 + Byte5 + Byte6 + Byte7) + Most significant nibbles of (Byte0 + Byte1 + Byte2 + Byte3 + Byte4 + Byte5 + Byte6))";
BA_ "Version" SG_ 394 TCU_Crc1Val_Copy_1 "1.0";
BA_ "SignalLongName" SG_ 394 TCU_CluTrgtGearSta_Copy_1 "TCU_ClusterTargetGear";
BA_ "UserSigValidity" SG_ 394 TCU_CluTrgtGearSta_Copy_1 3;
BA_ "UsrSigTimeoutValue" SG_ 394 TCU_CluTrgtGearSta_Copy_1 "";
BA_ "Description" SG_ 394 TCU_CluTrgtGearSta_Copy_1 "TCH_CluTrgtGearSta informs about target gear of SS timing 

(For indicating Paddle shift or Manual mode on cluster)";
BA_ "Version" SG_ 394 TCU_CluTrgtGearSta_Copy_1 "1.0";
BA_ "SignalLongName" SG_ 394 TCU_AlvCnt1Val_Copy_1 "TCU_AliveCounter1Value";
BA_ "UserSigValidity" SG_ 394 TCU_AlvCnt1Val_Copy_1 3;
BA_ "UsrSigTimeoutValue" SG_ 394 TCU_AlvCnt1Val_Copy_1 "";
BA_ "Description" SG_ 394 TCU_AlvCnt1Val_Copy_1 "Alive Counter";
BA_ "Version" SG_ 394 TCU_AlvCnt1Val_Copy_1 "1.0";
BA_ "SignalLongName" SG_ 394 TCH_EngTrgtGearSta_Copy_1 "TCU_EngineTargetGear";
BA_ "UserSigValidity" SG_ 394 TCH_EngTrgtGearSta_Copy_1 3;
BA_ "UsrSigTimeoutValue" SG_ 394 TCH_EngTrgtGearSta_Copy_1 "";
BA_ "Description" SG_ 394 TCH_EngTrgtGearSta_Copy_1 "TCH_EngTrgtGearSta informs about target gear of SS timing 

(For indicating Paddle shift or Manual mode on cluster)";
BA_ "Version" SG_ 394 TCH_EngTrgtGearSta_Copy_1 "1.0";
BA_ "Version" SG_ 368 SCC_Crc1Val "1.0";
BA_ "GenSigStartValue" SG_ 368 SCC_Crc1Val 4095;
BA_ "UsrSigTimeoutValue" SG_ 368 SCC_Crc1Val "";
BA_ "UserSigValidity" SG_ 368 SCC_Crc1Val 3;
BA_ "SignalLongName" SG_ 368 SCC_Crc1Val "SCC_Crc1Value";
BA_ "Version" SG_ 368 SCC_AlvCnt1Val "1.0";
BA_ "Description" SG_ 368 SCC_AlvCnt1Val "This signal indicates message counter (alive-counter) for robustness.

* 0 to15 rolling count ; increases by 1 at every sampling count

* after the counter is 15, it starts again at 0";
BA_ "UsrSigTimeoutValue" SG_ 368 SCC_AlvCnt1Val "";
BA_ "UserSigValidity" SG_ 368 SCC_AlvCnt1Val 3;
BA_ "SignalLongName" SG_ 368 SCC_AlvCnt1Val "SCC_AliveCounter1Value";
BA_ "Version" SG_ 368 SCC_ObjDstVal "1.0";
BA_ "Description" SG_ 368 SCC_ObjDstVal "This signal provides the distance to the in lane detected SCC object regarding to the own vehicle.

- 자차선상의 전방 인식된 물체와의 거리";
BA_ "GenSigStartValue" SG_ 368 SCC_ObjDstVal 2047;
BA_ "UsrSigTimeoutValue" SG_ 368 SCC_ObjDstVal "";
BA_ "UserSigValidity" SG_ 368 SCC_ObjDstVal 3;
BA_ "SignalLongName" SG_ 368 SCC_ObjDstVal "SCC_ObjectDistanceValue";
BA_ "Version" SG_ 368 SCC_ObjRelSpdVal "1.0";
BA_ "Description" SG_ 368 SCC_ObjRelSpdVal "This signal provides the relative speed to the in lane detected SCC object regarding to the own vehicle.

- 자차선상의 전방 인식된 물체와 자차간 상대 속도";
BA_ "GenSigStartValue" SG_ 368 SCC_ObjRelSpdVal 4095;
BA_ "UsrSigTimeoutValue" SG_ 368 SCC_ObjRelSpdVal "";
BA_ "UserSigValidity" SG_ 368 SCC_ObjRelSpdVal 3;
BA_ "SignalLongName" SG_ 368 SCC_ObjRelSpdVal "SCC_ObjectRelativeSpeedValue";
BA_ "Version" SG_ 368 SCC_ObjLatPosVal "1.0";
BA_ "Description" SG_ 368 SCC_ObjLatPosVal "This signal provides the lateral position of the detected SCC object regarding to the own vehicle. 

The position of the SCC object on the left side in driving direction of the vehicle longitudinal axis correlates with a negative signal value. 

Thus an ";
BA_ "GenSigStartValue" SG_ 368 SCC_ObjLatPosVal 511;
BA_ "UsrSigTimeoutValue" SG_ 368 SCC_ObjLatPosVal "";
BA_ "UserSigValidity" SG_ 368 SCC_ObjLatPosVal 3;
BA_ "SignalLongName" SG_ 368 SCC_ObjLatPosVal "SCC_ObjectLateralPositionValue";
BA_ "Version" SG_ 368 SCC_SysFlrSta "1.0";
BA_ "Description" SG_ 368 SCC_SysFlrSta "This signal is evaluated by the driver information device to release the failure information to the driver.

If this signal is set to anything other than 0, the TCS/ESC shall ignore any requests from SCC

- 시스템 고장 발생 정보용

- 해당 값이 0 이외의 �";
BA_ "UsrSigTimeoutValue" SG_ 368 SCC_SysFlrSta "";
BA_ "UserSigValidity" SG_ 368 SCC_SysFlrSta 3;
BA_ "SignalLongName" SG_ 368 SCC_SysFlrSta "SCC_SystemFailureStatus";
BA_ "Version" SG_ 368 SCC_MainOnOffSta "1.0";
BA_ "Description" SG_ 368 SCC_MainOnOffSta "This signal specifies the status of a Main switch of SCC system

- Main swith 에 의한 SCC ON/OFF 상태 정보";
BA_ "UsrSigTimeoutValue" SG_ 368 SCC_MainOnOffSta "";
BA_ "UserSigValidity" SG_ 368 SCC_MainOnOffSta 3;
BA_ "SignalLongName" SG_ 368 SCC_MainOnOffSta "SCC_MainOnOffStatus";
BA_ "Version" SG_ 368 SCC_OpSta "1.0";
BA_ "Description" SG_ 368 SCC_OpSta "The signal ACCMode specifies the operational mode of SCC

- ACC 작동 상태 정보(off&ready / active / override / shut off)";
BA_ "UsrSigTimeoutValue" SG_ 368 SCC_OpSta "";
BA_ "UserSigValidity" SG_ 368 SCC_OpSta 3;
BA_ "SignalLongName" SG_ 368 SCC_OpSta "SCC_OperatingStatus";
BA_ "Version" SG_ 368 SCC_TakeoverReq "1.0";
BA_ "Description" SG_ 368 SCC_TakeoverReq "The Take-over Request supports the driver to identify the limits of the SCC control. Reasons for such a request may be:

- Deceleration capability insufficient for the current situation.

Clutch actuation by the driver is necessary to avoid stopping of t";
BA_ "UsrSigTimeoutValue" SG_ 368 SCC_TakeoverReq "";
BA_ "UserSigValidity" SG_ 368 SCC_TakeoverReq 3;
BA_ "SignalLongName" SG_ 368 SCC_TakeoverReq "SCC_TakeoverRequest";
BA_ "Version" SG_ 368 SCC_InfoDis "1.0";
BA_ "Description" SG_ 368 SCC_InfoDis "This signal carries information that indicates below 4 signals.

(1) SCC Mode display

(2) CC Mode display

(3) Object disapearing display

(4) Go notifying display

- SCC 제어 상세 상태를 보여주는 정보 신호

(SCC 모드 / CC 모드 / 전방차량 주의 / 정차 출";
BA_ "UsrSigTimeoutValue" SG_ 368 SCC_InfoDis "";
BA_ "UserSigValidity" SG_ 368 SCC_InfoDis 3;
BA_ "SignalLongName" SG_ 368 SCC_InfoDis "SCC_InformationDisplay";
BA_ "Version" SG_ 368 SCC_DrvAlrtDis "1.0";
BA_ "Description" SG_ 368 SCC_DrvAlrtDis "This signal carries the information which message shall be displayed to the driver 

when the SCC must be disengaged by the system or cann’t be engaged.

A signal value unequal 00H is repeated for 5 messages cycles in order to ensure it appears for at l";
BA_ "UsrSigTimeoutValue" SG_ 368 SCC_DrvAlrtDis "";
BA_ "UserSigValidity" SG_ 368 SCC_DrvAlrtDis 3;
BA_ "SignalLongName" SG_ 368 SCC_DrvAlrtDis "SCC_DriverAlertDisplay";
BA_ "Version" SG_ 368 SCC_ObjDetSta "1.0";
BA_ "Description" SG_ 368 SCC_ObjDetSta "If a in-path object is recognized by SCC, the driver should be informed.

- 자차선상의 전방 물체 인식 여부 정보";
BA_ "UsrSigTimeoutValue" SG_ 368 SCC_ObjDetSta "";
BA_ "UserSigValidity" SG_ 368 SCC_ObjDetSta 3;
BA_ "SignalLongName" SG_ 368 SCC_ObjDetSta "SCC_ObjectDetectedStatus";
BA_ "Version" SG_ 368 SCC_HeadwayDstSetVal "1.0";
BA_ "Description" SG_ 368 SCC_HeadwayDstSetVal "The desired time gap from which a following distance is extracted has to be presented to the driver at least if the value changes. 

The representation of the information depends on the display concept.

- 전방 차량과의 거리 setting 정보";
BA_ "UsrSigTimeoutValue" SG_ 368 SCC_HeadwayDstSetVal "";
BA_ "UserSigValidity" SG_ 368 SCC_HeadwayDstSetVal 3;
BA_ "SignalLongName" SG_ 368 SCC_HeadwayDstSetVal "SCC_HeadwayDistanceSettingValue";
BA_ "Version" SG_ 368 SCC_EquipSta "1.0";
BA_ "Description" SG_ 368 SCC_EquipSta "This signal indicates equipment for SCC

- SCC 장착 사양 정보";
BA_ "UsrSigTimeoutValue" SG_ 368 SCC_EquipSta "";
BA_ "UserSigValidity" SG_ 368 SCC_EquipSta 3;
BA_ "SignalLongName" SG_ 368 SCC_EquipSta "SCC_EquipmentStatus";
BA_ "Version" SG_ 368 SCC_TrgtSpdSetVal "1.0";
BA_ "Description" SG_ 368 SCC_TrgtSpdSetVal "The desired vehicle speed for free cruising has to be displayed all the time SCC is under active control.

※This signal can be sent in km/h or MPH according to the “SPEED_UNIT” signal (See CLU1 message).

SPEED_UNIT = 0 : [km/h], SPEED_UNIT = 1 : [MPH";
BA_ "UsrSigTimeoutValue" SG_ 368 SCC_TrgtSpdSetVal "";
BA_ "UserSigValidity" SG_ 368 SCC_TrgtSpdSetVal 3;
BA_ "SignalLongName" SG_ 368 SCC_TrgtSpdSetVal "SCC_TargetSpeedSettingValue";
BA_ "Version" SG_ 368 SCC_NaviCamOpSta "1.0";
BA_ "Description" SG_ 368 SCC_NaviCamOpSta "This signal describes the operational status of SCC with Navigation function.(speed camera control)

- 내비 연동 SCC(고속도로안전운행자동감속기능) 작동 상태 정보(off/ready/active)";
BA_ "UsrSigTimeoutValue" SG_ 368 SCC_NaviCamOpSta "";
BA_ "UserSigValidity" SG_ 368 SCC_NaviCamOpSta 3;
BA_ "SignalLongName" SG_ 368 SCC_NaviCamOpSta "SCC_NaviCameraOperatingStatus";
BA_ "Version" SG_ 368 SCC_NaviCamOnOffSta "1.0";
BA_ "Description" SG_ 368 SCC_NaviCamOnOffSta "This signal describes thes of SCC with Navigation function.(speed camera control)

- 내비 연동 SCC(고속도로안전운행자동감속기능) on/off 상태 정보";
BA_ "UsrSigTimeoutValue" SG_ 368 SCC_NaviCamOnOffSta "";
BA_ "UserSigValidity" SG_ 368 SCC_NaviCamOnOffSta 3;
BA_ "SignalLongName" SG_ 368 SCC_NaviCamOnOffSta "SCC_NaviCameraOnOffStatus";
BA_ "Version" SG_ 368 SCC_AccelReqVal "1.0";
BA_ "Description" SG_ 368 SCC_AccelReqVal "This signal represents the SCC acceleration request. 

- SCC 의 요구 가속도/감속도 값";
BA_ "UsrSigTimeoutValue" SG_ 368 SCC_AccelReqVal "";
BA_ "UserSigValidity" SG_ 368 SCC_AccelReqVal 3;
BA_ "SignalLongName" SG_ 368 SCC_AccelReqVal "SCC_AccelerationRequestValue";
BA_ "Version" SG_ 368 SCC_VehStpReq "1.0";
BA_ "Description" SG_ 368 SCC_VehStpReq "A control request flag for vehicle stop. SCC expects vehicle to be controlled to a complete stop and hold its state.

- SCC 해제 상황 발생시 차량 정차 유지를 위한 제동 요청 신호";
BA_ "UsrSigTimeoutValue" SG_ 368 SCC_VehStpReq "";
BA_ "UserSigValidity" SG_ 368 SCC_VehStpReq 3;
BA_ "SignalLongName" SG_ 368 SCC_VehStpReq "SCC_VehicleStopRequest";
BA_ "Version" SG_ 368 SCC_SnstvtyModRetVal "1.0";
BA_ "Description" SG_ 368 SCC_SnstvtyModRetVal "This signal is SCC sensitive set mode switch info return value to cluster

- SCC 민감도 설정 관련 USM 설정 스위치 정보의 리턴 값";
BA_ "GenSigStartValue" SG_ 368 SCC_SnstvtyModRetVal 2;
BA_ "UsrSigTimeoutValue" SG_ 368 SCC_SnstvtyModRetVal "";
BA_ "UserSigValidity" SG_ 368 SCC_SnstvtyModRetVal 3;
BA_ "SignalLongName" SG_ 368 SCC_SnstvtyModRetVal "SCC_SensitivityModeReturnValue";
BA_ "Version" SG_ 229 SAS_Crc1Val "1";
BA_ "GenSigStartValue" SG_ 229 SAS_Crc1Val 4095;
BA_ "UsrSigTimeoutValue" SG_ 229 SAS_Crc1Val "";
BA_ "UserSigValidity" SG_ 229 SAS_Crc1Val 3;
BA_ "SignalLongName" SG_ 229 SAS_Crc1Val "SAS_Crc1Value";
BA_ "Version" SG_ 229 SAS_AlvCnt1Val "1";
BA_ "UsrSigTimeoutValue" SG_ 229 SAS_AlvCnt1Val "";
BA_ "UserSigValidity" SG_ 229 SAS_AlvCnt1Val 3;
BA_ "SignalLongName" SG_ 229 SAS_AlvCnt1Val "SAS_AliveCounter1Value";
BA_ "Version" SG_ 229 SAS_AnglVal "1";
BA_ "Description" SG_ 229 SAS_AnglVal "Information regarding the steering wheel angle.



(PH) = (HEX) * 0.1 (0 <  HEX ≤ 7FFFH) or

(PH) = (HEX - 65536) * 0.1 (HEX > 7FFFH)";
BA_ "GenSigStartValue" SG_ 229 SAS_AnglVal 7;
BA_ "UsrSigTimeoutValue" SG_ 229 SAS_AnglVal "";
BA_ "UserSigValidity" SG_ 229 SAS_AnglVal 3;
BA_ "SignalLongName" SG_ 229 SAS_AnglVal "SAS_AngleValue";
BA_ "Version" SG_ 229 SAS_SpdVal "1";
BA_ "Description" SG_ 229 SAS_SpdVal "Information regarding the steering wheel rotation speed



(PH) = (HEX) × 4  (for 0 < HEX  ≤ 254)";
BA_ "UsrSigTimeoutValue" SG_ 229 SAS_SpdVal "";
BA_ "UserSigValidity" SG_ 229 SAS_SpdVal 3;
BA_ "SignalLongName" SG_ 229 SAS_SpdVal "SAS_SpeedValue";
BA_ "Version" SG_ 229 SAS_IntSta "1";
BA_ "Description" SG_ 229 SAS_IntSta "Information regarding the steering angle sensor’s internal state. If SAS_AnglVal value is O.K., SAS_OK flag is set and otherwise SAS_OK flag is cleared. If steering angle sensor has been calibrated, SAS_CAL flag is set and otherwise cleared.

SF1 - SF5 ";
BA_ "UsrSigTimeoutValue" SG_ 229 SAS_IntSta "";
BA_ "UserSigValidity" SG_ 229 SAS_IntSta 3;
BA_ "SignalLongName" SG_ 229 SAS_IntSta "SAS_InternalStatus";
BA_ "Version" SG_ 170 MDPS_Crc1Val "1.0";
BA_ "GenSigStartValue" SG_ 170 MDPS_Crc1Val 4095;
BA_ "UsrSigTimeoutValue" SG_ 170 MDPS_Crc1Val "";
BA_ "UserSigValidity" SG_ 170 MDPS_Crc1Val 3;
BA_ "SignalLongName" SG_ 170 MDPS_Crc1Val "MDPS_Crc1Value";
BA_ "Version" SG_ 170 MDPS_AlvCnt1Val "1.0";
BA_ "Description" SG_ 170 MDPS_AlvCnt1Val "This value is used to check the MDPS2 message is transmitted regularly and none have been lost.";
BA_ "UsrSigTimeoutValue" SG_ 170 MDPS_AlvCnt1Val "";
BA_ "UserSigValidity" SG_ 170 MDPS_AlvCnt1Val 3;
BA_ "SignalLongName" SG_ 170 MDPS_AlvCnt1Val "MDPS_AliveCounter1Value";
BA_ "Version" SG_ 170 MDPS_WrngLmpSta "1.0";
BA_ "Description" SG_ 170 MDPS_WrngLmpSta "The signal indicates the ststus of the “MDPS Warning lamp”";
BA_ "UsrSigTimeoutValue" SG_ 170 MDPS_WrngLmpSta "";
BA_ "UserSigValidity" SG_ 170 MDPS_WrngLmpSta 3;
BA_ "SignalLongName" SG_ 170 MDPS_WrngLmpSta "MDPS_WarningLampStatus";
BA_ "Version" SG_ 170 MDPS_Typ "1.0";
BA_ "Description" SG_ 170 MDPS_Typ "Information regarding the type of MDPS. (C-MDPS / R-MDPS)";
BA_ "UsrSigTimeoutValue" SG_ 170 MDPS_Typ "";
BA_ "UserSigValidity" SG_ 170 MDPS_Typ 3;
BA_ "SignalLongName" SG_ 170 MDPS_Typ "MDPS_Type";
BA_ "Version" SG_ 170 MDPS_EngIdleRpmReq "1.0";
BA_ "Description" SG_ 170 MDPS_EngIdleRpmReq "This signal indicates the request status for engine idle rpm up according to MDPS fast rotation.";
BA_ "UsrSigTimeoutValue" SG_ 170 MDPS_EngIdleRpmReq "";
BA_ "UserSigValidity" SG_ 170 MDPS_EngIdleRpmReq 3;
BA_ "SignalLongName" SG_ 170 MDPS_EngIdleRpmReq "MDPS_EngineIdleRpmRequest";
BA_ "Version" SG_ 170 MDPS_VsmPlgInSta "1.0";
BA_ "Description" SG_ 170 MDPS_VsmPlgInSta "This signal indicates whether the VSM function of MDPS is plugged in or not.";
BA_ "UsrSigTimeoutValue" SG_ 170 MDPS_VsmPlgInSta "";
BA_ "UserSigValidity" SG_ 170 MDPS_VsmPlgInSta 3;
BA_ "SignalLongName" SG_ 170 MDPS_VsmPlgInSta "MDPS_VsmPluginStatus";
BA_ "Version" SG_ 170 MDPS_DfctvSta "1.0";
BA_ "Description" SG_ 170 MDPS_DfctvSta "Information regarding the MDPS “defective” Indication";
BA_ "UsrSigTimeoutValue" SG_ 170 MDPS_DfctvSta "";
BA_ "UserSigValidity" SG_ 170 MDPS_DfctvSta 3;
BA_ "SignalLongName" SG_ 170 MDPS_DfctvSta "MDPS_DefectiveStatus";
BA_ "Version" SG_ 170 MDPS_SigErrSta "1.0";
BA_ "Description" SG_ 170 MDPS_SigErrSta "Information indicating VSM1 signal status";
BA_ "UsrSigTimeoutValue" SG_ 170 MDPS_SigErrSta "";
BA_ "UserSigValidity" SG_ 170 MDPS_SigErrSta 3;
BA_ "SignalLongName" SG_ 170 MDPS_SigErrSta "MDPS_SignalErrorStatus";
BA_ "Version" SG_ 170 MDPS_SpasPlugInSta "1.0";
BA_ "Description" SG_ 170 MDPS_SpasPlugInSta "This signal indicates whether the SPAS function of MDPS is plugged in or not.";
BA_ "UsrSigTimeoutValue" SG_ 170 MDPS_SpasPlugInSta "";
BA_ "UserSigValidity" SG_ 170 MDPS_SpasPlugInSta 3;
BA_ "SignalLongName" SG_ 170 MDPS_SpasPlugInSta "MDPS_SpasPlug-inStatus";
BA_ "Version" SG_ 170 MDPS_SpasModeSta "1.0";
BA_ "Description" SG_ 170 MDPS_SpasModeSta "This signal indicates the status of the automatic steering function.";
BA_ "GenSigStartValue" SG_ 170 MDPS_SpasModeSta 1;
BA_ "UsrSigTimeoutValue" SG_ 170 MDPS_SpasModeSta "";
BA_ "UserSigValidity" SG_ 170 MDPS_SpasModeSta 3;
BA_ "SignalLongName" SG_ 170 MDPS_SpasModeSta "MDPS_SpasModeStatus";
BA_ "Version" SG_ 170 MDPS_LkasPlgInSta "1.0";
BA_ "Description" SG_ 170 MDPS_LkasPlgInSta "This signal indicates whether the LKAS function of MDPS is plugged in or not.";
BA_ "UsrSigTimeoutValue" SG_ 170 MDPS_LkasPlgInSta "";
BA_ "UserSigValidity" SG_ 170 MDPS_LkasPlgInSta 3;
BA_ "SignalLongName" SG_ 170 MDPS_LkasPlgInSta "MDPS_LkasPlug-inStatus";
BA_ "Version" SG_ 170 MDPS_LkasToiActvSta "1.0";
BA_ "Description" SG_ 170 MDPS_LkasToiActvSta "This flag is set to 1 in response to the LKAS Controller requesting the activation of the torque interface and set back to 0 in response to the LKAS Controller requesting the de-activation of the torque interface.";
BA_ "UsrSigTimeoutValue" SG_ 170 MDPS_LkasToiActvSta "";
BA_ "UserSigValidity" SG_ 170 MDPS_LkasToiActvSta 3;
BA_ "SignalLongName" SG_ 170 MDPS_LkasToiActvSta "MDPS_LkasToiActiveStatus";
BA_ "Version" SG_ 170 MDPS_ToiUnblSta "1.0";
BA_ "Description" SG_ 170 MDPS_ToiUnblSta "This is a flag that is set when the MDPS is not faulty, but is temporarily unable to activate the TOI due to steering torque limiting e.g. when the supply voltage is too low.";
BA_ "UsrSigTimeoutValue" SG_ 170 MDPS_ToiUnblSta "";
BA_ "UserSigValidity" SG_ 170 MDPS_ToiUnblSta 3;
BA_ "SignalLongName" SG_ 170 MDPS_ToiUnblSta "MDPS_ToiUnavailableStatus";
BA_ "Version" SG_ 170 MDPS_ToiFltSta "1.0";
BA_ "Description" SG_ 170 MDPS_ToiFltSta "This fault flag is set when a fault within the MDPS system has been detected such that the LKAS TOI can no longer function. CAN failures, internal MDPS failures, and LKAS controller logic failures are all reported by this flag. Failures reported by the L";
BA_ "UsrSigTimeoutValue" SG_ 170 MDPS_ToiFltSta "";
BA_ "UserSigValidity" SG_ 170 MDPS_ToiFltSta 3;
BA_ "SignalLongName" SG_ 170 MDPS_ToiFltSta "MDPS_ToiFaultStatus";
BA_ "Version" SG_ 170 MDPS_LkasFailSta "1.0";
BA_ "Description" SG_ 170 MDPS_LkasFailSta "This fault flag is set whilst the MDPS TOI is in a fail state and has not yet recovered from it. This could either be due to an MDPS detected fault (as communicated by the ‘CF_Mdps_ToiFlt’ flag) or an LKAS detected fault (as communicated by the ‘CF_Lk";
BA_ "UsrSigTimeoutValue" SG_ 170 MDPS_LkasFailSta "";
BA_ "UserSigValidity" SG_ 170 MDPS_LkasFailSta 3;
BA_ "SignalLongName" SG_ 170 MDPS_LkasFailSta "MDPS_LkasFailStatus";
BA_ "Version" SG_ 170 MDPS_FlxStrSta "1.0";
BA_ "Description" SG_ 170 MDPS_FlxStrSta "This signal indicates flex steer parameter set in MDPS.";
BA_ "UsrSigTimeoutValue" SG_ 170 MDPS_FlxStrSta "";
BA_ "UserSigValidity" SG_ 170 MDPS_FlxStrSta 3;
BA_ "SignalLongName" SG_ 170 MDPS_FlxStrSta "MDPS_FlexSteerStatus";
BA_ "Version" SG_ 170 MDPS_FlxStrDis "1.0";
BA_ "Description" SG_ 170 MDPS_FlxStrDis "This signal request to display 

 status of MDPS Mode";
BA_ "UsrSigTimeoutValue" SG_ 170 MDPS_FlxStrDis "";
BA_ "UserSigValidity" SG_ 170 MDPS_FlxStrDis 3;
BA_ "SignalLongName" SG_ 170 MDPS_FlxStrDis "MDPS_FlexSteerDisplay";
BA_ "Version" SG_ 170 MDPS_CurrModVal "1.0";
BA_ "Description" SG_ 170 MDPS_CurrModVal "This signal indicates flex steer parameter value in MDPS.



※ For information about flex steer mode set by user, refer to CF_Mdps_Flex signal.";
BA_ "UsrSigTimeoutValue" SG_ 170 MDPS_CurrModVal "";
BA_ "UserSigValidity" SG_ 170 MDPS_CurrModVal 3;
BA_ "SignalLongName" SG_ 170 MDPS_CurrModVal "MDPS_CurrentModeStatus";
BA_ "Version" SG_ 170 MDPS_OutTqVal "1.0";
BA_ "Description" SG_ 170 MDPS_OutTqVal "MDPS column torque";
BA_ "GenSigStartValue" SG_ 170 MDPS_OutTqVal 2048;
BA_ "UsrSigTimeoutValue" SG_ 170 MDPS_OutTqVal "";
BA_ "UserSigValidity" SG_ 170 MDPS_OutTqVal 3;
BA_ "SignalLongName" SG_ 170 MDPS_OutTqVal "MDPS_OutputTorqueValue";
BA_ "Version" SG_ 170 MDPS_StrTqSnsrVal "1.0";
BA_ "Description" SG_ 170 MDPS_StrTqSnsrVal "Steering torque sensor value";
BA_ "GenSigStartValue" SG_ 170 MDPS_StrTqSnsrVal 2048;
BA_ "UsrSigTimeoutValue" SG_ 170 MDPS_StrTqSnsrVal "";
BA_ "UserSigValidity" SG_ 170 MDPS_StrTqSnsrVal 3;
BA_ "SignalLongName" SG_ 170 MDPS_StrTqSnsrVal "MDPS_SteeringTorqueSensorValue";
BA_ "Version" SG_ 170 MDPS_StrAnglVal "1.0";
BA_ "Description" SG_ 170 MDPS_StrAnglVal "This value is used to inform SPAS of a compensated steering wheel angle by MDPS. The signal is signed 16bits.



(PH) = (HEX) × 0.1 (for 0 < HEX ≤ 32767)  or

= (HEX - 65536) × 0.1 (for HEX > 32767) [Deg]";
BA_ "GenSigStartValue" SG_ 170 MDPS_StrAnglVal 32767;
BA_ "UsrSigTimeoutValue" SG_ 170 MDPS_StrAnglVal "";
BA_ "UserSigValidity" SG_ 170 MDPS_StrAnglVal 3;
BA_ "SignalLongName" SG_ 170 MDPS_StrAnglVal "MDPS_SteeringAngleValue";
BA_ "Version" SG_ 586 HUD_Crc1Val "1.0";
BA_ "GenSigStartValue" SG_ 586 HUD_Crc1Val 4095;
BA_ "UsrSigTimeoutValue" SG_ 586 HUD_Crc1Val "";
BA_ "GenSigTimeoutTime" SG_ 586 HUD_Crc1Val 2000;
BA_ "UserSigValidity" SG_ 586 HUD_Crc1Val 3;
BA_ "SignalLongName" SG_ 586 HUD_Crc1Val "HUD_Crc1Value";
BA_ "Version" SG_ 586 HUD_AlvCnt1Val "1.0";
BA_ "UsrSigTimeoutValue" SG_ 586 HUD_AlvCnt1Val "";
BA_ "GenSigTimeoutTime" SG_ 586 HUD_AlvCnt1Val 2000;
BA_ "UserSigValidity" SG_ 586 HUD_AlvCnt1Val 3;
BA_ "SignalLongName" SG_ 586 HUD_AlvCnt1Val "HUD_AliveCounter1Value";
BA_ "Version" SG_ 586 HUD_HghtSta "1.0";
BA_ "Description" SG_ 586 HUD_HghtSta "This signal indicates that the HUD Height Status.";
BA_ "GenSigStartValue" SG_ 586 HUD_HghtSta 9;
BA_ "UsrSigTimeoutValue" SG_ 586 HUD_HghtSta "";
BA_ "GenSigTimeoutTime" SG_ 586 HUD_HghtSta 2000;
BA_ "UserSigValidity" SG_ 586 HUD_HghtSta 3;
BA_ "SignalLongName" SG_ 586 HUD_HghtSta "HUD_HeightStatus";
BA_ "Version" SG_ 586 HUD_PbackSta "1.0";
BA_ "Description" SG_ 586 HUD_PbackSta "Status signal for HUD interoperation with IMS

(The number of memory is expanded.)";
BA_ "UsrSigTimeoutValue" SG_ 586 HUD_PbackSta "";
BA_ "GenSigTimeoutTime" SG_ 586 HUD_PbackSta 2000;
BA_ "UserSigValidity" SG_ 586 HUD_PbackSta 3;
BA_ "SignalLongName" SG_ 586 HUD_PbackSta "HUD_PbackStatus";
BA_ "Version" SG_ 586 HUD_BrgtnsSta "1.0";
BA_ "Description" SG_ 586 HUD_BrgtnsSta "This signal indicates that the Hud Brightness Status.";
BA_ "GenSigStartValue" SG_ 586 HUD_BrgtnsSta 14;
BA_ "UsrSigTimeoutValue" SG_ 586 HUD_BrgtnsSta "";
BA_ "GenSigTimeoutTime" SG_ 586 HUD_BrgtnsSta 2000;
BA_ "UserSigValidity" SG_ 586 HUD_BrgtnsSta 3;
BA_ "SignalLongName" SG_ 586 HUD_BrgtnsSta "HUD_BrightnessStatus";
BA_ "Version" SG_ 586 HUD_RotatSta "1.0";
BA_ "Description" SG_ 586 HUD_RotatSta "The status signal of HUD rotation";
BA_ "UsrSigTimeoutValue" SG_ 586 HUD_RotatSta "";
BA_ "GenSigTimeoutTime" SG_ 586 HUD_RotatSta 2000;
BA_ "UserSigValidity" SG_ 586 HUD_RotatSta 3;
BA_ "SignalLongName" SG_ 586 HUD_RotatSta "HUD_RotateStatus";
BA_ "Version" SG_ 378 CLU_Crc1Val "1.0";
BA_ "GenSigStartValue" SG_ 378 CLU_Crc1Val 4095;
BA_ "UsrSigTimeoutValue" SG_ 378 CLU_Crc1Val "";
BA_ "UserSigValidity" SG_ 378 CLU_Crc1Val 3;
BA_ "SignalLongName" SG_ 378 CLU_Crc1Val "CLU_Crc1Value";
BA_ "Version" SG_ 378 CLU_AlvCnt1Val "1.0";
BA_ "Description" SG_ 378 CLU_AlvCnt1Val "This cyclic counter indicates the actuality of the dashboard message.

This signal counts up every 20msec only when ignition is ON.

When ignition is off, AliveCounter is set as initial value (00H) 



IPM receives this signal from CLUSTER and IPM sends ";
BA_ "UsrSigTimeoutValue" SG_ 378 CLU_AlvCnt1Val "";
BA_ "UserSigValidity" SG_ 378 CLU_AlvCnt1Val 3;
BA_ "SignalLongName" SG_ 378 CLU_AlvCnt1Val "CLU_AliveCounter1Value";
BA_ "Version" SG_ 378 CLU_PrtyBitSta "1.0";
BA_ "Description" SG_ 378 CLU_PrtyBitSta "TBD (레이아웃 결정 후 로직 수정)";
BA_ "UsrSigTimeoutValue" SG_ 378 CLU_PrtyBitSta "";
BA_ "UserSigValidity" SG_ 378 CLU_PrtyBitSta 3;
BA_ "SignalLongName" SG_ 378 CLU_PrtyBitSta "CLU_ParityBitValue";
BA_ "Version" SG_ 378 CLU_PasDisTyp "1.0";
BA_ "Description" SG_ 378 CLU_PasDisTyp "Cluster Display information";
BA_ "UsrSigTimeoutValue" SG_ 378 CLU_PasDisTyp "";
BA_ "UserSigValidity" SG_ 378 CLU_PasDisTyp 3;
BA_ "SignalLongName" SG_ 378 CLU_PasDisTyp "CLU_PasDisplayType";
BA_ "Version" SG_ 378 CLU_DtntOutSta "1.0";
BA_ "Description" SG_ 378 CLU_DtntOutSta "This signal indicates the status of detent illumination. Cluster sends the detent information for a Unified Illumination system.";
BA_ "UsrSigTimeoutValue" SG_ 378 CLU_DtntOutSta "";
BA_ "UserSigValidity" SG_ 378 CLU_DtntOutSta 0;
BA_ "SignalLongName" SG_ 378 CLU_DtntOutSta "CLU_DetentOutStatus";
BA_ "Version" SG_ 378 CLU_SpdUnitTyp "1.0";
BA_ "Description" SG_ 378 CLU_SpdUnitTyp "This signal indicates the unit of the speed displayed in the speedometer.";
BA_ "UsrSigTimeoutValue" SG_ 378 CLU_SpdUnitTyp "";
BA_ "UserSigValidity" SG_ 378 CLU_SpdUnitTyp 3;
BA_ "SignalLongName" SG_ 378 CLU_SpdUnitTyp "CLU_SpeedUnitType";
BA_ "Version" SG_ 378 CLU_DisSpdDcmlVal "1.0";
BA_ "Description" SG_ 378 CLU_DisSpdDcmlVal "The signal 'CF_Clu_VanzDecimal' means the extra value of the signal 'CF_Clu_Vanz' (vehicle speed which is indicated in the speedometer)

Also, This signal should be sent in km/h or MPH according to the 'CF_Clu_SPEED_UNIT' signal.

CF_Clu_SPEED_UNIT = 0 :";
BA_ "UsrSigTimeoutValue" SG_ 378 CLU_DisSpdDcmlVal "";
BA_ "UserSigValidity" SG_ 378 CLU_DisSpdDcmlVal 3;
BA_ "SignalLongName" SG_ 378 CLU_DisSpdDcmlVal "CLU_DisplaySpeedDecimalValue";
BA_ "Version" SG_ 378 CLU_CrsMainSwSta "1.0";
BA_ "Description" SG_ 378 CLU_CrsMainSwSta "This signal enables or disables ACC/SCC function (ACC/SCC main switch). Default value of this sgnal is 0 and the value is set to 1 only while a driver is pressing the ACC/SCC main switch. This signal changes enable/disable state of SCC function according";
BA_ "UsrSigTimeoutValue" SG_ 378 CLU_CrsMainSwSta "";
BA_ "UserSigValidity" SG_ 378 CLU_CrsMainSwSta 3;
BA_ "SignalLongName" SG_ 378 CLU_CrsMainSwSta "CLU_CruiseMainSwitchStatus";
BA_ "Version" SG_ 378 CLU_RhstaLvlSta "1.0";
BA_ "Description" SG_ 378 CLU_RhstaLvlSta "This signal is used for a rheostat level of CLUSTER from 1 to 21 level (21 level : Detent) for a Unified Illumination system.";
BA_ "UsrSigTimeoutValue" SG_ 378 CLU_RhstaLvlSta "";
BA_ "UserSigValidity" SG_ 378 CLU_RhstaLvlSta 0;
BA_ "SignalLongName" SG_ 378 CLU_RhstaLvlSta "CLU_RheostatLevelStatus";
BA_ "Version" SG_ 378 CLU_DisSpdVal "1.0";
BA_ "Description" SG_ 378 CLU_DisSpdVal "The vehicle speed which is indicated in the speedmeter has to be sent to SCC. This value is used for evalution of SCC command values instead of the vehicle velocity in order to avoid significant difference between the speedmeter indicator and the set spe";
BA_ "UsrSigTimeoutValue" SG_ 378 CLU_DisSpdVal "";
BA_ "UserSigValidity" SG_ 378 CLU_DisSpdVal 3;
BA_ "SignalLongName" SG_ 378 CLU_DisSpdVal "CLU_DisplaySpeedValue";
BA_ "Version" SG_ 469 CLU_Crc2Val "1.0";
BA_ "GenSigStartValue" SG_ 469 CLU_Crc2Val 4095;
BA_ "UsrSigTimeoutValue" SG_ 469 CLU_Crc2Val "";
BA_ "GenSigTimeoutTime" SG_ 469 CLU_Crc2Val 2000;
BA_ "UserSigValidity" SG_ 469 CLU_Crc2Val 3;
BA_ "SignalLongName" SG_ 469 CLU_Crc2Val "CLU_Crc2Value";
BA_ "Version" SG_ 469 CLU_AlvCnt2Val "1.0";
BA_ "Description" SG_ 469 CLU_AlvCnt2Val "This signal enables the systems which are using signals from CLUSTER to check whether the CLU5 message is updated or not. The counter has to be increased by 1 after sending of a frame. If the counter reaches 0F, it will restart with 0 at the next frame.

";
BA_ "UsrSigTimeoutValue" SG_ 469 CLU_AlvCnt2Val "";
BA_ "GenSigTimeoutTime" SG_ 469 CLU_AlvCnt2Val 2000;
BA_ "UserSigValidity" SG_ 469 CLU_AlvCnt2Val 3;
BA_ "SignalLongName" SG_ 469 CLU_AlvCnt2Val "CLU_AliveCounter2Value";
BA_ "Version" SG_ 469 CLU_DrvModSwSta "1.0";
BA_ "Description" SG_ 469 CLU_DrvModSwSta "This signal represents the drive mode switch's state.

0x0:off /0x1:on";
BA_ "UsrSigTimeoutValue" SG_ 469 CLU_DrvModSwSta "";
BA_ "GenSigTimeoutTime" SG_ 469 CLU_DrvModSwSta 2000;
BA_ "UserSigValidity" SG_ 469 CLU_DrvModSwSta 3;
BA_ "SignalLongName" SG_ 469 CLU_DrvModSwSta "CLU_DriveModeSwitchStatus";
BA_ "Version" SG_ 469 CLU_DrvngModSwSta "1.0";
BA_ "Description" SG_ 469 CLU_DrvngModSwSta "This signal occurs when drive mode switch(button) is selected either 'Normal' or 'Sports' or 'Snow' or 'Eco‘";
BA_ "UsrSigTimeoutValue" SG_ 469 CLU_DrvngModSwSta "";
BA_ "GenSigTimeoutTime" SG_ 469 CLU_DrvngModSwSta 2000;
BA_ "UserSigValidity" SG_ 469 CLU_DrvngModSwSta 3;
BA_ "SignalLongName" SG_ 469 CLU_DrvngModSwSta "CLU_DrivingModeSwitchStatus";
BA_ "Version" SG_ 469 CLU_SRSWrngLmpSta "1.0";
BA_ "Description" SG_ 469 CLU_SRSWrngLmpSta "This signal is generated by one of the following 5 self-diagnostic result of micro-controller of Cluster.

1) “Lamp ON” status as a self-status diagnostic result of cluster

2) “Lamp OFF” status as a self-status diagnostic result of cluster

3) “Lam";
BA_ "UsrSigTimeoutValue" SG_ 469 CLU_SRSWrngLmpSta "";
BA_ "GenSigTimeoutTime" SG_ 469 CLU_SRSWrngLmpSta 2000;
BA_ "UserSigValidity" SG_ 469 CLU_SRSWrngLmpSta 3;
BA_ "SignalLongName" SG_ 469 CLU_SRSWrngLmpSta "CLU_SRSWarningLampStatus";
BA_ "Version" SG_ 469 CLU_DTEVal "1.0";
BA_ "Description" SG_ 469 CLU_DTEVal "This signal indicates DTE.

0x0: Invalid

0x1: Not account (DTE display not in available : less than 50km)

0x2~0x3FF : Valid DTE (50~1023km)";
BA_ "UsrSigTimeoutValue" SG_ 469 CLU_DTEVal "";
BA_ "GenSigTimeoutTime" SG_ 469 CLU_DTEVal 2000;
BA_ "UserSigValidity" SG_ 469 CLU_DTEVal 3;
BA_ "SignalLongName" SG_ 469 CLU_DTEVal "CLU_DTEValue";
BA_ "Version" SG_ 469 CLU_AltLSta "1.0";
BA_ "Description" SG_ 469 CLU_AltLSta "This signal indicates the status of alternator L port. Cluster sends the information of the alternator L port to MTC/DATC.";
BA_ "UsrSigTimeoutValue" SG_ 469 CLU_AltLSta "";
BA_ "GenSigTimeoutTime" SG_ 469 CLU_AltLSta 2000;
BA_ "UserSigValidity" SG_ 469 CLU_AltLSta 3;
BA_ "SignalLongName" SG_ 469 CLU_AltLSta "CLU_AlternatorLStatus";
BA_ "Version" SG_ 469 CLU_SndTyp "1.0";
BA_ "Description" SG_ 469 CLU_SndTyp "This signal is for sound type of Cluster.

The Cluster applied buzzer is can generate only on channel sound

and the Cluster applied speaker can generate multi channel sound.";
BA_ "UsrSigTimeoutValue" SG_ 469 CLU_SndTyp "";
BA_ "GenSigTimeoutTime" SG_ 469 CLU_SndTyp 2000;
BA_ "UserSigValidity" SG_ 469 CLU_SndTyp 3;
BA_ "SignalLongName" SG_ 469 CLU_SndTyp "CLU_SoundType";
BA_ "Version" SG_ 469 CLU_TripUnitSta "1.0";
BA_ "Description" SG_ 469 CLU_TripUnitSta "This signal indicates Distance to Empty UNIT";
BA_ "UsrSigTimeoutValue" SG_ 469 CLU_TripUnitSta "";
BA_ "GenSigTimeoutTime" SG_ 469 CLU_TripUnitSta 2000;
BA_ "UserSigValidity" SG_ 469 CLU_TripUnitSta 3;
BA_ "SignalLongName" SG_ 469 CLU_TripUnitSta "CLU_TripUnitStatus";
BA_ "Version" SG_ 469 CLU_AvgFuelCnsmptnVal "1.0";
BA_ "Description" SG_ 469 CLU_AvgFuelCnsmptnVal "This average fuel consumption which is displayed in the trip-computer has to be sent to Tele-matics control unit. 

This signal is applied to the case cluster displays in the trip-computer.";
BA_ "UsrSigTimeoutValue" SG_ 469 CLU_AvgFuelCnsmptnVal "";
BA_ "GenSigTimeoutTime" SG_ 469 CLU_AvgFuelCnsmptnVal 2000;
BA_ "UserSigValidity" SG_ 469 CLU_AvgFuelCnsmptnVal 3;
BA_ "SignalLongName" SG_ 469 CLU_AvgFuelCnsmptnVal "CLU_AverageFuelConsumptionValue";
BA_ "Version" SG_ 469 CLU_AvgFuelCnsmptnUnitSta "1.0";
BA_ "Description" SG_ 469 CLU_AvgFuelCnsmptnUnitSta "This signal indicates the unit of average fuel consumption displayed in the trip computer.

This signal is applied to the case cluster displays in the trip-computer.";
BA_ "UsrSigTimeoutValue" SG_ 469 CLU_AvgFuelCnsmptnUnitSta "";
BA_ "GenSigTimeoutTime" SG_ 469 CLU_AvgFuelCnsmptnUnitSta 2000;
BA_ "UserSigValidity" SG_ 469 CLU_AvgFuelCnsmptnUnitSta 3;
BA_ "SignalLongName" SG_ 469 CLU_AvgFuelCnsmptnUnitSta "CLU_AverageFuelConsumptionUnitStatus";
BA_ "Version" SG_ 469 CLU_LoFuelWrngSta "1.0";
BA_ "Description" SG_ 469 CLU_LoFuelWrngSta "This signal indicates that the Low fuel warning in the cluster is On or Off. When Low Fuel Warning is On, its value is 01H otherwise its value is 00H.";
BA_ "UsrSigTimeoutValue" SG_ 469 CLU_LoFuelWrngSta "";
BA_ "GenSigTimeoutTime" SG_ 469 CLU_LoFuelWrngSta 2000;
BA_ "UserSigValidity" SG_ 469 CLU_LoFuelWrngSta 3;
BA_ "SignalLongName" SG_ 469 CLU_LoFuelWrngSta "CLU_LowFuelWarningStatus";
BA_ "Version" SG_ 469 CLU_RefuelDetSta "1.0";
BA_ "Description" SG_ 469 CLU_RefuelDetSta "This signal sends the refuel detected status to the tele-matics control unit. 

It transfers 3 times during refuel detected event why if valid one is missing, valid signals are used for extra signal.";
BA_ "UsrSigTimeoutValue" SG_ 469 CLU_RefuelDetSta "";
BA_ "GenSigTimeoutTime" SG_ 469 CLU_RefuelDetSta 2000;
BA_ "UserSigValidity" SG_ 469 CLU_RefuelDetSta 3;
BA_ "SignalLongName" SG_ 469 CLU_RefuelDetSta "CLU_RefuelDetectedStatus";
BA_ "Version" SG_ 469 CLU_FuelLvlDisVal "1.0";
BA_ "Description" SG_ 469 CLU_FuelLvlDisVal "This signal is fuel level of the cluster that fuel gauge indicate.";
BA_ "UsrSigTimeoutValue" SG_ 469 CLU_FuelLvlDisVal "";
BA_ "GenSigTimeoutTime" SG_ 469 CLU_FuelLvlDisVal 2000;
BA_ "UserSigValidity" SG_ 469 CLU_FuelLvlDisVal 3;
BA_ "SignalLongName" SG_ 469 CLU_FuelLvlDisVal "CLU_FuelLevelDisplayValue";
BA_ "Version" SG_ 469 CLU_LngSta "1.0";
BA_ "Description" SG_ 469 CLU_LngSta "Language Info. for Display Font";
BA_ "UsrSigTimeoutValue" SG_ 469 CLU_LngSta "";
BA_ "GenSigTimeoutTime" SG_ 469 CLU_LngSta 2000;
BA_ "UserSigValidity" SG_ 469 CLU_LngSta 3;
BA_ "SignalLongName" SG_ 469 CLU_LngSta "CLU_LanguageStatus";
BA_ "Version" SG_ 469 CLU_OdoVal "1.0";
BA_ "Description" SG_ 469 CLU_OdoVal "This signal indicates mileage counter of a vehicle. Cluster calculates total mileage and sends it to SCC and CUBIS. This value shall be the same with the mileage that is displayed to a driver.";
BA_ "UsrSigTimeoutValue" SG_ 469 CLU_OdoVal "";
BA_ "GenSigTimeoutTime" SG_ 469 CLU_OdoVal 2000;
BA_ "UserSigValidity" SG_ 469 CLU_OdoVal 3;
BA_ "SignalLongName" SG_ 469 CLU_OdoVal "CLU_OdometerValue";
BA_ "Version" SG_ 778 CLU_Crc3Val "1.0";
BA_ "GenSigStartValue" SG_ 778 CLU_Crc3Val 4095;
BA_ "UsrSigTimeoutValue" SG_ 778 CLU_Crc3Val "";
BA_ "GenSigTimeoutTime" SG_ 778 CLU_Crc3Val 2000;
BA_ "UserSigValidity" SG_ 778 CLU_Crc3Val 3;
BA_ "SignalLongName" SG_ 778 CLU_Crc3Val "CLU_Crc3Value";
BA_ "Version" SG_ 778 CLU_AlvCnt3Val "1.0";
BA_ "UsrSigTimeoutValue" SG_ 778 CLU_AlvCnt3Val "";
BA_ "GenSigTimeoutTime" SG_ 778 CLU_AlvCnt3Val 2000;
BA_ "UserSigValidity" SG_ 778 CLU_AlvCnt3Val 3;
BA_ "SignalLongName" SG_ 778 CLU_AlvCnt3Val "CLU_AliveCounter3Value";
BA_ "Version" SG_ 778 VCRM_CluDISWrngSta "1.0";
BA_ "Description" SG_ 778 VCRM_CluDISWrngSta "Cluster DIS warning(on/off)";
BA_ "UsrSigTimeoutValue" SG_ 778 VCRM_CluDISWrngSta "";
BA_ "GenSigTimeoutTime" SG_ 778 VCRM_CluDISWrngSta 2000;
BA_ "UserSigValidity" SG_ 778 VCRM_CluDISWrngSta 3;
BA_ "SignalLongName" SG_ 778 VCRM_CluDISWrngSta "VCRM_ClusterDISWarningStatus";
BA_ "Version" SG_ 778 VCRM_CluFuelConsmptnUnitSta "1.0";
BA_ "Description" SG_ 778 VCRM_CluFuelConsmptnUnitSta "Cluster Fuen Consumption Unit (km/l, MPG(US), L/100, MPG(UK))";
BA_ "UsrSigTimeoutValue" SG_ 778 VCRM_CluFuelConsmptnUnitSta "";
BA_ "GenSigTimeoutTime" SG_ 778 VCRM_CluFuelConsmptnUnitSta 2000;
BA_ "UserSigValidity" SG_ 778 VCRM_CluFuelConsmptnUnitSta 3;
BA_ "SignalLongName" SG_ 778 VCRM_CluFuelConsmptnUnitSta "VCRM_ClusterFuelConsumptionUnitStatus";
BA_ "Version" SG_ 778 VCRM_CluGearPosPopupSta "1.0";
BA_ "Description" SG_ 778 VCRM_CluGearPosPopupSta "Cluster Gear Position Popup(off/on)";
BA_ "UsrSigTimeoutValue" SG_ 778 VCRM_CluGearPosPopupSta "";
BA_ "GenSigTimeoutTime" SG_ 778 VCRM_CluGearPosPopupSta 2000;
BA_ "UserSigValidity" SG_ 778 VCRM_CluGearPosPopupSta 3;
BA_ "SignalLongName" SG_ 778 VCRM_CluGearPosPopupSta "VCRM_ClusterGearPositionPopupStatus";
BA_ "Version" SG_ 778 VCRM_CluMFSWPopupSta "1.0";
BA_ "Description" SG_ 778 VCRM_CluMFSWPopupSta "Cluster Multifunction SW popup(on/off)";
BA_ "UsrSigTimeoutValue" SG_ 778 VCRM_CluMFSWPopupSta "";
BA_ "GenSigTimeoutTime" SG_ 778 VCRM_CluMFSWPopupSta 2000;
BA_ "UserSigValidity" SG_ 778 VCRM_CluMFSWPopupSta 3;
BA_ "SignalLongName" SG_ 778 VCRM_CluMFSWPopupSta "VCRM_ClusterMFSWPopupStatus";
BA_ "Version" SG_ 778 VCRM_CluSrvRmndrSta "1.0";
BA_ "Description" SG_ 778 VCRM_CluSrvRmndrSta "Cluster Service Reminder(on/off)";
BA_ "UsrSigTimeoutValue" SG_ 778 VCRM_CluSrvRmndrSta "";
BA_ "GenSigTimeoutTime" SG_ 778 VCRM_CluSrvRmndrSta 2000;
BA_ "UserSigValidity" SG_ 778 VCRM_CluSrvRmndrSta 3;
BA_ "SignalLongName" SG_ 778 VCRM_CluSrvRmndrSta "VCRM_ClusterServiceReminderStatus";
BA_ "Version" SG_ 778 VCRM_CluSpdmtrSta "1.0";
BA_ "Description" SG_ 778 VCRM_CluSpdmtrSta "Cluster Speedometer Unit(km/h, MPH)";
BA_ "UsrSigTimeoutValue" SG_ 778 VCRM_CluSpdmtrSta "";
BA_ "GenSigTimeoutTime" SG_ 778 VCRM_CluSpdmtrSta 2000;
BA_ "UserSigValidity" SG_ 778 VCRM_CluSpdmtrSta 3;
BA_ "SignalLongName" SG_ 778 VCRM_CluSpdmtrSta "VCRM_ClusterSpeedometerStatus";
BA_ "Version" SG_ 778 VCRM_CluStrWhlAlignSta "1.0";
BA_ "Description" SG_ 778 VCRM_CluStrWhlAlignSta "Steering Wheel Alignment(on/off)";
BA_ "UsrSigTimeoutValue" SG_ 778 VCRM_CluStrWhlAlignSta "";
BA_ "GenSigTimeoutTime" SG_ 778 VCRM_CluStrWhlAlignSta 2000;
BA_ "UserSigValidity" SG_ 778 VCRM_CluStrWhlAlignSta 3;
BA_ "SignalLongName" SG_ 778 VCRM_CluStrWhlAlignSta "VCRM_ClusterSteeringWheelAlignmentStatus";
BA_ "Version" SG_ 778 VCRM_CluWlcmSndSta "1.0";
BA_ "Description" SG_ 778 VCRM_CluWlcmSndSta "Cluster Welcome Sound(on/off)";
BA_ "UsrSigTimeoutValue" SG_ 778 VCRM_CluWlcmSndSta "";
BA_ "GenSigTimeoutTime" SG_ 778 VCRM_CluWlcmSndSta 2000;
BA_ "UserSigValidity" SG_ 778 VCRM_CluWlcmSndSta 3;
BA_ "SignalLongName" SG_ 778 VCRM_CluWlcmSndSta "VCRM_ClusterWelcomeSoundStatus";
BA_ "Version" SG_ 778 VCRM_CluDisGrpSta "1.0";
BA_ "Description" SG_ 778 VCRM_CluDisGrpSta "Cluster CGW Display Group(1st tab, 2nd tab, 3rd tab, ...)";
BA_ "UsrSigTimeoutValue" SG_ 778 VCRM_CluDisGrpSta "";
BA_ "GenSigTimeoutTime" SG_ 778 VCRM_CluDisGrpSta 2000;
BA_ "UserSigValidity" SG_ 778 VCRM_CluDisGrpSta 3;
BA_ "SignalLongName" SG_ 778 VCRM_CluDisGrpSta "VCRM_ClusterDisplayGroupStatus";
BA_ "Version" SG_ 778 VCRM_CluDisModSta "1.0";
BA_ "Description" SG_ 778 VCRM_CluDisModSta "Cluster Display Mode(1st page, 2nd page, 3rd page, ...)";
BA_ "UsrSigTimeoutValue" SG_ 778 VCRM_CluDisModSta "";
BA_ "GenSigTimeoutTime" SG_ 778 VCRM_CluDisModSta 2000;
BA_ "UserSigValidity" SG_ 778 VCRM_CluDisModSta 3;
BA_ "SignalLongName" SG_ 778 VCRM_CluDisModSta "VCRM_ClusterDisplayModeStatus";
BA_ "Version" SG_ 778 VCRM_CluAvgFuelCnsmptnAutoRstSta "1.0";
BA_ "Description" SG_ 778 VCRM_CluAvgFuelCnsmptnAutoRstSta "Cluster Average Fuel Consumption Autoreset(off, after ignition, after refueling)";
BA_ "UsrSigTimeoutValue" SG_ 778 VCRM_CluAvgFuelCnsmptnAutoRstSta "";
BA_ "GenSigTimeoutTime" SG_ 778 VCRM_CluAvgFuelCnsmptnAutoRstSta 2000;
BA_ "UserSigValidity" SG_ 778 VCRM_CluAvgFuelCnsmptnAutoRstSta 3;
BA_ "SignalLongName" SG_ 778 VCRM_CluAvgFuelCnsmptnAutoRstSta "VCRM_ClusterAverageFuelConsumptionAutoResetStatus";
BA_ "Version" SG_ 778 VCRM_CluTxtSizeSta "1.0";
BA_ "Description" SG_ 778 VCRM_CluTxtSizeSta "Cluster Text Size(medium, large)";
BA_ "UsrSigTimeoutValue" SG_ 778 VCRM_CluTxtSizeSta "";
BA_ "GenSigTimeoutTime" SG_ 778 VCRM_CluTxtSizeSta 2000;
BA_ "UserSigValidity" SG_ 778 VCRM_CluTxtSizeSta 3;
BA_ "SignalLongName" SG_ 778 VCRM_CluTxtSizeSta "VCRM_ClusterTextSizeStatus";
BA_ "Version" SG_ 778 VCRM_CluLngSetSta "1.0";
BA_ "Description" SG_ 778 VCRM_CluLngSetSta "Cluster Language Setting(English, French, Spanish, ... )";
BA_ "UsrSigTimeoutValue" SG_ 778 VCRM_CluLngSetSta "";
BA_ "GenSigTimeoutTime" SG_ 778 VCRM_CluLngSetSta 2000;
BA_ "UserSigValidity" SG_ 778 VCRM_CluLngSetSta 3;
BA_ "SignalLongName" SG_ 778 VCRM_CluLngSetSta "VCRM_ClusterLanguageSettingStatus";
BA_ "Version" SG_ 778 VCRM_CluSrvRmndrDaySta "1.0";
BA_ "Description" SG_ 778 VCRM_CluSrvRmndrDaySta "Cluster Service Reminder Day(__months)";
BA_ "UsrSigTimeoutValue" SG_ 778 VCRM_CluSrvRmndrDaySta "";
BA_ "GenSigTimeoutTime" SG_ 778 VCRM_CluSrvRmndrDaySta 2000;
BA_ "UserSigValidity" SG_ 778 VCRM_CluSrvRmndrDaySta 3;
BA_ "SignalLongName" SG_ 778 VCRM_CluSrvRmndrDaySta "VCRM_ClusterServiceReminderDayStatus";
BA_ "Version" SG_ 778 VCRM_CluSrvRmndrDstSta "1.0";
BA_ "Description" SG_ 778 VCRM_CluSrvRmndrDstSta "Cluster Service Reminder Distance(___00km)";
BA_ "UsrSigTimeoutValue" SG_ 778 VCRM_CluSrvRmndrDstSta "";
BA_ "GenSigTimeoutTime" SG_ 778 VCRM_CluSrvRmndrDstSta 2000;
BA_ "UserSigValidity" SG_ 778 VCRM_CluSrvRmndrDstSta 3;
BA_ "SignalLongName" SG_ 778 VCRM_CluSrvRmndrDstSta "VCRM_ClusterServiceReminderDistanceStatus";
BA_ "Version" SG_ 778 VCRM_CluVcAlrmVolSta "1.0";
BA_ "Description" SG_ 778 VCRM_CluVcAlrmVolSta "cluster volume ( mute, volume1, volume2, volume3 )";
BA_ "UsrSigTimeoutValue" SG_ 778 VCRM_CluVcAlrmVolSta "";
BA_ "GenSigTimeoutTime" SG_ 778 VCRM_CluVcAlrmVolSta 2000;
BA_ "UserSigValidity" SG_ 778 VCRM_CluVcAlrmVolSta 3;
BA_ "SignalLongName" SG_ 778 VCRM_CluVcAlrmVolSta "VCRM_ClusterVoiceAlarmVolumeStatus";
BA_ "Version" SG_ 1194 CLU_Crc4Val "1.0";
BA_ "GenSigStartValue" SG_ 1194 CLU_Crc4Val 4095;
BA_ "UsrSigTimeoutValue" SG_ 1194 CLU_Crc4Val "";
BA_ "GenSigTimeoutTime" SG_ 1194 CLU_Crc4Val 0;
BA_ "UserSigValidity" SG_ 1194 CLU_Crc4Val 3;
BA_ "SignalLongName" SG_ 1194 CLU_Crc4Val "CLU_Crc4Value";
BA_ "GenSigSendType" SG_ 1194 CLU_Crc4Val 0;
BA_ "Version" SG_ 1194 CLU_AlvCnt4Val "1.0";
BA_ "UsrSigTimeoutValue" SG_ 1194 CLU_AlvCnt4Val "";
BA_ "GenSigTimeoutTime" SG_ 1194 CLU_AlvCnt4Val 0;
BA_ "UserSigValidity" SG_ 1194 CLU_AlvCnt4Val 3;
BA_ "SignalLongName" SG_ 1194 CLU_AlvCnt4Val "CLU_AliveCounter4Value";
BA_ "GenSigSendType" SG_ 1194 CLU_AlvCnt4Val 0;
BA_ "Version" SG_ 1194 USM_HudBrgtnsDnReq "1.0";
BA_ "Description" SG_ 1194 USM_HudBrgtnsDnReq "Request to decrease HUD Brightness. Scroll type switch use 0x0~0x2. Tumbler type switch use 0x0~0x1.";
BA_ "UsrSigTimeoutValue" SG_ 1194 USM_HudBrgtnsDnReq "";
BA_ "GenSigTimeoutTime" SG_ 1194 USM_HudBrgtnsDnReq 0;
BA_ "UserSigValidity" SG_ 1194 USM_HudBrgtnsDnReq 3;
BA_ "SignalLongName" SG_ 1194 USM_HudBrgtnsDnReq "USM_HudBrightnessDownRequest";
BA_ "GenSigSendType" SG_ 1194 USM_HudBrgtnsDnReq 0;
BA_ "Version" SG_ 1194 USM_HudBrgtnsUpReq "1.0";
BA_ "Description" SG_ 1194 USM_HudBrgtnsUpReq "Request to increase HUD Brightness. Scroll type switch use 0x0~0x2. Tumbler type switch use 0x0~0x1.";
BA_ "UsrSigTimeoutValue" SG_ 1194 USM_HudBrgtnsUpReq "";
BA_ "GenSigTimeoutTime" SG_ 1194 USM_HudBrgtnsUpReq 0;
BA_ "UserSigValidity" SG_ 1194 USM_HudBrgtnsUpReq 3;
BA_ "SignalLongName" SG_ 1194 USM_HudBrgtnsUpReq "USM_HudBrightnessUpRequest";
BA_ "GenSigSendType" SG_ 1194 USM_HudBrgtnsUpReq 0;
BA_ "Version" SG_ 1194 USM_HudFntClrReq "1.0";
BA_ "Description" SG_ 1194 USM_HudFntClrReq "Request to set HUD Color";
BA_ "UsrSigTimeoutValue" SG_ 1194 USM_HudFntClrReq "";
BA_ "GenSigTimeoutTime" SG_ 1194 USM_HudFntClrReq 0;
BA_ "UserSigValidity" SG_ 1194 USM_HudFntClrReq 3;
BA_ "SignalLongName" SG_ 1194 USM_HudFntClrReq "USM_HudFontColorRequest";
BA_ "GenSigSendType" SG_ 1194 USM_HudFntClrReq 0;
BA_ "Version" SG_ 1194 USM_HudFntSizeReq "1.0";
BA_ "Description" SG_ 1194 USM_HudFntSizeReq "Request to set HUD Font size";
BA_ "UsrSigTimeoutValue" SG_ 1194 USM_HudFntSizeReq "";
BA_ "GenSigTimeoutTime" SG_ 1194 USM_HudFntSizeReq 0;
BA_ "UserSigValidity" SG_ 1194 USM_HudFntSizeReq 3;
BA_ "SignalLongName" SG_ 1194 USM_HudFntSizeReq "USM_HudFontSizeRequest";
BA_ "GenSigSendType" SG_ 1194 USM_HudFntSizeReq 0;
BA_ "Version" SG_ 1194 USM_HudHghtDnReq "1.0";
BA_ "Description" SG_ 1194 USM_HudHghtDnReq "Request to decrease HUD Height. Scroll type switch use 0x0~0x2. Tumbler type switch use 0x0~0x1.";
BA_ "UsrSigTimeoutValue" SG_ 1194 USM_HudHghtDnReq "";
BA_ "GenSigTimeoutTime" SG_ 1194 USM_HudHghtDnReq 0;
BA_ "UserSigValidity" SG_ 1194 USM_HudHghtDnReq 3;
BA_ "SignalLongName" SG_ 1194 USM_HudHghtDnReq "USM_HudHeightDownRequest";
BA_ "GenSigSendType" SG_ 1194 USM_HudHghtDnReq 0;
BA_ "Version" SG_ 1194 USM_HudHghtUpReq "1.0";
BA_ "Description" SG_ 1194 USM_HudHghtUpReq "Request to increase HUD Height. Scroll type switch use 0x0~0x2. Tumbler type switch use 0x0~0x1.";
BA_ "UsrSigTimeoutValue" SG_ 1194 USM_HudHghtUpReq "";
BA_ "GenSigTimeoutTime" SG_ 1194 USM_HudHghtUpReq 0;
BA_ "UserSigValidity" SG_ 1194 USM_HudHghtUpReq 3;
BA_ "SignalLongName" SG_ 1194 USM_HudHghtUpReq "USM_HudHeightUpRequest";
BA_ "GenSigSendType" SG_ 1194 USM_HudHghtUpReq 0;
BA_ "Version" SG_ 1194 USM_HudRotatDnReq "1.0";
BA_ "Description" SG_ 1194 USM_HudRotatDnReq "Request to rotate HUD image CCW. Scroll type switch use 0x0~0x2. Tumbler type switch use 0x0~0x1.";
BA_ "UsrSigTimeoutValue" SG_ 1194 USM_HudRotatDnReq "";
BA_ "GenSigTimeoutTime" SG_ 1194 USM_HudRotatDnReq 0;
BA_ "UserSigValidity" SG_ 1194 USM_HudRotatDnReq 3;
BA_ "SignalLongName" SG_ 1194 USM_HudRotatDnReq "USM_HudRotationDownRequest";
BA_ "GenSigSendType" SG_ 1194 USM_HudRotatDnReq 0;
BA_ "Version" SG_ 1194 USM_HudRotatUpReq "1.0";
BA_ "Description" SG_ 1194 USM_HudRotatUpReq "Request to rotate HUD image CW, Scroll type switch use 0x0~0x2, Tumbler type switch use 0x0~0x1";
BA_ "UsrSigTimeoutValue" SG_ 1194 USM_HudRotatUpReq "";
BA_ "GenSigTimeoutTime" SG_ 1194 USM_HudRotatUpReq 0;
BA_ "UserSigValidity" SG_ 1194 USM_HudRotatUpReq 3;
BA_ "SignalLongName" SG_ 1194 USM_HudRotatUpReq "USM_HudRotationUpRequest";
BA_ "GenSigSendType" SG_ 1194 USM_HudRotatUpReq 0;
BA_ "Version" SG_ 1194 USM_HudDisReq "1.0";
BA_ "Description" SG_ 1194 USM_HudDisReq "Request to set HUD display. Error Value is Old Value.";
BA_ "UsrSigTimeoutValue" SG_ 1194 USM_HudDisReq "";
BA_ "GenSigTimeoutTime" SG_ 1194 USM_HudDisReq 0;
BA_ "UserSigValidity" SG_ 1194 USM_HudDisReq 3;
BA_ "SignalLongName" SG_ 1194 USM_HudDisReq "USM_HudDisplayRequest";
BA_ "GenSigSendType" SG_ 1194 USM_HudDisReq 0;
BA_ "Version" SG_ 1194 USM_HudInfoTBTReq "1.0";
BA_ "Description" SG_ 1194 USM_HudInfoTBTReq "TBD (신규 시그널)";
BA_ "UsrSigTimeoutValue" SG_ 1194 USM_HudInfoTBTReq "";
BA_ "GenSigTimeoutTime" SG_ 1194 USM_HudInfoTBTReq 0;
BA_ "UserSigValidity" SG_ 1194 USM_HudInfoTBTReq 3;
BA_ "SignalLongName" SG_ 1194 USM_HudInfoTBTReq "USM_HudInformationTBTRequest";
BA_ "GenSigSendType" SG_ 1194 USM_HudInfoTBTReq 0;
BA_ "Version" SG_ 1194 USM_HudInfoDISReq "1.0";
BA_ "Description" SG_ 1194 USM_HudInfoDISReq "TBD (신규 시그널)";
BA_ "UsrSigTimeoutValue" SG_ 1194 USM_HudInfoDISReq "";
BA_ "GenSigTimeoutTime" SG_ 1194 USM_HudInfoDISReq 0;
BA_ "UserSigValidity" SG_ 1194 USM_HudInfoDISReq 3;
BA_ "SignalLongName" SG_ 1194 USM_HudInfoDISReq "USM_HudInformationDISRequest";
BA_ "GenSigSendType" SG_ 1194 USM_HudInfoDISReq 0;
BA_ "Version" SG_ 1194 USM_HudInfoSCCReq "1.0";
BA_ "Description" SG_ 1194 USM_HudInfoSCCReq "TBD (신규 시그널)";
BA_ "UsrSigTimeoutValue" SG_ 1194 USM_HudInfoSCCReq "";
BA_ "GenSigTimeoutTime" SG_ 1194 USM_HudInfoSCCReq 0;
BA_ "UserSigValidity" SG_ 1194 USM_HudInfoSCCReq 3;
BA_ "SignalLongName" SG_ 1194 USM_HudInfoSCCReq "USM_HudInformationSCCRequest";
BA_ "GenSigSendType" SG_ 1194 USM_HudInfoSCCReq 0;
BA_ "Version" SG_ 1194 USM_HudInfoCCReq "1.0";
BA_ "Description" SG_ 1194 USM_HudInfoCCReq "TBD (신규 시그널)";
BA_ "UsrSigTimeoutValue" SG_ 1194 USM_HudInfoCCReq "";
BA_ "GenSigTimeoutTime" SG_ 1194 USM_HudInfoCCReq 0;
BA_ "UserSigValidity" SG_ 1194 USM_HudInfoCCReq 3;
BA_ "SignalLongName" SG_ 1194 USM_HudInfoCCReq "USM_HudInformationCCRequest";
BA_ "GenSigSendType" SG_ 1194 USM_HudInfoCCReq 0;
BA_ "Version" SG_ 1194 USM_HudInfoLDWSReq "1.0";
BA_ "Description" SG_ 1194 USM_HudInfoLDWSReq "TBD (신규 시그널)";
BA_ "UsrSigTimeoutValue" SG_ 1194 USM_HudInfoLDWSReq "";
BA_ "GenSigTimeoutTime" SG_ 1194 USM_HudInfoLDWSReq 0;
BA_ "UserSigValidity" SG_ 1194 USM_HudInfoLDWSReq 3;
BA_ "SignalLongName" SG_ 1194 USM_HudInfoLDWSReq "USM_HudInformationLDWSRequest";
BA_ "GenSigSendType" SG_ 1194 USM_HudInfoLDWSReq 0;
BA_ "Version" SG_ 1194 USM_HudInfoBSDReq "1.0";
BA_ "Description" SG_ 1194 USM_HudInfoBSDReq "TBD (신규 시그널)";
BA_ "UsrSigTimeoutValue" SG_ 1194 USM_HudInfoBSDReq "";
BA_ "GenSigTimeoutTime" SG_ 1194 USM_HudInfoBSDReq 0;
BA_ "UserSigValidity" SG_ 1194 USM_HudInfoBSDReq 3;
BA_ "SignalLongName" SG_ 1194 USM_HudInfoBSDReq "USM_HudInformationBSDRequest";
BA_ "GenSigSendType" SG_ 1194 USM_HudInfoBSDReq 0;
BA_ "Version" SG_ 1184 CLU_Crc5Val "1.0";
BA_ "GenSigStartValue" SG_ 1184 CLU_Crc5Val 4095;
BA_ "UsrSigTimeoutValue" SG_ 1184 CLU_Crc5Val "";
BA_ "GenSigTimeoutTime" SG_ 1184 CLU_Crc5Val 0;
BA_ "UserSigValidity" SG_ 1184 CLU_Crc5Val 3;
BA_ "SignalLongName" SG_ 1184 CLU_Crc5Val "CLU_Crc5Value";
BA_ "GenSigSendType" SG_ 1184 CLU_Crc5Val 0;
BA_ "Version" SG_ 1184 CLU_AlvCnt5Val "1.0";
BA_ "UsrSigTimeoutValue" SG_ 1184 CLU_AlvCnt5Val "";
BA_ "GenSigTimeoutTime" SG_ 1184 CLU_AlvCnt5Val 0;
BA_ "UserSigValidity" SG_ 1184 CLU_AlvCnt5Val 3;
BA_ "SignalLongName" SG_ 1184 CLU_AlvCnt5Val "CLU_AliveCounter5Value";
BA_ "GenSigSendType" SG_ 1184 CLU_AlvCnt5Val 0;
BA_ "Version" SG_ 1184 USM_AutoDrLkSetReq "1.0";
BA_ "Description" SG_ 1184 USM_AutoDrLkSetReq "Request set the new Auto Door Lock Mode";
BA_ "UsrSigTimeoutValue" SG_ 1184 USM_AutoDrLkSetReq "";
BA_ "GenSigTimeoutTime" SG_ 1184 USM_AutoDrLkSetReq 0;
BA_ "UserSigValidity" SG_ 1184 USM_AutoDrLkSetReq 3;
BA_ "SignalLongName" SG_ 1184 USM_AutoDrLkSetReq "USM_AutoDoorLockSetRequest";
BA_ "GenSigSendType" SG_ 1184 USM_AutoDrLkSetReq 0;
BA_ "Version" SG_ 1184 USM_AutoDrUnlckSetReq "1.0";
BA_ "Description" SG_ 1184 USM_AutoDrUnlckSetReq "Request to set Auto Door Unlock Mode";
BA_ "UsrSigTimeoutValue" SG_ 1184 USM_AutoDrUnlckSetReq "";
BA_ "GenSigTimeoutTime" SG_ 1184 USM_AutoDrUnlckSetReq 0;
BA_ "UserSigValidity" SG_ 1184 USM_AutoDrUnlckSetReq 3;
BA_ "SignalLongName" SG_ 1184 USM_AutoDrUnlckSetReq "USM_AutoDoorUnlockSetRequest";
BA_ "GenSigSendType" SG_ 1184 USM_AutoDrUnlckSetReq 0;
BA_ "Version" SG_ 1184 USM_HLmpEscrtSetReq "1.0";
BA_ "Description" SG_ 1184 USM_HLmpEscrtSetReq "Request to set Head Lamp Escort Option";
BA_ "UsrSigTimeoutValue" SG_ 1184 USM_HLmpEscrtSetReq "";
BA_ "GenSigTimeoutTime" SG_ 1184 USM_HLmpEscrtSetReq 0;
BA_ "UserSigValidity" SG_ 1184 USM_HLmpEscrtSetReq 3;
BA_ "SignalLongName" SG_ 1184 USM_HLmpEscrtSetReq "USM_HeadLampEscortSetRequest";
BA_ "GenSigSendType" SG_ 1184 USM_HLmpEscrtSetReq 0;
BA_ "Version" SG_ 1184 USM_DrLkSndSetReq "1.0";
BA_ "Description" SG_ 1184 USM_DrLkSndSetReq "Request to set Door Lock Sound Option";
BA_ "UsrSigTimeoutValue" SG_ 1184 USM_DrLkSndSetReq "";
BA_ "GenSigTimeoutTime" SG_ 1184 USM_DrLkSndSetReq 0;
BA_ "UserSigValidity" SG_ 1184 USM_DrLkSndSetReq 3;
BA_ "SignalLongName" SG_ 1184 USM_DrLkSndSetReq "USM_DoorLockSoundSetRequest";
BA_ "GenSigSendType" SG_ 1184 USM_DrLkSndSetReq 0;
BA_ "Version" SG_ 1184 USM_FcwModSetReq "1.0";
BA_ "Description" SG_ 1184 USM_FcwModSetReq "This signal is used for a request to set the value of USM Menus. This signal requests to set FCWS status.

When this signal change, the message (CLU16) is sent 3 times.";
BA_ "UsrSigTimeoutValue" SG_ 1184 USM_FcwModSetReq "";
BA_ "GenSigTimeoutTime" SG_ 1184 USM_FcwModSetReq 0;
BA_ "UserSigValidity" SG_ 1184 USM_FcwModSetReq 3;
BA_ "SignalLongName" SG_ 1184 USM_FcwModSetReq "USM_FcwModeSetRequest";
BA_ "GenSigSendType" SG_ 1184 USM_FcwModSetReq 0;
BA_ "Version" SG_ 1184 USM_FcwSetReq "1.0";
BA_ "Description" SG_ 1184 USM_FcwSetReq "This signal is used for a request to set the value of USM Menus. This signal requests to set FCW system state.

When this signal change, the message (CLU14) is sent 3 times.";
BA_ "UsrSigTimeoutValue" SG_ 1184 USM_FcwSetReq "";
BA_ "GenSigTimeoutTime" SG_ 1184 USM_FcwSetReq 0;
BA_ "UserSigValidity" SG_ 1184 USM_FcwSetReq 3;
BA_ "SignalLongName" SG_ 1184 USM_FcwSetReq "USM_FcwSetRequest";
BA_ "GenSigSendType" SG_ 1184 USM_FcwSetReq 0;
BA_ "Version" SG_ 1184 USM_SmrtTrnkSetReq "1.0";
BA_ "Description" SG_ 1184 USM_SmrtTrnkSetReq "Request to set Smart Trunk/Tailgate Mode";
BA_ "UsrSigTimeoutValue" SG_ 1184 USM_SmrtTrnkSetReq "";
BA_ "GenSigTimeoutTime" SG_ 1184 USM_SmrtTrnkSetReq 0;
BA_ "UserSigValidity" SG_ 1184 USM_SmrtTrnkSetReq 3;
BA_ "SignalLongName" SG_ 1184 USM_SmrtTrnkSetReq "USM_SmartTrunkSetRequest";
BA_ "GenSigSendType" SG_ 1184 USM_SmrtTrnkSetReq 0;
BA_ "Version" SG_ 1184 USM_MdLmpSetReq "1.0";
BA_ "Description" SG_ 1184 USM_MdLmpSetReq "Request to set interior mood lamp setting";
BA_ "UsrSigTimeoutValue" SG_ 1184 USM_MdLmpSetReq "";
BA_ "GenSigTimeoutTime" SG_ 1184 USM_MdLmpSetReq 0;
BA_ "UserSigValidity" SG_ 1184 USM_MdLmpSetReq 3;
BA_ "SignalLongName" SG_ 1184 USM_MdLmpSetReq "USM_MoodLampSetRequest";
BA_ "GenSigSendType" SG_ 1184 USM_MdLmpSetReq 0;
BA_ "Version" SG_ 1184 USM_HrnAnswerBckSetReq "1.0";
BA_ "Description" SG_ 1184 USM_HrnAnswerBckSetReq "Request to set Horn Answer Back Mode";
BA_ "UsrSigTimeoutValue" SG_ 1184 USM_HrnAnswerBckSetReq "";
BA_ "GenSigTimeoutTime" SG_ 1184 USM_HrnAnswerBckSetReq 0;
BA_ "UserSigValidity" SG_ 1184 USM_HrnAnswerBckSetReq 3;
BA_ "SignalLongName" SG_ 1184 USM_HrnAnswerBckSetReq "USM_HornAnswerBackSetRequest";
BA_ "GenSigSendType" SG_ 1184 USM_HrnAnswerBckSetReq 0;
BA_ "Version" SG_ 1184 USM_OneTouchTrplTrnSetReq "1.0";
BA_ "Description" SG_ 1184 USM_OneTouchTrplTrnSetReq "This signal is used for a request current setting value of USM Menus. When this signal change, the message (CLU14) is sent 3 times.";
BA_ "UsrSigTimeoutValue" SG_ 1184 USM_OneTouchTrplTrnSetReq "";
BA_ "GenSigTimeoutTime" SG_ 1184 USM_OneTouchTrplTrnSetReq 0;
BA_ "UserSigValidity" SG_ 1184 USM_OneTouchTrplTrnSetReq 3;
BA_ "SignalLongName" SG_ 1184 USM_OneTouchTrplTrnSetReq "USM_OneTouchTripleTurnSetRequest";
BA_ "GenSigSendType" SG_ 1184 USM_OneTouchTrplTrnSetReq 0;
BA_ "Version" SG_ 1184 USM_PasSpkrVolLvlSetReq "1.0";
BA_ "Description" SG_ 1184 USM_PasSpkrVolLvlSetReq "Request to set PAS Speaker Volume Level";
BA_ "UsrSigTimeoutValue" SG_ 1184 USM_PasSpkrVolLvlSetReq "";
BA_ "GenSigTimeoutTime" SG_ 1184 USM_PasSpkrVolLvlSetReq 0;
BA_ "UserSigValidity" SG_ 1184 USM_PasSpkrVolLvlSetReq 3;
BA_ "SignalLongName" SG_ 1184 USM_PasSpkrVolLvlSetReq "USM_PasSpeakerVolumeLevelSetRequest";
BA_ "GenSigSendType" SG_ 1184 USM_PasSpkrVolLvlSetReq 0;
BA_ "Version" SG_ 1184 USM_BsdSndWarnSetReq "1.0";
BA_ "Description" SG_ 1184 USM_BsdSndWarnSetReq "This signal is used for a request to set the value of USM Menus. This signal requests to set LCA system state.

When this signal change, the message (CLU14) is sent 3 times.";
BA_ "UsrSigTimeoutValue" SG_ 1184 USM_BsdSndWarnSetReq "";
BA_ "GenSigTimeoutTime" SG_ 1184 USM_BsdSndWarnSetReq 0;
BA_ "UserSigValidity" SG_ 1184 USM_BsdSndWarnSetReq 3;
BA_ "SignalLongName" SG_ 1184 USM_BsdSndWarnSetReq "USM_BsdSoundWarnSetRequest";
BA_ "GenSigSendType" SG_ 1184 USM_BsdSndWarnSetReq 0;
BA_ "Version" SG_ 1184 USM_PsmSetReq "1.0";
BA_ "Description" SG_ 1184 USM_PsmSetReq "This signal is used for a request to set the value of UMS Menus.

This signal requests to set Seat Easy Access Mode.

When this signal change, the message (CLU14) is sent 3 times.";
BA_ "UsrSigTimeoutValue" SG_ 1184 USM_PsmSetReq "";
BA_ "GenSigTimeoutTime" SG_ 1184 USM_PsmSetReq 0;
BA_ "UserSigValidity" SG_ 1184 USM_PsmSetReq 3;
BA_ "SignalLongName" SG_ 1184 USM_PsmSetReq "USM_PsmSetRequest";
BA_ "GenSigSendType" SG_ 1184 USM_PsmSetReq 0;
BA_ "Version" SG_ 1184 USM_SccDrvSetReq "1.0";
BA_ "Description" SG_ 1184 USM_SccDrvSetReq "This signal is used for a request to set the value of USM Menus. This signal requests to change SCC driving mode.

When this signal change, the message (CLU14) is sent 3 times.";
BA_ "UsrSigTimeoutValue" SG_ 1184 USM_SccDrvSetReq "";
BA_ "GenSigTimeoutTime" SG_ 1184 USM_SccDrvSetReq 0;
BA_ "UserSigValidity" SG_ 1184 USM_SccDrvSetReq 3;
BA_ "SignalLongName" SG_ 1184 USM_SccDrvSetReq "USM_SccDriveSetRequest";
BA_ "GenSigSendType" SG_ 1184 USM_SccDrvSetReq 0;
BA_ "Version" SG_ 1184 USM_LkasSetReq "1.0";
BA_ "Description" SG_ 1184 USM_LkasSetReq "This signal is used for a request to set the value of USM Menus. This signal requests to set LKAS control mode.

When this signal change, the message (CLU14) is sent 3 times.";
BA_ "UsrSigTimeoutValue" SG_ 1184 USM_LkasSetReq "";
BA_ "GenSigTimeoutTime" SG_ 1184 USM_LkasSetReq 0;
BA_ "UserSigValidity" SG_ 1184 USM_LkasSetReq 3;
BA_ "SignalLongName" SG_ 1184 USM_LkasSetReq "USM_LkasSetRequest";
BA_ "GenSigSendType" SG_ 1184 USM_LkasSetReq 0;
BA_ "Version" SG_ 1184 USM_PtgmSetReq "1.0";
BA_ "Description" SG_ 1184 USM_PtgmSetReq "Request to set PTGM Mode";
BA_ "UsrSigTimeoutValue" SG_ 1184 USM_PtgmSetReq "";
BA_ "GenSigTimeoutTime" SG_ 1184 USM_PtgmSetReq 0;
BA_ "UserSigValidity" SG_ 1184 USM_PtgmSetReq 3;
BA_ "SignalLongName" SG_ 1184 USM_PtgmSetReq "USM_PtgmSetRequest";
BA_ "GenSigSendType" SG_ 1184 USM_PtgmSetReq 0;
BA_ "Version" SG_ 1184 USM_RctaSetReq "1.0";
BA_ "Description" SG_ 1184 USM_RctaSetReq "This signal is used for a request to set the value of USM Menus. This signal requests to set RCTA system state.

When this signal change, the message (CLU14) is sent 3 times.";
BA_ "UsrSigTimeoutValue" SG_ 1184 USM_RctaSetReq "";
BA_ "GenSigTimeoutTime" SG_ 1184 USM_RctaSetReq 0;
BA_ "UserSigValidity" SG_ 1184 USM_RctaSetReq 3;
BA_ "SignalLongName" SG_ 1184 USM_RctaSetReq "USM_RctaSetRequest";
BA_ "GenSigSendType" SG_ 1184 USM_RctaSetReq 0;
BA_ "Version" SG_ 1184 USM_RcwSetReq "1.0";
BA_ "Description" SG_ 1184 USM_RcwSetReq "This signal is used for a request to set the value of USM Menus. This signal requests to set RCW system state.

When this signal change, the message (CLU14) is sent 3 times.";
BA_ "UsrSigTimeoutValue" SG_ 1184 USM_RcwSetReq "";
BA_ "GenSigTimeoutTime" SG_ 1184 USM_RcwSetReq 0;
BA_ "UserSigValidity" SG_ 1184 USM_RcwSetReq 3;
BA_ "SignalLongName" SG_ 1184 USM_RcwSetReq "USM_RcwSetRequest";
BA_ "GenSigSendType" SG_ 1184 USM_RcwSetReq 0;
BA_ "Version" SG_ 1184 USM_SccAebSetReq "1.0";
BA_ "Description" SG_ 1184 USM_SccAebSetReq "This signal is used for a request to set the value of USM Menus. This signal requests to change status of AEB.";
BA_ "UsrSigTimeoutValue" SG_ 1184 USM_SccAebSetReq "";
BA_ "GenSigTimeoutTime" SG_ 1184 USM_SccAebSetReq 0;
BA_ "UserSigValidity" SG_ 1184 USM_SccAebSetReq 3;
BA_ "SignalLongName" SG_ 1184 USM_SccAebSetReq "USM_SccAebSetRequest";
BA_ "GenSigSendType" SG_ 1184 USM_SccAebSetReq 0;
BA_ "Version" SG_ 1184 USM_SccNAviCamSetReq "1.0";
BA_ "Description" SG_ 1184 USM_SccNAviCamSetReq "This signal is used for a request to set the value of USM Menus. This signal requests to change status of SCC interlocked with Navi Camera function.

When this signal change, the message (CLU14) is sent 3 times.";
BA_ "UsrSigTimeoutValue" SG_ 1184 USM_SccNAviCamSetReq "";
BA_ "GenSigTimeoutTime" SG_ 1184 USM_SccNAviCamSetReq 0;
BA_ "UserSigValidity" SG_ 1184 USM_SccNAviCamSetReq 3;
BA_ "SignalLongName" SG_ 1184 USM_SccNAviCamSetReq "USM_SccNaviCameraSetRequest";
BA_ "GenSigSendType" SG_ 1184 USM_SccNAviCamSetReq 0;
BA_ "Version" SG_ 1184 USM_SccNaviCurveSetReq "1.0";
BA_ "Description" SG_ 1184 USM_SccNaviCurveSetReq "This signal is used for a request to set the value of USM Menus. This signal requests to change status of SCC interlocked with Navi Curve function.

When this signal change, the message (CLU14) is sent 3 times.";
BA_ "UsrSigTimeoutValue" SG_ 1184 USM_SccNaviCurveSetReq "";
BA_ "GenSigTimeoutTime" SG_ 1184 USM_SccNaviCurveSetReq 0;
BA_ "UserSigValidity" SG_ 1184 USM_SccNaviCurveSetReq 3;
BA_ "SignalLongName" SG_ 1184 USM_SccNaviCurveSetReq "USM_SccNaviCurveSetRequest";
BA_ "GenSigSendType" SG_ 1184 USM_SccNaviCurveSetReq 0;
BA_ "Version" SG_ 1184 USM_ScmSetReq "1.0";
BA_ "Description" SG_ 1184 USM_ScmSetReq "Request to set Steering Easy Access mode";
BA_ "UsrSigTimeoutValue" SG_ 1184 USM_ScmSetReq "";
BA_ "GenSigTimeoutTime" SG_ 1184 USM_ScmSetReq 0;
BA_ "UserSigValidity" SG_ 1184 USM_ScmSetReq 3;
BA_ "SignalLongName" SG_ 1184 USM_ScmSetReq "USM_ScmSetRequest";
BA_ "GenSigSendType" SG_ 1184 USM_ScmSetReq 0;
BA_ "Version" SG_ 1184 USM_OSTempUnitSetReq "1.0";
BA_ "Description" SG_ 1184 USM_OSTempUnitSetReq "This signal is used for a request to set the value of USM Menus. This signal requests to set Outside Temperature Unit.

When this signal change, the message (CLU14) is sent 3 times.";
BA_ "UsrSigTimeoutValue" SG_ 1184 USM_OSTempUnitSetReq "";
BA_ "GenSigTimeoutTime" SG_ 1184 USM_OSTempUnitSetReq 0;
BA_ "UserSigValidity" SG_ 1184 USM_OSTempUnitSetReq 3;
BA_ "SignalLongName" SG_ 1184 USM_OSTempUnitSetReq "USM_OutsideTemperatureUnitSetValue";
BA_ "GenSigSendType" SG_ 1184 USM_OSTempUnitSetReq 0;
BA_ "Version" SG_ 1184 USM_TfrChgSetReq "1.0";
BA_ "Description" SG_ 1184 USM_TfrChgSetReq "This signal is used for a request to set the value of UMS Menus.

This signal requests to set Traffic Change Mode.

When this signal change, the message (CLU4) is sent 3 times.";
BA_ "UsrSigTimeoutValue" SG_ 1184 USM_TfrChgSetReq "";
BA_ "GenSigTimeoutTime" SG_ 1184 USM_TfrChgSetReq 0;
BA_ "UserSigValidity" SG_ 1184 USM_TfrChgSetReq 3;
BA_ "SignalLongName" SG_ 1184 USM_TfrChgSetReq "USM_TrafficChangeSetRequest";
BA_ "GenSigSendType" SG_ 1184 USM_TfrChgSetReq 0;
BA_ "Version" SG_ 1184 USM_TwoTrnUnlckSetReq "1.0";
BA_ "Description" SG_ 1184 USM_TwoTrnUnlckSetReq "Request to set Two Turn Unlock Mode";
BA_ "UsrSigTimeoutValue" SG_ 1184 USM_TwoTrnUnlckSetReq "";
BA_ "GenSigTimeoutTime" SG_ 1184 USM_TwoTrnUnlckSetReq 0;
BA_ "UserSigValidity" SG_ 1184 USM_TwoTrnUnlckSetReq 3;
BA_ "SignalLongName" SG_ 1184 USM_TwoTrnUnlckSetReq "USM_TwoTurnUnlockSetRequest";
BA_ "GenSigSendType" SG_ 1184 USM_TwoTrnUnlckSetReq 0;
BA_ "Version" SG_ 1184 USM_WlcmLtSetReq "1.0";
BA_ "Description" SG_ 1184 USM_WlcmLtSetReq "Request to set Welcome Light Option";
BA_ "UsrSigTimeoutValue" SG_ 1184 USM_WlcmLtSetReq "";
BA_ "GenSigTimeoutTime" SG_ 1184 USM_WlcmLtSetReq 0;
BA_ "UserSigValidity" SG_ 1184 USM_WlcmLtSetReq 3;
BA_ "SignalLongName" SG_ 1184 USM_WlcmLtSetReq "USM_WelcomeLightSetRequset";
BA_ "GenSigSendType" SG_ 1184 USM_WlcmLtSetReq 0;
BA_ "Version" SG_ 1189 CLU_Crc6Val "1.0";
BA_ "GenSigStartValue" SG_ 1189 CLU_Crc6Val 4095;
BA_ "UsrSigTimeoutValue" SG_ 1189 CLU_Crc6Val "";
BA_ "GenSigTimeoutTime" SG_ 1189 CLU_Crc6Val 0;
BA_ "UserSigValidity" SG_ 1189 CLU_Crc6Val 3;
BA_ "SignalLongName" SG_ 1189 CLU_Crc6Val "CLU_Crc6Value";
BA_ "GenSigSendType" SG_ 1189 CLU_Crc6Val 0;
BA_ "Version" SG_ 1189 CLU_AlvCnt6Val "1.0";
BA_ "UsrSigTimeoutValue" SG_ 1189 CLU_AlvCnt6Val "";
BA_ "GenSigTimeoutTime" SG_ 1189 CLU_AlvCnt6Val 0;
BA_ "UserSigValidity" SG_ 1189 CLU_AlvCnt6Val 3;
BA_ "SignalLongName" SG_ 1189 CLU_AlvCnt6Val "CLU_AliveCounter6Value";
BA_ "GenSigSendType" SG_ 1189 CLU_AlvCnt6Val 0;
BA_ "Version" SG_ 1189 USM_AAsstSetReq "1.0";
BA_ "Description" SG_ 1189 USM_AAsstSetReq "This signal is used for a request to set the value of USM Menus.

If USM setting is changed, the message (CLU16) is sent 3 times.";
BA_ "UsrSigTimeoutValue" SG_ 1189 USM_AAsstSetReq "";
BA_ "GenSigTimeoutTime" SG_ 1189 USM_AAsstSetReq 0;
BA_ "UserSigValidity" SG_ 1189 USM_AAsstSetReq 3;
BA_ "SignalLongName" SG_ 1189 USM_AAsstSetReq "USM_AAssistSetRequset";
BA_ "GenSigSendType" SG_ 1189 USM_AAsstSetReq 0;
BA_ "Version" SG_ 1189 USM_Aeb1stWrngSetReq "1.0";
BA_ "Description" SG_ 1189 USM_Aeb1stWrngSetReq "This signal is used for a request to set the value of USM Menus. This signal requests to change AEB 1st warning mode.

When this signal change, the message (CLU16) is sent 3 times.";
BA_ "UsrSigTimeoutValue" SG_ 1189 USM_Aeb1stWrngSetReq "";
BA_ "GenSigTimeoutTime" SG_ 1189 USM_Aeb1stWrngSetReq 0;
BA_ "UserSigValidity" SG_ 1189 USM_Aeb1stWrngSetReq 3;
BA_ "SignalLongName" SG_ 1189 USM_Aeb1stWrngSetReq "USM_Aeb1stWarningSetRequset";
BA_ "GenSigSendType" SG_ 1189 USM_Aeb1stWrngSetReq 0;
BA_ "Version" SG_ 1189 USM_ECoastSetReq "1.0";
BA_ "Description" SG_ 1189 USM_ECoastSetReq "This signal is used for a request to set the value of USM Menus. This signal requests to set E-Coasting system state.

When this signal change, the message (CLU16) is sent 3 times.";
BA_ "UsrSigTimeoutValue" SG_ 1189 USM_ECoastSetReq "";
BA_ "GenSigTimeoutTime" SG_ 1189 USM_ECoastSetReq 0;
BA_ "UserSigValidity" SG_ 1189 USM_ECoastSetReq 3;
BA_ "SignalLongName" SG_ 1189 USM_ECoastSetReq "USM_ECoastingSetRequset";
BA_ "GenSigSendType" SG_ 1189 USM_ECoastSetReq 0;
BA_ "Version" SG_ 1189 USM_AutoLtSnsbltySetReq "1.0";
BA_ "Description" SG_ 1189 USM_AutoLtSnsbltySetReq "This signal is used for a request to set the value of USM Menus. This signal requests to set Auto Lighst Sensibility.

When this signal change, the message (CLU16) is sent 3 times.";
BA_ "UsrSigTimeoutValue" SG_ 1189 USM_AutoLtSnsbltySetReq "";
BA_ "GenSigTimeoutTime" SG_ 1189 USM_AutoLtSnsbltySetReq 0;
BA_ "UserSigValidity" SG_ 1189 USM_AutoLtSnsbltySetReq 3;
BA_ "SignalLongName" SG_ 1189 USM_AutoLtSnsbltySetReq "USM_AutoLightSensibilitySetRequset";
BA_ "GenSigSendType" SG_ 1189 USM_AutoLtSnsbltySetReq 0;
BA_ "Version" SG_ 1189 USM_HealthcareIMSModReq "1.0";
BA_ "Description" SG_ 1189 USM_HealthcareIMSModReq "This signal is used for Healthcare IMS to send user's input";
BA_ "UsrSigTimeoutValue" SG_ 1189 USM_HealthcareIMSModReq "";
BA_ "GenSigTimeoutTime" SG_ 1189 USM_HealthcareIMSModReq 0;
BA_ "UserSigValidity" SG_ 1189 USM_HealthcareIMSModReq 0;
BA_ "SignalLongName" SG_ 1189 USM_HealthcareIMSModReq "USM_HealthcareIMSModeRequest";
BA_ "GenSigSendType" SG_ 1189 USM_HealthcareIMSModReq 0;
BA_ "Version" SG_ 1189 USM_ECoastingWrngSndSetReq "1.0";
BA_ "Description" SG_ 1189 USM_ECoastingWrngSndSetReq "This signal is used for a request to set the value of USM Menus. This signal requests to set warning sound state for e-Coasting system.

When this signal change, the message (CLU16) is sent 3 times.";
BA_ "UsrSigTimeoutValue" SG_ 1189 USM_ECoastingWrngSndSetReq "";
BA_ "GenSigTimeoutTime" SG_ 1189 USM_ECoastingWrngSndSetReq 0;
BA_ "UserSigValidity" SG_ 1189 USM_ECoastingWrngSndSetReq 3;
BA_ "SignalLongName" SG_ 1189 USM_ECoastingWrngSndSetReq "USM_ECoastingWarningSoundSetRequset";
BA_ "GenSigSendType" SG_ 1189 USM_ECoastingWrngSndSetReq 0;
BA_ "Version" SG_ 1189 USM_MdLmpBrgtnsSetReq "1.0";
BA_ "Description" SG_ 1189 USM_MdLmpBrgtnsSetReq "Request set the Mood Lamp Brightness";
BA_ "UsrSigTimeoutValue" SG_ 1189 USM_MdLmpBrgtnsSetReq "";
BA_ "GenSigTimeoutTime" SG_ 1189 USM_MdLmpBrgtnsSetReq 0;
BA_ "UserSigValidity" SG_ 1189 USM_MdLmpBrgtnsSetReq 3;
BA_ "SignalLongName" SG_ 1189 USM_MdLmpBrgtnsSetReq "USM_MoodLampBrightnessSetRequest";
BA_ "GenSigSendType" SG_ 1189 USM_MdLmpBrgtnsSetReq 0;
BA_ "Version" SG_ 1189 USM_TirePrsrUnitSetReq "1.0";
BA_ "Description" SG_ 1189 USM_TirePrsrUnitSetReq "This signal is used for a request to set the value of USM Menus. This signal requests to set Tire Pressure Unit.

When this signal change, the message (CLU16) is sent 3 times.";
BA_ "UsrSigTimeoutValue" SG_ 1189 USM_TirePrsrUnitSetReq "";
BA_ "GenSigTimeoutTime" SG_ 1189 USM_TirePrsrUnitSetReq 0;
BA_ "UserSigValidity" SG_ 1189 USM_TirePrsrUnitSetReq 3;
BA_ "SignalLongName" SG_ 1189 USM_TirePrsrUnitSetReq "USM_TirePressureUnitSetRequest";
BA_ "GenSigSendType" SG_ 1189 USM_TirePrsrUnitSetReq 0;
BA_ "Version" SG_ 1189 USM_FuelGdRstReq "1.0";
BA_ "Description" SG_ 1189 USM_FuelGdRstReq "This signal is used for a request to reset the Fuel efficiency percent.

When this signal change, the message (CLU16) is sent 3 times.";
BA_ "UsrSigTimeoutValue" SG_ 1189 USM_FuelGdRstReq "";
BA_ "GenSigTimeoutTime" SG_ 1189 USM_FuelGdRstReq 0;
BA_ "UserSigValidity" SG_ 1189 USM_FuelGdRstReq 3;
BA_ "SignalLongName" SG_ 1189 USM_FuelGdRstReq "USM_FuelGuideResetRequest";
BA_ "GenSigSendType" SG_ 1189 USM_FuelGdRstReq 0;
BA_ "Version" SG_ 1189 USM_HealthcareIMSHghtSetReq "1.0";
BA_ "Description" SG_ 1189 USM_HealthcareIMSHghtSetReq "This signal is used for Healthcare IMS to input user's height";
BA_ "UsrSigTimeoutValue" SG_ 1189 USM_HealthcareIMSHghtSetReq "";
BA_ "GenSigTimeoutTime" SG_ 1189 USM_HealthcareIMSHghtSetReq 0;
BA_ "UserSigValidity" SG_ 1189 USM_HealthcareIMSHghtSetReq 0;
BA_ "SignalLongName" SG_ 1189 USM_HealthcareIMSHghtSetReq "USM_HealthcareIMSHeightSetRequest";
BA_ "GenSigSendType" SG_ 1189 USM_HealthcareIMSHghtSetReq 0;
BA_ "Version" SG_ 1189 USM_HealthcareIMSSitHghtSetReq "1.0";
BA_ "Description" SG_ 1189 USM_HealthcareIMSSitHghtSetReq "This signal is used for Healthcare IMS to input user's sitting height";
BA_ "UsrSigTimeoutValue" SG_ 1189 USM_HealthcareIMSSitHghtSetReq "";
BA_ "GenSigTimeoutTime" SG_ 1189 USM_HealthcareIMSSitHghtSetReq 0;
BA_ "UserSigValidity" SG_ 1189 USM_HealthcareIMSSitHghtSetReq 0;
BA_ "SignalLongName" SG_ 1189 USM_HealthcareIMSSitHghtSetReq "USM_HealthcareIMSSittingHeightSetRequest";
BA_ "GenSigSendType" SG_ 1189 USM_HealthcareIMSSitHghtSetReq 0;
BA_ "Version" SG_ 1189 USM_HealthcareIMSWghtSetReq "1.0";
BA_ "Description" SG_ 1189 USM_HealthcareIMSWghtSetReq "This signal is used for Healthcare IMS to input user's weight";
BA_ "UsrSigTimeoutValue" SG_ 1189 USM_HealthcareIMSWghtSetReq "";
BA_ "GenSigTimeoutTime" SG_ 1189 USM_HealthcareIMSWghtSetReq 0;
BA_ "UserSigValidity" SG_ 1189 USM_HealthcareIMSWghtSetReq 0;
BA_ "SignalLongName" SG_ 1189 USM_HealthcareIMSWghtSetReq "USM_HealthcareIMSWeightSetRequest";
BA_ "GenSigSendType" SG_ 1189 USM_HealthcareIMSWghtSetReq 0;
BA_ "Version" SG_ 1189 USM_MdLmpClrSetReq "1.0";
BA_ "Description" SG_ 1189 USM_MdLmpClrSetReq "Request set the Mood Lamp Color";
BA_ "UsrSigTimeoutValue" SG_ 1189 USM_MdLmpClrSetReq "";
BA_ "GenSigTimeoutTime" SG_ 1189 USM_MdLmpClrSetReq 0;
BA_ "UserSigValidity" SG_ 1189 USM_MdLmpClrSetReq 3;
BA_ "SignalLongName" SG_ 1189 USM_MdLmpClrSetReq "USM_MoodLampColorSetRequest";
BA_ "GenSigSendType" SG_ 1189 USM_MdLmpClrSetReq 0;
BA_ "Version" SG_ 1189 USM_HADSetReq "1.0";
BA_ "Description" SG_ 1189 USM_HADSetReq "This signal is used to set HDA(Highway Driving Assist) Function.";
BA_ "UsrSigTimeoutValue" SG_ 1189 USM_HADSetReq "";
BA_ "GenSigTimeoutTime" SG_ 1189 USM_HADSetReq 0;
BA_ "UserSigValidity" SG_ 1189 USM_HADSetReq 3;
BA_ "SignalLongName" SG_ 1189 USM_HADSetReq "USM_HADSetRequest";
BA_ "GenSigSendType" SG_ 1189 USM_HADSetReq 0;
BA_ "Version" SG_ 1189 USM_RrWiperRevSetReq "1.0";
BA_ "Description" SG_ 1189 USM_RrWiperRevSetReq "Request to set RearWiper Reverse Mode";
BA_ "UsrSigTimeoutValue" SG_ 1189 USM_RrWiperRevSetReq "";
BA_ "GenSigTimeoutTime" SG_ 1189 USM_RrWiperRevSetReq 0;
BA_ "UserSigValidity" SG_ 1189 USM_RrWiperRevSetReq 3;
BA_ "SignalLongName" SG_ 1189 USM_RrWiperRevSetReq "USM_RearWiperReverseSetRequest";
BA_ "GenSigSendType" SG_ 1189 USM_RrWiperRevSetReq 0;
BA_ "Version" SG_ 1189 USM_SlifSetReq "1.0";
BA_ "Description" SG_ 1189 USM_SlifSetReq "This signal is used for a request to set the value of USM Menus. This signal requests to set SLIF status.

When this signal change, the message (CLU16) is sent 3 times.";
BA_ "UsrSigTimeoutValue" SG_ 1189 USM_SlifSetReq "";
BA_ "GenSigTimeoutTime" SG_ 1189 USM_SlifSetReq 0;
BA_ "UserSigValidity" SG_ 1189 USM_SlifSetReq 3;
BA_ "SignalLongName" SG_ 1189 USM_SlifSetReq "USM_SlifSetRequest";
BA_ "GenSigSendType" SG_ 1189 USM_SlifSetReq 0;
BA_ "Version" SG_ 1189 USM_StaRstReq "1.0";
BA_ "Description" SG_ 1189 USM_StaRstReq "This signal is used for a request to reset the value of USM menus.

When this signal change, the message (CLU16) is sent 3 times.";
BA_ "UsrSigTimeoutValue" SG_ 1189 USM_StaRstReq "";
BA_ "GenSigTimeoutTime" SG_ 1189 USM_StaRstReq 0;
BA_ "UserSigValidity" SG_ 1189 USM_StaRstReq 3;
BA_ "SignalLongName" SG_ 1189 USM_StaRstReq "USM_StatusResetRequest";
BA_ "GenSigSendType" SG_ 1189 USM_StaRstReq 0;
BA_ "Version" SG_ 1189 USM_RrWpcSetReq "1.0";
BA_ "Description" SG_ 1189 USM_RrWpcSetReq "USM Function for REAR WPC(Wireless Phone Chager) on/off SW";
BA_ "UsrSigTimeoutValue" SG_ 1189 USM_RrWpcSetReq "";
BA_ "GenSigTimeoutTime" SG_ 1189 USM_RrWpcSetReq 0;
BA_ "UserSigValidity" SG_ 1189 USM_RrWpcSetReq 3;
BA_ "SignalLongName" SG_ 1189 USM_RrWpcSetReq "USM_RearWpcSetRequest";
BA_ "GenSigSendType" SG_ 1189 USM_RrWpcSetReq 0;
BA_ "Version" SG_ 1189 USM_WpcSetReq "1.0";
BA_ "Description" SG_ 1189 USM_WpcSetReq "USM Function for WPC(Wireless Phone Chager) on/off SW";
BA_ "UsrSigTimeoutValue" SG_ 1189 USM_WpcSetReq "";
BA_ "GenSigTimeoutTime" SG_ 1189 USM_WpcSetReq 0;
BA_ "UserSigValidity" SG_ 1189 USM_WpcSetReq 3;
BA_ "SignalLongName" SG_ 1189 USM_WpcSetReq "USM_WpcSetRequest";
BA_ "GenSigSendType" SG_ 1189 USM_WpcSetReq 0;
BA_ "Version" SG_ 373 AWD_ErrCodeVal "1.0";
BA_ "Description" SG_ 373 AWD_ErrCodeVal "This is for the “AWD ECU, MAGNA & WIA JV社” system applied vehicles only.";
BA_ "UsrSigTimeoutValue" SG_ 373 AWD_ErrCodeVal "";
BA_ "UserSigValidity" SG_ 373 AWD_ErrCodeVal 3;
BA_ "SignalLongName" SG_ 373 AWD_ErrCodeVal "AWD_ErrorCodeValue";
BA_ "Version" SG_ 373 AWD_OpModLkSta "1.0";
BA_ "UsrSigTimeoutValue" SG_ 373 AWD_OpModLkSta "";
BA_ "UserSigValidity" SG_ 373 AWD_OpModLkSta 3;
BA_ "SignalLongName" SG_ 373 AWD_OpModLkSta "AWD_OperationModeLockStatus";
BA_ "Version" SG_ 373 AWD_SysOpSta "1.0";
BA_ "UsrSigTimeoutValue" SG_ 373 AWD_SysOpSta "";
BA_ "UserSigValidity" SG_ 373 AWD_SysOpSta 3;
BA_ "SignalLongName" SG_ 373 AWD_SysOpSta "AWD_SystemOperationStatus";
BA_ "Version" SG_ 149 ENG_EngSpdErrSta "1.0";
BA_ "Description" SG_ 149 ENG_EngSpdErrSta "This signal identifies an error on searching for a long tooth or on engine speed sensing.

Note : in some cases a limp-home function can be activated in the ECU (the engine speed signal is then based on the camshaft signal), and the engine may run even i";
BA_ "UsrSigTimeoutValue" SG_ 149 ENG_EngSpdErrSta "";
BA_ "UserSigValidity" SG_ 149 ENG_EngSpdErrSta 3;
BA_ "SignalLongName" SG_ 149 ENG_EngSpdErrSta "ENG_EngineSpeedErrorStatus";
BA_ "Version" SG_ 149 ENG_MafErrSta "1.0";
BA_ "Description" SG_ 149 ENG_MafErrSta "This signal indicates error on MAF signal";
BA_ "UsrSigTimeoutValue" SG_ 149 ENG_MafErrSta "";
BA_ "UserSigValidity" SG_ 149 ENG_MafErrSta 3;
BA_ "SignalLongName" SG_ 149 ENG_MafErrSta "ENG_MassAirFlowErrorStatus";
BA_ "Version" SG_ 149 ENG_EngSpdVal "1.0";
BA_ "Description" SG_ 149 ENG_EngSpdVal "This signal is generated by crankshaft segment period measurement (in case of an six-cylinder engine, this corresponds to a crankshaft angle of 120°) and measured with a resolution of 4 us.

This signal is represented as a 16 bit value.



The signal is";
BA_ "UsrSigTimeoutValue" SG_ 149 ENG_EngSpdVal "";
BA_ "UserSigValidity" SG_ 149 ENG_EngSpdVal 3;
BA_ "SignalLongName" SG_ 149 ENG_EngSpdVal "ENG_EngineSpeedValue";
BA_ "Version" SG_ 149 ENG_CrctEngTqVal "1.0";
BA_ "Description" SG_ 149 ENG_CrctEngTqVal "This signal comprises the actual indicated engine torque (determined by calculation within the engine management system) (lambda control, knock control, catalyst overheating prevention function, temperature influences, TCS, TCU torque intervention etc. b";
BA_ "UsrSigTimeoutValue" SG_ 149 ENG_CrctEngTqVal "";
BA_ "UserSigValidity" SG_ 149 ENG_CrctEngTqVal 3;
BA_ "SignalLongName" SG_ 149 ENG_CrctEngTqVal "ENG_CorrectedEngineTorqueValue";
BA_ "Version" SG_ 149 ENG_IndTqVal "1.0";
BA_ "Description" SG_ 149 ENG_IndTqVal "1) In cars equipped with gasoline engines with ETC system, the signal TQI is determined on the driver’s demand including cruise control and other functions and corresponds to the theoretical

engine torque. The signal comprises influences, such as the a";
BA_ "UsrSigTimeoutValue" SG_ 149 ENG_IndTqVal "";
BA_ "UserSigValidity" SG_ 149 ENG_IndTqVal 3;
BA_ "SignalLongName" SG_ 149 ENG_IndTqVal "ENG_IndicatedTorqueValue";
BA_ "Version" SG_ 149 ENG_IsgSta "1.0";
BA_ "Description" SG_ 149 ENG_IsgSta "1. ISG Status expressing CAN message divided by CF_EMS_IsgStat and CF_EMS_IsgStat2 

2. In EMS , CF_EMS_IsgStat and CF_EMS_IsgStat2 do not duplicate the output condition

(EX: If CF_EMS_IsgStat is 01h~07h, CF_EMS_IsgStat2 is 00h)";
BA_ "UsrSigTimeoutValue" SG_ 149 ENG_IsgSta "";
BA_ "UserSigValidity" SG_ 149 ENG_IsgSta 3;
BA_ "SignalLongName" SG_ 149 ENG_IsgSta "ENG_IsgStatus";
BA_ "Version" SG_ 149 ENG_OilLvlSta "1.0";
BA_ "Description" SG_ 149 ENG_OilLvlSta "This signal indicates the replace time of engine oil.";
BA_ "UsrSigTimeoutValue" SG_ 149 ENG_OilLvlSta "";
BA_ "UserSigValidity" SG_ 149 ENG_OilLvlSta 3;
BA_ "SignalLongName" SG_ 149 ENG_OilLvlSta "ENG_OilLevelStatus";
BA_ "Version" SG_ 149 ENG_GearShftUpDis "1.0";
BA_ "Description" SG_ 149 ENG_GearShftUpDis "This signal represents gear shift up display status. EMS transmits gear shift up status to the cluster.";
BA_ "UsrSigTimeoutValue" SG_ 149 ENG_GearShftUpDis "";
BA_ "UserSigValidity" SG_ 149 ENG_GearShftUpDis 3;
BA_ "SignalLongName" SG_ 149 ENG_GearShftUpDis "ENG_GearShiftUpDisplay";
BA_ "Version" SG_ 149 ENG_GearShftDnDis "1.0";
BA_ "Description" SG_ 149 ENG_GearShftDnDis "This signal represents gear shift down display status. EMS transmits gear shift down status to the cluster.";
BA_ "UsrSigTimeoutValue" SG_ 149 ENG_GearShftDnDis "";
BA_ "UserSigValidity" SG_ 149 ENG_GearShftDnDis 3;
BA_ "SignalLongName" SG_ 149 ENG_GearShftDnDis "ENG_GearShiftDownDisplay";
BA_ "Version" SG_ 149 ENG_DsrGearPosDis "1.0";
BA_ "Description" SG_ 149 ENG_DsrGearPosDis "This signal represents desirable gear position of current driving condition.

EMS transmits desirable gear position to the cluster.";
BA_ "UsrSigTimeoutValue" SG_ 149 ENG_DsrGearPosDis "";
BA_ "UserSigValidity" SG_ 149 ENG_DsrGearPosDis 3;
BA_ "SignalLongName" SG_ 149 ENG_DsrGearPosDis "ENG_DesirableGearPositionDisplay";
BA_ "Version" SG_ 149 ENG_SldFuncSta "1.0";
BA_ "Description" SG_ 149 ENG_SldFuncSta "This signal indicates that if speed limiter function is active or not.

If the speed limiter function is activated then CF_Ems_SldAct = 1. Although “SLD Main” switch is on, if the Speed limiter function is deactivated then CF_Ems_SldAct should be set t";
BA_ "UsrSigTimeoutValue" SG_ 149 ENG_SldFuncSta "";
BA_ "UserSigValidity" SG_ 149 ENG_SldFuncSta 3;
BA_ "SignalLongName" SG_ 149 ENG_SldFuncSta "ENG_SpeedLimitFunctionStatus";
BA_ "Version" SG_ 149 ENG_IsgBzrReq "1.0";
BA_ "Description" SG_ 149 ENG_IsgBzrReq "This signal is for Economy Type ISG. This signal is reminding for preventing sudden starting immediately just after engine restarted or driver shift gear N to D range without braking to make auto starting.

 It transfer first 3 times why if valid one is ";
BA_ "UsrSigTimeoutValue" SG_ 149 ENG_IsgBzrReq "";
BA_ "UserSigValidity" SG_ 149 ENG_IsgBzrReq 3;
BA_ "SignalLongName" SG_ 149 ENG_IsgBzrReq "ENG_IsgBuzzerRequest";
BA_ "Version" SG_ 149 ENG_Isg2Sta "1.0";
BA_ "Description" SG_ 149 ENG_Isg2Sta "1. ISG Status CAN message is divided by CF_EMS_IsgStat and CF_EMS_IsgStat2 

2. CF_EMS_IsgStat and CF_EMS_IsgStat2 do not duplicate the output condition

(EX: If CF_EMS_IsgStat2 is 01h~03h, CF_EMS_IsgStat is 00h)";
BA_ "UsrSigTimeoutValue" SG_ 149 ENG_Isg2Sta "";
BA_ "UserSigValidity" SG_ 149 ENG_Isg2Sta 3;
BA_ "SignalLongName" SG_ 149 ENG_Isg2Sta "ENG_Isg2Status";
BA_ "Version" SG_ 149 ENG_IgnOnSta "1.0";
BA_ "Description" SG_ 149 ENG_IgnOnSta "Status of ignition lock.";
BA_ "GenSigStartValue" SG_ 149 ENG_IgnOnSta 1;
BA_ "UsrSigTimeoutValue" SG_ 149 ENG_IgnOnSta "";
BA_ "UserSigValidity" SG_ 149 ENG_IgnOnSta 3;
BA_ "SignalLongName" SG_ 149 ENG_IgnOnSta "ENG_IgnitionOnStatus";
BA_ "Version" SG_ 149 ENG_FuelCutOffSta "1.0";
BA_ "Description" SG_ 149 ENG_FuelCutOffSta "If the PUC_STAT - bit = 1 then the engine is in fuel cut off state, i.e. e. no injection is applied.";
BA_ "UsrSigTimeoutValue" SG_ 149 ENG_FuelCutOffSta "";
BA_ "UserSigValidity" SG_ 149 ENG_FuelCutOffSta 3;
BA_ "SignalLongName" SG_ 149 ENG_FuelCutOffSta "ENG_FuelCutOffStatus";
BA_ "Version" SG_ 149 ENG_VehSpdLimVal "1.0";
BA_ "Description" SG_ 149 ENG_VehSpdLimVal "The vehicle speed which is measured by the EMS has to be sent to CLUSTER. This value is used for limiting speed of EMS. 

EMS limite vehicle speed as this value.";
BA_ "UsrSigTimeoutValue" SG_ 149 ENG_VehSpdLimVal "";
BA_ "UserSigValidity" SG_ 149 ENG_VehSpdLimVal 3;
BA_ "SignalLongName" SG_ 149 ENG_VehSpdLimVal "ENG_VehicleSpeedLimitValue";
BA_ "Version" SG_ 149 ENG_VehSpdVal "1.0";
BA_ "Description" SG_ 149 ENG_VehSpdVal "The velocity of the vehicle is transferred. The signal VS is necessary to have a vehicle speed information even is there is no TCS ECU (compare to signal WHEEL of message TCS1)



In case of failure the value FFH is used as error identifier.";
BA_ "UsrSigTimeoutValue" SG_ 149 ENG_VehSpdVal "";
BA_ "UserSigValidity" SG_ 149 ENG_VehSpdVal 3;
BA_ "SignalLongName" SG_ 149 ENG_VehSpdVal "ENG_VehicleSpeedValue";
BA_ "Version" SG_ 149 ENG_FuelCnsmptVal "1.0";
BA_ "Description" SG_ 149 ENG_FuelCnsmptVal "The EMS uses the signal 'FCO' (FUEL CONSUMPTION) to inform other ECUs about the current consumption.";
BA_ "UsrSigTimeoutValue" SG_ 149 ENG_FuelCnsmptVal "";
BA_ "UserSigValidity" SG_ 149 ENG_FuelCnsmptVal 3;
BA_ "SignalLongName" SG_ 149 ENG_FuelCnsmptVal "ENG_FuelConsumptionValue";
BA_ "Version" SG_ 149 ENG_VehSpdHiVal "1.0";
BA_ "Description" SG_ 149 ENG_VehSpdHiVal "This signal provides the one wheel velocity with resolution of 0.0625 km/h,

and have 12 bits lengh.

In case of failure of sheel speed sensor, the value FFF is used as error identifier";
BA_ "UsrSigTimeoutValue" SG_ 149 ENG_VehSpdHiVal "";
BA_ "UserSigValidity" SG_ 149 ENG_VehSpdHiVal 3;
BA_ "SignalLongName" SG_ 149 ENG_VehSpdHiVal "ENG_VehicleSpeedHighValue";
BA_ "Version" SG_ 149 ENG_LnchCntrlSta "1.0";
BA_ "Description" SG_ 149 ENG_LnchCntrlSta "State of Launch Control";
BA_ "UsrSigTimeoutValue" SG_ 149 ENG_LnchCntrlSta "";
BA_ "UserSigValidity" SG_ 149 ENG_LnchCntrlSta 3;
BA_ "SignalLongName" SG_ 149 ENG_LnchCntrlSta "ENG_LaunchControlStatus";
VAL_ 165 ESC_LatAccelVal 2047 "Error" ;
VAL_ 165 ESC_LatAccelDiagSta 0 "Lateral acceleration signal is not available temporarily" 1 "Lateral acceleration signal is available" 2 "Not used" 3 "Error Indicator" ;
VAL_ 165 ESC_LatAccelSpdSta 0 "Lateral acceleration signal is invalid" 1 "Lateral acceleration signal is valid" 2 "Not used" 3 "Error Indicator" ;
VAL_ 165 ESC_LongAccelSpdVal 2047 "Error" ;
VAL_ 165 ESC_LongAccelDiagSta 0 "Longitudinal acceleration signal is not available temporarily" 1 "Longitudinal acceleration signal is available" 2 "Not used" 3 "Error Indicator" ;
VAL_ 165 ESC_LongAccelSpdSta 0 "Longitudinal acceleration signal is invalid" 1 "Longitudinal acceleration signal is valid" 2 "Not used" 3 "Error Indicator" ;
VAL_ 165 ESC_YawRtVal 8191 "Error" ;
VAL_ 165 ESC_YawRtDiagSta 0 "Yaw rate signal is available" 1 "Yaw rate signal is not available temporarily" ;
VAL_ 165 ESC_YawRtSta 0 "Yaw rate sensor signal is invalid" 1 "Yaw rate sensor signal is valid" 2 "Not used" 3 "Error Indicator" ;
VAL_ 325 ESC_AccelBasisVal 2047 "Error" ;
VAL_ 325 ESC_VehAccelVal 2047 "Error" ;
VAL_ 325 ESC_StdStillVal 0 "No stand still detected" 1 "stand still detected" 2 "Not used" 3 "Error Indicator" ;
VAL_ 325 ESC_BrkLtReq 0 "No request" 1 "Activate brake lights" 2 "Not used" 3 "Error Indicator" ;
VAL_ 325 ESC_DclEnblReq 0 "Disable deceleration control" 1 "Enable deceleration control" 2 "Not used" 3 "Error Indicator" ;
VAL_ 325 ESC_OvrrdeReq 0 "No override" 1 "Override by acceleration pedal" 2 "Override by deceleration" 3 "Error Indicator" ;
VAL_ 325 ESC_PrkBrkActvSta 0 "Parking brake is not activated" 1 "Parking brake is activated" 2 "Not used" 3 "Error Indicator" ;
VAL_ 325 ESC_DiffBrkFuncSta 0 "Differential braking available without error" 1 "Differential braking disable" 2 "Differential braking is activated" 3 "Error Indicator" ;
VAL_ 325 ESC_DrvBrkActvSta 0 "Brake pedal not pressed" 1 "Brake pedal pressed" 2 "Not used" 3 "Error Indicator" ;
VAL_ 325 ESC_DrvBrkSta 0 "Driver is not braking / failure" 1 "Driver is braking" 2 "Not used" 3 "Error Indicator" ;
VAL_ 325 AEB_EquipSta 0 "AEB is not equipped" 1 "AEB is equipped" 2 "Not used" 3 "Error Indicator" ;
VAL_ 325 VSM_ConfSwSta 0 "Switch Not Pressed" 1 "Switch Pressed" 2 "Reserved" 3 "Error Identifier (switch failure detected by ESC or CAN communication failure)" ;
VAL_ 325 VSM_CodedSta 0 "Not coded" 1 "Coded" 2 "Not used" 3 "Error Indicator" ;
VAL_ 325 VSM_AvlblSta 0 "Not available" 1 "Available" 2 "Temporarily not available" 3 "Permanently not available" ;
VAL_ 325 VSM_HndShkSta 0 "Not okay" 1 "Okay" 2 "Not used" 3 "Error Indicator" ;
VAL_ 325 SCC_OptTyp 0 "SCC is not equipped" 1 "SCC is equipped" 2 "Not used" 3 "Error Indicator" ;
VAL_ 325 SCC_EnblReq 0 "SCC enabled" 1 "SCC disabled reversible" 2 "SCC disabled irreversible" 3 "SCC disabled irreversible due to communication error" ;
VAL_ 325 SCC_TqReq 0 "No request" 1 "Enable SCC torque request" 2 "Not used" 3 "Error Indicator" ;
VAL_ 325 SCC_ReqLimSta 0 "No request" 1 "Limited No Limitation" 2 "Acceleration Limited" 3 "Deceleration Limited" ;
VAL_ 1216 SAS_CmdCodWrdVal 3 "Request calibration and acceptance of SAS_CID" 5 "Reset SAS_CAL flag" ;
VAL_ 277 WHL_PlsFLSta 255 "Error" ;
VAL_ 277 WHL_PlsFRSta 255 "Error" ;
VAL_ 277 WHL_PlsRLSta 255 "Error" ;
VAL_ 277 WHL_PlsRRSta 255 "Error" ;
VAL_ 277 WHL_DirFLSta 0 "Unknown (Wheel moving stop state or Not applied wheel sensor for direction)" 1 "Forward direction" 2 "Backward direction" 3 "Error identifier" ;
VAL_ 277 WHL_DirFRSta 0 "Unknown (Wheel moving stop state or Not applied wheel sensor for direction)" 1 "Forward direction" 2 "Backward direction" 3 "Error identifier" ;
VAL_ 277 WHL_DirRLSta 0 "Unknown (Wheel moving stop state or Not applied wheel sensor for direction)" 1 "Forward direction" 2 "Backward direction" 3 "Error identifier" ;
VAL_ 277 WHL_DirRRSta 0 "Unknown (Wheel moving stop state or Not applied wheel sensor for direction)" 1 "Forward direction" 2 "Backward direction" 3 "Error identifier" ;
VAL_ 277 WHL_SpdFLVal 16383 "Error" ;
VAL_ 277 WHL_SpdFRVal 16383 "Error" ;
VAL_ 277 WHL_SpdRLVal 16383 "Error" ;
VAL_ 277 WHL_SpdRRVal 16383 "Error" ;
VAL_ 117 IVSS_EcsActvSta 0 "IVSS Inactivate" 1 "IVSS Activate" 2 "Not used" 3 "Error Indicator" ;
VAL_ 117 IVSS_EcsDfctvSta 0 "IVSS is not defective" 1 "IVSS is defective" 2 "Not used" 3 "Error Indicator" ;
VAL_ 117 IVSS_EmsModSta 0 "Normal" 1 "Sport" 2 "ECO" 3 "Snow" ;
VAL_ 117 IVSS_TcuModSta 0 "Normal" 1 "Sport" 2 "ECO" 3 "Snow" ;
VAL_ 117 IVSS_MdpsModSta 0 "Normal" 1 "Sport" 2 "ECO(Comfort)" 3 "Error Indicator" ;
VAL_ 117 IVSS_EcsModSta 0 "Normal" 1 "Sport" 2 "Comfort" 3 "Error Indicator" ;
VAL_ 117 IVSS_EscModSta 0 "Normal" 1 "Sport" 2 "Not used" 3 "Error Indicator" ;
VAL_ 117 IVSS_AwdModSta 0 "Normal" 1 "Sport" 2 "ECO" 3 "Error Indicator" ;
VAL_ 117 IVSS_SmrtShftModSta 0 "Off" 1 "On" 2 "Not used" 3 "Error Indicator" ;
VAL_ 117 IVSS_DrvngModSta 0 "Comfort(Normal)" 1 "Sport" 2 "ECO" 3 "Snow" 4 "Individual" 5 "SMART" 6 "Reserved" 7 "Invalid" ;
VAL_ 117 IVSS_PtModDis 0 "Comfort(Normal)" 1 "Sport" 2 "ECO" 3 "Error Indicator" ;
VAL_ 117 IVSS_MdpsModDis 0 "Comfort(Normal)" 1 "Sport" 2 "Not used" 3 "Error Indicator" ;
VAL_ 117 IVSS_EcsModDis 0 "Normal" 1 "Sport" 2 "Comfort" 3 "Error Indicator" ;
VAL_ 117 IVSS_AwdModDis 0 "Comfort(Normal)" 1 "Sport" 2 "ECO" 3 "Error Indicator" ;
VAL_ 117 IVSS_EmsModFltSta 0 "Not defective" 1 "Defective" 2 "Not used" 3 "Error Indicator" ;
VAL_ 117 IVSS_TcuModFltSta 0 "Not defective" 1 "Defective" 2 "Not used" 3 "Error Indicator" ;
VAL_ 117 IVSS_MdpsModFltSta 0 "Not defective" 1 "Defective" 2 "Not used" 3 "Error Indicator" ;
VAL_ 117 IVSS_EcsModFltSta 0 "Not defective" 1 "Defective" 2 "Not used" 3 "Error Indicator" ;
VAL_ 117 IVSS_EscModFltSta 0 "Not defective" 1 "Defective" 2 "Not used" 3 "Error Indicator" ;
VAL_ 117 IVSS_AwdModFltSta 0 "Not defective" 1 "Defective" 2 "Not used" 3 "Error Indicator" ;
VAL_ 117 IVSS_DrvngModFltSta 0 "All mode available" 1 "Sport mode unavailable" 2 "ECO mode and Sport mode unavailable" 3 "Comfort(Normal) mode only available (The other modes unavailable)" 4 "Reserved" 5 "Reserved" 6 "Reserved" 7 "Reserved" 8 "Reserved" 9 "Reserved" 10 "Reserved" 11 "Reserved" 12 "Reserved" 13 "Reserved" 14 "Reserved" 15 "Reserved" ;
VAL_ 394 TCU_VgisInhbtReq_Copy_1 0 "There’s no request from TCU" 1 "TCU inhibits ECU from changing VGIS status" 2 "Not used" 3 "Error Indicator" ;
VAL_ 394 TCU_VehSpdKphVal_Copy_1 255 "Error Indicator" ;
VAL_ 394 TCU_TrgtGearSta_Copy_1 0 "if N or P are detected (no frictional connection)" 1 "1st speed" 2 "2nd speed" 3 "3rd speed" 4 "4th speed" 5 "5th speed" 6 "6th speed" 7 "7th speed" 8 "8th speed" 14 "Reverse speed" ;
VAL_ 394 TCU_TqRdctnPcVal_Copy_1 0 "Max. reduction" 255 "No reduction" ;
VAL_ 394 TCU_TqCnvrtrSta_Copy_1 0 "No lock up control" 1 "Slip lock up" 2 "Fully lock up" 3 "Off slip lock up" ;
VAL_ 394 TCU_SprtyIndxSta_Copy_1 0 "Invalid" 1 "Step 1" 2 "Step 2" 3 "Step 3" 4 "Step 4" 5 "Step 5" 6 "Step 6" 7 "Step 7" 8 "Step 8" 9 "Step 9" 10 "Step 10" 11 "Step 11" 12 "Step 12" 13 "Step 13" 14 "Step 14" 15 "Step 15" 16 "Step 16" 17 "Step 17" 18 "Step 18" 19 "Step 19" 20 "Step 20" 21 "Step 21" 22 "Step 22" 23 "Step 23" 24 "Step 24" 25 "Step 25" 26 "Invalid" 27 "Invalid" 28 "Invalid" 29 "Invalid" 30 "Invalid" 31 "Invalid" ;
VAL_ 394 TCU_SmrtShftSta_Copy_1 0 "Smart Shift not Applied" 1 "Smart Shift Applied" 2 "Not used" 3 "Error Indicator" ;
VAL_ 394 TCU_ShftPtrnSta_Copy_1 0 "Normal (ECO)" 1 "Uphill 1 (Optional)" 2 "Uphill 2 (Optional)" 3 "Reserved" 4 "Downhill 1 (Optional)" 5 "Cruise (Optional)" 6 "Cruise_Uphill 1 (Optional)" 7 "Cruise_Uphill 2 (Optional)" 8 "Active ECO (Optional)" 9 "Sport Drive (Optional)" 15 "None of the above" ;
VAL_ 394 TCU_NetrlCtrlSta_Copy_1 0 "No NC" 1 "NC Entry" 2 "NC Applied" 3 "NC Exit" ;
VAL_ 394 TCU_GearStepTyp_Copy_1 3 "3 - Speed A/T or DCT" 4 "4 - Speed A/T or DCT" 5 "5 - Speed A/T or DCT" 6 "6 - Speed A/T or DCT" ;
VAL_ 394 TCU_GearSlctDis_Copy_1 0 "P" 1 "L" 2 "2" 3 "3" 4 "DS Mode" 5 "D" 6 "N" 7 "R" 8 "sports mode / manual shift / paddle shift" 9 "Not Display at Cluster" 10 "Sub-Rom Communication" 11 "Sub-Rom Communication Error" 12 "Paddle shift (D-position)" 13 "Reserved" 14 "Intermediate Position" 15 "fault" ;
VAL_ 394 TCU_GearShftSta_Copy_1 0 "no gear change" 1 "gear change is active" 2 "Not used" 3 "Error Indicator" ;
VAL_ 394 TCU_GearLmpBlnkngReq_Copy_1 0 "No blink" 1 "Request lamp blinking" 2 "Not used" 3 "Error Indicator" ;
VAL_ 394 TCU_FuelCutInhbtReq_Copy_1 0 "No request" 1 "Fuel cut inhibition request from TCU" 2 "Not used" 3 "Error Indicator" ;
VAL_ 394 TCU_EngRpmDis_Copy_1 65535 "Error Indicator" ;
VAL_ 394 TCU_DrvngModDis_Copy_1 0 "Inactive" 1 "Normal" 2 "Eco" 3 "Eco+" 4 "Sport" 5 "Sport+" 6 "Snow" 7 "Reserved" ;
VAL_ 394 TCU_DcmlVehSpdKphVal_Copy_1 0 "Error Indicator" ;
VAL_ 394 TCU_CurrGearSta_Copy_1 0 "if N or P are detected (no frictional connection)" 1 "1st speed" 2 "2nd speed" 3 "3rd speed" 4 "4th speed" 5 "5th speed" 6 "6th speed" 7 "7th speed" 8 "8th speed" 14 "Reverse speed" ;
VAL_ 394 TCU_CluTrgtGearSta_Copy_1 0 "if N or P are detected (no frictional connection)" 1 "1st speed" 2 "2nd speed" 3 "3rd speed" 4 "4th speed" 5 "5th speed" 6 "6th speed" 7 "7th speed" 8 "8th speed" 14 "Reverse speed" ;
VAL_ 394 TCH_EngTrgtGearSta_Copy_1 0 "if N or P are detected (no frictional connection)" 1 "1st speed" 2 "2nd speed" 3 "3rd speed" 4 "4th speed" 5 "5th speed" 6 "6th speed" 7 "7th speed" 8 "8th speed" 14 "Reverse speed" ;
VAL_ 368 SCC_AlvCnt1Val 15 "Signal Invalid" ;
VAL_ 368 SCC_SysFlrSta 0 "System without error" 1 "Performance degredation" 2 "System temporairy unavailable" 3 "SCC Service Required" ;
VAL_ 368 SCC_MainOnOffSta 0 "OFF" 1 "ON" 2 "Not used" 3 "Error Indicator" ;
VAL_ 368 SCC_OpSta 0 "Off" 1 "Engaged" 2 "Override" 3 "Shutoff" ;
VAL_ 368 SCC_TakeoverReq 0 "No takeover request" 1 "Takeover request" 2 "Not used" 3 "Error Indicator" ;
VAL_ 368 SCC_InfoDis 0 "-" 1 "Display “SCC Mode”" 2 "Display “Conventional Cruise Mode”" 3 "Display “Object disappeared at low speed”" 4 "Display “Available to resume acceleration control”" ;
VAL_ 368 SCC_DrvAlrtDis 0 "-" 1 "Display 'SCC Disengaged'" 2 "Display 'No SCC Engage Condition!'" 3 "Display 'SCC Disengaged When The Vehicle Stops'" ;
VAL_ 368 SCC_ObjDetSta 0 "No in-path object detected" 1 "In-path object detected" 2 "Not used" 3 "Error Indicator" ;
VAL_ 368 SCC_HeadwayDstSetVal 0 "No time gap set" 1 "1st level distance" 2 "2nd level distance" 3 "3rd level distance" 4 "4th level distance" ;
VAL_ 368 SCC_EquipSta 0 "Not Applied" 1 "Applied" 2 "Not used" 3 "Error Indicator" ;
VAL_ 368 SCC_TrgtSpdSetVal 255 "Error" ;
VAL_ 368 SCC_NaviCamOpSta 0 "Off" 1 "Ready" 2 "Act" 3 "Error Indicator" ;
VAL_ 368 SCC_NaviCamOnOffSta 0 "Not Applied" 1 "Function Off" 2 "Function On" 3 "Invalid(Fail)" ;
VAL_ 368 SCC_AccelReqVal 2047 "Error" ;
VAL_ 368 SCC_VehStpReq 0 "No request" 1 "Stop control is required" 2 "Not used" 3 "Error Indicator" ;
VAL_ 368 SCC_SnstvtyModRetVal 0 "Default" 1 "Comford Mode" 2 "Normal Mode" 3 "Dynamic Mode" 4 "Reserved" 5 "Reserved" 6 "Reserved" 7 "Invalid" ;
VAL_ 170 MDPS_WrngLmpSta 0 "MDPS Malfunction Warning lamp OFF" 1 "MDPS Malfunciton Warning lamp BLANKING(2Hz)" 2 "MDPS Malfunction Warning lamp ON" 3 "MDPS Malfunction Warning lamp BLANKING(1Hz)" 4 "RESERVED" 5 "RESERVED" 6 "Not Used" 7 "Error Indicator" ;
VAL_ 170 MDPS_Typ 0 "C-MDPS" 1 "R-MDPS(Dual Pinion)" 2 "R-MDPS(Belt)" 6 "Not Used" 7 "Error Indicator" ;
VAL_ 170 MDPS_EngIdleRpmReq 0 "Current Consumption is Low" 1 "Current Consumption is High" 2 "Not Used" 3 "Error Indicator" ;
VAL_ 170 MDPS_VsmPlgInSta 0 "The VSM function of MDPS is not plugged in (unplugged)." 1 "The VSM function of MDPS is plugged in." 2 "Not Used" 3 "Error Indicator" ;
VAL_ 170 MDPS_DfctvSta 0 "MDPS is not defective" 1 "MDPS is defective" 2 "Not Used" 3 "Error Indicator" ;
VAL_ 170 MDPS_SigErrSta 0 "VSM1 signal is not error" 1 "VSM1 signal is error" 2 "Not Used" 3 "Error Indicator" ;
VAL_ 170 MDPS_SpasPlugInSta 0 "The SPAS function of MDPS is not plugged in (unplugged)." 1 "The SPAS function of MDPS is plugged in." 2 "Not Used" 3 "Error Indicator" ;
VAL_ 170 MDPS_SpasModeSta 0 "Reserved" 1 "Steering still in initialization phase" 2 "Steering ready, waits for SPAS command" 3 "Steering set in standby by SPAS" 4 "Steering requested to go to first activation step" 5 "Steering requested to go to final activation step" 6 "Steering went to error internally" 7 "Steering aborted the automatic function" 14 "Not Used" 15 "Error Indicator" ;
VAL_ 170 MDPS_LkasPlgInSta 0 "The LKAS function of MDPS is not plugged in (unplugged)." 1 "The LKAS function of MDPS is plugged in." 2 "Not Used" 3 "Error Indicator" ;
VAL_ 170 MDPS_LkasToiActvSta 0 "Deactivated" 1 "Activated" 2 "Not Used" 3 "Error Indicator" ;
VAL_ 170 MDPS_ToiUnblSta 0 "Available" 1 "Unavailable" 2 "Not Used" 3 "Error Indicator" ;
VAL_ 170 MDPS_ToiFltSta 0 "No fault" 1 "Faulty" 2 "Not Used" 3 "Error Indicator" ;
VAL_ 170 MDPS_LkasFailSta 0 "Not in fail state" 1 "In fail state" 2 "Not Used" 3 "Error Indicator" ;
VAL_ 170 MDPS_FlxStrSta 0 "Standard Mode" 1 "Sport Mode" 2 "Comport Mode" 3 "RESERVED" 4 "RESERVED" 5 "RESERVED" 6 "Not Used" 7 "Error Indicator" ;
VAL_ 170 MDPS_FlxStrDis 0 "No Display" 1 "Display" 2 "Not Used" 3 "Error Indicator" ;
VAL_ 170 MDPS_CurrModVal 0 "Standard Mode" 1 "Sport Mode" 2 "Comfort Mode" 3 "RESERVED" 4 "RESERVED" 5 "RESERVED" 6 "Not Used" 7 "Error Indicator" ;
VAL_ 170 MDPS_OutTqVal 4094 "Not Used" 4095 "Error Indicator" ;
VAL_ 170 MDPS_StrTqSnsrVal 8190 "Not Used" 8191 "Error Indicator" ;
VAL_ 170 MDPS_StrAnglVal 32766 "Not Used" 32767 "Error Indicator" ;
VAL_ 586 HUD_HghtSta 0 "Step 1" 1 "Step 2" 2 "Step 3" 3 "Step 4" 4 "Step 5" 5 "Step 6" 6 "Step 7" 7 "Step 8" 8 "Step 9" 9 "Step 10" 10 "Step 11" 11 "Step 12" 12 "Step 13" 13 "Step 14" 14 "Step 15" 15 "Step 16" 16 "Step 17" 17 "Step 18" 18 "Step 19" 19 "Step 20" ;
VAL_ 586 HUD_PbackSta 0 "Stop" 1 "Play 1" 2 "Play 2" 3 "Health Care IMS" 4 "Reserved" 5 "Reserved" 6 "Reserved" 7 "Invalid" ;
VAL_ 586 HUD_BrgtnsSta 0 "Step 1" 1 "Step 2" 2 "Step 3" 3 "Step 4" 4 "Step 5" 5 "Step 6" 6 "Step 7" 7 "Step 8" 8 "Step 9" 9 "Step 10" 10 "Step 11" 11 "Step 12" 12 "Step 13" 13 "Step 14" 14 "Step 15" 15 "Step 16" 16 "Step 17" 17 "Step 18" 18 "Step 19" 19 "Step 20" ;
VAL_ 586 HUD_RotatSta 0 "CENTER" 1 "CW 1" 2 "CW 2" 3 "CW 3" 4 "CW 4" 5 "CW 5" 6 "CW 6" 7 "CW 7" 8 "CW 8" 9 "CW 9" 10 "CW 10" 17 "CCW 1" 18 "CCW 2" 19 "CCW 3" 20 "CCW 4" 21 "CCW 5" 22 "CCW 6" 23 "CCW 7" 24 "CCW 8" 25 "CCW 9" 26 "CCW 10" ;
VAL_ 378 CLU_PasDisTyp 0 "Display is not applied" 1 "Display is applied" 2 "Not used" 3 "Error Indicator" ;
VAL_ 378 CLU_DtntOutSta 0 "Detent Off" 1 "Detent On" 2 "Not used" 3 "Error Indicator" ;
VAL_ 378 CLU_SpdUnitTyp 0 "km/h" 1 "MPH" 2 "Not used" 3 "Error Indicator" ;
VAL_ 378 CLU_DisSpdDcmlVal 0 "0" 1 "0.125" 2 "0.250" 3 "0.375" ;
VAL_ 378 CLU_CrsMainSwSta 0 "Idle Position" 1 "Main" 2 "Mode (Cruise+SLD)" 3 "Resume/Plus" 4 "Set/Minus" 5 "Time gap (Distance, SCC Only)" 6 "ACC/SCC cancel" 7 "Reserved" ;
VAL_ 378 CLU_RhstaLvlSta 0 "Reserved" 1 "Step 1" 2 "Step 2" 3 "Step 3" 4 "Step 4" 5 "Step 5" 6 "Step 6" 7 "Step 7" 8 "Step 8" 9 "Step 9" 10 "Step 10" 11 "Step 11" 12 "Step 12" 13 "Step 13" 14 "Step 14" 15 "Step 15" 16 "Step 16" 17 "Step 17" 18 "Step 18" 19 "Step 19" 20 "Step 20 (Reset Value)" 21 "Step 21 (Detent)" ;
VAL_ 378 CLU_DisSpdVal 511 "Error" ;
VAL_ 469 CLU_DrvModSwSta 0 "Off" 1 "On" 2 "Not used" 3 "Error Indicator" ;
VAL_ 469 CLU_DrvngModSwSta 0 "Off" 1 "Normal" 2 "Eco" 3 "Sport" 4 "Snow" 5 "Smart" 6 "Individual" 7 "Invalid" ;
VAL_ 469 CLU_SRSWrngLmpSta 0 "Lamp OFF" 1 "Lamp On" 2 "Lamp Flashing" 3 "ACU message error" 7 "Lamp Circuit Failure" ;
VAL_ 469 CLU_AltLSta 0 "Off (Low)" 1 "On (Open or High)" 2 "Not used" 3 "Error Indicator" ;
VAL_ 469 CLU_SndTyp 0 "Cluster applied speaker" 1 "Cluster applied buzzer" 2 "Not used" 3 "Error Indicator" ;
VAL_ 469 CLU_TripUnitSta 0 "Not Used" 1 "km" 2 "mile" 3 "Invailid" ;
VAL_ 469 CLU_AvgFuelCnsmptnVal 1023 "Error" ;
VAL_ 469 CLU_AvgFuelCnsmptnUnitSta 0 "km/L" 1 "L/100km" 2 "MPG(US)" 3 "MPG(UK)" ;
VAL_ 469 CLU_LoFuelWrngSta 0 "Low fuel Warning is off" 1 "Low fuel Warning is on" 2 "Not used" 3 "Invalid" ;
VAL_ 469 CLU_RefuelDetSta 0 "Non refuel detected" 1 "Refuel detected" 2 "Not used" 3 "Error Indicator" ;
VAL_ 469 CLU_FuelLvlDisVal 0 "Empty" 1 "Level 0" 2 "Level 1" 3 "Level 2" 4 "Level 3" 5 "Level 4" 6 "Level 5" 7 "Level 6" 8 "Level 7" 9 "Level 8" 10 "Level 9" 11 "Level 10" 12 "Level 11" 13 "Level 12" 14 "Level 13" 15 "Level 14" 16 "Level 15" 17 "Level 16" 31 "Invalid (Error)" ;
VAL_ 469 CLU_LngSta 0 "Off" 1 "Korean" 2 "English(US)" 3 "English(UK)" 4 "Chinese(Mandarin)" 5 "Chinese(Cantonese)" 6 "French(EU)" 7 "Spanish(EU)" 8 "Arabic" 9 "Czech" 10 "Danish" 11 "German" 12 "Italian" 13 "Dutch" 14 "Polish" 15 "Portuguese" 16 "Russian" 17 "Slovak" 18 "Swedish" 19 "Turkish" 20 "French(US)" 21 "Spanish(US)" 22 "Reserved" 23 "Reserved" 24 "Reserved" 25 "Reserved" 26 "Reserved" 27 "Reserved" 28 "Reserved" 29 "Reserved" 30 "Reserved" 31 "Invalid" ;
VAL_ 469 CLU_OdoVal 16777215 "Error" ;
VAL_ 778 VCRM_CluDISWrngSta 0 "Off" 1 "On" 2 "Not used" 3 "Error Indicator" ;
VAL_ 778 VCRM_CluFuelConsmptnUnitSta 0 "km/L" 1 "MPG(US)" 2 "L/100km" 3 "MPG(UK)" ;
VAL_ 778 VCRM_CluGearPosPopupSta 0 "Off" 1 "On" 2 "Not used" 3 "Error Indicator" ;
VAL_ 778 VCRM_CluMFSWPopupSta 0 "Off" 1 "On" 2 "Not used" 3 "Error Indicator" ;
VAL_ 778 VCRM_CluSrvRmndrSta 0 "Off" 1 "On" 2 "Not used" 3 "Error Indicator" ;
VAL_ 778 VCRM_CluSpdmtrSta 0 "km/h" 1 "mph" 2 "reserved" 3 "invalid" ;
VAL_ 778 VCRM_CluStrWhlAlignSta 0 "Off" 1 "On" 2 "Not used" 3 "Error Indicator" ;
VAL_ 778 VCRM_CluWlcmSndSta 0 "Off" 1 "On" 2 "Not used" 3 "Error Indicator" ;
VAL_ 778 VCRM_CluDisGrpSta 0 "NA" 1 "1st tab" 2 "2nd tab" 3 "3rd tab ~ 15th tab" 4 "3rd tab ~ 15th tab" 5 "3rd tab ~ 15th tab" 6 "3rd tab ~ 15th tab" 7 "3rd tab ~ 15th tab" 8 "3rd tab ~ 15th tab" 9 "3rd tab ~ 15th tab" 10 "3rd tab ~ 15th tab" 11 "3rd tab ~ 15th tab" 12 "3rd tab ~ 15th tab" 13 "3rd tab ~ 15th tab" 14 "3rd tab ~ 15th tab" 15 "invalid" ;
VAL_ 778 VCRM_CluDisModSta 0 "NA" 1 "1st page" 2 "2nd page" 3 "3rd page ~ 15th page" 4 "3rd page ~ 15th page" 5 "3rd page ~ 15th page" 6 "3rd page ~ 15th page" 7 "3rd page ~ 15th page" 8 "3rd page ~ 15th page" 9 "3rd page ~ 15th page" 10 "3rd page ~ 15th page" 11 "3rd page ~ 15th page" 12 "3rd page ~ 15th page" 13 "3rd page ~ 15th page" 14 "3rd page ~ 15th page" 15 "invalid" ;
VAL_ 778 VCRM_CluAvgFuelCnsmptnAutoRstSta 0 "off" 1 "after ignition" 2 "after refueling" 3 "reserved" 4 "reserved" 5 "reserved" 6 "reserved" 7 "invalid" ;
VAL_ 778 VCRM_CluTxtSizeSta 0 "medium" 1 "large" 2 "reserved" 3 "reserved" 4 "reserved" 5 "reserved" 6 "reserved" 7 "invalid" ;
VAL_ 778 VCRM_CluLngSetSta 0 "NA" 1 "Korean" 2 "English(US)" 3 "French(US)" 4 "Spanish(US)" 5 "Simplified Chinese" 6 "Arabic" 7 "English(UK)" 8 "French(EU)" 9 "Portuguese (EU)" 10 "Italian" 11 "German" 12 "Russian" 13 "Spanish (EU)" 14 "Dutch" 15 "Swedish" 16 "Slovakia" 17 "Polish" 18 "Turkish" 19 "Czech" 20 "Danish" 21 "reserved" 22 "reserved" 23 "reserved" 24 "reserved" 25 "reserved" 26 "reserved" 27 "reserved" 28 "reserved" 29 "reserved" 30 "reserved" 31 "reserved" 32 "reserved" 33 "reserved" 34 "reserved" 35 "reserved" 36 "reserved" 37 "reserved" 38 "reserved" 39 "reserved" 40 "reserved" 41 "reserved" 42 "reserved" 43 "reserved" 44 "reserved" 45 "reserved" 46 "reserved" 47 "reserved" 48 "reserved" 49 "reserved" 50 "reserved" 51 "reserved" 52 "reserved" 53 "reserved" 54 "reserved" 55 "reserved" 56 "reserved" 57 "reserved" 58 "reserved" 59 "reserved" 60 "reserved" 61 "reserved" 62 "reserved" 63 "invalid" ;
VAL_ 778 VCRM_CluSrvRmndrDaySta 0 "00 months" 1 "01 months" 2 "02 months" 3 "03 months ~ 99 months" 4 "03 months ~ 99 months" 5 "03 months ~ 99 months" 6 "03 months ~ 99 months" 7 "03 months ~ 99 months" 8 "03 months ~ 99 months" 9 "03 months ~ 99 months" 10 "03 months ~ 99 months" 11 "03 months ~ 99 months" 12 "03 months ~ 99 months" 13 "03 months ~ 99 months" 14 "03 months ~ 99 months" 15 "03 months ~ 99 months" 16 "03 months ~ 99 months" 17 "03 months ~ 99 months" 18 "03 months ~ 99 months" 19 "03 months ~ 99 months" 20 "03 months ~ 99 months" 21 "03 months ~ 99 months" 22 "03 months ~ 99 months" 23 "03 months ~ 99 months" 24 "03 months ~ 99 months" 25 "03 months ~ 99 months" 26 "03 months ~ 99 months" 27 "03 months ~ 99 months" 28 "03 months ~ 99 months" 29 "03 months ~ 99 months" 30 "03 months ~ 99 months" 31 "03 months ~ 99 months" 32 "03 months ~ 99 months" 33 "03 months ~ 99 months" 34 "03 months ~ 99 months" 35 "03 months ~ 99 months" 36 "03 months ~ 99 months" 37 "03 months ~ 99 months" 38 "03 months ~ 99 months" 39 "03 months ~ 99 months" 40 "03 months ~ 99 months" 41 "03 months ~ 99 months" 42 "03 months ~ 99 months" 43 "03 months ~ 99 months" 44 "03 months ~ 99 months" 45 "03 months ~ 99 months" 46 "03 months ~ 99 months" 47 "03 months ~ 99 months" 48 "03 months ~ 99 months" 49 "03 months ~ 99 months" 50 "03 months ~ 99 months" 51 "03 months ~ 99 months" 52 "03 months ~ 99 months" 53 "03 months ~ 99 months" 54 "03 months ~ 99 months" 55 "03 months ~ 99 months" 56 "03 months ~ 99 months" 57 "03 months ~ 99 months" 58 "03 months ~ 99 months" 59 "03 months ~ 99 months" 60 "03 months ~ 99 months" 61 "03 months ~ 99 months" 62 "03 months ~ 99 months" 63 "03 months ~ 99 months" 64 "03 months ~ 99 months" 65 "03 months ~ 99 months" 66 "03 months ~ 99 months" 67 "03 months ~ 99 months" 68 "03 months ~ 99 months" 69 "03 months ~ 99 months" 70 "03 months ~ 99 months" 71 "03 months ~ 99 months" 72 "03 months ~ 99 months" 73 "03 months ~ 99 months" 74 "03 months ~ 99 months" 75 "03 months ~ 99 months" 76 "03 months ~ 99 months" 77 "03 months ~ 99 months" 78 "03 months ~ 99 months" 79 "03 months ~ 99 months" 80 "03 months ~ 99 months" 81 "03 months ~ 99 months" 82 "03 months ~ 99 months" 83 "03 months ~ 99 months" 84 "03 months ~ 99 months" 85 "03 months ~ 99 months" 86 "03 months ~ 99 months" 87 "03 months ~ 99 months" 88 "03 months ~ 99 months" 89 "03 months ~ 99 months" 90 "03 months ~ 99 months" 91 "03 months ~ 99 months" 92 "03 months ~ 99 months" 93 "03 months ~ 99 months" 94 "03 months ~ 99 months" 95 "03 months ~ 99 months" 96 "03 months ~ 99 months" 97 "03 months ~ 99 months" 98 "03 months ~ 99 months" 99 "03 months ~ 99 months" 100 "reserved" 101 "reserved" 102 "reserved" 103 "reserved" 104 "reserved" 105 "reserved" 106 "reserved" 107 "reserved" 108 "reserved" 109 "reserved" 110 "reserved" 111 "reserved" 112 "reserved" 113 "reserved" 114 "reserved" 115 "reserved" 116 "reserved" 117 "reserved" 118 "reserved" 119 "reserved" 120 "reserved" 121 "reserved" 122 "reserved" 123 "reserved" 124 "reserved" 125 "reserved" 126 "reserved" 127 "invalid" ;
VAL_ 778 VCRM_CluSrvRmndrDstSta 0 "00000km" 1 "00100km" 2 "00200km" 3 "00300km~99900km" 4 "00300km~99900km" 5 "00300km~99900km" 6 "00300km~99900km" 7 "00300km~99900km" 8 "00300km~99900km" 9 "00300km~99900km" 10 "00300km~99900km" 11 "00300km~99900km" 12 "00300km~99900km" 13 "00300km~99900km" 14 "00300km~99900km" 15 "00300km~99900km" 16 "00300km~99900km" 17 "00300km~99900km" 18 "00300km~99900km" 19 "00300km~99900km" 20 "00300km~99900km" 21 "00300km~99900km" 22 "00300km~99900km" 23 "00300km~99900km" 24 "00300km~99900km" 25 "00300km~99900km" 26 "00300km~99900km" 27 "00300km~99900km" 28 "00300km~99900km" 29 "00300km~99900km" 30 "00300km~99900km" 31 "00300km~99900km" 32 "00300km~99900km" 33 "00300km~99900km" 34 "00300km~99900km" 35 "00300km~99900km" 36 "00300km~99900km" 37 "00300km~99900km" 38 "00300km~99900km" 39 "00300km~99900km" 40 "00300km~99900km" 41 "00300km~99900km" 42 "00300km~99900km" 43 "00300km~99900km" 44 "00300km~99900km" 45 "00300km~99900km" 46 "00300km~99900km" 47 "00300km~99900km" 48 "00300km~99900km" 49 "00300km~99900km" 50 "00300km~99900km" 51 "00300km~99900km" 52 "00300km~99900km" 53 "00300km~99900km" 54 "00300km~99900km" 55 "00300km~99900km" 56 "00300km~99900km" 57 "00300km~99900km" 58 "00300km~99900km" 59 "00300km~99900km" 60 "00300km~99900km" 61 "00300km~99900km" 62 "00300km~99900km" 63 "00300km~99900km" 64 "00300km~99900km" 65 "00300km~99900km" 66 "00300km~99900km" 67 "00300km~99900km" 68 "00300km~99900km" 69 "00300km~99900km" 70 "00300km~99900km" 71 "00300km~99900km" 72 "00300km~99900km" 73 "00300km~99900km" 74 "00300km~99900km" 75 "00300km~99900km" 76 "00300km~99900km" 77 "00300km~99900km" 78 "00300km~99900km" 79 "00300km~99900km" 80 "00300km~99900km" 81 "00300km~99900km" 82 "00300km~99900km" 83 "00300km~99900km" 84 "00300km~99900km" 85 "00300km~99900km" 86 "00300km~99900km" 87 "00300km~99900km" 88 "00300km~99900km" 89 "00300km~99900km" 90 "00300km~99900km" 91 "00300km~99900km" 92 "00300km~99900km" 93 "00300km~99900km" 94 "00300km~99900km" 95 "00300km~99900km" 96 "00300km~99900km" 97 "00300km~99900km" 98 "00300km~99900km" 99 "00300km~99900km" 100 "00300km~99900km" 101 "00300km~99900km" 102 "00300km~99900km" 103 "00300km~99900km" 104 "00300km~99900km" 105 "00300km~99900km" 106 "00300km~99900km" 107 "00300km~99900km" 108 "00300km~99900km" 109 "00300km~99900km" 110 "00300km~99900km" 111 "00300km~99900km" 112 "00300km~99900km" 113 "00300km~99900km" 114 "00300km~99900km" 115 "00300km~99900km" 116 "00300km~99900km" 117 "00300km~99900km" 118 "00300km~99900km" 119 "00300km~99900km" 120 "00300km~99900km" 121 "00300km~99900km" 122 "00300km~99900km" 123 "00300km~99900km" 124 "00300km~99900km" 125 "00300km~99900km" 126 "00300km~99900km" 127 "00300km~99900km" 128 "00300km~99900km" 129 "00300km~99900km" 130 "00300km~99900km" 131 "00300km~99900km" 132 "00300km~99900km" 133 "00300km~99900km" 134 "00300km~99900km" 135 "00300km~99900km" 136 "00300km~99900km" 137 "00300km~99900km" 138 "00300km~99900km" 139 "00300km~99900km" 140 "00300km~99900km" 141 "00300km~99900km" 142 "00300km~99900km" 143 "00300km~99900km" 144 "00300km~99900km" 145 "00300km~99900km" 146 "00300km~99900km" 147 "00300km~99900km" 148 "00300km~99900km" 149 "00300km~99900km" 150 "00300km~99900km" 151 "00300km~99900km" 152 "00300km~99900km" 153 "00300km~99900km" 154 "00300km~99900km" 155 "00300km~99900km" 156 "00300km~99900km" 157 "00300km~99900km" 158 "00300km~99900km" 159 "00300km~99900km" 160 "00300km~99900km" 161 "00300km~99900km" 162 "00300km~99900km" 163 "00300km~99900km" 164 "00300km~99900km" 165 "00300km~99900km" 166 "00300km~99900km" 167 "00300km~99900km" 168 "00300km~99900km" 169 "00300km~99900km" 170 "00300km~99900km" 171 "00300km~99900km" 172 "00300km~99900km" 173 "00300km~99900km" 174 "00300km~99900km" 175 "00300km~99900km" 176 "00300km~99900km" 177 "00300km~99900km" 178 "00300km~99900km" 179 "00300km~99900km" 180 "00300km~99900km" 181 "00300km~99900km" 182 "00300km~99900km" 183 "00300km~99900km" 184 "00300km~99900km" 185 "00300km~99900km" 186 "00300km~99900km" 187 "00300km~99900km" 188 "00300km~99900km" 189 "00300km~99900km" 190 "00300km~99900km" 191 "00300km~99900km" 192 "00300km~99900km" 193 "00300km~99900km" 194 "00300km~99900km" 195 "00300km~99900km" 196 "00300km~99900km" 197 "00300km~99900km" 198 "00300km~99900km" 199 "00300km~99900km" 200 "00300km~99900km" 201 "00300km~99900km" 202 "00300km~99900km" 203 "00300km~99900km" 204 "00300km~99900km" 205 "00300km~99900km" 206 "00300km~99900km" 207 "00300km~99900km" 208 "00300km~99900km" 209 "00300km~99900km" 210 "00300km~99900km" 211 "00300km~99900km" 212 "00300km~99900km" 213 "00300km~99900km" 214 "00300km~99900km" 215 "00300km~99900km" 216 "00300km~99900km" 217 "00300km~99900km" 218 "00300km~99900km" 219 "00300km~99900km" 220 "00300km~99900km" 221 "00300km~99900km" 222 "00300km~99900km" 223 "00300km~99900km" 224 "00300km~99900km" 225 "00300km~99900km" 226 "00300km~99900km" 227 "00300km~99900km" 228 "00300km~99900km" 229 "00300km~99900km" 230 "00300km~99900km" 231 "00300km~99900km" 232 "00300km~99900km" 233 "00300km~99900km" 234 "00300km~99900km" 235 "00300km~99900km" 236 "00300km~99900km" 237 "00300km~99900km" 238 "00300km~99900km" 239 "00300km~99900km" 240 "00300km~99900km" 241 "00300km~99900km" 242 "00300km~99900km" 243 "00300km~99900km" 244 "00300km~99900km" 245 "00300km~99900km" 246 "00300km~99900km" 247 "00300km~99900km" 248 "00300km~99900km" 249 "00300km~99900km" 250 "00300km~99900km" 251 "00300km~99900km" 252 "00300km~99900km" 253 "00300km~99900km" 254 "00300km~99900km" 255 "00300km~99900km" 256 "00300km~99900km" 257 "00300km~99900km" 258 "00300km~99900km" 259 "00300km~99900km" 260 "00300km~99900km" 261 "00300km~99900km" 262 "00300km~99900km" 263 "00300km~99900km" 264 "00300km~99900km" 265 "00300km~99900km" 266 "00300km~99900km" 267 "00300km~99900km" 268 "00300km~99900km" 269 "00300km~99900km" 270 "00300km~99900km" 271 "00300km~99900km" 272 "00300km~99900km" 273 "00300km~99900km" 274 "00300km~99900km" 275 "00300km~99900km" 276 "00300km~99900km" 277 "00300km~99900km" 278 "00300km~99900km" 279 "00300km~99900km" 280 "00300km~99900km" 281 "00300km~99900km" 282 "00300km~99900km" 283 "00300km~99900km" 284 "00300km~99900km" 285 "00300km~99900km" 286 "00300km~99900km" 287 "00300km~99900km" 288 "00300km~99900km" 289 "00300km~99900km" 290 "00300km~99900km" 291 "00300km~99900km" 292 "00300km~99900km" 293 "00300km~99900km" 294 "00300km~99900km" 295 "00300km~99900km" 296 "00300km~99900km" 297 "00300km~99900km" 298 "00300km~99900km" 299 "00300km~99900km" 300 "00300km~99900km" 301 "00300km~99900km" 302 "00300km~99900km" 303 "00300km~99900km" 304 "00300km~99900km" 305 "00300km~99900km" 306 "00300km~99900km" 307 "00300km~99900km" 308 "00300km~99900km" 309 "00300km~99900km" 310 "00300km~99900km" 311 "00300km~99900km" 312 "00300km~99900km" 313 "00300km~99900km" 314 "00300km~99900km" 315 "00300km~99900km" 316 "00300km~99900km" 317 "00300km~99900km" 318 "00300km~99900km" 319 "00300km~99900km" 320 "00300km~99900km" 321 "00300km~99900km" 322 "00300km~99900km" 323 "00300km~99900km" 324 "00300km~99900km" 325 "00300km~99900km" 326 "00300km~99900km" 327 "00300km~99900km" 328 "00300km~99900km" 329 "00300km~99900km" 330 "00300km~99900km" 331 "00300km~99900km" 332 "00300km~99900km" 333 "00300km~99900km" 334 "00300km~99900km" 335 "00300km~99900km" 336 "00300km~99900km" 337 "00300km~99900km" 338 "00300km~99900km" 339 "00300km~99900km" 340 "00300km~99900km" 341 "00300km~99900km" 342 "00300km~99900km" 343 "00300km~99900km" 344 "00300km~99900km" 345 "00300km~99900km" 346 "00300km~99900km" 347 "00300km~99900km" 348 "00300km~99900km" 349 "00300km~99900km" 350 "00300km~99900km" 351 "00300km~99900km" 352 "00300km~99900km" 353 "00300km~99900km" 354 "00300km~99900km" 355 "00300km~99900km" 356 "00300km~99900km" 357 "00300km~99900km" 358 "00300km~99900km" 359 "00300km~99900km" 360 "00300km~99900km" 361 "00300km~99900km" 362 "00300km~99900km" 363 "00300km~99900km" 364 "00300km~99900km" 365 "00300km~99900km" 366 "00300km~99900km" 367 "00300km~99900km" 368 "00300km~99900km" 369 "00300km~99900km" 370 "00300km~99900km" 371 "00300km~99900km" 372 "00300km~99900km" 373 "00300km~99900km" 374 "00300km~99900km" 375 "00300km~99900km" 376 "00300km~99900km" 377 "00300km~99900km" 378 "00300km~99900km" 379 "00300km~99900km" 380 "00300km~99900km" 381 "00300km~99900km" 382 "00300km~99900km" 383 "00300km~99900km" 384 "00300km~99900km" 385 "00300km~99900km" 386 "00300km~99900km" 387 "00300km~99900km" 388 "00300km~99900km" 389 "00300km~99900km" 390 "00300km~99900km" 391 "00300km~99900km" 392 "00300km~99900km" 393 "00300km~99900km" 394 "00300km~99900km" 395 "00300km~99900km" 396 "00300km~99900km" 397 "00300km~99900km" 398 "00300km~99900km" 399 "00300km~99900km" 400 "00300km~99900km" 401 "00300km~99900km" 402 "00300km~99900km" 403 "00300km~99900km" 404 "00300km~99900km" 405 "00300km~99900km" 406 "00300km~99900km" 407 "00300km~99900km" 408 "00300km~99900km" 409 "00300km~99900km" 410 "00300km~99900km" 411 "00300km~99900km" 412 "00300km~99900km" 413 "00300km~99900km" 414 "00300km~99900km" 415 "00300km~99900km" 416 "00300km~99900km" 417 "00300km~99900km" 418 "00300km~99900km" 419 "00300km~99900km" 420 "00300km~99900km" 421 "00300km~99900km" 422 "00300km~99900km" 423 "00300km~99900km" 424 "00300km~99900km" 425 "00300km~99900km" 426 "00300km~99900km" 427 "00300km~99900km" 428 "00300km~99900km" 429 "00300km~99900km" 430 "00300km~99900km" 431 "00300km~99900km" 432 "00300km~99900km" 433 "00300km~99900km" 434 "00300km~99900km" 435 "00300km~99900km" 436 "00300km~99900km" 437 "00300km~99900km" 438 "00300km~99900km" 439 "00300km~99900km" 440 "00300km~99900km" 441 "00300km~99900km" 442 "00300km~99900km" 443 "00300km~99900km" 444 "00300km~99900km" 445 "00300km~99900km" 446 "00300km~99900km" 447 "00300km~99900km" 448 "00300km~99900km" 449 "00300km~99900km" 450 "00300km~99900km" 451 "00300km~99900km" 452 "00300km~99900km" 453 "00300km~99900km" 454 "00300km~99900km" 455 "00300km~99900km" 456 "00300km~99900km" 457 "00300km~99900km" 458 "00300km~99900km" 459 "00300km~99900km" 460 "00300km~99900km" 461 "00300km~99900km" 462 "00300km~99900km" 463 "00300km~99900km" 464 "00300km~99900km" 465 "00300km~99900km" 466 "00300km~99900km" 467 "00300km~99900km" 468 "00300km~99900km" 469 "00300km~99900km" 470 "00300km~99900km" 471 "00300km~99900km" 472 "00300km~99900km" 473 "00300km~99900km" 474 "00300km~99900km" 475 "00300km~99900km" 476 "00300km~99900km" 477 "00300km~99900km" 478 "00300km~99900km" 479 "00300km~99900km" 480 "00300km~99900km" 481 "00300km~99900km" 482 "00300km~99900km" 483 "00300km~99900km" 484 "00300km~99900km" 485 "00300km~99900km" 486 "00300km~99900km" 487 "00300km~99900km" 488 "00300km~99900km" 489 "00300km~99900km" 490 "00300km~99900km" 491 "00300km~99900km" 492 "00300km~99900km" 493 "00300km~99900km" 494 "00300km~99900km" 495 "00300km~99900km" 496 "00300km~99900km" 497 "00300km~99900km" 498 "00300km~99900km" 499 "00300km~99900km" 500 "00300km~99900km" 501 "00300km~99900km" 502 "00300km~99900km" 503 "00300km~99900km" 504 "00300km~99900km" 505 "00300km~99900km" 506 "00300km~99900km" 507 "00300km~99900km" 508 "00300km~99900km" 509 "00300km~99900km" 510 "00300km~99900km" 511 "00300km~99900km" 512 "00300km~99900km" 513 "00300km~99900km" 514 "00300km~99900km" 515 "00300km~99900km" 516 "00300km~99900km" 517 "00300km~99900km" 518 "00300km~99900km" 519 "00300km~99900km" 520 "00300km~99900km" 521 "00300km~99900km" 522 "00300km~99900km" 523 "00300km~99900km" 524 "00300km~99900km" 525 "00300km~99900km" 526 "00300km~99900km" 527 "00300km~99900km" 528 "00300km~99900km" 529 "00300km~99900km" 530 "00300km~99900km" 531 "00300km~99900km" 532 "00300km~99900km" 533 "00300km~99900km" 534 "00300km~99900km" 535 "00300km~99900km" 536 "00300km~99900km" 537 "00300km~99900km" 538 "00300km~99900km" 539 "00300km~99900km" 540 "00300km~99900km" 541 "00300km~99900km" 542 "00300km~99900km" 543 "00300km~99900km" 544 "00300km~99900km" 545 "00300km~99900km" 546 "00300km~99900km" 547 "00300km~99900km" 548 "00300km~99900km" 549 "00300km~99900km" 550 "00300km~99900km" 551 "00300km~99900km" 552 "00300km~99900km" 553 "00300km~99900km" 554 "00300km~99900km" 555 "00300km~99900km" 556 "00300km~99900km" 557 "00300km~99900km" 558 "00300km~99900km" 559 "00300km~99900km" 560 "00300km~99900km" 561 "00300km~99900km" 562 "00300km~99900km" 563 "00300km~99900km" 564 "00300km~99900km" 565 "00300km~99900km" 566 "00300km~99900km" 567 "00300km~99900km" 568 "00300km~99900km" 569 "00300km~99900km" 570 "00300km~99900km" 571 "00300km~99900km" 572 "00300km~99900km" 573 "00300km~99900km" 574 "00300km~99900km" 575 "00300km~99900km" 576 "00300km~99900km" 577 "00300km~99900km" 578 "00300km~99900km" 579 "00300km~99900km" 580 "00300km~99900km" 581 "00300km~99900km" 582 "00300km~99900km" 583 "00300km~99900km" 584 "00300km~99900km" 585 "00300km~99900km" 586 "00300km~99900km" 587 "00300km~99900km" 588 "00300km~99900km" 589 "00300km~99900km" 590 "00300km~99900km" 591 "00300km~99900km" 592 "00300km~99900km" 593 "00300km~99900km" 594 "00300km~99900km" 595 "00300km~99900km" 596 "00300km~99900km" 597 "00300km~99900km" 598 "00300km~99900km" 599 "00300km~99900km" 600 "00300km~99900km" 601 "00300km~99900km" 602 "00300km~99900km" 603 "00300km~99900km" 604 "00300km~99900km" 605 "00300km~99900km" 606 "00300km~99900km" 607 "00300km~99900km" 608 "00300km~99900km" 609 "00300km~99900km" 610 "00300km~99900km" 611 "00300km~99900km" 612 "00300km~99900km" 613 "00300km~99900km" 614 "00300km~99900km" 615 "00300km~99900km" 616 "00300km~99900km" 617 "00300km~99900km" 618 "00300km~99900km" 619 "00300km~99900km" 620 "00300km~99900km" 621 "00300km~99900km" 622 "00300km~99900km" 623 "00300km~99900km" 624 "00300km~99900km" 625 "00300km~99900km" 626 "00300km~99900km" 627 "00300km~99900km" 628 "00300km~99900km" 629 "00300km~99900km" 630 "00300km~99900km" 631 "00300km~99900km" 632 "00300km~99900km" 633 "00300km~99900km" 634 "00300km~99900km" 635 "00300km~99900km" 636 "00300km~99900km" 637 "00300km~99900km" 638 "00300km~99900km" 639 "00300km~99900km" 640 "00300km~99900km" 641 "00300km~99900km" 642 "00300km~99900km" 643 "00300km~99900km" 644 "00300km~99900km" 645 "00300km~99900km" 646 "00300km~99900km" 647 "00300km~99900km" 648 "00300km~99900km" 649 "00300km~99900km" 650 "00300km~99900km" 651 "00300km~99900km" 652 "00300km~99900km" 653 "00300km~99900km" 654 "00300km~99900km" 655 "00300km~99900km" 656 "00300km~99900km" 657 "00300km~99900km" 658 "00300km~99900km" 659 "00300km~99900km" 660 "00300km~99900km" 661 "00300km~99900km" 662 "00300km~99900km" 663 "00300km~99900km" 664 "00300km~99900km" 665 "00300km~99900km" 666 "00300km~99900km" 667 "00300km~99900km" 668 "00300km~99900km" 669 "00300km~99900km" 670 "00300km~99900km" 671 "00300km~99900km" 672 "00300km~99900km" 673 "00300km~99900km" 674 "00300km~99900km" 675 "00300km~99900km" 676 "00300km~99900km" 677 "00300km~99900km" 678 "00300km~99900km" 679 "00300km~99900km" 680 "00300km~99900km" 681 "00300km~99900km" 682 "00300km~99900km" 683 "00300km~99900km" 684 "00300km~99900km" 685 "00300km~99900km" 686 "00300km~99900km" 687 "00300km~99900km" 688 "00300km~99900km" 689 "00300km~99900km" 690 "00300km~99900km" 691 "00300km~99900km" 692 "00300km~99900km" 693 "00300km~99900km" 694 "00300km~99900km" 695 "00300km~99900km" 696 "00300km~99900km" 697 "00300km~99900km" 698 "00300km~99900km" 699 "00300km~99900km" 700 "00300km~99900km" 701 "00300km~99900km" 702 "00300km~99900km" 703 "00300km~99900km" 704 "00300km~99900km" 705 "00300km~99900km" 706 "00300km~99900km" 707 "00300km~99900km" 708 "00300km~99900km" 709 "00300km~99900km" 710 "00300km~99900km" 711 "00300km~99900km" 712 "00300km~99900km" 713 "00300km~99900km" 714 "00300km~99900km" 715 "00300km~99900km" 716 "00300km~99900km" 717 "00300km~99900km" 718 "00300km~99900km" 719 "00300km~99900km" 720 "00300km~99900km" 721 "00300km~99900km" 722 "00300km~99900km" 723 "00300km~99900km" 724 "00300km~99900km" 725 "00300km~99900km" 726 "00300km~99900km" 727 "00300km~99900km" 728 "00300km~99900km" 729 "00300km~99900km" 730 "00300km~99900km" 731 "00300km~99900km" 732 "00300km~99900km" 733 "00300km~99900km" 734 "00300km~99900km" 735 "00300km~99900km" 736 "00300km~99900km" 737 "00300km~99900km" 738 "00300km~99900km" 739 "00300km~99900km" 740 "00300km~99900km" 741 "00300km~99900km" 742 "00300km~99900km" 743 "00300km~99900km" 744 "00300km~99900km" 745 "00300km~99900km" 746 "00300km~99900km" 747 "00300km~99900km" 748 "00300km~99900km" 749 "00300km~99900km" 750 "00300km~99900km" 751 "00300km~99900km" 752 "00300km~99900km" 753 "00300km~99900km" 754 "00300km~99900km" 755 "00300km~99900km" 756 "00300km~99900km" 757 "00300km~99900km" 758 "00300km~99900km" 759 "00300km~99900km" 760 "00300km~99900km" 761 "00300km~99900km" 762 "00300km~99900km" 763 "00300km~99900km" 764 "00300km~99900km" 765 "00300km~99900km" 766 "00300km~99900km" 767 "00300km~99900km" 768 "00300km~99900km" 769 "00300km~99900km" 770 "00300km~99900km" 771 "00300km~99900km" 772 "00300km~99900km" 773 "00300km~99900km" 774 "00300km~99900km" 775 "00300km~99900km" 776 "00300km~99900km" 777 "00300km~99900km" 778 "00300km~99900km" 779 "00300km~99900km" 780 "00300km~99900km" 781 "00300km~99900km" 782 "00300km~99900km" 783 "00300km~99900km" 784 "00300km~99900km" 785 "00300km~99900km" 786 "00300km~99900km" 787 "00300km~99900km" 788 "00300km~99900km" 789 "00300km~99900km" 790 "00300km~99900km" 791 "00300km~99900km" 792 "00300km~99900km" 793 "00300km~99900km" 794 "00300km~99900km" 795 "00300km~99900km" 796 "00300km~99900km" 797 "00300km~99900km" 798 "00300km~99900km" 799 "00300km~99900km" 800 "00300km~99900km" 801 "00300km~99900km" 802 "00300km~99900km" 803 "00300km~99900km" 804 "00300km~99900km" 805 "00300km~99900km" 806 "00300km~99900km" 807 "00300km~99900km" 808 "00300km~99900km" 809 "00300km~99900km" 810 "00300km~99900km" 811 "00300km~99900km" 812 "00300km~99900km" 813 "00300km~99900km" 814 "00300km~99900km" 815 "00300km~99900km" 816 "00300km~99900km" 817 "00300km~99900km" 818 "00300km~99900km" 819 "00300km~99900km" 820 "00300km~99900km" 821 "00300km~99900km" 822 "00300km~99900km" 823 "00300km~99900km" 824 "00300km~99900km" 825 "00300km~99900km" 826 "00300km~99900km" 827 "00300km~99900km" 828 "00300km~99900km" 829 "00300km~99900km" 830 "00300km~99900km" 831 "00300km~99900km" 832 "00300km~99900km" 833 "00300km~99900km" 834 "00300km~99900km" 835 "00300km~99900km" 836 "00300km~99900km" 837 "00300km~99900km" 838 "00300km~99900km" 839 "00300km~99900km" 840 "00300km~99900km" 841 "00300km~99900km" 842 "00300km~99900km" 843 "00300km~99900km" 844 "00300km~99900km" 845 "00300km~99900km" 846 "00300km~99900km" 847 "00300km~99900km" 848 "00300km~99900km" 849 "00300km~99900km" 850 "00300km~99900km" 851 "00300km~99900km" 852 "00300km~99900km" 853 "00300km~99900km" 854 "00300km~99900km" 855 "00300km~99900km" 856 "00300km~99900km" 857 "00300km~99900km" 858 "00300km~99900km" 859 "00300km~99900km" 860 "00300km~99900km" 861 "00300km~99900km" 862 "00300km~99900km" 863 "00300km~99900km" 864 "00300km~99900km" 865 "00300km~99900km" 866 "00300km~99900km" 867 "00300km~99900km" 868 "00300km~99900km" 869 "00300km~99900km" 870 "00300km~99900km" 871 "00300km~99900km" 872 "00300km~99900km" 873 "00300km~99900km" 874 "00300km~99900km" 875 "00300km~99900km" 876 "00300km~99900km" 877 "00300km~99900km" 878 "00300km~99900km" 879 "00300km~99900km" 880 "00300km~99900km" 881 "00300km~99900km" 882 "00300km~99900km" 883 "00300km~99900km" 884 "00300km~99900km" 885 "00300km~99900km" 886 "00300km~99900km" 887 "00300km~99900km" 888 "00300km~99900km" 889 "00300km~99900km" 890 "00300km~99900km" 891 "00300km~99900km" 892 "00300km~99900km" 893 "00300km~99900km" 894 "00300km~99900km" 895 "00300km~99900km" 896 "00300km~99900km" 897 "00300km~99900km" 898 "00300km~99900km" 899 "00300km~99900km" 900 "00300km~99900km" 901 "00300km~99900km" 902 "00300km~99900km" 903 "00300km~99900km" 904 "00300km~99900km" 905 "00300km~99900km" 906 "00300km~99900km" 907 "00300km~99900km" 908 "00300km~99900km" 909 "00300km~99900km" 910 "00300km~99900km" 911 "00300km~99900km" 912 "00300km~99900km" 913 "00300km~99900km" 914 "00300km~99900km" 915 "00300km~99900km" 916 "00300km~99900km" 917 "00300km~99900km" 918 "00300km~99900km" 919 "00300km~99900km" 920 "00300km~99900km" 921 "00300km~99900km" 922 "00300km~99900km" 923 "00300km~99900km" 924 "00300km~99900km" 925 "00300km~99900km" 926 "00300km~99900km" 927 "00300km~99900km" 928 "00300km~99900km" 929 "00300km~99900km" 930 "00300km~99900km" 931 "00300km~99900km" 932 "00300km~99900km" 933 "00300km~99900km" 934 "00300km~99900km" 935 "00300km~99900km" 936 "00300km~99900km" 937 "00300km~99900km" 938 "00300km~99900km" 939 "00300km~99900km" 940 "00300km~99900km" 941 "00300km~99900km" 942 "00300km~99900km" 943 "00300km~99900km" 944 "00300km~99900km" 945 "00300km~99900km" 946 "00300km~99900km" 947 "00300km~99900km" 948 "00300km~99900km" 949 "00300km~99900km" 950 "00300km~99900km" 951 "00300km~99900km" 952 "00300km~99900km" 953 "00300km~99900km" 954 "00300km~99900km" 955 "00300km~99900km" 956 "00300km~99900km" 957 "00300km~99900km" 958 "00300km~99900km" 959 "00300km~99900km" 960 "00300km~99900km" 961 "00300km~99900km" 962 "00300km~99900km" 963 "00300km~99900km" 964 "00300km~99900km" 965 "00300km~99900km" 966 "00300km~99900km" 967 "00300km~99900km" 968 "00300km~99900km" 969 "00300km~99900km" 970 "00300km~99900km" 971 "00300km~99900km" 972 "00300km~99900km" 973 "00300km~99900km" 974 "00300km~99900km" 975 "00300km~99900km" 976 "00300km~99900km" 977 "00300km~99900km" 978 "00300km~99900km" 979 "00300km~99900km" 980 "00300km~99900km" 981 "00300km~99900km" 982 "00300km~99900km" 983 "00300km~99900km" 984 "00300km~99900km" 985 "00300km~99900km" 986 "00300km~99900km" 987 "00300km~99900km" 988 "00300km~99900km" 989 "00300km~99900km" 990 "00300km~99900km" 991 "00300km~99900km" 992 "00300km~99900km" 993 "00300km~99900km" 994 "00300km~99900km" 995 "00300km~99900km" 996 "00300km~99900km" 997 "00300km~99900km" 998 "00300km~99900km" 999 "00300km~99900km" 1000 "reserved" 1001 "reserved" 1002 "reserved" 1003 "reserved" 1004 "reserved" 1005 "reserved" 1006 "reserved" 1007 "reserved" 1008 "reserved" 1009 "reserved" 1010 "reserved" 1011 "reserved" 1012 "reserved" 1013 "reserved" 1014 "reserved" 1015 "reserved" 1016 "reserved" 1017 "reserved" 1018 "reserved" 1019 "reserved" 1020 "reserved" 1021 "reserved" 1022 "reserved" 1023 "invalid" ;
VAL_ 778 VCRM_CluVcAlrmVolSta 0 "NA" 1 "mute" 2 "volume1" 3 "volume2" 4 "volume3" 5 "reserved" 6 "reserved" 7 "invalid" ;
VAL_ 1194 USM_HudBrgtnsDnReq 0 "OFF(default)" 1 "ON(status1)" 2 "ON(status2)" 3 "Error Indicator" ;
VAL_ 1194 USM_HudBrgtnsUpReq 0 "OFF(default)" 1 "ON(status1)" 2 "ON(status2)" 3 "Error Indicator" ;
VAL_ 1194 USM_HudFntClrReq 0 "White" 1 "Yellow" 2 "Green" 3 "Sky blue" ;
VAL_ 1194 USM_HudFntSizeReq 0 "Large" 1 "Mid" 2 "Small" 3 "Reserved" ;
VAL_ 1194 USM_HudHghtDnReq 0 "OFF(default)" 1 "ON(status1)" 2 "ON(status2)" 3 "Error Indicator" ;
VAL_ 1194 USM_HudHghtUpReq 0 "OFF(default)" 1 "ON(status1)" 2 "ON(status2)" 3 "Error Indicator" ;
VAL_ 1194 USM_HudRotatDnReq 0 "OFF(default)" 1 "ON(status1)" 2 "ON(status2)" 3 "Error Indicator" ;
VAL_ 1194 USM_HudRotatUpReq 0 "OFF(default)" 1 "ON(status1)" 2 "ON(status2)" 3 "Error Indicator" ;
VAL_ 1194 USM_HudDisReq 0 "Off" 1 "On" 2 "Not used" 3 "Error Indicator" ;
VAL_ 1194 USM_HudInfoTBTReq 0 "default" 1 "Off" 2 "On" 3 "Invalid" ;
VAL_ 1194 USM_HudInfoDISReq 0 "default" 1 "Off" 2 "On" 3 "Invalid" ;
VAL_ 1194 USM_HudInfoSCCReq 0 "default" 1 "Off" 2 "On" 3 "Invalid" ;
VAL_ 1194 USM_HudInfoCCReq 0 "default" 1 "Off" 2 "On" 3 "Invalid" ;
VAL_ 1194 USM_HudInfoLDWSReq 0 "default" 1 "Off" 2 "On" 3 "Invalid" ;
VAL_ 1194 USM_HudInfoBSDReq 0 "default" 1 "Off" 2 "On" 3 "Invalid" ;
VAL_ 1184 USM_AutoDrLkSetReq 0 "Default" 1 "Off" 2 "Vehicle Speed On (15Km)" 3 "Shift Lever On" 4 "Invalid" ;
VAL_ 1184 USM_AutoDrUnlckSetReq 0 "Default" 1 "Off" 2 "Key Out On (AllDoors)" 3 "Shift Lever On (AllDoors)" 4 "Override" 5 "Invalid" 6 "Key Out On (Driver Door)" 7 "Shift Lever On (Driver Door)" ;
VAL_ 1184 USM_HLmpEscrtSetReq 0 "Default Value" 1 "Escort Off" 2 "Escort On" 3 "Invalid" ;
VAL_ 1184 USM_DrLkSndSetReq 0 "Off" 1 "Disable" 2 "Enable" 3 "Invalid" ;
VAL_ 1184 USM_FcwModSetReq 0 "Default (Null)" 1 "Disable" 2 "Early" 3 "Normal" 4 "Late" 5 "Reserved" 6 "Reserved" 7 "Invalid" ;
VAL_ 1184 USM_FcwSetReq 0 "Default" 1 "Disable" 2 "Enable" 3 "Invalid" ;
VAL_ 1184 USM_SmrtTrnkSetReq 0 "Default" 1 "HandsFree Off" 2 "HandsFree On" 3 "Reserved" 4 "Invalid" ;
VAL_ 1184 USM_MdLmpSetReq 0 "Default Value" 1 "Mood Lamp Off" 2 "Mood Lamp On" 3 "Modd Lamp Auto" 4 "Invalid" 5 "Reserved" 6 "Reserved" 7 "Reserved" ;
VAL_ 1184 USM_HrnAnswerBckSetReq 0 "Default" 1 "Arm Disarm Buzzer Off" 2 "Arm Disarm Buzzer On" 3 "Invalid" ;
VAL_ 1184 USM_OneTouchTrplTrnSetReq 0 "Default" 1 "One Touch Turn Off" 2 "3 Flashing" 3 "5 Flashing" 4 "7 Flashing" 5 "Invalid" 6 "Reserved" 7 "Reserved" ;
VAL_ 1184 USM_PasSpkrVolLvlSetReq 0 "Default" 1 "Level 1" 2 "Level 2" 3 "Level 3" 4 "Reserved" 5 "Reserved" 6 "Reserved" 7 "Invalid (Error Value)" ;
VAL_ 1184 USM_BsdSndWarnSetReq 0 "Off" 1 "Disable" 2 "Enable" 3 "Invalid" ;
VAL_ 1184 USM_PsmSetReq 0 "Default Value" 1 "Off (Disable)" 2 "50mmOn (Enable)" 3 "75mmOn (Enable)" 4 "Reserved" 5 "Reserved" 6 "Reserved" 7 "Invalid" ;
VAL_ 1184 USM_SccDrvSetReq 0 "Default" 1 "Slow" 2 "Normal" 3 "Fast" 4 "Reserved" 5 "Reserved" 6 "Reserved" 7 "Invalid" ;
VAL_ 1184 USM_LkasSetReq 0 "Default Value" 1 "LDW Mode" 2 "Standard LKA" 3 "Active LKA" ;
VAL_ 1184 USM_PtgmSetReq 0 "Default" 1 "Power Mode" 2 "Manual Mode" 3 "Invalid" ;
VAL_ 1184 USM_RctaSetReq 0 "Off" 1 "Disable" 2 "Enable" 3 "Invalid" ;
VAL_ 1184 USM_RcwSetReq 0 "Off" 1 "Disable" 2 "Enable" 3 "Invalid" ;
VAL_ 1184 USM_SccAebSetReq 0 "Default" 1 "Disable" 2 "Enable" 3 "Invalid" ;
VAL_ 1184 USM_SccNAviCamSetReq 0 "Default" 1 "Disable" 2 "Enable" 3 "Invalid" ;
VAL_ 1184 USM_SccNaviCurveSetReq 0 "Default" 1 "Disable" 2 "Enable" 3 "Invalid" ;
VAL_ 1184 USM_ScmSetReq 0 "Default" 1 "Steering Off" 2 "Steering On" 3 "Invalid" ;
VAL_ 1184 USM_OSTempUnitSetReq 0 "Off" 1 "Centigrade(℃)" 2 "Fahrenheit(℉)" 3 "Invalid" ;
VAL_ 1184 USM_TfrChgSetReq 0 "Off(defualt)" 1 "Disable(Off)" 2 "Enable(On)" 3 "Reserved" ;
VAL_ 1184 USM_TwoTrnUnlckSetReq 0 "Default" 1 "Off" 2 "On" 3 "Invalid" ;
VAL_ 1184 USM_WlcmLtSetReq 0 "Default Value" 1 "Welcome Light Off" 2 "Welcome Light On" 3 "Invalid" ;
VAL_ 1189 USM_AAsstSetReq 0 "Default" 1 "OFF" 2 "Late" 3 "Normal" 4 "Early" 5 "Reserved" 6 "Reserved" 7 "Invalid" ;
VAL_ 1189 USM_Aeb1stWrngSetReq 0 "Default" 1 "On (Late)" 2 "ON (Normal)" 3 "ON (Early)" 4 "Reserved" 5 "Reserved" 6 "Reserved" 7 "Invalid" ;
VAL_ 1189 USM_ECoastSetReq 0 "Default" 1 "Disable" 2 "Enable" 3 "Invalid" ;
VAL_ 1189 USM_AutoLtSnsbltySetReq 0 "Default" 1 "Bright" 2 "Normal" 3 "Overcast" 4 "Reserved" 5 "Reserved" 6 "Reserved" 7 "Invalid" ;
VAL_ 1189 USM_HealthcareIMSModReq 0 "Default" 1 "Health Care IMS Exit" 2 "Next stage" 3 "Move to recommend position" 4 "Current Position Analysis" 5 "Move to setting page" 6 "Reserved" 7 "Invalid" ;
VAL_ 1189 USM_ECoastingWrngSndSetReq 0 "Default" 1 "Disable" 2 "Enable" 3 "Invalid" ;
VAL_ 1189 USM_MdLmpBrgtnsSetReq 0 "Default" 1 "Off" 2 "step 1" 3 "step 2" 4 "step 3" 5 "step 4" 6 "reserved" 7 "Invalid" ;
VAL_ 1189 USM_TirePrsrUnitSetReq 0 "Default Value" 1 "psi" 2 "kpa" 3 "bar" 4 "Reserved" 5 "Reserved" 6 "Reserved" 7 "Invalid" ;
VAL_ 1189 USM_FuelGdRstReq 0 "Default" 1 "Reset Request" 2 "Not used" 3 "Error Indicator" ;
VAL_ 1189 USM_HealthcareIMSHghtSetReq 0 "Default" 1 "Less than 147.5cm" 2 "147.5~152.4cm" 3 "152.5~157.4cm" 4 "157.5~162.4cm" 5 "162.5~167.4cm" 6 "167.5~172.4cm" 7 "172.5~177.4cm" 8 "177.5~182.4cm" 9 "182.5~187.4cm" 10 "187.5~192.4cm" 11 "192.5~197.4cm" 12 "more than 197.5cm" 15 "Invalid" ;
VAL_ 1189 USM_HealthcareIMSSitHghtSetReq 0 "Default" 1 "Tall" 2 "Middle" 3 "Short" 15 "Invalid" ;
VAL_ 1189 USM_HealthcareIMSWghtSetReq 0 "Default" 1 "Under 49.4kg" 2 "49.5~59.4kg" 3 "59.5~69.4kg" 4 "69.5~79.4kg" 5 "79.5~89.4kg" 6 "89.5~99.4kg" 7 "99.5~109.4kg" 8 "109.5~119.4kg" 9 "More than 119.5kg" 15 "Invalid" ;
VAL_ 1189 USM_MdLmpClrSetReq 0 "Default" 1 "color 1" 2 "color 2" 3 "color 3" 4 "color 4" 5 "color 5" 6 "color 6" 7 "color 7" 8 "reserved" 9 "reserved" 10 "reserved" 11 "reserved" 12 "reserved" 13 "reserved" 14 "reserved" 15 "Invalid" ;
VAL_ 1189 USM_HADSetReq 0 "Default" 1 "Function On" 2 "Function Off" 3 "Invalid" ;
VAL_ 1189 USM_RrWiperRevSetReq 0 "Default" 1 "Rear Wiper(reverse) Off" 2 "Rear Wiper(reverse) On" 3 "Invalid" ;
VAL_ 1189 USM_SlifSetReq 0 "Default Value" 1 "Disable" 2 "Enable" 3 "Invalid" ;
VAL_ 1189 USM_StaRstReq 0 "Defualt" 1 "Reset" 2 "Not used" 3 "Error Indicator" ;
VAL_ 1189 USM_RrWpcSetReq 0 "Default" 1 "Off(Disable)" 2 "On(Enable)" 3 "Invalid" ;
VAL_ 1189 USM_WpcSetReq 0 "Default" 1 "Off(Disable)" 2 "On(Enable)" 3 "Invalid" ;
VAL_ 373 AWD_OpModLkSta 0 "LOCK mode is inactive" 1 "LOCK mode is activated" 2 "Not used" 3 "Error indicator" ;
VAL_ 373 AWD_SysOpSta 0 "deactivated" 1 "initialization" 2 "calibration" 3 "normal operation (torque setting)" 4 "temporary failed (return to normal operation in same running cycle, clutch will be opened, reactivation of ESP requested)" 5 "failed" 6 "failed, clutch open" 7 "failed, position unknown" 15 "Signal not available(Error indicator)" ;
VAL_ 149 ENG_EngSpdErrSta 0 "No error/0x1" ;
VAL_ 149 ENG_MafErrSta 0 "No error/0x1" ;
VAL_ 149 ENG_IsgSta 0 "ISG is not operating Normal engine operating without ISG/0x1" ;
VAL_ 149 ENG_OilLvlSta 0 "OIL LEVEL LAMP Off/0x1" ;
VAL_ 149 ENG_GearShftUpDis 0 "Gear Shiftup Display Off/0x1" ;
VAL_ 149 ENG_GearShftDnDis 0 "Gear Shiftdown Display Off/0x1" ;
VAL_ 149 ENG_DsrGearPosDis 0 "No display/0x1" ;
VAL_ 149 ENG_SldFuncSta 0 "Speed limiter function is not active/0x1" ;
VAL_ 149 ENG_IsgBzrReq 0 "Request buzzer OFF/0x1" ;
VAL_ 149 ENG_Isg2Sta 0 "Default/0x1" ;
VAL_ 149 ENG_IgnOnSta 0 "KEY OFF, control unit in self-holding phase/0x1" ;
VAL_ 149 ENG_FuelCutOffSta 0 "Engine not in fuel cut off/0x1" ;
VAL_ 149 ENG_VehSpdLimVal 255 "Error indicator" ;
VAL_ 149 ENG_VehSpdVal 255 "Error indicator" ;
VAL_ 149 ENG_VehSpdHiVal 4095 "Error indicator" ;
VAL_ 149 ENG_LnchCntrlSta 0 "Off state/0x1" ;
