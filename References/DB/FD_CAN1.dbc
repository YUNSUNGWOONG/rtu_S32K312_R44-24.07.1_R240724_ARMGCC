VERSION ""

NS_ :

BS_:

BU_: ECS Dummy CGW MFC SPAS ESC BSD SCC SAS MDPS HUD CLU

BO_ 122 ECS_03_10ms: 32 ECS
 SG_ ECSIVSS_YawGyroSnsrVal : 240|12@1+ (0.1,102.4) [0|0] "deg/s"  Dummy

BO_ 234 MFC_01_10ms: 32 MFC
 SG_ MFC_Crc1Val : 0|12@1+ (1,0) [0|0] ""  Dummy,CGW
 SG_ MFC_AlvCnt1Val : 12|4@1+ (1,0) [0|0] ""  Dummy,CGW
 SG_ LKAS_SysSta : 16|4@1+ (1,0) [0|0] ""  Dummy,CGW
 SG_ LKAS_SysWrnSta : 20|4@1+ (1,0) [0|0] ""  Dummy,CGW
 SG_ LKAS_LHWrnSta : 24|2@1+ (1,0) [0|0] ""  Dummy,CGW
 SG_ LKAS_RHWrnSta : 26|2@1+ (1,0) [0|0] ""  Dummy,CGW
 SG_ LKAS_StrTqReqVal : 29|11@1+ (0.0078125,-8) [0|0] "Nm"  Dummy,CGW
 SG_ LKAS_ActToiSta : 40|2@1+ (1,0) [0|0] ""  Dummy,CGW
 SG_ LKAS_ToiFltSta : 42|2@1+ (1,0) [0|0] ""  Dummy,CGW
 SG_ LKAS_MsgCntVal : 44|4@1+ (1,0) [0|0] ""  Dummy,CGW
 SG_ LKAS_OptUsmSta : 48|3@1+ (1,0) [0|0] ""  Dummy,CGW
 SG_ HBA_SysSta : 64|3@1+ (1,0) [0|0] ""  Dummy,CGW
 SG_ HBA_SysOptSta : 67|2@1+ (1,0) [0|0] ""  Dummy,CGW
 SG_ HBA_IndLmpReq : 69|2@1+ (1,0) [0|0] ""  Dummy,CGW
 SG_ FCWS_SysSta : 72|3@1+ (1,0) [0|0] ""  Dummy,CGW
 SG_ FCWS_OptUsmSta : 75|3@1+ (1,0) [0|0] ""  Dummy,CGW
 SG_ FCWS_CllsnWrnSta : 78|2@1+ (1,0) [0|0] ""  Dummy,CGW
 SG_ FCWS_DbsReq : 80|2@1+ (1,0) [0|0] ""  Dummy,CGW
 SG_ AEBref_FusFuncSta : 82|2@1+ (1,0) [0|0] ""  Dummy,CGW
 SG_ DAA_SysSta : 96|4@1+ (1,0) [0|0] ""  Dummy,CGW
 SG_ DAA_OptUsmSta : 100|3@1+ (1,0) [0|0] ""  Dummy,CGW
 SG_ DAA_WrnMsgSta : 104|3@1+ (1,0) [0|0] ""  Dummy,CGW
 SG_ DAA_WrnSndSta : 107|3@1+ (1,0) [0|0] ""  Dummy,CGW
 SG_ DAA_TimeRstReq : 110|2@1+ (1,0) [0|0] ""  Dummy,CGW

BO_ 389 MFC_02_50ms: 32 MFC
 SG_ MFC_Crc2Val : 0|12@1+ (1,0) [0|0] ""  Dummy
 SG_ MFC_AlvCnt2Val : 12|4@1+ (1,0) [0|0] ""  Dummy
 SG_ SLIF_SysSta : 16|2@1+ (1,0) [0|0] ""  Dummy
 SG_ SLIF_OptUsmSta : 18|2@1+ (1,0) [0|0] ""  Dummy
 SG_ SLIF_NoPassingInfoDis : 20|2@1+ (1,0) [0|0] ""  Dummy
 SG_ SLIF_Spd4CluDis : 24|8@1+ (1,0) [0|0] ""  Dummy
 SG_ SLIF_Spd4NaviDis : 32|8@1+ (1,0) [0|0] ""  Dummy
 SG_ ABSDref_LftLnQualSta : 48|3@1+ (1,0) [0|0] ""  Dummy
 SG_ ABSDref_LftLnDptSta : 51|2@1+ (1,0) [0|0] ""  Dummy
 SG_ ABSDref_LftLnPosVal : 53|11@1- (0.00390625,0) [0|0] ""  Dummy
 SG_ ABSDref_LftLnHdingAnglVal : 64|14@1+ (1.52588E-005,-0.0625) [0|0] ""  Dummy
 SG_ ABSDref_RtLnQualSta : 80|3@1+ (1,0) [0|0] ""  Dummy
 SG_ ABSDref_RtLnDptSta : 83|2@1+ (1,0) [0|0] ""  Dummy
 SG_ ABSDref_RtLnPosVal : 85|11@1- (0.00390625,0) [0|0] "m"  Dummy
 SG_ ABSDref_RtLnHdingAnglVal : 96|14@1+ (1.52588E-005,-0.0625) [0|0] ""  Dummy
 SG_ ABSDref_LftLnCvtrVal : 112|16@1+ (2.32831E-006,-0.076) [0|0] "1/m"  Dummy
 SG_ ABSDref_RtLnCvtrVal : 128|16@1+ (2.32831E-006,-0.076) [0|0] "1/m"  Dummy
 SG_ ABSDref_LnInfoAlvCntVal : 144|4@1+ (1,0) [0|0] ""  Dummy
 SG_ HDAref_SysSta : 149|3@1+ (1,0) [0|0] ""  Dummy
 SG_ HDAref_AutoSetSpdSta : 152|2@1+ (1,0) [0|0] ""  Dummy
 SG_ HDAref_CntrlModSta : 154|3@1+ (1,0) [0|0] ""  Dummy
 SG_ HDAref_InfoDis : 157|3@1+ (1,0) [0|0] ""  Dummy
 SG_ HDAref_AutoSetSpdUpdtSta : 160|2@1+ (1,0) [0|0] ""  Dummy
 SG_ HDAref_LnGdActSta : 162|2@1+ (1,0) [0|0] ""  Dummy
 SG_ HDAref_LnDetSta : 164|2@1+ (1,0) [0|0] ""  Dummy
 SG_ HDAref_AutoSetSpdVal : 166|8@1+ (1,0) [0|0] "km/h"  Dummy

BO_ 314 SPAS_01_20ms: 32 SPAS
 SG_ SPAS_Crc1Val : 0|12@1+ (1,0) [0|0] ""  Dummy,CGW
 SG_ SPAS_AlvCnt1Val : 12|4@1+ (1,0) [0|0] ""  Dummy,CGW
 SG_ SPAS_ModDis : 16|3@1+ (1,0) [0|0] ""  Dummy,CGW
 SG_ SPAS_ModSelSeqDis : 19|3@1+ (1,0) [0|0] ""  Dummy,CGW
 SG_ SPAS_HmiStaDis : 24|8@1+ (1,0) [0|0] ""  Dummy,CGW
 SG_ SPAS_FrLftWrngDis : 32|3@1+ (1,0) [0|0] ""  Dummy,CGW
 SG_ SPAS_FrCtrWrngDis : 35|3@1+ (1,0) [0|0] ""  Dummy,CGW
 SG_ SPAS_FrRtWrngDis : 40|3@1+ (1,0) [0|0] ""  Dummy,CGW
 SG_ SPAS_RrLftWrngDis : 43|3@1+ (1,0) [0|0] ""  Dummy,CGW
 SG_ SPAS_RrCtrWrngDis : 48|3@1+ (1,0) [0|0] ""  Dummy,CGW
 SG_ SPAS_RrRtWrngDis : 51|3@1+ (1,0) [0|0] ""  Dummy,CGW
 SG_ SPAS_BpAlrmReq : 56|5@1+ (1,0) [0|0] ""  Dummy,CGW
 SG_ SPAS_AlrmVlmLvlReq : 61|3@1+ (1,0) [0|0] ""  Dummy,CGW
 SG_ SPAS_AlrmVlmDeratingReq : 64|2@1+ (1,0) [0|0] ""  Dummy,CGW
 SG_ SPAS_FrAlrmReq : 66|2@1+ (1,0) [0|0] ""  Dummy,CGW
 SG_ SPAS_RrWrngAlrmReq : 68|2@1+ (1,0) [0|0] ""  Dummy,CGW
 SG_ SPAS_FrLftWrngAlrmReq : 70|2@1+ (1,0) [0|0] ""  Dummy,CGW
 SG_ SPAS_FrCtrWrngAlrmReq : 72|2@1+ (1,0) [0|0] ""  Dummy,CGW
 SG_ SPAS_FrRtWrngAlrmReq : 74|2@1+ (1,0) [0|0] ""  Dummy,CGW
 SG_ SPAS_RrLftWrngAlrmReq : 76|2@1+ (1,0) [0|0] ""  Dummy,CGW
 SG_ SPAS_RrCtrWrngAlrmReq : 78|2@1+ (1,0) [0|0] ""  Dummy,CGW
 SG_ SPAS_RrRtWrngAlrmReq : 80|2@1+ (1,0) [0|0] ""  Dummy,CGW
 SG_ SPAS_Sta : 82|4@1+ (1,0) [0|0] ""  Dummy,CGW
 SG_ SPAS_TestModSta : 86|2@1+ (1,0) [0|0] ""  Dummy,CGW
 SG_ SPAS_StrAnglReq : 88|16@1- (0.1,0) [0|0] ""  Dummy,CGW

BO_ 96 ESC_01_10ms: 32 ESC
 SG_ ESC_Crc1Val : 0|12@1+ (1,0) [0|0] ""  Dummy,CGW
 SG_ ESC_AlvCnt1Val : 12|4@1+ (1,0) [0|0] ""  Dummy,CGW
 SG_ ABS_ActvSta : 16|2@1+ (1,0) [0|0] ""  Dummy,CGW
 SG_ ABS_DfctvSta : 18|2@1+ (1,0) [0|0] ""  Dummy,CGW
 SG_ ABS_DiagSta : 20|2@1+ (1,0) [0|0] ""  Dummy,CGW
 SG_ EBD_DfctvSta : 22|2@1+ (1,0) [0|0] ""  Dummy,CGW
 SG_ TCS_CtrlSta : 24|2@1+ (1,0) [0|0] ""  Dummy,CGW
 SG_ TCS_DfctvSta : 26|2@1+ (1,0) [0|0] ""  Dummy,CGW
 SG_ TCS_DisableSta : 28|2@1+ (1,0) [0|0] ""  Dummy,CGW
 SG_ TCS_Req : 30|2@1+ (1,0) [0|0] ""  Dummy,CGW
 SG_ TCS_GearShftCharacteristicVal : 32|2@1+ (1,0) [0|0] ""  Dummy,CGW
 SG_ MSR_FuncReq : 34|2@1+ (1,0) [0|0] ""  Dummy,CGW
 SG_ MSR_TqIntrvntnVal : 40|8@1+ (0.390625,0) [0|0] "%"  Dummy,CGW
 SG_ TCS_SlwTqIntrvntnVal : 48|8@1+ (0.390625,0) [0|0] "%"  Dummy,CGW
 SG_ TCS_TqIntrvntnVal : 56|8@1+ (0.390625,0) [0|0] "%"  Dummy,CGW
 SG_ TCS_PreActvSta : 64|2@1+ (1,0) [0|0] ""  Dummy,CGW
 SG_ TCS_ManufacturerVal : 66|2@1+ (1,0) [0|0] ""  Dummy,CGW
 SG_ ESC_CtrlSta : 72|2@1+ (1,0) [0|0] ""  Dummy,CGW
 SG_ ESC_DfctvSta : 74|2@1+ (1,0) [0|0] ""  Dummy,CGW
 SG_ ESC_DisableSta : 76|2@1+ (1,0) [0|0] ""  Dummy,CGW
 SG_ HAC_CtrlSta : 80|2@1+ (1,0) [0|0] ""  Dummy,CGW
 SG_ HAC_DfctvSta : 82|2@1+ (1,0) [0|0] ""  Dummy,CGW
 SG_ HAC_StdbySta : 84|2@1+ (1,0) [0|0] ""  Dummy,CGW
 SG_ DBC_CtrlSta : 88|2@1+ (1,0) [0|0] ""  Dummy,CGW
 SG_ DBC_DfctvSta : 90|2@1+ (1,0) [0|0] ""  Dummy,CGW
 SG_ DBC_StdbySta : 92|2@1+ (1,0) [0|0] ""  Dummy,CGW
 SG_ ESC_VsmCtrlModSta : 96|3@1+ (1,0) [0|0] ""  Dummy,CGW
 SG_ ESC_VsmActvSta : 99|2@1+ (1,0) [0|0] ""  Dummy,CGW
 SG_ ESC_VsmDfctvSta : 101|2@1+ (1,0) [0|0] ""  Dummy,CGW
 SG_ ESC_StrTqReq : 104|12@1+ (0.01,-20.48) [0|0] "Nm"  Dummy,CGW
 SG_ ABS_WrngLmpSta : 120|2@1+ (1,0) [0|0] ""  Dummy,CGW
 SG_ EBD_WrngLmpSta : 122|2@1+ (1,0) [0|0] ""  Dummy,CGW
 SG_ TCS_LmpSta : 124|2@1+ (1,0) [0|0] ""  Dummy,CGW
 SG_ TCS_OffLmpSta : 126|2@1+ (1,0) [0|0] ""  Dummy,CGW
 SG_ ESC_OffTempSta : 128|2@1+ (1,0) [0|0] ""  Dummy,CGW
 SG_ DBC_FuncLmpSta : 130|2@1+ (1,0) [0|0] ""  Dummy,CGW
 SG_ DBC_WrngLmpSta : 132|2@1+ (1,0) [0|0] ""  Dummy,CGW
 SG_ AVH_CluDis : 136|8@1+ (1,0) [0|0] ""  Dummy,CGW
 SG_ AVH_AlrmReq : 144|2@1+ (1,0) [0|0] ""  Dummy,CGW
 SG_ AVH_ActvStaLmpDis : 146|2@1+ (1,0) [0|0] ""  Dummy,CGW
 SG_ AVH_LmpDis : 148|3@1+ (1,0) [0|0] ""  Dummy,CGW
 SG_ AWD_TransmsnTqLimModSta : 152|2@1+ (1,0) [0|0] ""  Dummy,CGW
 SG_ AWD_CltchDtyLimVal : 160|8@1+ (0.390625,0) [0|0] "%"  Dummy,CGW
 SG_ AWD_RrWhlDtyLimReq : 168|2@1+ (1,0) [0|0] ""  Dummy,CGW
 SG_ AWD_FastOpnCrdnShftCltchReq : 170|2@1+ (1,0) [0|0] ""  Dummy,CGW
 SG_ AWD_CrdnShftTqLimVal : 176|16@1+ (1,0) [0|0] "Nm"  Dummy,CGW
 SG_ EPB_ActvReq : 192|2@1+ (1,0) [0|0] ""  Dummy,CGW
 SG_ EPB_StaReq : 194|2@1+ (1,0) [0|0] ""  Dummy,CGW
 SG_ LDM_Sta : 196|2@1+ (1,0) [0|0] ""  Dummy,CGW
 SG_ ECD_ActvSta : 198|2@1+ (1,0) [0|0] ""  Dummy,CGW
 SG_ AVH_Sta : 200|2@1+ (1,0) [0|0] ""  Dummy,CGW
 SG_ ESC_CylPrsrVal : 208|12@1+ (0.1,0) [0|0] "Bar"  Dummy,CGW
 SG_ ESC_CylPrsrSta : 220|2@1+ (1,0) [0|0] ""  Dummy,CGW
 SG_ ESC_CylPrsrDiagSta : 222|2@1+ (1,0) [0|0] ""  Dummy,CGW
 SG_ ESC_CylPrsrFlagSta : 224|2@1+ (1,0) [0|0] ""  Dummy,CGW
 SG_ ESS_Sta : 232|2@1+ (1,0) [0|0] ""  Dummy,CGW
 SG_ ESC_BrkLtActvSta : 234|2@1+ (1,0) [0|0] ""  Dummy,CGW
 SG_ ESC_BrkCtrlSta : 240|2@1+ (1,0) [0|0] ""  Dummy,CGW

BA_DEF_ BO_  "NmAsrMessage" ENUM  "No","Yes";
BA_DEF_ BO_  "GenMsgCycleTime" INT 0 2000;
BA_DEF_ BO_  "GenMsgSendType" ENUM  "Cyclic","NoMsgSendType";
BA_DEF_ BO_  "GenMsgCycleTimeFast" INT 0 500;
BA_DEF_ BO_  "GenMsgDelayTime" INT 0 20;
BA_DEF_ BO_  "GenMsgILSupport" ENUM  "No","Yes";
BA_DEF_ BO_  "GenMsgNrOfRepetition" INT 0 3;
BA_DEF_ BO_  "VFrameFormat" ENUM  "StandardCAN","ExtendedCAN","reserved","reserved","reserved","reserved","reserved","reserved","reserved","reserved","reserved","reserved","reserved","reserved","StandardCAN_FD","ExtendedCAN_FD";
BA_DEF_ SG_  "SignalLongName" STRING ;
BA_DEF_ SG_  "UserSigValidity" ENUM  "B+","ACC","IG","IG1","IG2","IG3","IG1 or IG2","IG1 or IG3","Undef";
BA_DEF_ SG_  "GenSigTimeoutTime" INT 0 7000;
BA_DEF_ SG_  "UsrSigTimeoutValue" STRING ;
BA_DEF_ SG_  "UsrSigPurpose" ENUM  "Undef","FN","DIAG","DEV","NM";
BA_DEF_ SG_  "GenSigStartValue" INT 0 1215752192;
BA_DEF_ SG_  "NetworkRequest" ENUM  "Yes","No";
BA_DEF_ SG_  "NetworkRequestHoldingTime" INT 0 65535;
BA_DEF_ SG_  "Description" STRING ;
BA_DEF_ SG_  "Version" STRING ;
BA_DEF_ SG_  "GenSigEnvVarType" ENUM  "Int","Float","Undef";
BA_DEF_ SG_  "GenSigSendType" ENUM  "OnChangeWithRepetition","OnWriteWithRepetition","NoSigSendType";
BA_DEF_ SG_  "GwSigLatencyTime" INT 0 65536;
BA_DEF_ SG_  "GwSigMissingSourceType" ENUM  "Undef","OldValue","DefaultValue","InitialValue";
BA_DEF_ SG_  "RoutingFactor" INT 1 1215752192;
BA_DEF_ SG_  "RoutingFactorMM" INT 1 1215752192;
BA_DEF_DEF_  "NmAsrMessage" "No";
BA_DEF_DEF_  "GenMsgCycleTime" 200;
BA_DEF_DEF_  "GenMsgSendType" "NoMsgSendType";
BA_DEF_DEF_  "GenMsgCycleTimeFast" 40;
BA_DEF_DEF_  "GenMsgDelayTime" 20;
BA_DEF_DEF_  "GenMsgILSupport" "Yes";
BA_DEF_DEF_  "GenMsgNrOfRepetition" 3;
BA_DEF_DEF_  "VFrameFormat" "StandardCAN";
BA_DEF_DEF_  "SignalLongName" "";
BA_DEF_DEF_  "UserSigValidity" "IG";
BA_DEF_DEF_  "GenSigTimeoutTime" 500;
BA_DEF_DEF_  "UsrSigTimeoutValue" "Undef";
BA_DEF_DEF_  "UsrSigPurpose" "FN";
BA_DEF_DEF_  "GenSigStartValue" 0;
BA_DEF_DEF_  "NetworkRequest" "No";
BA_DEF_DEF_  "NetworkRequestHoldingTime" 5.03070881554866E-316;
BA_DEF_DEF_  "Description" "";
BA_DEF_DEF_  "Version" "";
BA_DEF_DEF_  "GenSigEnvVarType" "Undef";
BA_DEF_DEF_  "GenSigSendType" "NoSigSendType";
BA_DEF_DEF_  "GwSigLatencyTime" 40;
BA_DEF_DEF_  "GwSigMissingSourceType" "Undef";
BA_DEF_DEF_  "RoutingFactor" 1;
BA_DEF_DEF_  "RoutingFactorMM" 1;
BA_ "GenMsgSendType" BO_ 234 0;
BA_ "GenMsgCycleTime" BO_ 234 10;
BA_ "VFrameFormat" BO_ 234 14;
BA_ "GenMsgSendType" BO_ 389 0;
BA_ "GenMsgCycleTime" BO_ 389 50;
BA_ "VFrameFormat" BO_ 389 14;
BA_ "GenMsgSendType" BO_ 314 0;
BA_ "GenMsgCycleTime" BO_ 314 20;
BA_ "VFrameFormat" BO_ 314 14;
BA_ "GenMsgSendType" BO_ 96 0;
BA_ "GenMsgCycleTime" BO_ 96 10;
BA_ "VFrameFormat" BO_ 96 14;
BA_ "Version" SG_ 122 ECSIVSS_YawGyroSnsrVal "1.0";
BA_ "Description" SG_ 122 ECSIVSS_YawGyroSnsrVal "ECU Inertial Sensor - Gyro (Yaw)";
BA_ "UsrSigTimeoutValue" SG_ 122 ECSIVSS_YawGyroSnsrVal "";
BA_ "UserSigValidity" SG_ 122 ECSIVSS_YawGyroSnsrVal 3;
BA_ "SignalLongName" SG_ 122 ECSIVSS_YawGyroSnsrVal "ECSIVSS_ECUYawGyroSensorValue";
BA_ "Version" SG_ 234 MFC_Crc1Val "1.0";
BA_ "GenSigStartValue" SG_ 234 MFC_Crc1Val 4095;
BA_ "UsrSigTimeoutValue" SG_ 234 MFC_Crc1Val "";
BA_ "UserSigValidity" SG_ 234 MFC_Crc1Val 3;
BA_ "SignalLongName" SG_ 234 MFC_Crc1Val "MFC_Crc1Value";
BA_ "Version" SG_ 234 MFC_AlvCnt1Val "1.0";
BA_ "UsrSigTimeoutValue" SG_ 234 MFC_AlvCnt1Val "";
BA_ "UserSigValidity" SG_ 234 MFC_AlvCnt1Val 3;
BA_ "SignalLongName" SG_ 234 MFC_AlvCnt1Val "MFC_AliveCounter1Value";
BA_ "Version" SG_ 234 LKAS_SysSta "1.0";
BA_ "Description" SG_ 234 LKAS_SysSta "A signal indicating the current operational state of the system.";
BA_ "UsrSigTimeoutValue" SG_ 234 LKAS_SysSta "";
BA_ "UserSigValidity" SG_ 234 LKAS_SysSta 3;
BA_ "SignalLongName" SG_ 234 LKAS_SysSta "LKAS_SystemStatus";
BA_ "Version" SG_ 234 LKAS_SysWrnSta "1.0";
BA_ "Description" SG_ 234 LKAS_SysWrnSta "A signal that provides additional information on the operation of the LKAS system for the HMI to display to the driver. This includes additional fault information, reasons for unavailability of the system and additional warnings like the hands-off warnin";
BA_ "UsrSigTimeoutValue" SG_ 234 LKAS_SysWrnSta "";
BA_ "UserSigValidity" SG_ 234 LKAS_SysWrnSta 3;
BA_ "SignalLongName" SG_ 234 LKAS_SysWrnSta "LKAS_SystemWarningStatus";
BA_ "Version" SG_ 234 LKAS_LHWrnSta "1.0";
BA_ "Description" SG_ 234 LKAS_LHWrnSta "This is a simple warning signal that can be used by the HMI to alert the driver to a lane departure on the left hand side of the vehicle.";
BA_ "UsrSigTimeoutValue" SG_ 234 LKAS_LHWrnSta "";
BA_ "UserSigValidity" SG_ 234 LKAS_LHWrnSta 3;
BA_ "SignalLongName" SG_ 234 LKAS_LHWrnSta "LKAS_LeftHandWarningStatus";
BA_ "Version" SG_ 234 LKAS_RHWrnSta "1.0";
BA_ "Description" SG_ 234 LKAS_RHWrnSta "This is a simple warning signal that can be used by the HMI to alert the driver to a lane departure on the right hand side of the vehicle.";
BA_ "UsrSigTimeoutValue" SG_ 234 LKAS_RHWrnSta "";
BA_ "UserSigValidity" SG_ 234 LKAS_RHWrnSta 3;
BA_ "SignalLongName" SG_ 234 LKAS_RHWrnSta "LKAS_RightHandWarningStatus";
BA_ "Version" SG_ 234 LKAS_StrTqReqVal "1.0";
BA_ "Description" SG_ 234 LKAS_StrTqReqVal "This is the driver torque overlay demand value. A negative value represents a torque that would accelerate the steering wheel in a clockwise direction. This signal is always zero whilst the TOI is inactive.";
BA_ "GenSigStartValue" SG_ 234 LKAS_StrTqReqVal 1024;
BA_ "UsrSigTimeoutValue" SG_ 234 LKAS_StrTqReqVal "";
BA_ "UserSigValidity" SG_ 234 LKAS_StrTqReqVal 3;
BA_ "SignalLongName" SG_ 234 LKAS_StrTqReqVal "LKAS_SteeringTorqueRequestValue";
BA_ "Version" SG_ 234 LKAS_ActToiSta "1.0";
BA_ "Description" SG_ 234 LKAS_ActToiSta "This is a flag that is set to 1 when requesting the steering to activate the torque overlay interface (TOI).  This must be done before an attempt is made to request non-zero steering torque overlay.";
BA_ "UsrSigTimeoutValue" SG_ 234 LKAS_ActToiSta "";
BA_ "UserSigValidity" SG_ 234 LKAS_ActToiSta 3;
BA_ "SignalLongName" SG_ 234 LKAS_ActToiSta "LKAS_ActiveTorqueOverlayInterfaceStatus";
BA_ "Version" SG_ 234 LKAS_ToiFltSta "1.0";
BA_ "Description" SG_ 234 LKAS_ToiFltSta "This fault flag is set when a fault in the LKAS system has been detected by the LKAS ECU such that LKAS can no longer function. CAN failures, internal video ECU failures, hard-wired component (e.g. master switch) failures and other system logic failures ";
BA_ "UsrSigTimeoutValue" SG_ 234 LKAS_ToiFltSta "";
BA_ "UserSigValidity" SG_ 234 LKAS_ToiFltSta 3;
BA_ "SignalLongName" SG_ 234 LKAS_ToiFltSta "LKAS_TorqueOverlayInterfaceFaultStatus";
BA_ "Version" SG_ 234 LKAS_MsgCntVal "1.0";
BA_ "Description" SG_ 234 LKAS_MsgCntVal "This is a counter (counts continuously from 0 to its maximum bit count and back to 0 again), that can be used for checking the internal logic of the LKAS controller by the HMI. On power-up, this signal starts counting from 0.";
BA_ "UsrSigTimeoutValue" SG_ 234 LKAS_MsgCntVal "";
BA_ "UserSigValidity" SG_ 234 LKAS_MsgCntVal 3;
BA_ "SignalLongName" SG_ 234 LKAS_MsgCntVal "LKAS_MessageCounterValue";
BA_ "Version" SG_ 234 LKAS_OptUsmSta "1.0";
BA_ "Description" SG_ 234 LKAS_OptUsmSta "LDW/LKA System Option & USM setting Information to Cluster";
BA_ "UsrSigTimeoutValue" SG_ 234 LKAS_OptUsmSta "";
BA_ "UserSigValidity" SG_ 234 LKAS_OptUsmSta 3;
BA_ "SignalLongName" SG_ 234 LKAS_OptUsmSta "LKAS_OptionUsmStatus";
BA_ "Version" SG_ 234 HBA_SysSta "1.0";
BA_ "Description" SG_ 234 HBA_SysSta "This signal indicates the status of High Beam Assist system.";
BA_ "UsrSigTimeoutValue" SG_ 234 HBA_SysSta "";
BA_ "UserSigValidity" SG_ 234 HBA_SysSta 3;
BA_ "SignalLongName" SG_ 234 HBA_SysSta "HBA_SystemStatus";
BA_ "Version" SG_ 234 HBA_SysOptSta "1.0";
BA_ "Description" SG_ 234 HBA_SysOptSta "HBA System Option Information to Lamp Controller";
BA_ "UsrSigTimeoutValue" SG_ 234 HBA_SysOptSta "";
BA_ "UserSigValidity" SG_ 234 HBA_SysOptSta 3;
BA_ "SignalLongName" SG_ 234 HBA_SysOptSta "HBA_SystemOptionStatus";
BA_ "Version" SG_ 234 HBA_IndLmpReq "1.0";
BA_ "Description" SG_ 234 HBA_IndLmpReq "HBA System Indicator Lamp Status";
BA_ "UsrSigTimeoutValue" SG_ 234 HBA_IndLmpReq "";
BA_ "UserSigValidity" SG_ 234 HBA_IndLmpReq 3;
BA_ "SignalLongName" SG_ 234 HBA_IndLmpReq "HBA_IndicatorLampRequest";
BA_ "Version" SG_ 234 FCWS_SysSta "1.0";
BA_ "Description" SG_ 234 FCWS_SysSta "This signal indicates the status of FCW function.";
BA_ "UsrSigTimeoutValue" SG_ 234 FCWS_SysSta "";
BA_ "UserSigValidity" SG_ 234 FCWS_SysSta 3;
BA_ "SignalLongName" SG_ 234 FCWS_SysSta "FCWS_SystemStatus";
BA_ "Version" SG_ 234 FCWS_OptUsmSta "1.0";
BA_ "Description" SG_ 234 FCWS_OptUsmSta "FCW System Option & USM setting Information to Cluster";
BA_ "UsrSigTimeoutValue" SG_ 234 FCWS_OptUsmSta "";
BA_ "UserSigValidity" SG_ 234 FCWS_OptUsmSta 3;
BA_ "SignalLongName" SG_ 234 FCWS_OptUsmSta "FCWS_OptionUsmStatus";
BA_ "Version" SG_ 234 FCWS_CllsnWrnSta "1.0";
BA_ "Description" SG_ 234 FCWS_CllsnWrnSta "This is a warning signal that can be used by HMI for driver to alert collision with preceding vehicle.";
BA_ "UsrSigTimeoutValue" SG_ 234 FCWS_CllsnWrnSta "";
BA_ "UserSigValidity" SG_ 234 FCWS_CllsnWrnSta 3;
BA_ "SignalLongName" SG_ 234 FCWS_CllsnWrnSta "FCWS_CollisionWarningStatus";
BA_ "Version" SG_ 234 FCWS_DbsReq "1.0";
BA_ "Description" SG_ 234 FCWS_DbsReq "This signal request DBS(Brake Support) Operation to ESC";
BA_ "UsrSigTimeoutValue" SG_ 234 FCWS_DbsReq "";
BA_ "UserSigValidity" SG_ 234 FCWS_DbsReq 3;
BA_ "SignalLongName" SG_ 234 FCWS_DbsReq "FCWS_DbsRequest";
BA_ "Version" SG_ 234 AEBref_FusFuncSta "1.0";
BA_ "Description" SG_ 234 AEBref_FusFuncSta "Fusion Function State";
BA_ "UsrSigTimeoutValue" SG_ 234 AEBref_FusFuncSta "";
BA_ "UserSigValidity" SG_ 234 AEBref_FusFuncSta 3;
BA_ "SignalLongName" SG_ 234 AEBref_FusFuncSta "AEBref_FusionFunctionStatus";
BA_ "Version" SG_ 234 DAA_SysSta "1.0";
BA_ "Description" SG_ 234 DAA_SysSta "This signal represents Attention Assist System Status or Attention Level.";
BA_ "UsrSigTimeoutValue" SG_ 234 DAA_SysSta "";
BA_ "UserSigValidity" SG_ 234 DAA_SysSta 3;
BA_ "SignalLongName" SG_ 234 DAA_SysSta "DAA_SystemStatus";
BA_ "Version" SG_ 234 DAA_OptUsmSta "1.0";
BA_ "Description" SG_ 234 DAA_OptUsmSta "0x0:None AA option (Default)/0x1:System OFF/0x2:Late/0x3:Normal/0x4:Early/0x5:Reserved/0x6:Reserved/0x7:Invalid";
BA_ "UsrSigTimeoutValue" SG_ 234 DAA_OptUsmSta "";
BA_ "UserSigValidity" SG_ 234 DAA_OptUsmSta 3;
BA_ "SignalLongName" SG_ 234 DAA_OptUsmSta "DAA_OptionUsmStatus";
BA_ "Version" SG_ 234 DAA_WrnMsgSta "1.0";
BA_ "Description" SG_ 234 DAA_WrnMsgSta "This signal represents Rest recommend warning message popup state.";
BA_ "UsrSigTimeoutValue" SG_ 234 DAA_WrnMsgSta "";
BA_ "UserSigValidity" SG_ 234 DAA_WrnMsgSta 3;
BA_ "SignalLongName" SG_ 234 DAA_WrnMsgSta "DAA_WarningMessageStatus";
BA_ "Version" SG_ 234 DAA_WrnSndSta "1.0";
BA_ "Description" SG_ 234 DAA_WrnSndSta "This signal represents Sound type of Warning";
BA_ "UsrSigTimeoutValue" SG_ 234 DAA_WrnSndSta "";
BA_ "UserSigValidity" SG_ 234 DAA_WrnSndSta 3;
BA_ "SignalLongName" SG_ 234 DAA_WrnSndSta "DAA_WarningSoundStatus";
BA_ "Version" SG_ 234 DAA_TimeRstReq "1.0";
BA_ "UsrSigTimeoutValue" SG_ 234 DAA_TimeRstReq "";
BA_ "UserSigValidity" SG_ 234 DAA_TimeRstReq 3;
BA_ "SignalLongName" SG_ 234 DAA_TimeRstReq "DAA_TimeResetRequest";
BA_ "Version" SG_ 389 MFC_Crc2Val "1.0";
BA_ "GenSigStartValue" SG_ 389 MFC_Crc2Val 4095;
BA_ "UsrSigTimeoutValue" SG_ 389 MFC_Crc2Val "";
BA_ "UserSigValidity" SG_ 389 MFC_Crc2Val 3;
BA_ "SignalLongName" SG_ 389 MFC_Crc2Val "MFC_Crc2Value";
BA_ "Version" SG_ 389 MFC_AlvCnt2Val "1.0";
BA_ "UsrSigTimeoutValue" SG_ 389 MFC_AlvCnt2Val "";
BA_ "UserSigValidity" SG_ 389 MFC_AlvCnt2Val 3;
BA_ "SignalLongName" SG_ 389 MFC_AlvCnt2Val "MFC_AliveCounter2Value";
BA_ "Version" SG_ 389 SLIF_SysSta "1.0";
BA_ "Description" SG_ 389 SLIF_SysSta "Validity of TSR information";
BA_ "UsrSigTimeoutValue" SG_ 389 SLIF_SysSta "";
BA_ "UserSigValidity" SG_ 389 SLIF_SysSta 3;
BA_ "SignalLongName" SG_ 389 SLIF_SysSta "SLIF_SystemStatus";
BA_ "Version" SG_ 389 SLIF_OptUsmSta "1.0";
BA_ "Description" SG_ 389 SLIF_OptUsmSta "SLIF option information";
BA_ "UsrSigTimeoutValue" SG_ 389 SLIF_OptUsmSta "";
BA_ "UserSigValidity" SG_ 389 SLIF_OptUsmSta 3;
BA_ "SignalLongName" SG_ 389 SLIF_OptUsmSta "SLIF_OptionUsmStatus";
BA_ "Version" SG_ 389 SLIF_NoPassingInfoDis "1.0";
BA_ "Description" SG_ 389 SLIF_NoPassingInfoDis "This signal indicates additional information of TSR. For example no passing.";
BA_ "UsrSigTimeoutValue" SG_ 389 SLIF_NoPassingInfoDis "";
BA_ "UserSigValidity" SG_ 389 SLIF_NoPassingInfoDis 3;
BA_ "SignalLongName" SG_ 389 SLIF_NoPassingInfoDis "SLIF_NoPassingInfoDisplay";
BA_ "Version" SG_ 389 SLIF_Spd4CluDis "1.0";
BA_ "Description" SG_ 389 SLIF_Spd4CluDis "Speed Information for cluster display



(0x1~0xFCH: 1*(HEX VALUE) 



[KPH or MPH :Reference signal is  CF_Clu_SPEED_UNIT of CLU])";
BA_ "UsrSigTimeoutValue" SG_ 389 SLIF_Spd4CluDis "";
BA_ "UserSigValidity" SG_ 389 SLIF_Spd4CluDis 3;
BA_ "SignalLongName" SG_ 389 SLIF_Spd4CluDis "SLIF_SpeedForCluDisplay";
BA_ "Version" SG_ 389 SLIF_Spd4NaviDis "1.0";
BA_ "Description" SG_ 389 SLIF_Spd4NaviDis "Speed information for navigation display



(0x1~0xFCH: 1*(HEX VALUE) 



[KPH or MPH :Reference signal is  Navi_SLIF_SpdUnit of Navigation)";
BA_ "UsrSigTimeoutValue" SG_ 389 SLIF_Spd4NaviDis "";
BA_ "UserSigValidity" SG_ 389 SLIF_Spd4NaviDis 3;
BA_ "SignalLongName" SG_ 389 SLIF_Spd4NaviDis "SLIF_SpeedForNaviDisplay";
BA_ "Version" SG_ 389 ABSDref_LftLnQualSta "1.0";
BA_ "Description" SG_ 389 ABSDref_LftLnQualSta "This signal indicates the quality of left line.";
BA_ "UsrSigTimeoutValue" SG_ 389 ABSDref_LftLnQualSta "";
BA_ "UserSigValidity" SG_ 389 ABSDref_LftLnQualSta 3;
BA_ "SignalLongName" SG_ 389 ABSDref_LftLnQualSta "ABSDref_LeftLineQualityStatus";
BA_ "Version" SG_ 389 ABSDref_LftLnDptSta "1.0";
BA_ "Description" SG_ 389 ABSDref_LftLnDptSta "This signal indicates the lane departure status of left line.";
BA_ "UsrSigTimeoutValue" SG_ 389 ABSDref_LftLnDptSta "";
BA_ "UserSigValidity" SG_ 389 ABSDref_LftLnDptSta 3;
BA_ "SignalLongName" SG_ 389 ABSDref_LftLnDptSta "ABSDref_LeftLineDepartureStatus";
BA_ "Version" SG_ 389 ABSDref_LftLnPosVal "1.0";
BA_ "Description" SG_ 389 ABSDref_LftLnPosVal "This signal outputs the position of left line from camera center.";
BA_ "UsrSigTimeoutValue" SG_ 389 ABSDref_LftLnPosVal "";
BA_ "UserSigValidity" SG_ 389 ABSDref_LftLnPosVal 3;
BA_ "SignalLongName" SG_ 389 ABSDref_LftLnPosVal "ABSDref_LeftLinePositionValue";
BA_ "Version" SG_ 389 ABSDref_LftLnHdingAnglVal "1.0";
BA_ "Description" SG_ 389 ABSDref_LftLnHdingAnglVal "This signal outputs the heading angle of left line.";
BA_ "UsrSigTimeoutValue" SG_ 389 ABSDref_LftLnHdingAnglVal "";
BA_ "UserSigValidity" SG_ 389 ABSDref_LftLnHdingAnglVal 3;
BA_ "SignalLongName" SG_ 389 ABSDref_LftLnHdingAnglVal "ABSDref_LeftLineHeadingAngleValue";
BA_ "Version" SG_ 389 ABSDref_RtLnQualSta "1.0";
BA_ "Description" SG_ 389 ABSDref_RtLnQualSta "This signal indicates the quality of right line.";
BA_ "UsrSigTimeoutValue" SG_ 389 ABSDref_RtLnQualSta "";
BA_ "UserSigValidity" SG_ 389 ABSDref_RtLnQualSta 3;
BA_ "SignalLongName" SG_ 389 ABSDref_RtLnQualSta "ABSDref_RightLineQualityStatus";
BA_ "Version" SG_ 389 ABSDref_RtLnDptSta "1.0";
BA_ "Description" SG_ 389 ABSDref_RtLnDptSta "This signal indicates the lane departure status of right line.";
BA_ "UsrSigTimeoutValue" SG_ 389 ABSDref_RtLnDptSta "";
BA_ "UserSigValidity" SG_ 389 ABSDref_RtLnDptSta 3;
BA_ "SignalLongName" SG_ 389 ABSDref_RtLnDptSta "ABSDref_RightLineDepartureStatus";
BA_ "Version" SG_ 389 ABSDref_RtLnPosVal "1.0";
BA_ "Description" SG_ 389 ABSDref_RtLnPosVal "This signal outputs the position of right line from camera center.";
BA_ "UsrSigTimeoutValue" SG_ 389 ABSDref_RtLnPosVal "";
BA_ "UserSigValidity" SG_ 389 ABSDref_RtLnPosVal 3;
BA_ "SignalLongName" SG_ 389 ABSDref_RtLnPosVal "ABSDref_RightLinePositionValue";
BA_ "Version" SG_ 389 ABSDref_RtLnHdingAnglVal "1.0";
BA_ "Description" SG_ 389 ABSDref_RtLnHdingAnglVal "This signal outputs the heading angle of right line.";
BA_ "UsrSigTimeoutValue" SG_ 389 ABSDref_RtLnHdingAnglVal "";
BA_ "UserSigValidity" SG_ 389 ABSDref_RtLnHdingAnglVal 3;
BA_ "SignalLongName" SG_ 389 ABSDref_RtLnHdingAnglVal "ABSDref_RightLineHeadingAngleValue";
BA_ "Version" SG_ 389 ABSDref_LftLnCvtrVal "1.0";
BA_ "Description" SG_ 389 ABSDref_LftLnCvtrVal "This signal outputs the curvature of left line.";
BA_ "UsrSigTimeoutValue" SG_ 389 ABSDref_LftLnCvtrVal "";
BA_ "UserSigValidity" SG_ 389 ABSDref_LftLnCvtrVal 3;
BA_ "SignalLongName" SG_ 389 ABSDref_LftLnCvtrVal "ABSDref_LeftLineCurvatureValue";
BA_ "Version" SG_ 389 ABSDref_RtLnCvtrVal "1.0";
BA_ "Description" SG_ 389 ABSDref_RtLnCvtrVal "This signal outputs the curvature of right line.";
BA_ "UsrSigTimeoutValue" SG_ 389 ABSDref_RtLnCvtrVal "";
BA_ "UserSigValidity" SG_ 389 ABSDref_RtLnCvtrVal 3;
BA_ "SignalLongName" SG_ 389 ABSDref_RtLnCvtrVal "ABSDref_RightLineCurvatureValue";
BA_ "Version" SG_ 389 ABSDref_LnInfoAlvCntVal "1.0";
BA_ "Description" SG_ 389 ABSDref_LnInfoAlvCntVal "This indicates the alive status of lane information message.";
BA_ "UsrSigTimeoutValue" SG_ 389 ABSDref_LnInfoAlvCntVal "";
BA_ "UserSigValidity" SG_ 389 ABSDref_LnInfoAlvCntVal 3;
BA_ "SignalLongName" SG_ 389 ABSDref_LnInfoAlvCntVal "ABSDref_LaneInfoAliveCounterValue";
BA_ "Version" SG_ 389 HDAref_SysSta "1.0";
BA_ "Description" SG_ 389 HDAref_SysSta "This is HDA system status needed for the cluster USM display.";
BA_ "UsrSigTimeoutValue" SG_ 389 HDAref_SysSta "";
BA_ "UserSigValidity" SG_ 389 HDAref_SysSta 3;
BA_ "SignalLongName" SG_ 389 HDAref_SysSta "HDAref_SystemStatus";
BA_ "Version" SG_ 389 HDAref_AutoSetSpdSta "1.0";
BA_ "Description" SG_ 389 HDAref_AutoSetSpdSta "This is information if Auto Set Speed Control is enabled or not";
BA_ "UsrSigTimeoutValue" SG_ 389 HDAref_AutoSetSpdSta "";
BA_ "UserSigValidity" SG_ 389 HDAref_AutoSetSpdSta 3;
BA_ "SignalLongName" SG_ 389 HDAref_AutoSetSpdSta "HDAref_AutoSetSpeedStatus";
BA_ "Version" SG_ 389 HDAref_CntrlModSta "1.0";
BA_ "Description" SG_ 389 HDAref_CntrlModSta "This is HDA Control Mode needed for longitudinal/lateral control and cluster display.";
BA_ "UsrSigTimeoutValue" SG_ 389 HDAref_CntrlModSta "";
BA_ "UserSigValidity" SG_ 389 HDAref_CntrlModSta 3;
BA_ "SignalLongName" SG_ 389 HDAref_CntrlModSta "HDAref_ControlModeStatus";
BA_ "Version" SG_ 389 HDAref_InfoDis "1.0";
BA_ "Description" SG_ 389 HDAref_InfoDis "This is HDA information display needed for the cluster pop-up display.";
BA_ "UsrSigTimeoutValue" SG_ 389 HDAref_InfoDis "";
BA_ "UserSigValidity" SG_ 389 HDAref_InfoDis 3;
BA_ "SignalLongName" SG_ 389 HDAref_InfoDis "HDAref_InformationDisplay";
BA_ "Version" SG_ 389 HDAref_AutoSetSpdUpdtSta "1.0";
BA_ "Description" SG_ 389 HDAref_AutoSetSpdUpdtSta "This is information if Auto Set Speed Control is updated or not.";
BA_ "UsrSigTimeoutValue" SG_ 389 HDAref_AutoSetSpdUpdtSta "";
BA_ "UserSigValidity" SG_ 389 HDAref_AutoSetSpdUpdtSta 3;
BA_ "SignalLongName" SG_ 389 HDAref_AutoSetSpdUpdtSta "HDAref_AutoSetSpeedUpdateStatus";
BA_ "Version" SG_ 389 HDAref_LnGdActSta "1.0";
BA_ "Description" SG_ 389 HDAref_LnGdActSta "A signal indicating the HDA Lane Guidance Active State.";
BA_ "UsrSigTimeoutValue" SG_ 389 HDAref_LnGdActSta "";
BA_ "UserSigValidity" SG_ 389 HDAref_LnGdActSta 3;
BA_ "SignalLongName" SG_ 389 HDAref_LnGdActSta "HDAref_LaneGuidanceActiveStatus";
BA_ "Version" SG_ 389 HDAref_LnDetSta "1.0";
BA_ "Description" SG_ 389 HDAref_LnDetSta "A signal indicating the HDA Lane Detection Information.";
BA_ "UsrSigTimeoutValue" SG_ 389 HDAref_LnDetSta "";
BA_ "UserSigValidity" SG_ 389 HDAref_LnDetSta 3;
BA_ "SignalLongName" SG_ 389 HDAref_LnDetSta "HDAref_LaneDetectStatus";
BA_ "Version" SG_ 389 HDAref_AutoSetSpdVal "1.0";
BA_ "Description" SG_ 389 HDAref_AutoSetSpdVal "This is auto set speed value for SCC controller in Auto Set Spped Mode.";
BA_ "UsrSigTimeoutValue" SG_ 389 HDAref_AutoSetSpdVal "";
BA_ "UserSigValidity" SG_ 389 HDAref_AutoSetSpdVal 3;
BA_ "SignalLongName" SG_ 389 HDAref_AutoSetSpdVal "HDAref_AutoSetSpeedValue";
BA_ "Version" SG_ 314 SPAS_Crc1Val "1";
BA_ "Description" SG_ 314 SPAS_Crc1Val "This value is used to check the SPAS_01_20ms message is transmitted correctly.



(PH) = Byte (Byte0+Byte1+Byte2+Byte3+Byte4+...+Byte23)";
BA_ "GenSigStartValue" SG_ 314 SPAS_Crc1Val 4095;
BA_ "UsrSigTimeoutValue" SG_ 314 SPAS_Crc1Val "";
BA_ "UserSigValidity" SG_ 314 SPAS_Crc1Val 3;
BA_ "SignalLongName" SG_ 314 SPAS_Crc1Val "SPAS_Crc1Value";
BA_ "Version" SG_ 314 SPAS_AlvCnt1Val "1";
BA_ "Description" SG_ 314 SPAS_AlvCnt1Val "This value is used to check the SPAS_01_20ms message is transmitted regularly and none have been lost.";
BA_ "UsrSigTimeoutValue" SG_ 314 SPAS_AlvCnt1Val "";
BA_ "UserSigValidity" SG_ 314 SPAS_AlvCnt1Val 3;
BA_ "SignalLongName" SG_ 314 SPAS_AlvCnt1Val "SPAS_AliveCounter1Value";
BA_ "Version" SG_ 314 SPAS_ModDis "1";
BA_ "Description" SG_ 314 SPAS_ModDis "This signal is used for SPAS/PAS display ON/OFF.

The value is sended to be based on the SPAS/PAS internal activation status, not the only switch status.

This means that the signal value should be OFF in case of SPAS/PAS internal activation status OFF, ";
BA_ "UsrSigTimeoutValue" SG_ 314 SPAS_ModDis "";
BA_ "UserSigValidity" SG_ 314 SPAS_ModDis 3;
BA_ "SignalLongName" SG_ 314 SPAS_ModDis "SPAS_ModeDisplay";
BA_ "Version" SG_ 314 SPAS_ModSelSeqDis "1";
BA_ "Description" SG_ 314 SPAS_ModSelSeqDis "The signal is used for SPAS mode selection tap of Cluster.";
BA_ "UsrSigTimeoutValue" SG_ 314 SPAS_ModSelSeqDis "";
BA_ "UserSigValidity" SG_ 314 SPAS_ModSelSeqDis 3;
BA_ "SignalLongName" SG_ 314 SPAS_ModSelSeqDis "SPAS_ModeSelectionSequenceDisplay";
BA_ "Version" SG_ 314 SPAS_HmiStaDis "1";
BA_ "Description" SG_ 314 SPAS_HmiStaDis "This signal is used for SPAS HMI indicator (display).";
BA_ "UsrSigTimeoutValue" SG_ 314 SPAS_HmiStaDis "";
BA_ "UserSigValidity" SG_ 314 SPAS_HmiStaDis 3;
BA_ "SignalLongName" SG_ 314 SPAS_HmiStaDis "SPAS_HmiStateDisplay";
BA_ "Version" SG_ 314 SPAS_FrLftWrngDis "1";
BA_ "Description" SG_ 314 SPAS_FrLftWrngDis "This signal is used for SPAS sensors warning indicator(display).";
BA_ "UsrSigTimeoutValue" SG_ 314 SPAS_FrLftWrngDis "";
BA_ "UserSigValidity" SG_ 314 SPAS_FrLftWrngDis 3;
BA_ "SignalLongName" SG_ 314 SPAS_FrLftWrngDis "SPAS_FrontLeftWarningDisplay";
BA_ "Version" SG_ 314 SPAS_FrCtrWrngDis "1";
BA_ "Description" SG_ 314 SPAS_FrCtrWrngDis "This signal is used for SPAS sensors warning indicator(display).

SPAS_FrCtrWrngDis signal is to indicate the closest obstacle warning among front inner left & right sensors.";
BA_ "UsrSigTimeoutValue" SG_ 314 SPAS_FrCtrWrngDis "";
BA_ "UserSigValidity" SG_ 314 SPAS_FrCtrWrngDis 3;
BA_ "SignalLongName" SG_ 314 SPAS_FrCtrWrngDis "SPAS_FrontCenterWarningDisplay";
BA_ "Version" SG_ 314 SPAS_FrRtWrngDis "1";
BA_ "Description" SG_ 314 SPAS_FrRtWrngDis "This signal is used for SPAS sensors warning indicator(display).";
BA_ "UsrSigTimeoutValue" SG_ 314 SPAS_FrRtWrngDis "";
BA_ "UserSigValidity" SG_ 314 SPAS_FrRtWrngDis 3;
BA_ "SignalLongName" SG_ 314 SPAS_FrRtWrngDis "SPAS_FrontRightWarningDisplay";
BA_ "Version" SG_ 314 SPAS_RrLftWrngDis "1";
BA_ "Description" SG_ 314 SPAS_RrLftWrngDis "This signal is used for SPAS sensors warning indicator(display).";
BA_ "UsrSigTimeoutValue" SG_ 314 SPAS_RrLftWrngDis "";
BA_ "UserSigValidity" SG_ 314 SPAS_RrLftWrngDis 3;
BA_ "SignalLongName" SG_ 314 SPAS_RrLftWrngDis "SPAS_RearLeftWarningDisplay";
BA_ "Version" SG_ 314 SPAS_RrCtrWrngDis "1";
BA_ "Description" SG_ 314 SPAS_RrCtrWrngDis "This signal is used for SPAS sensors warning indicator(display).

SPAS_RrCtrWrngDis signal is to indicate the closest obstacle warning among rear inner left & right sensors.";
BA_ "UsrSigTimeoutValue" SG_ 314 SPAS_RrCtrWrngDis "";
BA_ "UserSigValidity" SG_ 314 SPAS_RrCtrWrngDis 3;
BA_ "SignalLongName" SG_ 314 SPAS_RrCtrWrngDis "SPAS_RearCenterWarningDisplay";
BA_ "Version" SG_ 314 SPAS_RrRtWrngDis "1";
BA_ "Description" SG_ 314 SPAS_RrRtWrngDis "This signal is used for SPAS sensors warning indicator(display).";
BA_ "UsrSigTimeoutValue" SG_ 314 SPAS_RrRtWrngDis "";
BA_ "UserSigValidity" SG_ 314 SPAS_RrRtWrngDis 3;
BA_ "SignalLongName" SG_ 314 SPAS_RrRtWrngDis "SPAS_RearRightWarningDisplay";
BA_ "Version" SG_ 314 SPAS_BpAlrmReq "1";
BA_ "Description" SG_ 314 SPAS_BpAlrmReq "This signal is used for Beep warning alarm of SPAS/PAS";
BA_ "UsrSigTimeoutValue" SG_ 314 SPAS_BpAlrmReq "";
BA_ "UserSigValidity" SG_ 314 SPAS_BpAlrmReq 3;
BA_ "SignalLongName" SG_ 314 SPAS_BpAlrmReq "SPAS_BeepAlarmRequest";
BA_ "Version" SG_ 314 SPAS_AlrmVlmLvlReq "1";
BA_ "Description" SG_ 314 SPAS_AlrmVlmLvlReq "This signal is used for adjusting PAS Volume";
BA_ "UsrSigTimeoutValue" SG_ 314 SPAS_AlrmVlmLvlReq "";
BA_ "UserSigValidity" SG_ 314 SPAS_AlrmVlmLvlReq 3;
BA_ "SignalLongName" SG_ 314 SPAS_AlrmVlmLvlReq "SPAS_AlarmVolumeLevelRequest";
BA_ "Version" SG_ 314 SPAS_AlrmVlmDeratingReq "1";
BA_ "Description" SG_ 314 SPAS_AlrmVlmDeratingReq "This signal indicates function of Audio volume down during SPAS / PAS Warning Alarm.";
BA_ "UsrSigTimeoutValue" SG_ 314 SPAS_AlrmVlmDeratingReq "";
BA_ "UserSigValidity" SG_ 314 SPAS_AlrmVlmDeratingReq 3;
BA_ "SignalLongName" SG_ 314 SPAS_AlrmVlmDeratingReq "SPAS_AlarmVolumeDeratingRequest";
BA_ "Version" SG_ 314 SPAS_FrAlrmReq "1";
BA_ "Description" SG_ 314 SPAS_FrAlrmReq "This signal is used for front warning alarm of SPAS/PAS.";
BA_ "UsrSigTimeoutValue" SG_ 314 SPAS_FrAlrmReq "";
BA_ "UserSigValidity" SG_ 314 SPAS_FrAlrmReq 3;
BA_ "SignalLongName" SG_ 314 SPAS_FrAlrmReq "SPAS_FrontWarningAlarmRequest";
BA_ "Version" SG_ 314 SPAS_RrWrngAlrmReq "1";
BA_ "Description" SG_ 314 SPAS_RrWrngAlrmReq "This signal is used for rear warning alarm of SPAS/PAS.";
BA_ "UsrSigTimeoutValue" SG_ 314 SPAS_RrWrngAlrmReq "";
BA_ "UserSigValidity" SG_ 314 SPAS_RrWrngAlrmReq 3;
BA_ "SignalLongName" SG_ 314 SPAS_RrWrngAlrmReq "SPAS_RearWarningAlarmRequest";
BA_ "Version" SG_ 314 SPAS_FrLftWrngAlrmReq "1";
BA_ "Description" SG_ 314 SPAS_FrLftWrngAlrmReq "This signal is used for front left warning alarm of SPAS/PAS for EXP AMP";
BA_ "UsrSigTimeoutValue" SG_ 314 SPAS_FrLftWrngAlrmReq "";
BA_ "UserSigValidity" SG_ 314 SPAS_FrLftWrngAlrmReq 3;
BA_ "SignalLongName" SG_ 314 SPAS_FrLftWrngAlrmReq "SPAS_FrontLeftWarningAlarmRequest";
BA_ "Version" SG_ 314 SPAS_FrCtrWrngAlrmReq "1";
BA_ "Description" SG_ 314 SPAS_FrCtrWrngAlrmReq "This signal is used for front center warning alarm of SPAS/PAS for EXP AMP";
BA_ "UsrSigTimeoutValue" SG_ 314 SPAS_FrCtrWrngAlrmReq "";
BA_ "UserSigValidity" SG_ 314 SPAS_FrCtrWrngAlrmReq 3;
BA_ "SignalLongName" SG_ 314 SPAS_FrCtrWrngAlrmReq "SPAS_FrontCenterWarningAlarmRequest";
BA_ "Version" SG_ 314 SPAS_FrRtWrngAlrmReq "1";
BA_ "Description" SG_ 314 SPAS_FrRtWrngAlrmReq "This signal is used for front right warning alarm of SPAS/PAS for EXP AMP";
BA_ "UsrSigTimeoutValue" SG_ 314 SPAS_FrRtWrngAlrmReq "";
BA_ "UserSigValidity" SG_ 314 SPAS_FrRtWrngAlrmReq 3;
BA_ "SignalLongName" SG_ 314 SPAS_FrRtWrngAlrmReq "SPAS_FrontRightWarningAlarmRequest";
BA_ "Version" SG_ 314 SPAS_RrLftWrngAlrmReq "1";
BA_ "Description" SG_ 314 SPAS_RrLftWrngAlrmReq "This signal is used for rear left warning alarm of SPAS/PAS for EXP AMP";
BA_ "UsrSigTimeoutValue" SG_ 314 SPAS_RrLftWrngAlrmReq "";
BA_ "UserSigValidity" SG_ 314 SPAS_RrLftWrngAlrmReq 3;
BA_ "SignalLongName" SG_ 314 SPAS_RrLftWrngAlrmReq "SPAS_RearLeftWarningAlarmRequest";
BA_ "Version" SG_ 314 SPAS_RrCtrWrngAlrmReq "1";
BA_ "Description" SG_ 314 SPAS_RrCtrWrngAlrmReq "This signal is used for rear center warning alarm of SPAS/PAS for EXP AMP";
BA_ "UsrSigTimeoutValue" SG_ 314 SPAS_RrCtrWrngAlrmReq "";
BA_ "UserSigValidity" SG_ 314 SPAS_RrCtrWrngAlrmReq 3;
BA_ "SignalLongName" SG_ 314 SPAS_RrCtrWrngAlrmReq "SPAS_RearCenterWarningAlarmRequest";
BA_ "Version" SG_ 314 SPAS_RrRtWrngAlrmReq "1";
BA_ "Description" SG_ 314 SPAS_RrRtWrngAlrmReq "This signal is used for rear right warning alarm of SPAS/PAS for EXP AMP";
BA_ "UsrSigTimeoutValue" SG_ 314 SPAS_RrRtWrngAlrmReq "";
BA_ "UserSigValidity" SG_ 314 SPAS_RrRtWrngAlrmReq 3;
BA_ "SignalLongName" SG_ 314 SPAS_RrRtWrngAlrmReq "SPAS_RearRightWarningAlarmRequest";
BA_ "Version" SG_ 314 SPAS_Sta "1";
BA_ "Description" SG_ 314 SPAS_Sta "This signal indicates the status of the SPAS steering activation machine. 



<Fuction>

0H : Reserved

1H : Initial value after ignition

2H : Request of a new start status after an abort of the MDPS

3H : StandBy status of the SPAS function. No error a";
BA_ "GenSigStartValue" SG_ 314 SPAS_Sta 1;
BA_ "UsrSigTimeoutValue" SG_ 314 SPAS_Sta "";
BA_ "UserSigValidity" SG_ 314 SPAS_Sta 3;
BA_ "SignalLongName" SG_ 314 SPAS_Sta "SPAS_Status";
BA_ "Version" SG_ 314 SPAS_TestModSta "1";
BA_ "Description" SG_ 314 SPAS_TestModSta "This signal indicates the status of the “ MDPS Activation control for testing the SPAS system”";
BA_ "UsrSigTimeoutValue" SG_ 314 SPAS_TestModSta "";
BA_ "UserSigValidity" SG_ 314 SPAS_TestModSta 3;
BA_ "SignalLongName" SG_ 314 SPAS_TestModSta "SPAS_TestModeStatus";
BA_ "Version" SG_ 314 SPAS_StrAnglReq "1";
BA_ "Description" SG_ 314 SPAS_StrAnglReq "This value is used to set a steering wheel position target for the SPAS function. The signal is signed 16bits.



Conversion: (PH) = (HEX) x 0.1 (for 0< HEX < 32767) OR

(HEX - 65536) x 0.1 (for HEX > 32767)";
BA_ "UsrSigTimeoutValue" SG_ 314 SPAS_StrAnglReq "";
BA_ "UserSigValidity" SG_ 314 SPAS_StrAnglReq 3;
BA_ "SignalLongName" SG_ 314 SPAS_StrAnglReq "SPAS_SteeringAngleRequest";
BA_ "Version" SG_ 96 ESC_Crc1Val "1.0";
BA_ "GenSigStartValue" SG_ 96 ESC_Crc1Val 4095;
BA_ "UsrSigTimeoutValue" SG_ 96 ESC_Crc1Val "";
BA_ "UserSigValidity" SG_ 96 ESC_Crc1Val 3;
BA_ "SignalLongName" SG_ 96 ESC_Crc1Val "ESC_Crc1Value";
BA_ "Version" SG_ 96 ESC_AlvCnt1Val "1.0";
BA_ "UsrSigTimeoutValue" SG_ 96 ESC_AlvCnt1Val "";
BA_ "UserSigValidity" SG_ 96 ESC_AlvCnt1Val 3;
BA_ "SignalLongName" SG_ 96 ESC_AlvCnt1Val "ESC_AliveCounter1Value";
BA_ "Version" SG_ 96 ABS_ActvSta "1.0";
BA_ "Description" SG_ 96 ABS_ActvSta "ABS controller provides an information on ABS Active signal.



ABS_ACT signal is 1 during the ABS control and if it is not ABS control phase this value is 0.";
BA_ "UsrSigTimeoutValue" SG_ 96 ABS_ActvSta "";
BA_ "UserSigValidity" SG_ 96 ABS_ActvSta 3;
BA_ "SignalLongName" SG_ 96 ABS_ActvSta "ABS_ActiveStatus";
BA_ "Version" SG_ 96 ABS_DfctvSta "1.0";
BA_ "Description" SG_ 96 ABS_DfctvSta "Information regarding the ABS 'defective' indication.";
BA_ "UsrSigTimeoutValue" SG_ 96 ABS_DfctvSta "";
BA_ "UserSigValidity" SG_ 96 ABS_DfctvSta 3;
BA_ "SignalLongName" SG_ 96 ABS_DfctvSta "ABS_DefectiveStatus";
BA_ "Version" SG_ 96 ABS_DiagSta "1.0";
BA_ "Description" SG_ 96 ABS_DiagSta "Information regarding the ABS/TCS/ESC “diagnostic mode” indication.";
BA_ "UsrSigTimeoutValue" SG_ 96 ABS_DiagSta "";
BA_ "UserSigValidity" SG_ 96 ABS_DiagSta 3;
BA_ "SignalLongName" SG_ 96 ABS_DiagSta "ABS_DiagnosticStatus";
BA_ "Version" SG_ 96 EBD_DfctvSta "1.0";
BA_ "Description" SG_ 96 EBD_DfctvSta "Information regarding the EBD  'defective' indication.";
BA_ "UsrSigTimeoutValue" SG_ 96 EBD_DfctvSta "";
BA_ "UserSigValidity" SG_ 96 EBD_DfctvSta 3;
BA_ "SignalLongName" SG_ 96 EBD_DfctvSta "EBD_DefectiveStatus";
BA_ "Version" SG_ 96 TCS_CtrlSta "1.0";
BA_ "Description" SG_ 96 TCS_CtrlSta "Information regarding the TCS 'control' indication.



Conversion :

1. TCS_DEF(0)/TCS_PAS(0)/TCS_CTL(0) -> TCS lamp OFF

2. TCS_DEF(0)/TCS_PAS(0)/TCS_CTL(1) -> TCS Active

3. TCS_DEF(0)/TCS_PAS(1)/TCS_CTL(x) -> TCS is disabled by user

4. TCS_DEF(1)/TCS";
BA_ "UsrSigTimeoutValue" SG_ 96 TCS_CtrlSta "";
BA_ "UserSigValidity" SG_ 96 TCS_CtrlSta 3;
BA_ "SignalLongName" SG_ 96 TCS_CtrlSta "TCS_ControlStatus";
BA_ "Version" SG_ 96 TCS_DfctvSta "1.0";
BA_ "Description" SG_ 96 TCS_DfctvSta "Information regarding the TCS 'defective' indication.



Conversion :

1. TCS_DEF(0)/TCS_PAS(0)/TCS_CTL(0) -> TCS lamp OFF

2. TCS_DEF(0)/TCS_PAS(0)/TCS_CTL(1) -> TCS Active

3. TCS_DEF(0)/TCS_PAS(1)/TCS_CTL(x) -> TCS is disabled by user

4. TCS_DEF(1)/T";
BA_ "UsrSigTimeoutValue" SG_ 96 TCS_DfctvSta "";
BA_ "UserSigValidity" SG_ 96 TCS_DfctvSta 3;
BA_ "SignalLongName" SG_ 96 TCS_DfctvSta "TCS_DefectiveStatus";
BA_ "Version" SG_ 96 TCS_DisableSta "1.0";
BA_ "Description" SG_ 96 TCS_DisableSta "Information regarding the TCS 'enable/disable' indication.



Conversion :

1. TCS_DEF(0)/TCS_PAS(0)/TCS_CTL(0) -> TCS lamp OFF

2. TCS_DEF(0)/TCS_PAS(0)/TCS_CTL(1) -> TCS Active

3. TCS_DEF(0)/TCS_PAS(1)/TCS_CTL(x) -> TCS is disabled by user

4. TCS_DEF";
BA_ "UsrSigTimeoutValue" SG_ 96 TCS_DisableSta "";
BA_ "UserSigValidity" SG_ 96 TCS_DisableSta 3;
BA_ "SignalLongName" SG_ 96 TCS_DisableSta "TCS_DisabledStatus";
BA_ "Version" SG_ 96 TCS_Req "1.0";
BA_ "Description" SG_ 96 TCS_Req "Request for an indicated desired engine torque, the combination of signals calls, on the one hand, for a desire for charge reduction (TCS or ESC function), and, on the other hand, for a desire for charge increase (MSR function).



TCS_REQ : Identifies a";
BA_ "UsrSigTimeoutValue" SG_ 96 TCS_Req "";
BA_ "UserSigValidity" SG_ 96 TCS_Req 3;
BA_ "SignalLongName" SG_ 96 TCS_Req "TCS_Request";
BA_ "Version" SG_ 96 TCS_GearShftCharacteristicVal "1.0";
BA_ "Description" SG_ 96 TCS_GearShftCharacteristicVal "Interface signal between TCS/ESC and TCU influencing the TCU switching characteristics in the case of an TCS control system.";
BA_ "UsrSigTimeoutValue" SG_ 96 TCS_GearShftCharacteristicVal "";
BA_ "UserSigValidity" SG_ 96 TCS_GearShftCharacteristicVal 3;
BA_ "SignalLongName" SG_ 96 TCS_GearShftCharacteristicVal "TCS_GearShiftCharacteristicValue";
BA_ "Version" SG_ 96 MSR_FuncReq "1.0";
BA_ "Description" SG_ 96 MSR_FuncReq "Request for an indicated desired engine torque, the combination of signals calls, on the one hand, for a desire for charge reduction (TCS or ESC function), and, on the other hand, for a desire for charge increase (MSR function).



MSR_C_REQ : Identifies";
BA_ "UsrSigTimeoutValue" SG_ 96 MSR_FuncReq "";
BA_ "UserSigValidity" SG_ 96 MSR_FuncReq 3;
BA_ "SignalLongName" SG_ 96 MSR_FuncReq "MSR_FunctionRequest";
BA_ "Version" SG_ 96 MSR_TqIntrvntnVal "1.0";
BA_ "Description" SG_ 96 MSR_TqIntrvntnVal "Request for an indicated desired engine torque, the combination of signals calls, on the one hand, for a desire for charge reduction (TCS or ESC function), and, on the other hand, for a desire for charge increase (MSR function).



TQI_MSR : The torque i";
BA_ "UsrSigTimeoutValue" SG_ 96 MSR_TqIntrvntnVal "";
BA_ "UserSigValidity" SG_ 96 MSR_TqIntrvntnVal 3;
BA_ "SignalLongName" SG_ 96 MSR_TqIntrvntnVal "MSR_TorqueInterventionValue";
BA_ "Version" SG_ 96 TCS_SlwTqIntrvntnVal "1.0";
BA_ "Description" SG_ 96 TCS_SlwTqIntrvntnVal "Request for an indicated desired engine torque, the combination of signals calls, on the one hand, for a desire for charge reduction (TCS or ESC function), and, on the other hand, for a desire for charge increase (MSR function).



TQI_SLW_TCS : The driv";
BA_ "GenSigStartValue" SG_ 96 TCS_SlwTqIntrvntnVal 255;
BA_ "UsrSigTimeoutValue" SG_ 96 TCS_SlwTqIntrvntnVal "";
BA_ "UserSigValidity" SG_ 96 TCS_SlwTqIntrvntnVal 3;
BA_ "SignalLongName" SG_ 96 TCS_SlwTqIntrvntnVal "TCS_SlowTorqueInterventionValue";
BA_ "Version" SG_ 96 TCS_TqIntrvntnVal "1.0";
BA_ "Description" SG_ 96 TCS_TqIntrvntnVal "Request for an indicated desired engine torque, the combination of signals calls, on the one hand, for a desire for charge reduction (TCS or ESC function), and, on the other hand, for a desire for charge increase (MSR function).



TQI_TCS : Torque reduc";
BA_ "GenSigStartValue" SG_ 96 TCS_TqIntrvntnVal 255;
BA_ "UsrSigTimeoutValue" SG_ 96 TCS_TqIntrvntnVal "";
BA_ "UserSigValidity" SG_ 96 TCS_TqIntrvntnVal 3;
BA_ "SignalLongName" SG_ 96 TCS_TqIntrvntnVal "TCS_TorqueInterventionValue";
BA_ "Version" SG_ 96 TCS_PreActvSta "1.0";
BA_ "Description" SG_ 96 TCS_PreActvSta "Pre TCS Control Signal";
BA_ "UsrSigTimeoutValue" SG_ 96 TCS_PreActvSta "";
BA_ "UserSigValidity" SG_ 96 TCS_PreActvSta 3;
BA_ "SignalLongName" SG_ 96 TCS_PreActvSta "TCS_PreActiveStatus";
BA_ "Version" SG_ 96 TCS_ManufacturerVal "1.0";
BA_ "Description" SG_ 96 TCS_ManufacturerVal "TCS manufacturer information to distinguish between a system which requires only TQI_TCS function and a system which requires both TQI_TCS and TQI_SLW_TCS functions. This signal indicates that TCS requests torque reduction using only TQI_TCS or using bot";
BA_ "UsrSigTimeoutValue" SG_ 96 TCS_ManufacturerVal "";
BA_ "UserSigValidity" SG_ 96 TCS_ManufacturerVal 3;
BA_ "SignalLongName" SG_ 96 TCS_ManufacturerVal "TCS_ManufacturerInformationValue";
BA_ "Version" SG_ 96 ESC_CtrlSta "1.0";
BA_ "Description" SG_ 96 ESC_CtrlSta "Information regarding the ESC 'control' indication.



Conversion:

1. ESP_DEF(0)/ESP_PAS(0)/ESP_CTL(0) -> ESC lamp OFF

2. ESP_DEF(0)/ESP_PAS(0)/ESP_CTL(1) -> ESC active

3. ESP_DEF(0)/ESP_PAS(1)/ESP_CTL(x) -> ESC disabled by user (SW off)

4. ESP_DEF(1";
BA_ "UsrSigTimeoutValue" SG_ 96 ESC_CtrlSta "";
BA_ "UserSigValidity" SG_ 96 ESC_CtrlSta 3;
BA_ "SignalLongName" SG_ 96 ESC_CtrlSta "ESC_ControlStatus";
BA_ "Version" SG_ 96 ESC_DfctvSta "1.0";
BA_ "Description" SG_ 96 ESC_DfctvSta "Information regarding the ESC 'defective' indication.



Conversion:

1. ESP_DEF(0)/ESP_PAS(0)/ESP_CTL(0) -> ESC lamp OFF

2. ESP_DEF(0)/ESP_PAS(0)/ESP_CTL(1) -> ESC active

3. ESP_DEF(0)/ESP_PAS(1)/ESP_CTL(x) -> ESC disabled by user (SW off)

4. ESP_DEF";
BA_ "UsrSigTimeoutValue" SG_ 96 ESC_DfctvSta "";
BA_ "UserSigValidity" SG_ 96 ESC_DfctvSta 3;
BA_ "SignalLongName" SG_ 96 ESC_DfctvSta "ESC_DefectiveStatus";
BA_ "Version" SG_ 96 ESC_DisableSta "1.0";
BA_ "Description" SG_ 96 ESC_DisableSta "Information regarding the ESC 'enable/disable' indication.



Conversion:

1. ESP_DEF(0)/ESP_PAS(0)/ESP_CTL(0) -> ESC lamp OFF

2. ESP_DEF(0)/ESP_PAS(0)/ESP_CTL(1) -> ESC active

3. ESP_DEF(0)/ESP_PAS(1)/ESP_CTL(x) -> ESC disabled by user (SW off)

4. ES";
BA_ "UsrSigTimeoutValue" SG_ 96 ESC_DisableSta "";
BA_ "UserSigValidity" SG_ 96 ESC_DisableSta 3;
BA_ "SignalLongName" SG_ 96 ESC_DisableSta "ESC_DisabledStatus";
BA_ "Version" SG_ 96 HAC_CtrlSta "1.0";
BA_ "Description" SG_ 96 HAC_CtrlSta "This signal indicates the information regarding the HAC 'control' indicator



Conversion:

1. HAC_DEF(0)/HAC_PAS(0)/HAC_CTL(0) -> HAC is not applied

2. HAC_DEF(0)/HAC_PAS(x)/HAC_CTL(1) -> HAC is Active

3. HAC_DEF(0)/HAC_PAS(1)/HAC_CTL(0) -> HAC is sta";
BA_ "UsrSigTimeoutValue" SG_ 96 HAC_CtrlSta "";
BA_ "UserSigValidity" SG_ 96 HAC_CtrlSta 3;
BA_ "SignalLongName" SG_ 96 HAC_CtrlSta "HAC_ControlStatus";
BA_ "Version" SG_ 96 HAC_DfctvSta "1.0";
BA_ "Description" SG_ 96 HAC_DfctvSta "This signal indicates the information regarding the HAC 'defective' indicator



Conversion:

1. HAC_DEF(0)/HAC_PAS(0)/HAC_CTL(0) -> HAC is not applied

2. HAC_DEF(0)/HAC_PAS(x)/HAC_CTL(1) -> HAC is Active

3. HAC_DEF(0)/HAC_PAS(1)/HAC_CTL(0) -> HAC is s";
BA_ "UsrSigTimeoutValue" SG_ 96 HAC_DfctvSta "";
BA_ "UserSigValidity" SG_ 96 HAC_DfctvSta 3;
BA_ "SignalLongName" SG_ 96 HAC_DfctvSta "HAC_DefectiveStatus";
BA_ "Version" SG_ 96 HAC_StdbySta "1.0";
BA_ "Description" SG_ 96 HAC_StdbySta "This signal indicates the information regarding the HAC “enable/disable” indicator



Conversion:

1. HAC_DEF(0)/HAC_PAS(0)/HAC_CTL(0) -> HAC is not applied

2. HAC_DEF(0)/HAC_PAS(x)/HAC_CTL(1) -> HAC is Active

3. HAC_DEF(0)/HAC_PAS(1)/HAC_CTL(0) -> H";
BA_ "UsrSigTimeoutValue" SG_ 96 HAC_StdbySta "";
BA_ "UserSigValidity" SG_ 96 HAC_StdbySta 3;
BA_ "SignalLongName" SG_ 96 HAC_StdbySta "HAC_StandbyStatus";
BA_ "Version" SG_ 96 DBC_CtrlSta "1.0";
BA_ "Description" SG_ 96 DBC_CtrlSta "This signal indicates the information regarding the DBC “control” indicator



Conversion:

1. DBC_DEF(0)/DBC_PAS(0)/DBC_CTL(0) -> DBC is not applied

2. DBC_DEF(0)/DBC_PAS(x)/DBC_CTL(1) -> DBC is Active

3. DBC_DEF(0)/DBC_PAS(1)/DBC_CTL(0) -> DBC is s";
BA_ "UsrSigTimeoutValue" SG_ 96 DBC_CtrlSta "";
BA_ "UserSigValidity" SG_ 96 DBC_CtrlSta 3;
BA_ "SignalLongName" SG_ 96 DBC_CtrlSta "DBC_ControlStatus";
BA_ "Version" SG_ 96 DBC_DfctvSta "1.0";
BA_ "Description" SG_ 96 DBC_DfctvSta "This signal indicates the information regarding the DBC “defective” indicator



Conversion:

1. DBC_DEF(0)/DBC_PAS(0)/DBC_CTL(0) -> DBC is not applied

2. DBC_DEF(0)/DBC_PAS(x)/DBC_CTL(1) -> DBC is Active

3. DBC_DEF(0)/DBC_PAS(1)/DBC_CTL(0) -> DBC is";
BA_ "UsrSigTimeoutValue" SG_ 96 DBC_DfctvSta "";
BA_ "UserSigValidity" SG_ 96 DBC_DfctvSta 3;
BA_ "SignalLongName" SG_ 96 DBC_DfctvSta "DBC_DefectiveStatus";
BA_ "Version" SG_ 96 DBC_StdbySta "1.0";
BA_ "Description" SG_ 96 DBC_StdbySta "This signal indicates the information regarding the DBC “enable/disable” indicator



Conversion:

1. DBC_DEF(0)/DBC_PAS(0)/DBC_CTL(0) -> DBC is not applied

2. DBC_DEF(0)/DBC_PAS(x)/DBC_CTL(1) -> DBC is Active

3. DBC_DEF(0)/DBC_PAS(1)/DBC_CTL(0) -> D";
BA_ "UsrSigTimeoutValue" SG_ 96 DBC_StdbySta "";
BA_ "UserSigValidity" SG_ 96 DBC_StdbySta 3;
BA_ "SignalLongName" SG_ 96 DBC_StdbySta "DBC_StandbyStatus";
BA_ "Version" SG_ 96 ESC_VsmCtrlModSta "1.0";
BA_ "Description" SG_ 96 ESC_VsmCtrlModSta "Classify mode1 , mode2 and mode3 of torque overlay. 

- Mode1 is sensor value overlay mode.

- Mode2 is output torque overlay mode. 

- Mode3 is for an alternative mode for Mobis VSM system";
BA_ "UsrSigTimeoutValue" SG_ 96 ESC_VsmCtrlModSta "";
BA_ "UserSigValidity" SG_ 96 ESC_VsmCtrlModSta 3;
BA_ "SignalLongName" SG_ 96 ESC_VsmCtrlModSta "ESC_VsmControlModeStatus";
BA_ "Version" SG_ 96 ESC_VsmActvSta "1.0";
BA_ "Description" SG_ 96 ESC_VsmActvSta "ESC controller provides an information on VSM (ESC+MDPS) Active signal. It indicates VSM control is

active or inactive.";
BA_ "UsrSigTimeoutValue" SG_ 96 ESC_VsmActvSta "";
BA_ "UserSigValidity" SG_ 96 ESC_VsmActvSta 3;
BA_ "SignalLongName" SG_ 96 ESC_VsmActvSta "ESC_VsmActiveStatus";
BA_ "Version" SG_ 96 ESC_VsmDfctvSta "1.0";
BA_ "Description" SG_ 96 ESC_VsmDfctvSta "Information regarding the VSM “defective” Indication";
BA_ "UsrSigTimeoutValue" SG_ 96 ESC_VsmDfctvSta "";
BA_ "UserSigValidity" SG_ 96 ESC_VsmDfctvSta 3;
BA_ "SignalLongName" SG_ 96 ESC_VsmDfctvSta "ESC_VsmDefectiveStatus";
BA_ "Version" SG_ 96 ESC_StrTqReq "1.0";
BA_ "Description" SG_ 96 ESC_StrTqReq "Requested additional Assist torque of MDPS gets from ESC to make vehicle more stable.



Relationship between signals:

ESC_StrTrqReq = 0 Nm  ( DST inactive )

-> ESC_DstAct = 0, ESC_DstCtrMode = 0

ESC_StrTrqReq < 0 Nm  or  ESC_StrTrqReq > 0 Nm  (active";
BA_ "GenSigStartValue" SG_ 96 ESC_StrTqReq 2048;
BA_ "UsrSigTimeoutValue" SG_ 96 ESC_StrTqReq "";
BA_ "UserSigValidity" SG_ 96 ESC_StrTqReq 3;
BA_ "SignalLongName" SG_ 96 ESC_StrTqReq "ESC_SteeringTorqueReqeust";
BA_ "Version" SG_ 96 ABS_WrngLmpSta "1.0";
BA_ "Description" SG_ 96 ABS_WrngLmpSta "The signal indicates the status of the “ABS Warning lamp”";
BA_ "UsrSigTimeoutValue" SG_ 96 ABS_WrngLmpSta "";
BA_ "UserSigValidity" SG_ 96 ABS_WrngLmpSta 3;
BA_ "SignalLongName" SG_ 96 ABS_WrngLmpSta "ABS_WarningLampStatus";
BA_ "Version" SG_ 96 EBD_WrngLmpSta "1.0";
BA_ "Description" SG_ 96 EBD_WrngLmpSta "The signal indicates the status of the “EBD Warning lamp”";
BA_ "UsrSigTimeoutValue" SG_ 96 EBD_WrngLmpSta "";
BA_ "UserSigValidity" SG_ 96 EBD_WrngLmpSta 3;
BA_ "SignalLongName" SG_ 96 EBD_WrngLmpSta "EBD_WarningLampStatus";
BA_ "Version" SG_ 96 TCS_LmpSta "1.0";
BA_ "Description" SG_ 96 TCS_LmpSta "The signal indicates the status of the “TCS/ESC Function/Warning Lamp”";
BA_ "UsrSigTimeoutValue" SG_ 96 TCS_LmpSta "";
BA_ "UserSigValidity" SG_ 96 TCS_LmpSta 3;
BA_ "SignalLongName" SG_ 96 TCS_LmpSta "TCS_LampStatus";
BA_ "Version" SG_ 96 TCS_OffLmpSta "1.0";
BA_ "Description" SG_ 96 TCS_OffLmpSta "The signal indicates the status of the “TCS/ESC OFF SW Lamp”";
BA_ "UsrSigTimeoutValue" SG_ 96 TCS_OffLmpSta "";
BA_ "UserSigValidity" SG_ 96 TCS_OffLmpSta 3;
BA_ "SignalLongName" SG_ 96 TCS_OffLmpSta "TCS_OffLampStatus";
BA_ "Version" SG_ 96 ESC_OffTempSta "1.0";
BA_ "Description" SG_ 96 ESC_OffTempSta "Information regarding the ESC OFF step by switch input of driver.";
BA_ "UsrSigTimeoutValue" SG_ 96 ESC_OffTempSta "";
BA_ "UserSigValidity" SG_ 96 ESC_OffTempSta 3;
BA_ "SignalLongName" SG_ 96 ESC_OffTempSta "ESC_OffStepStatus";
BA_ "Version" SG_ 96 DBC_FuncLmpSta "1.0";
BA_ "Description" SG_ 96 DBC_FuncLmpSta "The signal indicates the status of the “DBC Function lamp”";
BA_ "UsrSigTimeoutValue" SG_ 96 DBC_FuncLmpSta "";
BA_ "UserSigValidity" SG_ 96 DBC_FuncLmpSta 3;
BA_ "SignalLongName" SG_ 96 DBC_FuncLmpSta "DBC_FuncitonLampStatus";
BA_ "Version" SG_ 96 DBC_WrngLmpSta "1.0";
BA_ "Description" SG_ 96 DBC_WrngLmpSta "The signal indicates the status of the “DBC Warning lamp”";
BA_ "UsrSigTimeoutValue" SG_ 96 DBC_WrngLmpSta "";
BA_ "UserSigValidity" SG_ 96 DBC_WrngLmpSta 3;
BA_ "SignalLongName" SG_ 96 DBC_WrngLmpSta "DBC_WarningLampStatus";
BA_ "Version" SG_ 96 AVH_CluDis "1.0";
BA_ "Description" SG_ 96 AVH_CluDis "An ESC can show its information message to driver on a cluster or a display module with this signal.";
BA_ "UsrSigTimeoutValue" SG_ 96 AVH_CluDis "";
BA_ "UserSigValidity" SG_ 96 AVH_CluDis 3;
BA_ "SignalLongName" SG_ 96 AVH_CluDis "AVH_ClusterDisplay";
BA_ "Version" SG_ 96 AVH_AlrmReq "1.0";
BA_ "Description" SG_ 96 AVH_AlrmReq "This signal indicates that an ESC requests cluster or tone controller to ring the alarm according to the status of an ESC";
BA_ "UsrSigTimeoutValue" SG_ 96 AVH_AlrmReq "";
BA_ "UserSigValidity" SG_ 96 AVH_AlrmReq 3;
BA_ "SignalLongName" SG_ 96 AVH_AlrmReq "AVH_AlarmRequest";
BA_ "Version" SG_ 96 AVH_ActvStaLmpDis "1.0";
BA_ "Description" SG_ 96 AVH_ActvStaLmpDis "This signal indicates AVH active status lamp request from ESC to cluster.";
BA_ "UsrSigTimeoutValue" SG_ 96 AVH_ActvStaLmpDis "";
BA_ "UserSigValidity" SG_ 96 AVH_ActvStaLmpDis 3;
BA_ "SignalLongName" SG_ 96 AVH_ActvStaLmpDis "AVH_ActiveStatusLampDisplay";
BA_ "Version" SG_ 96 AVH_LmpDis "1.0";
BA_ "Description" SG_ 96 AVH_LmpDis "Information about the status lamp request from ESC (AVH) to cluster.";
BA_ "UsrSigTimeoutValue" SG_ 96 AVH_LmpDis "";
BA_ "UserSigValidity" SG_ 96 AVH_LmpDis 3;
BA_ "SignalLongName" SG_ 96 AVH_LmpDis "AVH_LampDisplay";
BA_ "Version" SG_ 96 AWD_TransmsnTqLimModSta "1.0";
BA_ "Description" SG_ 96 AWD_TransmsnTqLimModSta "This signal indicates that Interface signal between ESC and 4WD, selecting cardan shaft torque limitation mode of 4WD.";
BA_ "UsrSigTimeoutValue" SG_ 96 AWD_TransmsnTqLimModSta "";
BA_ "UserSigValidity" SG_ 96 AWD_TransmsnTqLimModSta 3;
BA_ "SignalLongName" SG_ 96 AWD_TransmsnTqLimModSta "AWD_TransmissionTorqueLimitModeStatus";
BA_ "Version" SG_ 96 AWD_CltchDtyLimVal "1.0";
BA_ "Description" SG_ 96 AWD_CltchDtyLimVal "Interface signal between ABS/TCS/ESC and 4WD and demands 4WD clutch duty limit.";
BA_ "UsrSigTimeoutValue" SG_ 96 AWD_CltchDtyLimVal "";
BA_ "UserSigValidity" SG_ 96 AWD_CltchDtyLimVal 3;
BA_ "SignalLongName" SG_ 96 AWD_CltchDtyLimVal "AWD_ClutchDutyLimitValue";
BA_ "Version" SG_ 96 AWD_RrWhlDtyLimReq "1.0";
BA_ "Description" SG_ 96 AWD_RrWhlDtyLimReq "This signal indicates that ESC request 4WD ECU to limit control duty of rear wheels for improvement of stability of a vehicle during ESC control.";
BA_ "UsrSigTimeoutValue" SG_ 96 AWD_RrWhlDtyLimReq "";
BA_ "UserSigValidity" SG_ 96 AWD_RrWhlDtyLimReq 3;
BA_ "SignalLongName" SG_ 96 AWD_RrWhlDtyLimReq "AWD_RearWheelDutyLimitRequest";
BA_ "Version" SG_ 96 AWD_FastOpnCrdnShftCltchReq "1.0";
BA_ "Description" SG_ 96 AWD_FastOpnCrdnShftCltchReq "Interface signal between ESC and 4WD, demands fast opening or torque limit of the 4WD cardan shaft clutch.";
BA_ "UsrSigTimeoutValue" SG_ 96 AWD_FastOpnCrdnShftCltchReq "";
BA_ "UserSigValidity" SG_ 96 AWD_FastOpnCrdnShftCltchReq 3;
BA_ "SignalLongName" SG_ 96 AWD_FastOpnCrdnShftCltchReq "AWD_FastOpenCardanShaftClutchRequest";
BA_ "Version" SG_ 96 AWD_CrdnShftTqLimVal "1.0";
BA_ "Description" SG_ 96 AWD_CrdnShftTqLimVal "Interface signal between ABS/TCS/ESC and 4WD, demands 4WD cardan shaft torque limit.";
BA_ "GenSigStartValue" SG_ 96 AWD_CrdnShftTqLimVal 64255;
BA_ "UsrSigTimeoutValue" SG_ 96 AWD_CrdnShftTqLimVal "";
BA_ "UserSigValidity" SG_ 96 AWD_CrdnShftTqLimVal 3;
BA_ "SignalLongName" SG_ 96 AWD_CrdnShftTqLimVal "AWD_CardanShaftTorqueLimitValue";
BA_ "Version" SG_ 96 EPB_ActvReq "1.0";
BA_ "Description" SG_ 96 EPB_ActvReq "This signal indicates that an ESC requests EPB to activate braking. 



REQ_EPB_ACT (0H)

 - AVH status : Don’t care

REQ_EPB_ACT (1H)

 - AVH status : Active

REQ_EPB_ACT (2H)

 - AVH status : Active

REQ_EPB_ACT (3H)

 - AVH status : Disabled

(EPB St";
BA_ "UsrSigTimeoutValue" SG_ 96 EPB_ActvReq "";
BA_ "UserSigValidity" SG_ 96 EPB_ActvReq 3;
BA_ "SignalLongName" SG_ 96 EPB_ActvReq "EPB_ActiveRequest";
BA_ "Version" SG_ 96 EPB_StaReq "1.0";
BA_ "Description" SG_ 96 EPB_StaReq "This signal indicates the validity of REQ_EPB_ACT (ESC request for EPB to activate braking) signal.";
BA_ "GenSigStartValue" SG_ 96 EPB_StaReq 1;
BA_ "UsrSigTimeoutValue" SG_ 96 EPB_StaReq "";
BA_ "UserSigValidity" SG_ 96 EPB_StaReq 3;
BA_ "SignalLongName" SG_ 96 EPB_StaReq "EPB_StatusRequest";
BA_ "Version" SG_ 96 LDM_Sta "1.0";
BA_ "Description" SG_ 96 LDM_Sta "Information about ESC-Readiness to perform Dynamic Braking Function (DBF) or Automatic Vehicle Hold (AVH) which is requested by AVH switch.



LDM_STAT (0H)

 - EPB function : EPB is slave

LDM_STAT (1H)

 - EPB function : EPB stand alone";
BA_ "UsrSigTimeoutValue" SG_ 96 LDM_Sta "";
BA_ "UserSigValidity" SG_ 96 LDM_Sta 3;
BA_ "SignalLongName" SG_ 96 LDM_Sta "LDM_Status";
BA_ "Version" SG_ 96 ECD_ActvSta "1.0";
BA_ "Description" SG_ 96 ECD_ActvSta "ECD Active signal indicates whether ECD function is active (operating) or not.";
BA_ "UsrSigTimeoutValue" SG_ 96 ECD_ActvSta "";
BA_ "UserSigValidity" SG_ 96 ECD_ActvSta 3;
BA_ "SignalLongName" SG_ 96 ECD_ActvSta "ECD_ActiveStatus";
BA_ "Version" SG_ 96 AVH_Sta "1.0";
BA_ "Description" SG_ 96 AVH_Sta "This signal indicates whether the vehicle is held with hydraulic brake (service brake).";
BA_ "UsrSigTimeoutValue" SG_ 96 AVH_Sta "";
BA_ "UserSigValidity" SG_ 96 AVH_Sta 3;
BA_ "SignalLongName" SG_ 96 AVH_Sta "AVH_Status";
BA_ "Version" SG_ 96 ESC_CylPrsrVal "1.0";
BA_ "Description" SG_ 96 ESC_CylPrsrVal "This signal indicates pressure of brake master cylinder and provides information how deeply  a driver is pressing brake pedal.";
BA_ "UsrSigTimeoutValue" SG_ 96 ESC_CylPrsrVal "";
BA_ "UserSigValidity" SG_ 96 ESC_CylPrsrVal 3;
BA_ "SignalLongName" SG_ 96 ESC_CylPrsrVal "ESC_CylinderPressureValue";
BA_ "Version" SG_ 96 ESC_CylPrsrSta "1.0";
BA_ "Description" SG_ 96 ESC_CylPrsrSta "This signal indicates validity of CYL_PRES signal. If pressure signal is invalid, this signal shall be set to 1.";
BA_ "GenSigStartValue" SG_ 96 ESC_CylPrsrSta 1;
BA_ "UsrSigTimeoutValue" SG_ 96 ESC_CylPrsrSta "";
BA_ "UserSigValidity" SG_ 96 ESC_CylPrsrSta 3;
BA_ "SignalLongName" SG_ 96 ESC_CylPrsrSta "ESC_CylinderPressureStatus";
BA_ "Version" SG_ 96 ESC_CylPrsrDiagSta "1.0";
BA_ "Description" SG_ 96 ESC_CylPrsrDiagSta "This signal indicates self-diagnosis mode of master cylinder pressure signal. During system check, master cylinder pressure information cannot be sent(not available) and this bit should be set to 1.";
BA_ "GenSigStartValue" SG_ 96 ESC_CylPrsrDiagSta 1;
BA_ "UsrSigTimeoutValue" SG_ 96 ESC_CylPrsrDiagSta "";
BA_ "UserSigValidity" SG_ 96 ESC_CylPrsrDiagSta 3;
BA_ "SignalLongName" SG_ 96 ESC_CylPrsrDiagSta "ESC_CylinderPressureDiagnosisStatus";
BA_ "Version" SG_ 96 ESC_CylPrsrFlagSta "1.0";
BA_ "Description" SG_ 96 ESC_CylPrsrFlagSta "This signal means that the pressure of master cylinder is 15 bar or over.

(0x0 : under 15 bar, 0x1 : 15 bar or over)



This signal may be difference with actual BLS(Brake Lamp Switch) state.

So the ESC does not guarantee using this signal as substitut";
BA_ "UsrSigTimeoutValue" SG_ 96 ESC_CylPrsrFlagSta "";
BA_ "UserSigValidity" SG_ 96 ESC_CylPrsrFlagSta 3;
BA_ "SignalLongName" SG_ 96 ESC_CylPrsrFlagSta "ESC_CylinderPressureFlagStatus";
BA_ "Version" SG_ 96 ESS_Sta "1.0";
BA_ "Description" SG_ 96 ESS_Sta "Information on ESS system active/inactive/fail from ABS/ESC.";
BA_ "UsrSigTimeoutValue" SG_ 96 ESS_Sta "";
BA_ "UserSigValidity" SG_ 96 ESS_Sta 3;
BA_ "SignalLongName" SG_ 96 ESS_Sta "ESS_Status";
BA_ "Version" SG_ 96 ESC_BrkLtActvSta "1.0";
BA_ "Description" SG_ 96 ESC_BrkLtActvSta "Flag from TCS which activates the illumination of the brake lights during automatic braking";
BA_ "UsrSigTimeoutValue" SG_ 96 ESC_BrkLtActvSta "";
BA_ "UserSigValidity" SG_ 96 ESC_BrkLtActvSta 0;
BA_ "SignalLongName" SG_ 96 ESC_BrkLtActvSta "ESC_BrakeLightActiveStatus";
BA_ "Version" SG_ 96 ESC_BrkCtrlSta "1.0";
BA_ "Description" SG_ 96 ESC_BrkCtrlSta "This signal indicates that if brake control from the ECU request is in activation or not  during cruise control or speed limiter.";
BA_ "UsrSigTimeoutValue" SG_ 96 ESC_BrkCtrlSta "";
BA_ "UserSigValidity" SG_ 96 ESC_BrkCtrlSta 3;
BA_ "SignalLongName" SG_ 96 ESC_BrkCtrlSta "ESC_BrakeControlStatus";
VAL_ 122 ECSIVSS_YawGyroSnsrVal 0 "-204.8~204.5 (deg/s)" 1 "-204.8~204.5 (deg/s)" 2 "-204.8~204.5 (deg/s)" 3 "-204.8~204.5 (deg/s)" 4 "-204.8~204.5 (deg/s)" 5 "-204.8~204.5 (deg/s)" 6 "-204.8~204.5 (deg/s)" 7 "-204.8~204.5 (deg/s)" 8 "-204.8~204.5 (deg/s)" 9 "-204.8~204.5 (deg/s)" 10 "-204.8~204.5 (deg/s)" 11 "-204.8~204.5 (deg/s)" 12 "-204.8~204.5 (deg/s)" 13 "-204.8~204.5 (deg/s)" 14 "-204.8~204.5 (deg/s)" 15 "-204.8~204.5 (deg/s)" 16 "-204.8~204.5 (deg/s)" 17 "-204.8~204.5 (deg/s)" 18 "-204.8~204.5 (deg/s)" 19 "-204.8~204.5 (deg/s)" 20 "-204.8~204.5 (deg/s)" 21 "-204.8~204.5 (deg/s)" 22 "-204.8~204.5 (deg/s)" 23 "-204.8~204.5 (deg/s)" 24 "-204.8~204.5 (deg/s)" 25 "-204.8~204.5 (deg/s)" 26 "-204.8~204.5 (deg/s)" 27 "-204.8~204.5 (deg/s)" 28 "-204.8~204.5 (deg/s)" 29 "-204.8~204.5 (deg/s)" 30 "-204.8~204.5 (deg/s)" 31 "-204.8~204.5 (deg/s)" 32 "-204.8~204.5 (deg/s)" 33 "-204.8~204.5 (deg/s)" 34 "-204.8~204.5 (deg/s)" 35 "-204.8~204.5 (deg/s)" 36 "-204.8~204.5 (deg/s)" 37 "-204.8~204.5 (deg/s)" 38 "-204.8~204.5 (deg/s)" 39 "-204.8~204.5 (deg/s)" 40 "-204.8~204.5 (deg/s)" 41 "-204.8~204.5 (deg/s)" 42 "-204.8~204.5 (deg/s)" 43 "-204.8~204.5 (deg/s)" 44 "-204.8~204.5 (deg/s)" 45 "-204.8~204.5 (deg/s)" 46 "-204.8~204.5 (deg/s)" 47 "-204.8~204.5 (deg/s)" 48 "-204.8~204.5 (deg/s)" 49 "-204.8~204.5 (deg/s)" 50 "-204.8~204.5 (deg/s)" 51 "-204.8~204.5 (deg/s)" 52 "-204.8~204.5 (deg/s)" 53 "-204.8~204.5 (deg/s)" 54 "-204.8~204.5 (deg/s)" 55 "-204.8~204.5 (deg/s)" 56 "-204.8~204.5 (deg/s)" 57 "-204.8~204.5 (deg/s)" 58 "-204.8~204.5 (deg/s)" 59 "-204.8~204.5 (deg/s)" 60 "-204.8~204.5 (deg/s)" 61 "-204.8~204.5 (deg/s)" 62 "-204.8~204.5 (deg/s)" 63 "-204.8~204.5 (deg/s)" 64 "-204.8~204.5 (deg/s)" 65 "-204.8~204.5 (deg/s)" 66 "-204.8~204.5 (deg/s)" 67 "-204.8~204.5 (deg/s)" 68 "-204.8~204.5 (deg/s)" 69 "-204.8~204.5 (deg/s)" 70 "-204.8~204.5 (deg/s)" 71 "-204.8~204.5 (deg/s)" 72 "-204.8~204.5 (deg/s)" 73 "-204.8~204.5 (deg/s)" 74 "-204.8~204.5 (deg/s)" 75 "-204.8~204.5 (deg/s)" 76 "-204.8~204.5 (deg/s)" 77 "-204.8~204.5 (deg/s)" 78 "-204.8~204.5 (deg/s)" 79 "-204.8~204.5 (deg/s)" 80 "-204.8~204.5 (deg/s)" 81 "-204.8~204.5 (deg/s)" 82 "-204.8~204.5 (deg/s)" 83 "-204.8~204.5 (deg/s)" 84 "-204.8~204.5 (deg/s)" 85 "-204.8~204.5 (deg/s)" 86 "-204.8~204.5 (deg/s)" 87 "-204.8~204.5 (deg/s)" 88 "-204.8~204.5 (deg/s)" 89 "-204.8~204.5 (deg/s)" 90 "-204.8~204.5 (deg/s)" 91 "-204.8~204.5 (deg/s)" 92 "-204.8~204.5 (deg/s)" 93 "-204.8~204.5 (deg/s)" 94 "-204.8~204.5 (deg/s)" 95 "-204.8~204.5 (deg/s)" 96 "-204.8~204.5 (deg/s)" 97 "-204.8~204.5 (deg/s)" 98 "-204.8~204.5 (deg/s)" 99 "-204.8~204.5 (deg/s)" 100 "-204.8~204.5 (deg/s)" 101 "-204.8~204.5 (deg/s)" 102 "-204.8~204.5 (deg/s)" 103 "-204.8~204.5 (deg/s)" 104 "-204.8~204.5 (deg/s)" 105 "-204.8~204.5 (deg/s)" 106 "-204.8~204.5 (deg/s)" 107 "-204.8~204.5 (deg/s)" 108 "-204.8~204.5 (deg/s)" 109 "-204.8~204.5 (deg/s)" 110 "-204.8~204.5 (deg/s)" 111 "-204.8~204.5 (deg/s)" 112 "-204.8~204.5 (deg/s)" 113 "-204.8~204.5 (deg/s)" 114 "-204.8~204.5 (deg/s)" 115 "-204.8~204.5 (deg/s)" 116 "-204.8~204.5 (deg/s)" 117 "-204.8~204.5 (deg/s)" 118 "-204.8~204.5 (deg/s)" 119 "-204.8~204.5 (deg/s)" 120 "-204.8~204.5 (deg/s)" 121 "-204.8~204.5 (deg/s)" 122 "-204.8~204.5 (deg/s)" 123 "-204.8~204.5 (deg/s)" 124 "-204.8~204.5 (deg/s)" 125 "-204.8~204.5 (deg/s)" 126 "-204.8~204.5 (deg/s)" 127 "-204.8~204.5 (deg/s)" 128 "-204.8~204.5 (deg/s)" 129 "-204.8~204.5 (deg/s)" 130 "-204.8~204.5 (deg/s)" 131 "-204.8~204.5 (deg/s)" 132 "-204.8~204.5 (deg/s)" 133 "-204.8~204.5 (deg/s)" 134 "-204.8~204.5 (deg/s)" 135 "-204.8~204.5 (deg/s)" 136 "-204.8~204.5 (deg/s)" 137 "-204.8~204.5 (deg/s)" 138 "-204.8~204.5 (deg/s)" 139 "-204.8~204.5 (deg/s)" 140 "-204.8~204.5 (deg/s)" 141 "-204.8~204.5 (deg/s)" 142 "-204.8~204.5 (deg/s)" 143 "-204.8~204.5 (deg/s)" 144 "-204.8~204.5 (deg/s)" 145 "-204.8~204.5 (deg/s)" 146 "-204.8~204.5 (deg/s)" 147 "-204.8~204.5 (deg/s)" 148 "-204.8~204.5 (deg/s)" 149 "-204.8~204.5 (deg/s)" 150 "-204.8~204.5 (deg/s)" 151 "-204.8~204.5 (deg/s)" 152 "-204.8~204.5 (deg/s)" 153 "-204.8~204.5 (deg/s)" 154 "-204.8~204.5 (deg/s)" 155 "-204.8~204.5 (deg/s)" 156 "-204.8~204.5 (deg/s)" 157 "-204.8~204.5 (deg/s)" 158 "-204.8~204.5 (deg/s)" 159 "-204.8~204.5 (deg/s)" 160 "-204.8~204.5 (deg/s)" 161 "-204.8~204.5 (deg/s)" 162 "-204.8~204.5 (deg/s)" 163 "-204.8~204.5 (deg/s)" 164 "-204.8~204.5 (deg/s)" 165 "-204.8~204.5 (deg/s)" 166 "-204.8~204.5 (deg/s)" 167 "-204.8~204.5 (deg/s)" 168 "-204.8~204.5 (deg/s)" 169 "-204.8~204.5 (deg/s)" 170 "-204.8~204.5 (deg/s)" 171 "-204.8~204.5 (deg/s)" 172 "-204.8~204.5 (deg/s)" 173 "-204.8~204.5 (deg/s)" 174 "-204.8~204.5 (deg/s)" 175 "-204.8~204.5 (deg/s)" 176 "-204.8~204.5 (deg/s)" 177 "-204.8~204.5 (deg/s)" 178 "-204.8~204.5 (deg/s)" 179 "-204.8~204.5 (deg/s)" 180 "-204.8~204.5 (deg/s)" 181 "-204.8~204.5 (deg/s)" 182 "-204.8~204.5 (deg/s)" 183 "-204.8~204.5 (deg/s)" 184 "-204.8~204.5 (deg/s)" 185 "-204.8~204.5 (deg/s)" 186 "-204.8~204.5 (deg/s)" 187 "-204.8~204.5 (deg/s)" 188 "-204.8~204.5 (deg/s)" 189 "-204.8~204.5 (deg/s)" 190 "-204.8~204.5 (deg/s)" 191 "-204.8~204.5 (deg/s)" 192 "-204.8~204.5 (deg/s)" 193 "-204.8~204.5 (deg/s)" 194 "-204.8~204.5 (deg/s)" 195 "-204.8~204.5 (deg/s)" 196 "-204.8~204.5 (deg/s)" 197 "-204.8~204.5 (deg/s)" 198 "-204.8~204.5 (deg/s)" 199 "-204.8~204.5 (deg/s)" 200 "-204.8~204.5 (deg/s)" 201 "-204.8~204.5 (deg/s)" 202 "-204.8~204.5 (deg/s)" 203 "-204.8~204.5 (deg/s)" 204 "-204.8~204.5 (deg/s)" 205 "-204.8~204.5 (deg/s)" 206 "-204.8~204.5 (deg/s)" 207 "-204.8~204.5 (deg/s)" 208 "-204.8~204.5 (deg/s)" 209 "-204.8~204.5 (deg/s)" 210 "-204.8~204.5 (deg/s)" 211 "-204.8~204.5 (deg/s)" 212 "-204.8~204.5 (deg/s)" 213 "-204.8~204.5 (deg/s)" 214 "-204.8~204.5 (deg/s)" 215 "-204.8~204.5 (deg/s)" 216 "-204.8~204.5 (deg/s)" 217 "-204.8~204.5 (deg/s)" 218 "-204.8~204.5 (deg/s)" 219 "-204.8~204.5 (deg/s)" 220 "-204.8~204.5 (deg/s)" 221 "-204.8~204.5 (deg/s)" 222 "-204.8~204.5 (deg/s)" 223 "-204.8~204.5 (deg/s)" 224 "-204.8~204.5 (deg/s)" 225 "-204.8~204.5 (deg/s)" 226 "-204.8~204.5 (deg/s)" 227 "-204.8~204.5 (deg/s)" 228 "-204.8~204.5 (deg/s)" 229 "-204.8~204.5 (deg/s)" 230 "-204.8~204.5 (deg/s)" 231 "-204.8~204.5 (deg/s)" 232 "-204.8~204.5 (deg/s)" 233 "-204.8~204.5 (deg/s)" 234 "-204.8~204.5 (deg/s)" 235 "-204.8~204.5 (deg/s)" 236 "-204.8~204.5 (deg/s)" 237 "-204.8~204.5 (deg/s)" 238 "-204.8~204.5 (deg/s)" 239 "-204.8~204.5 (deg/s)" 240 "-204.8~204.5 (deg/s)" 241 "-204.8~204.5 (deg/s)" 242 "-204.8~204.5 (deg/s)" 243 "-204.8~204.5 (deg/s)" 244 "-204.8~204.5 (deg/s)" 245 "-204.8~204.5 (deg/s)" 246 "-204.8~204.5 (deg/s)" 247 "-204.8~204.5 (deg/s)" 248 "-204.8~204.5 (deg/s)" 249 "-204.8~204.5 (deg/s)" 250 "-204.8~204.5 (deg/s)" 251 "-204.8~204.5 (deg/s)" 252 "-204.8~204.5 (deg/s)" 253 "-204.8~204.5 (deg/s)" 254 "-204.8~204.5 (deg/s)" 255 "-204.8~204.5 (deg/s)" 256 "-204.8~204.5 (deg/s)" 257 "-204.8~204.5 (deg/s)" 258 "-204.8~204.5 (deg/s)" 259 "-204.8~204.5 (deg/s)" 260 "-204.8~204.5 (deg/s)" 261 "-204.8~204.5 (deg/s)" 262 "-204.8~204.5 (deg/s)" 263 "-204.8~204.5 (deg/s)" 264 "-204.8~204.5 (deg/s)" 265 "-204.8~204.5 (deg/s)" 266 "-204.8~204.5 (deg/s)" 267 "-204.8~204.5 (deg/s)" 268 "-204.8~204.5 (deg/s)" 269 "-204.8~204.5 (deg/s)" 270 "-204.8~204.5 (deg/s)" 271 "-204.8~204.5 (deg/s)" 272 "-204.8~204.5 (deg/s)" 273 "-204.8~204.5 (deg/s)" 274 "-204.8~204.5 (deg/s)" 275 "-204.8~204.5 (deg/s)" 276 "-204.8~204.5 (deg/s)" 277 "-204.8~204.5 (deg/s)" 278 "-204.8~204.5 (deg/s)" 279 "-204.8~204.5 (deg/s)" 280 "-204.8~204.5 (deg/s)" 281 "-204.8~204.5 (deg/s)" 282 "-204.8~204.5 (deg/s)" 283 "-204.8~204.5 (deg/s)" 284 "-204.8~204.5 (deg/s)" 285 "-204.8~204.5 (deg/s)" 286 "-204.8~204.5 (deg/s)" 287 "-204.8~204.5 (deg/s)" 288 "-204.8~204.5 (deg/s)" 289 "-204.8~204.5 (deg/s)" 290 "-204.8~204.5 (deg/s)" 291 "-204.8~204.5 (deg/s)" 292 "-204.8~204.5 (deg/s)" 293 "-204.8~204.5 (deg/s)" 294 "-204.8~204.5 (deg/s)" 295 "-204.8~204.5 (deg/s)" 296 "-204.8~204.5 (deg/s)" 297 "-204.8~204.5 (deg/s)" 298 "-204.8~204.5 (deg/s)" 299 "-204.8~204.5 (deg/s)" 300 "-204.8~204.5 (deg/s)" 301 "-204.8~204.5 (deg/s)" 302 "-204.8~204.5 (deg/s)" 303 "-204.8~204.5 (deg/s)" 304 "-204.8~204.5 (deg/s)" 305 "-204.8~204.5 (deg/s)" 306 "-204.8~204.5 (deg/s)" 307 "-204.8~204.5 (deg/s)" 308 "-204.8~204.5 (deg/s)" 309 "-204.8~204.5 (deg/s)" 310 "-204.8~204.5 (deg/s)" 311 "-204.8~204.5 (deg/s)" 312 "-204.8~204.5 (deg/s)" 313 "-204.8~204.5 (deg/s)" 314 "-204.8~204.5 (deg/s)" 315 "-204.8~204.5 (deg/s)" 316 "-204.8~204.5 (deg/s)" 317 "-204.8~204.5 (deg/s)" 318 "-204.8~204.5 (deg/s)" 319 "-204.8~204.5 (deg/s)" 320 "-204.8~204.5 (deg/s)" 321 "-204.8~204.5 (deg/s)" 322 "-204.8~204.5 (deg/s)" 323 "-204.8~204.5 (deg/s)" 324 "-204.8~204.5 (deg/s)" 325 "-204.8~204.5 (deg/s)" 326 "-204.8~204.5 (deg/s)" 327 "-204.8~204.5 (deg/s)" 328 "-204.8~204.5 (deg/s)" 329 "-204.8~204.5 (deg/s)" 330 "-204.8~204.5 (deg/s)" 331 "-204.8~204.5 (deg/s)" 332 "-204.8~204.5 (deg/s)" 333 "-204.8~204.5 (deg/s)" 334 "-204.8~204.5 (deg/s)" 335 "-204.8~204.5 (deg/s)" 336 "-204.8~204.5 (deg/s)" 337 "-204.8~204.5 (deg/s)" 338 "-204.8~204.5 (deg/s)" 339 "-204.8~204.5 (deg/s)" 340 "-204.8~204.5 (deg/s)" 341 "-204.8~204.5 (deg/s)" 342 "-204.8~204.5 (deg/s)" 343 "-204.8~204.5 (deg/s)" 344 "-204.8~204.5 (deg/s)" 345 "-204.8~204.5 (deg/s)" 346 "-204.8~204.5 (deg/s)" 347 "-204.8~204.5 (deg/s)" 348 "-204.8~204.5 (deg/s)" 349 "-204.8~204.5 (deg/s)" 350 "-204.8~204.5 (deg/s)" 351 "-204.8~204.5 (deg/s)" 352 "-204.8~204.5 (deg/s)" 353 "-204.8~204.5 (deg/s)" 354 "-204.8~204.5 (deg/s)" 355 "-204.8~204.5 (deg/s)" 356 "-204.8~204.5 (deg/s)" 357 "-204.8~204.5 (deg/s)" 358 "-204.8~204.5 (deg/s)" 359 "-204.8~204.5 (deg/s)" 360 "-204.8~204.5 (deg/s)" 361 "-204.8~204.5 (deg/s)" 362 "-204.8~204.5 (deg/s)" 363 "-204.8~204.5 (deg/s)" 364 "-204.8~204.5 (deg/s)" 365 "-204.8~204.5 (deg/s)" 366 "-204.8~204.5 (deg/s)" 367 "-204.8~204.5 (deg/s)" 368 "-204.8~204.5 (deg/s)" 369 "-204.8~204.5 (deg/s)" 370 "-204.8~204.5 (deg/s)" 371 "-204.8~204.5 (deg/s)" 372 "-204.8~204.5 (deg/s)" 373 "-204.8~204.5 (deg/s)" 374 "-204.8~204.5 (deg/s)" 375 "-204.8~204.5 (deg/s)" 376 "-204.8~204.5 (deg/s)" 377 "-204.8~204.5 (deg/s)" 378 "-204.8~204.5 (deg/s)" 379 "-204.8~204.5 (deg/s)" 380 "-204.8~204.5 (deg/s)" 381 "-204.8~204.5 (deg/s)" 382 "-204.8~204.5 (deg/s)" 383 "-204.8~204.5 (deg/s)" 384 "-204.8~204.5 (deg/s)" 385 "-204.8~204.5 (deg/s)" 386 "-204.8~204.5 (deg/s)" 387 "-204.8~204.5 (deg/s)" 388 "-204.8~204.5 (deg/s)" 389 "-204.8~204.5 (deg/s)" 390 "-204.8~204.5 (deg/s)" 391 "-204.8~204.5 (deg/s)" 392 "-204.8~204.5 (deg/s)" 393 "-204.8~204.5 (deg/s)" 394 "-204.8~204.5 (deg/s)" 395 "-204.8~204.5 (deg/s)" 396 "-204.8~204.5 (deg/s)" 397 "-204.8~204.5 (deg/s)" 398 "-204.8~204.5 (deg/s)" 399 "-204.8~204.5 (deg/s)" 400 "-204.8~204.5 (deg/s)" 401 "-204.8~204.5 (deg/s)" 402 "-204.8~204.5 (deg/s)" 403 "-204.8~204.5 (deg/s)" 404 "-204.8~204.5 (deg/s)" 405 "-204.8~204.5 (deg/s)" 406 "-204.8~204.5 (deg/s)" 407 "-204.8~204.5 (deg/s)" 408 "-204.8~204.5 (deg/s)" 409 "-204.8~204.5 (deg/s)" 410 "-204.8~204.5 (deg/s)" 411 "-204.8~204.5 (deg/s)" 412 "-204.8~204.5 (deg/s)" 413 "-204.8~204.5 (deg/s)" 414 "-204.8~204.5 (deg/s)" 415 "-204.8~204.5 (deg/s)" 416 "-204.8~204.5 (deg/s)" 417 "-204.8~204.5 (deg/s)" 418 "-204.8~204.5 (deg/s)" 419 "-204.8~204.5 (deg/s)" 420 "-204.8~204.5 (deg/s)" 421 "-204.8~204.5 (deg/s)" 422 "-204.8~204.5 (deg/s)" 423 "-204.8~204.5 (deg/s)" 424 "-204.8~204.5 (deg/s)" 425 "-204.8~204.5 (deg/s)" 426 "-204.8~204.5 (deg/s)" 427 "-204.8~204.5 (deg/s)" 428 "-204.8~204.5 (deg/s)" 429 "-204.8~204.5 (deg/s)" 430 "-204.8~204.5 (deg/s)" 431 "-204.8~204.5 (deg/s)" 432 "-204.8~204.5 (deg/s)" 433 "-204.8~204.5 (deg/s)" 434 "-204.8~204.5 (deg/s)" 435 "-204.8~204.5 (deg/s)" 436 "-204.8~204.5 (deg/s)" 437 "-204.8~204.5 (deg/s)" 438 "-204.8~204.5 (deg/s)" 439 "-204.8~204.5 (deg/s)" 440 "-204.8~204.5 (deg/s)" 441 "-204.8~204.5 (deg/s)" 442 "-204.8~204.5 (deg/s)" 443 "-204.8~204.5 (deg/s)" 444 "-204.8~204.5 (deg/s)" 445 "-204.8~204.5 (deg/s)" 446 "-204.8~204.5 (deg/s)" 447 "-204.8~204.5 (deg/s)" 448 "-204.8~204.5 (deg/s)" 449 "-204.8~204.5 (deg/s)" 450 "-204.8~204.5 (deg/s)" 451 "-204.8~204.5 (deg/s)" 452 "-204.8~204.5 (deg/s)" 453 "-204.8~204.5 (deg/s)" 454 "-204.8~204.5 (deg/s)" 455 "-204.8~204.5 (deg/s)" 456 "-204.8~204.5 (deg/s)" 457 "-204.8~204.5 (deg/s)" 458 "-204.8~204.5 (deg/s)" 459 "-204.8~204.5 (deg/s)" 460 "-204.8~204.5 (deg/s)" 461 "-204.8~204.5 (deg/s)" 462 "-204.8~204.5 (deg/s)" 463 "-204.8~204.5 (deg/s)" 464 "-204.8~204.5 (deg/s)" 465 "-204.8~204.5 (deg/s)" 466 "-204.8~204.5 (deg/s)" 467 "-204.8~204.5 (deg/s)" 468 "-204.8~204.5 (deg/s)" 469 "-204.8~204.5 (deg/s)" 470 "-204.8~204.5 (deg/s)" 471 "-204.8~204.5 (deg/s)" 472 "-204.8~204.5 (deg/s)" 473 "-204.8~204.5 (deg/s)" 474 "-204.8~204.5 (deg/s)" 475 "-204.8~204.5 (deg/s)" 476 "-204.8~204.5 (deg/s)" 477 "-204.8~204.5 (deg/s)" 478 "-204.8~204.5 (deg/s)" 479 "-204.8~204.5 (deg/s)" 480 "-204.8~204.5 (deg/s)" 481 "-204.8~204.5 (deg/s)" 482 "-204.8~204.5 (deg/s)" 483 "-204.8~204.5 (deg/s)" 484 "-204.8~204.5 (deg/s)" 485 "-204.8~204.5 (deg/s)" 486 "-204.8~204.5 (deg/s)" 487 "-204.8~204.5 (deg/s)" 488 "-204.8~204.5 (deg/s)" 489 "-204.8~204.5 (deg/s)" 490 "-204.8~204.5 (deg/s)" 491 "-204.8~204.5 (deg/s)" 492 "-204.8~204.5 (deg/s)" 493 "-204.8~204.5 (deg/s)" 494 "-204.8~204.5 (deg/s)" 495 "-204.8~204.5 (deg/s)" 496 "-204.8~204.5 (deg/s)" 497 "-204.8~204.5 (deg/s)" 498 "-204.8~204.5 (deg/s)" 499 "-204.8~204.5 (deg/s)" 500 "-204.8~204.5 (deg/s)" 501 "-204.8~204.5 (deg/s)" 502 "-204.8~204.5 (deg/s)" 503 "-204.8~204.5 (deg/s)" 504 "-204.8~204.5 (deg/s)" 505 "-204.8~204.5 (deg/s)" 506 "-204.8~204.5 (deg/s)" 507 "-204.8~204.5 (deg/s)" 508 "-204.8~204.5 (deg/s)" 509 "-204.8~204.5 (deg/s)" 510 "-204.8~204.5 (deg/s)" 511 "-204.8~204.5 (deg/s)" 512 "-204.8~204.5 (deg/s)" 513 "-204.8~204.5 (deg/s)" 514 "-204.8~204.5 (deg/s)" 515 "-204.8~204.5 (deg/s)" 516 "-204.8~204.5 (deg/s)" 517 "-204.8~204.5 (deg/s)" 518 "-204.8~204.5 (deg/s)" 519 "-204.8~204.5 (deg/s)" 520 "-204.8~204.5 (deg/s)" 521 "-204.8~204.5 (deg/s)" 522 "-204.8~204.5 (deg/s)" 523 "-204.8~204.5 (deg/s)" 524 "-204.8~204.5 (deg/s)" 525 "-204.8~204.5 (deg/s)" 526 "-204.8~204.5 (deg/s)" 527 "-204.8~204.5 (deg/s)" 528 "-204.8~204.5 (deg/s)" 529 "-204.8~204.5 (deg/s)" 530 "-204.8~204.5 (deg/s)" 531 "-204.8~204.5 (deg/s)" 532 "-204.8~204.5 (deg/s)" 533 "-204.8~204.5 (deg/s)" 534 "-204.8~204.5 (deg/s)" 535 "-204.8~204.5 (deg/s)" 536 "-204.8~204.5 (deg/s)" 537 "-204.8~204.5 (deg/s)" 538 "-204.8~204.5 (deg/s)" 539 "-204.8~204.5 (deg/s)" 540 "-204.8~204.5 (deg/s)" 541 "-204.8~204.5 (deg/s)" 542 "-204.8~204.5 (deg/s)" 543 "-204.8~204.5 (deg/s)" 544 "-204.8~204.5 (deg/s)" 545 "-204.8~204.5 (deg/s)" 546 "-204.8~204.5 (deg/s)" 547 "-204.8~204.5 (deg/s)" 548 "-204.8~204.5 (deg/s)" 549 "-204.8~204.5 (deg/s)" 550 "-204.8~204.5 (deg/s)" 551 "-204.8~204.5 (deg/s)" 552 "-204.8~204.5 (deg/s)" 553 "-204.8~204.5 (deg/s)" 554 "-204.8~204.5 (deg/s)" 555 "-204.8~204.5 (deg/s)" 556 "-204.8~204.5 (deg/s)" 557 "-204.8~204.5 (deg/s)" 558 "-204.8~204.5 (deg/s)" 559 "-204.8~204.5 (deg/s)" 560 "-204.8~204.5 (deg/s)" 561 "-204.8~204.5 (deg/s)" 562 "-204.8~204.5 (deg/s)" 563 "-204.8~204.5 (deg/s)" 564 "-204.8~204.5 (deg/s)" 565 "-204.8~204.5 (deg/s)" 566 "-204.8~204.5 (deg/s)" 567 "-204.8~204.5 (deg/s)" 568 "-204.8~204.5 (deg/s)" 569 "-204.8~204.5 (deg/s)" 570 "-204.8~204.5 (deg/s)" 571 "-204.8~204.5 (deg/s)" 572 "-204.8~204.5 (deg/s)" 573 "-204.8~204.5 (deg/s)" 574 "-204.8~204.5 (deg/s)" 575 "-204.8~204.5 (deg/s)" 576 "-204.8~204.5 (deg/s)" 577 "-204.8~204.5 (deg/s)" 578 "-204.8~204.5 (deg/s)" 579 "-204.8~204.5 (deg/s)" 580 "-204.8~204.5 (deg/s)" 581 "-204.8~204.5 (deg/s)" 582 "-204.8~204.5 (deg/s)" 583 "-204.8~204.5 (deg/s)" 584 "-204.8~204.5 (deg/s)" 585 "-204.8~204.5 (deg/s)" 586 "-204.8~204.5 (deg/s)" 587 "-204.8~204.5 (deg/s)" 588 "-204.8~204.5 (deg/s)" 589 "-204.8~204.5 (deg/s)" 590 "-204.8~204.5 (deg/s)" 591 "-204.8~204.5 (deg/s)" 592 "-204.8~204.5 (deg/s)" 593 "-204.8~204.5 (deg/s)" 594 "-204.8~204.5 (deg/s)" 595 "-204.8~204.5 (deg/s)" 596 "-204.8~204.5 (deg/s)" 597 "-204.8~204.5 (deg/s)" 598 "-204.8~204.5 (deg/s)" 599 "-204.8~204.5 (deg/s)" 600 "-204.8~204.5 (deg/s)" 601 "-204.8~204.5 (deg/s)" 602 "-204.8~204.5 (deg/s)" 603 "-204.8~204.5 (deg/s)" 604 "-204.8~204.5 (deg/s)" 605 "-204.8~204.5 (deg/s)" 606 "-204.8~204.5 (deg/s)" 607 "-204.8~204.5 (deg/s)" 608 "-204.8~204.5 (deg/s)" 609 "-204.8~204.5 (deg/s)" 610 "-204.8~204.5 (deg/s)" 611 "-204.8~204.5 (deg/s)" 612 "-204.8~204.5 (deg/s)" 613 "-204.8~204.5 (deg/s)" 614 "-204.8~204.5 (deg/s)" 615 "-204.8~204.5 (deg/s)" 616 "-204.8~204.5 (deg/s)" 617 "-204.8~204.5 (deg/s)" 618 "-204.8~204.5 (deg/s)" 619 "-204.8~204.5 (deg/s)" 620 "-204.8~204.5 (deg/s)" 621 "-204.8~204.5 (deg/s)" 622 "-204.8~204.5 (deg/s)" 623 "-204.8~204.5 (deg/s)" 624 "-204.8~204.5 (deg/s)" 625 "-204.8~204.5 (deg/s)" 626 "-204.8~204.5 (deg/s)" 627 "-204.8~204.5 (deg/s)" 628 "-204.8~204.5 (deg/s)" 629 "-204.8~204.5 (deg/s)" 630 "-204.8~204.5 (deg/s)" 631 "-204.8~204.5 (deg/s)" 632 "-204.8~204.5 (deg/s)" 633 "-204.8~204.5 (deg/s)" 634 "-204.8~204.5 (deg/s)" 635 "-204.8~204.5 (deg/s)" 636 "-204.8~204.5 (deg/s)" 637 "-204.8~204.5 (deg/s)" 638 "-204.8~204.5 (deg/s)" 639 "-204.8~204.5 (deg/s)" 640 "-204.8~204.5 (deg/s)" 641 "-204.8~204.5 (deg/s)" 642 "-204.8~204.5 (deg/s)" 643 "-204.8~204.5 (deg/s)" 644 "-204.8~204.5 (deg/s)" 645 "-204.8~204.5 (deg/s)" 646 "-204.8~204.5 (deg/s)" 647 "-204.8~204.5 (deg/s)" 648 "-204.8~204.5 (deg/s)" 649 "-204.8~204.5 (deg/s)" 650 "-204.8~204.5 (deg/s)" 651 "-204.8~204.5 (deg/s)" 652 "-204.8~204.5 (deg/s)" 653 "-204.8~204.5 (deg/s)" 654 "-204.8~204.5 (deg/s)" 655 "-204.8~204.5 (deg/s)" 656 "-204.8~204.5 (deg/s)" 657 "-204.8~204.5 (deg/s)" 658 "-204.8~204.5 (deg/s)" 659 "-204.8~204.5 (deg/s)" 660 "-204.8~204.5 (deg/s)" 661 "-204.8~204.5 (deg/s)" 662 "-204.8~204.5 (deg/s)" 663 "-204.8~204.5 (deg/s)" 664 "-204.8~204.5 (deg/s)" 665 "-204.8~204.5 (deg/s)" 666 "-204.8~204.5 (deg/s)" 667 "-204.8~204.5 (deg/s)" 668 "-204.8~204.5 (deg/s)" 669 "-204.8~204.5 (deg/s)" 670 "-204.8~204.5 (deg/s)" 671 "-204.8~204.5 (deg/s)" 672 "-204.8~204.5 (deg/s)" 673 "-204.8~204.5 (deg/s)" 674 "-204.8~204.5 (deg/s)" 675 "-204.8~204.5 (deg/s)" 676 "-204.8~204.5 (deg/s)" 677 "-204.8~204.5 (deg/s)" 678 "-204.8~204.5 (deg/s)" 679 "-204.8~204.5 (deg/s)" 680 "-204.8~204.5 (deg/s)" 681 "-204.8~204.5 (deg/s)" 682 "-204.8~204.5 (deg/s)" 683 "-204.8~204.5 (deg/s)" 684 "-204.8~204.5 (deg/s)" 685 "-204.8~204.5 (deg/s)" 686 "-204.8~204.5 (deg/s)" 687 "-204.8~204.5 (deg/s)" 688 "-204.8~204.5 (deg/s)" 689 "-204.8~204.5 (deg/s)" 690 "-204.8~204.5 (deg/s)" 691 "-204.8~204.5 (deg/s)" 692 "-204.8~204.5 (deg/s)" 693 "-204.8~204.5 (deg/s)" 694 "-204.8~204.5 (deg/s)" 695 "-204.8~204.5 (deg/s)" 696 "-204.8~204.5 (deg/s)" 697 "-204.8~204.5 (deg/s)" 698 "-204.8~204.5 (deg/s)" 699 "-204.8~204.5 (deg/s)" 700 "-204.8~204.5 (deg/s)" 701 "-204.8~204.5 (deg/s)" 702 "-204.8~204.5 (deg/s)" 703 "-204.8~204.5 (deg/s)" 704 "-204.8~204.5 (deg/s)" 705 "-204.8~204.5 (deg/s)" 706 "-204.8~204.5 (deg/s)" 707 "-204.8~204.5 (deg/s)" 708 "-204.8~204.5 (deg/s)" 709 "-204.8~204.5 (deg/s)" 710 "-204.8~204.5 (deg/s)" 711 "-204.8~204.5 (deg/s)" 712 "-204.8~204.5 (deg/s)" 713 "-204.8~204.5 (deg/s)" 714 "-204.8~204.5 (deg/s)" 715 "-204.8~204.5 (deg/s)" 716 "-204.8~204.5 (deg/s)" 717 "-204.8~204.5 (deg/s)" 718 "-204.8~204.5 (deg/s)" 719 "-204.8~204.5 (deg/s)" 720 "-204.8~204.5 (deg/s)" 721 "-204.8~204.5 (deg/s)" 722 "-204.8~204.5 (deg/s)" 723 "-204.8~204.5 (deg/s)" 724 "-204.8~204.5 (deg/s)" 725 "-204.8~204.5 (deg/s)" 726 "-204.8~204.5 (deg/s)" 727 "-204.8~204.5 (deg/s)" 728 "-204.8~204.5 (deg/s)" 729 "-204.8~204.5 (deg/s)" 730 "-204.8~204.5 (deg/s)" 731 "-204.8~204.5 (deg/s)" 732 "-204.8~204.5 (deg/s)" 733 "-204.8~204.5 (deg/s)" 734 "-204.8~204.5 (deg/s)" 735 "-204.8~204.5 (deg/s)" 736 "-204.8~204.5 (deg/s)" 737 "-204.8~204.5 (deg/s)" 738 "-204.8~204.5 (deg/s)" 739 "-204.8~204.5 (deg/s)" 740 "-204.8~204.5 (deg/s)" 741 "-204.8~204.5 (deg/s)" 742 "-204.8~204.5 (deg/s)" 743 "-204.8~204.5 (deg/s)" 744 "-204.8~204.5 (deg/s)" 745 "-204.8~204.5 (deg/s)" 746 "-204.8~204.5 (deg/s)" 747 "-204.8~204.5 (deg/s)" 748 "-204.8~204.5 (deg/s)" 749 "-204.8~204.5 (deg/s)" 750 "-204.8~204.5 (deg/s)" 751 "-204.8~204.5 (deg/s)" 752 "-204.8~204.5 (deg/s)" 753 "-204.8~204.5 (deg/s)" 754 "-204.8~204.5 (deg/s)" 755 "-204.8~204.5 (deg/s)" 756 "-204.8~204.5 (deg/s)" 757 "-204.8~204.5 (deg/s)" 758 "-204.8~204.5 (deg/s)" 759 "-204.8~204.5 (deg/s)" 760 "-204.8~204.5 (deg/s)" 761 "-204.8~204.5 (deg/s)" 762 "-204.8~204.5 (deg/s)" 763 "-204.8~204.5 (deg/s)" 764 "-204.8~204.5 (deg/s)" 765 "-204.8~204.5 (deg/s)" 766 "-204.8~204.5 (deg/s)" 767 "-204.8~204.5 (deg/s)" 768 "-204.8~204.5 (deg/s)" 769 "-204.8~204.5 (deg/s)" 770 "-204.8~204.5 (deg/s)" 771 "-204.8~204.5 (deg/s)" 772 "-204.8~204.5 (deg/s)" 773 "-204.8~204.5 (deg/s)" 774 "-204.8~204.5 (deg/s)" 775 "-204.8~204.5 (deg/s)" 776 "-204.8~204.5 (deg/s)" 777 "-204.8~204.5 (deg/s)" 778 "-204.8~204.5 (deg/s)" 779 "-204.8~204.5 (deg/s)" 780 "-204.8~204.5 (deg/s)" 781 "-204.8~204.5 (deg/s)" 782 "-204.8~204.5 (deg/s)" 783 "-204.8~204.5 (deg/s)" 784 "-204.8~204.5 (deg/s)" 785 "-204.8~204.5 (deg/s)" 786 "-204.8~204.5 (deg/s)" 787 "-204.8~204.5 (deg/s)" 788 "-204.8~204.5 (deg/s)" 789 "-204.8~204.5 (deg/s)" 790 "-204.8~204.5 (deg/s)" 791 "-204.8~204.5 (deg/s)" 792 "-204.8~204.5 (deg/s)" 793 "-204.8~204.5 (deg/s)" 794 "-204.8~204.5 (deg/s)" 795 "-204.8~204.5 (deg/s)" 796 "-204.8~204.5 (deg/s)" 797 "-204.8~204.5 (deg/s)" 798 "-204.8~204.5 (deg/s)" 799 "-204.8~204.5 (deg/s)" 800 "-204.8~204.5 (deg/s)" 801 "-204.8~204.5 (deg/s)" 802 "-204.8~204.5 (deg/s)" 803 "-204.8~204.5 (deg/s)" 804 "-204.8~204.5 (deg/s)" 805 "-204.8~204.5 (deg/s)" 806 "-204.8~204.5 (deg/s)" 807 "-204.8~204.5 (deg/s)" 808 "-204.8~204.5 (deg/s)" 809 "-204.8~204.5 (deg/s)" 810 "-204.8~204.5 (deg/s)" 811 "-204.8~204.5 (deg/s)" 812 "-204.8~204.5 (deg/s)" 813 "-204.8~204.5 (deg/s)" 814 "-204.8~204.5 (deg/s)" 815 "-204.8~204.5 (deg/s)" 816 "-204.8~204.5 (deg/s)" 817 "-204.8~204.5 (deg/s)" 818 "-204.8~204.5 (deg/s)" 819 "-204.8~204.5 (deg/s)" 820 "-204.8~204.5 (deg/s)" 821 "-204.8~204.5 (deg/s)" 822 "-204.8~204.5 (deg/s)" 823 "-204.8~204.5 (deg/s)" 824 "-204.8~204.5 (deg/s)" 825 "-204.8~204.5 (deg/s)" 826 "-204.8~204.5 (deg/s)" 827 "-204.8~204.5 (deg/s)" 828 "-204.8~204.5 (deg/s)" 829 "-204.8~204.5 (deg/s)" 830 "-204.8~204.5 (deg/s)" 831 "-204.8~204.5 (deg/s)" 832 "-204.8~204.5 (deg/s)" 833 "-204.8~204.5 (deg/s)" 834 "-204.8~204.5 (deg/s)" 835 "-204.8~204.5 (deg/s)" 836 "-204.8~204.5 (deg/s)" 837 "-204.8~204.5 (deg/s)" 838 "-204.8~204.5 (deg/s)" 839 "-204.8~204.5 (deg/s)" 840 "-204.8~204.5 (deg/s)" 841 "-204.8~204.5 (deg/s)" 842 "-204.8~204.5 (deg/s)" 843 "-204.8~204.5 (deg/s)" 844 "-204.8~204.5 (deg/s)" 845 "-204.8~204.5 (deg/s)" 846 "-204.8~204.5 (deg/s)" 847 "-204.8~204.5 (deg/s)" 848 "-204.8~204.5 (deg/s)" 849 "-204.8~204.5 (deg/s)" 850 "-204.8~204.5 (deg/s)" 851 "-204.8~204.5 (deg/s)" 852 "-204.8~204.5 (deg/s)" 853 "-204.8~204.5 (deg/s)" 854 "-204.8~204.5 (deg/s)" 855 "-204.8~204.5 (deg/s)" 856 "-204.8~204.5 (deg/s)" 857 "-204.8~204.5 (deg/s)" 858 "-204.8~204.5 (deg/s)" 859 "-204.8~204.5 (deg/s)" 860 "-204.8~204.5 (deg/s)" 861 "-204.8~204.5 (deg/s)" 862 "-204.8~204.5 (deg/s)" 863 "-204.8~204.5 (deg/s)" 864 "-204.8~204.5 (deg/s)" 865 "-204.8~204.5 (deg/s)" 866 "-204.8~204.5 (deg/s)" 867 "-204.8~204.5 (deg/s)" 868 "-204.8~204.5 (deg/s)" 869 "-204.8~204.5 (deg/s)" 870 "-204.8~204.5 (deg/s)" 871 "-204.8~204.5 (deg/s)" 872 "-204.8~204.5 (deg/s)" 873 "-204.8~204.5 (deg/s)" 874 "-204.8~204.5 (deg/s)" 875 "-204.8~204.5 (deg/s)" 876 "-204.8~204.5 (deg/s)" 877 "-204.8~204.5 (deg/s)" 878 "-204.8~204.5 (deg/s)" 879 "-204.8~204.5 (deg/s)" 880 "-204.8~204.5 (deg/s)" 881 "-204.8~204.5 (deg/s)" 882 "-204.8~204.5 (deg/s)" 883 "-204.8~204.5 (deg/s)" 884 "-204.8~204.5 (deg/s)" 885 "-204.8~204.5 (deg/s)" 886 "-204.8~204.5 (deg/s)" 887 "-204.8~204.5 (deg/s)" 888 "-204.8~204.5 (deg/s)" 889 "-204.8~204.5 (deg/s)" 890 "-204.8~204.5 (deg/s)" 891 "-204.8~204.5 (deg/s)" 892 "-204.8~204.5 (deg/s)" 893 "-204.8~204.5 (deg/s)" 894 "-204.8~204.5 (deg/s)" 895 "-204.8~204.5 (deg/s)" 896 "-204.8~204.5 (deg/s)" 897 "-204.8~204.5 (deg/s)" 898 "-204.8~204.5 (deg/s)" 899 "-204.8~204.5 (deg/s)" 900 "-204.8~204.5 (deg/s)" 901 "-204.8~204.5 (deg/s)" 902 "-204.8~204.5 (deg/s)" 903 "-204.8~204.5 (deg/s)" 904 "-204.8~204.5 (deg/s)" 905 "-204.8~204.5 (deg/s)" 906 "-204.8~204.5 (deg/s)" 907 "-204.8~204.5 (deg/s)" 908 "-204.8~204.5 (deg/s)" 909 "-204.8~204.5 (deg/s)" 910 "-204.8~204.5 (deg/s)" 911 "-204.8~204.5 (deg/s)" 912 "-204.8~204.5 (deg/s)" 913 "-204.8~204.5 (deg/s)" 914 "-204.8~204.5 (deg/s)" 915 "-204.8~204.5 (deg/s)" 916 "-204.8~204.5 (deg/s)" 917 "-204.8~204.5 (deg/s)" 918 "-204.8~204.5 (deg/s)" 919 "-204.8~204.5 (deg/s)" 920 "-204.8~204.5 (deg/s)" 921 "-204.8~204.5 (deg/s)" 922 "-204.8~204.5 (deg/s)" 923 "-204.8~204.5 (deg/s)" 924 "-204.8~204.5 (deg/s)" 925 "-204.8~204.5 (deg/s)" 926 "-204.8~204.5 (deg/s)" 927 "-204.8~204.5 (deg/s)" 928 "-204.8~204.5 (deg/s)" 929 "-204.8~204.5 (deg/s)" 930 "-204.8~204.5 (deg/s)" 931 "-204.8~204.5 (deg/s)" 932 "-204.8~204.5 (deg/s)" 933 "-204.8~204.5 (deg/s)" 934 "-204.8~204.5 (deg/s)" 935 "-204.8~204.5 (deg/s)" 936 "-204.8~204.5 (deg/s)" 937 "-204.8~204.5 (deg/s)" 938 "-204.8~204.5 (deg/s)" 939 "-204.8~204.5 (deg/s)" 940 "-204.8~204.5 (deg/s)" 941 "-204.8~204.5 (deg/s)" 942 "-204.8~204.5 (deg/s)" 943 "-204.8~204.5 (deg/s)" 944 "-204.8~204.5 (deg/s)" 945 "-204.8~204.5 (deg/s)" 946 "-204.8~204.5 (deg/s)" 947 "-204.8~204.5 (deg/s)" 948 "-204.8~204.5 (deg/s)" 949 "-204.8~204.5 (deg/s)" 950 "-204.8~204.5 (deg/s)" 951 "-204.8~204.5 (deg/s)" 952 "-204.8~204.5 (deg/s)" 953 "-204.8~204.5 (deg/s)" 954 "-204.8~204.5 (deg/s)" 955 "-204.8~204.5 (deg/s)" 956 "-204.8~204.5 (deg/s)" 957 "-204.8~204.5 (deg/s)" 958 "-204.8~204.5 (deg/s)" 959 "-204.8~204.5 (deg/s)" 960 "-204.8~204.5 (deg/s)" 961 "-204.8~204.5 (deg/s)" 962 "-204.8~204.5 (deg/s)" 963 "-204.8~204.5 (deg/s)" 964 "-204.8~204.5 (deg/s)" 965 "-204.8~204.5 (deg/s)" 966 "-204.8~204.5 (deg/s)" 967 "-204.8~204.5 (deg/s)" 968 "-204.8~204.5 (deg/s)" 969 "-204.8~204.5 (deg/s)" 970 "-204.8~204.5 (deg/s)" 971 "-204.8~204.5 (deg/s)" 972 "-204.8~204.5 (deg/s)" 973 "-204.8~204.5 (deg/s)" 974 "-204.8~204.5 (deg/s)" 975 "-204.8~204.5 (deg/s)" 976 "-204.8~204.5 (deg/s)" 977 "-204.8~204.5 (deg/s)" 978 "-204.8~204.5 (deg/s)" 979 "-204.8~204.5 (deg/s)" 980 "-204.8~204.5 (deg/s)" 981 "-204.8~204.5 (deg/s)" 982 "-204.8~204.5 (deg/s)" 983 "-204.8~204.5 (deg/s)" 984 "-204.8~204.5 (deg/s)" 985 "-204.8~204.5 (deg/s)" 986 "-204.8~204.5 (deg/s)" 987 "-204.8~204.5 (deg/s)" 988 "-204.8~204.5 (deg/s)" 989 "-204.8~204.5 (deg/s)" 990 "-204.8~204.5 (deg/s)" 991 "-204.8~204.5 (deg/s)" 992 "-204.8~204.5 (deg/s)" 993 "-204.8~204.5 (deg/s)" 994 "-204.8~204.5 (deg/s)" 995 "-204.8~204.5 (deg/s)" 996 "-204.8~204.5 (deg/s)" 997 "-204.8~204.5 (deg/s)" 998 "-204.8~204.5 (deg/s)" 999 "-204.8~204.5 (deg/s)" 1000 "-204.8~204.5 (deg/s)" 1001 "-204.8~204.5 (deg/s)" 1002 "-204.8~204.5 (deg/s)" 1003 "-204.8~204.5 (deg/s)" 1004 "-204.8~204.5 (deg/s)" 1005 "-204.8~204.5 (deg/s)" 1006 "-204.8~204.5 (deg/s)" 1007 "-204.8~204.5 (deg/s)" 1008 "-204.8~204.5 (deg/s)" 1009 "-204.8~204.5 (deg/s)" 1010 "-204.8~204.5 (deg/s)" 1011 "-204.8~204.5 (deg/s)" 1012 "-204.8~204.5 (deg/s)" 1013 "-204.8~204.5 (deg/s)" 1014 "-204.8~204.5 (deg/s)" 1015 "-204.8~204.5 (deg/s)" 1016 "-204.8~204.5 (deg/s)" 1017 "-204.8~204.5 (deg/s)" 1018 "-204.8~204.5 (deg/s)" 1019 "-204.8~204.5 (deg/s)" 1020 "-204.8~204.5 (deg/s)" 1021 "-204.8~204.5 (deg/s)" 1022 "-204.8~204.5 (deg/s)" 1023 "-204.8~204.5 (deg/s)" 1024 "-204.8~204.5 (deg/s)" 1025 "-204.8~204.5 (deg/s)" 1026 "-204.8~204.5 (deg/s)" 1027 "-204.8~204.5 (deg/s)" 1028 "-204.8~204.5 (deg/s)" 1029 "-204.8~204.5 (deg/s)" 1030 "-204.8~204.5 (deg/s)" 1031 "-204.8~204.5 (deg/s)" 1032 "-204.8~204.5 (deg/s)" 1033 "-204.8~204.5 (deg/s)" 1034 "-204.8~204.5 (deg/s)" 1035 "-204.8~204.5 (deg/s)" 1036 "-204.8~204.5 (deg/s)" 1037 "-204.8~204.5 (deg/s)" 1038 "-204.8~204.5 (deg/s)" 1039 "-204.8~204.5 (deg/s)" 1040 "-204.8~204.5 (deg/s)" 1041 "-204.8~204.5 (deg/s)" 1042 "-204.8~204.5 (deg/s)" 1043 "-204.8~204.5 (deg/s)" 1044 "-204.8~204.5 (deg/s)" 1045 "-204.8~204.5 (deg/s)" 1046 "-204.8~204.5 (deg/s)" 1047 "-204.8~204.5 (deg/s)" 1048 "-204.8~204.5 (deg/s)" 1049 "-204.8~204.5 (deg/s)" 1050 "-204.8~204.5 (deg/s)" 1051 "-204.8~204.5 (deg/s)" 1052 "-204.8~204.5 (deg/s)" 1053 "-204.8~204.5 (deg/s)" 1054 "-204.8~204.5 (deg/s)" 1055 "-204.8~204.5 (deg/s)" 1056 "-204.8~204.5 (deg/s)" 1057 "-204.8~204.5 (deg/s)" 1058 "-204.8~204.5 (deg/s)" 1059 "-204.8~204.5 (deg/s)" 1060 "-204.8~204.5 (deg/s)" 1061 "-204.8~204.5 (deg/s)" 1062 "-204.8~204.5 (deg/s)" 1063 "-204.8~204.5 (deg/s)" 1064 "-204.8~204.5 (deg/s)" 1065 "-204.8~204.5 (deg/s)" 1066 "-204.8~204.5 (deg/s)" 1067 "-204.8~204.5 (deg/s)" 1068 "-204.8~204.5 (deg/s)" 1069 "-204.8~204.5 (deg/s)" 1070 "-204.8~204.5 (deg/s)" 1071 "-204.8~204.5 (deg/s)" 1072 "-204.8~204.5 (deg/s)" 1073 "-204.8~204.5 (deg/s)" 1074 "-204.8~204.5 (deg/s)" 1075 "-204.8~204.5 (deg/s)" 1076 "-204.8~204.5 (deg/s)" 1077 "-204.8~204.5 (deg/s)" 1078 "-204.8~204.5 (deg/s)" 1079 "-204.8~204.5 (deg/s)" 1080 "-204.8~204.5 (deg/s)" 1081 "-204.8~204.5 (deg/s)" 1082 "-204.8~204.5 (deg/s)" 1083 "-204.8~204.5 (deg/s)" 1084 "-204.8~204.5 (deg/s)" 1085 "-204.8~204.5 (deg/s)" 1086 "-204.8~204.5 (deg/s)" 1087 "-204.8~204.5 (deg/s)" 1088 "-204.8~204.5 (deg/s)" 1089 "-204.8~204.5 (deg/s)" 1090 "-204.8~204.5 (deg/s)" 1091 "-204.8~204.5 (deg/s)" 1092 "-204.8~204.5 (deg/s)" 1093 "-204.8~204.5 (deg/s)" 1094 "-204.8~204.5 (deg/s)" 1095 "-204.8~204.5 (deg/s)" 1096 "-204.8~204.5 (deg/s)" 1097 "-204.8~204.5 (deg/s)" 1098 "-204.8~204.5 (deg/s)" 1099 "-204.8~204.5 (deg/s)" 1100 "-204.8~204.5 (deg/s)" 1101 "-204.8~204.5 (deg/s)" 1102 "-204.8~204.5 (deg/s)" 1103 "-204.8~204.5 (deg/s)" 1104 "-204.8~204.5 (deg/s)" 1105 "-204.8~204.5 (deg/s)" 1106 "-204.8~204.5 (deg/s)" 1107 "-204.8~204.5 (deg/s)" 1108 "-204.8~204.5 (deg/s)" 1109 "-204.8~204.5 (deg/s)" 1110 "-204.8~204.5 (deg/s)" 1111 "-204.8~204.5 (deg/s)" 1112 "-204.8~204.5 (deg/s)" 1113 "-204.8~204.5 (deg/s)" 1114 "-204.8~204.5 (deg/s)" 1115 "-204.8~204.5 (deg/s)" 1116 "-204.8~204.5 (deg/s)" 1117 "-204.8~204.5 (deg/s)" 1118 "-204.8~204.5 (deg/s)" 1119 "-204.8~204.5 (deg/s)" 1120 "-204.8~204.5 (deg/s)" 1121 "-204.8~204.5 (deg/s)" 1122 "-204.8~204.5 (deg/s)" 1123 "-204.8~204.5 (deg/s)" 1124 "-204.8~204.5 (deg/s)" 1125 "-204.8~204.5 (deg/s)" 1126 "-204.8~204.5 (deg/s)" 1127 "-204.8~204.5 (deg/s)" 1128 "-204.8~204.5 (deg/s)" 1129 "-204.8~204.5 (deg/s)" 1130 "-204.8~204.5 (deg/s)" 1131 "-204.8~204.5 (deg/s)" 1132 "-204.8~204.5 (deg/s)" 1133 "-204.8~204.5 (deg/s)" 1134 "-204.8~204.5 (deg/s)" 1135 "-204.8~204.5 (deg/s)" 1136 "-204.8~204.5 (deg/s)" 1137 "-204.8~204.5 (deg/s)" 1138 "-204.8~204.5 (deg/s)" 1139 "-204.8~204.5 (deg/s)" 1140 "-204.8~204.5 (deg/s)" 1141 "-204.8~204.5 (deg/s)" 1142 "-204.8~204.5 (deg/s)" 1143 "-204.8~204.5 (deg/s)" 1144 "-204.8~204.5 (deg/s)" 1145 "-204.8~204.5 (deg/s)" 1146 "-204.8~204.5 (deg/s)" 1147 "-204.8~204.5 (deg/s)" 1148 "-204.8~204.5 (deg/s)" 1149 "-204.8~204.5 (deg/s)" 1150 "-204.8~204.5 (deg/s)" 1151 "-204.8~204.5 (deg/s)" 1152 "-204.8~204.5 (deg/s)" 1153 "-204.8~204.5 (deg/s)" 1154 "-204.8~204.5 (deg/s)" 1155 "-204.8~204.5 (deg/s)" 1156 "-204.8~204.5 (deg/s)" 1157 "-204.8~204.5 (deg/s)" 1158 "-204.8~204.5 (deg/s)" 1159 "-204.8~204.5 (deg/s)" 1160 "-204.8~204.5 (deg/s)" 1161 "-204.8~204.5 (deg/s)" 1162 "-204.8~204.5 (deg/s)" 1163 "-204.8~204.5 (deg/s)" 1164 "-204.8~204.5 (deg/s)" 1165 "-204.8~204.5 (deg/s)" 1166 "-204.8~204.5 (deg/s)" 1167 "-204.8~204.5 (deg/s)" 1168 "-204.8~204.5 (deg/s)" 1169 "-204.8~204.5 (deg/s)" 1170 "-204.8~204.5 (deg/s)" 1171 "-204.8~204.5 (deg/s)" 1172 "-204.8~204.5 (deg/s)" 1173 "-204.8~204.5 (deg/s)" 1174 "-204.8~204.5 (deg/s)" 1175 "-204.8~204.5 (deg/s)" 1176 "-204.8~204.5 (deg/s)" 1177 "-204.8~204.5 (deg/s)" 1178 "-204.8~204.5 (deg/s)" 1179 "-204.8~204.5 (deg/s)" 1180 "-204.8~204.5 (deg/s)" 1181 "-204.8~204.5 (deg/s)" 1182 "-204.8~204.5 (deg/s)" 1183 "-204.8~204.5 (deg/s)" 1184 "-204.8~204.5 (deg/s)" 1185 "-204.8~204.5 (deg/s)" 1186 "-204.8~204.5 (deg/s)" 1187 "-204.8~204.5 (deg/s)" 1188 "-204.8~204.5 (deg/s)" 1189 "-204.8~204.5 (deg/s)" 1190 "-204.8~204.5 (deg/s)" 1191 "-204.8~204.5 (deg/s)" 1192 "-204.8~204.5 (deg/s)" 1193 "-204.8~204.5 (deg/s)" 1194 "-204.8~204.5 (deg/s)" 1195 "-204.8~204.5 (deg/s)" 1196 "-204.8~204.5 (deg/s)" 1197 "-204.8~204.5 (deg/s)" 1198 "-204.8~204.5 (deg/s)" 1199 "-204.8~204.5 (deg/s)" 1200 "-204.8~204.5 (deg/s)" 1201 "-204.8~204.5 (deg/s)" 1202 "-204.8~204.5 (deg/s)" 1203 "-204.8~204.5 (deg/s)" 1204 "-204.8~204.5 (deg/s)" 1205 "-204.8~204.5 (deg/s)" 1206 "-204.8~204.5 (deg/s)" 1207 "-204.8~204.5 (deg/s)" 1208 "-204.8~204.5 (deg/s)" 1209 "-204.8~204.5 (deg/s)" 1210 "-204.8~204.5 (deg/s)" 1211 "-204.8~204.5 (deg/s)" 1212 "-204.8~204.5 (deg/s)" 1213 "-204.8~204.5 (deg/s)" 1214 "-204.8~204.5 (deg/s)" 1215 "-204.8~204.5 (deg/s)" 1216 "-204.8~204.5 (deg/s)" 1217 "-204.8~204.5 (deg/s)" 1218 "-204.8~204.5 (deg/s)" 1219 "-204.8~204.5 (deg/s)" 1220 "-204.8~204.5 (deg/s)" 1221 "-204.8~204.5 (deg/s)" 1222 "-204.8~204.5 (deg/s)" 1223 "-204.8~204.5 (deg/s)" 1224 "-204.8~204.5 (deg/s)" 1225 "-204.8~204.5 (deg/s)" 1226 "-204.8~204.5 (deg/s)" 1227 "-204.8~204.5 (deg/s)" 1228 "-204.8~204.5 (deg/s)" 1229 "-204.8~204.5 (deg/s)" 1230 "-204.8~204.5 (deg/s)" 1231 "-204.8~204.5 (deg/s)" 1232 "-204.8~204.5 (deg/s)" 1233 "-204.8~204.5 (deg/s)" 1234 "-204.8~204.5 (deg/s)" 1235 "-204.8~204.5 (deg/s)" 1236 "-204.8~204.5 (deg/s)" 1237 "-204.8~204.5 (deg/s)" 1238 "-204.8~204.5 (deg/s)" 1239 "-204.8~204.5 (deg/s)" 1240 "-204.8~204.5 (deg/s)" 1241 "-204.8~204.5 (deg/s)" 1242 "-204.8~204.5 (deg/s)" 1243 "-204.8~204.5 (deg/s)" 1244 "-204.8~204.5 (deg/s)" 1245 "-204.8~204.5 (deg/s)" 1246 "-204.8~204.5 (deg/s)" 1247 "-204.8~204.5 (deg/s)" 1248 "-204.8~204.5 (deg/s)" 1249 "-204.8~204.5 (deg/s)" 1250 "-204.8~204.5 (deg/s)" 1251 "-204.8~204.5 (deg/s)" 1252 "-204.8~204.5 (deg/s)" 1253 "-204.8~204.5 (deg/s)" 1254 "-204.8~204.5 (deg/s)" 1255 "-204.8~204.5 (deg/s)" 1256 "-204.8~204.5 (deg/s)" 1257 "-204.8~204.5 (deg/s)" 1258 "-204.8~204.5 (deg/s)" 1259 "-204.8~204.5 (deg/s)" 1260 "-204.8~204.5 (deg/s)" 1261 "-204.8~204.5 (deg/s)" 1262 "-204.8~204.5 (deg/s)" 1263 "-204.8~204.5 (deg/s)" 1264 "-204.8~204.5 (deg/s)" 1265 "-204.8~204.5 (deg/s)" 1266 "-204.8~204.5 (deg/s)" 1267 "-204.8~204.5 (deg/s)" 1268 "-204.8~204.5 (deg/s)" 1269 "-204.8~204.5 (deg/s)" 1270 "-204.8~204.5 (deg/s)" 1271 "-204.8~204.5 (deg/s)" 1272 "-204.8~204.5 (deg/s)" 1273 "-204.8~204.5 (deg/s)" 1274 "-204.8~204.5 (deg/s)" 1275 "-204.8~204.5 (deg/s)" 1276 "-204.8~204.5 (deg/s)" 1277 "-204.8~204.5 (deg/s)" 1278 "-204.8~204.5 (deg/s)" 1279 "-204.8~204.5 (deg/s)" 1280 "-204.8~204.5 (deg/s)" 1281 "-204.8~204.5 (deg/s)" 1282 "-204.8~204.5 (deg/s)" 1283 "-204.8~204.5 (deg/s)" 1284 "-204.8~204.5 (deg/s)" 1285 "-204.8~204.5 (deg/s)" 1286 "-204.8~204.5 (deg/s)" 1287 "-204.8~204.5 (deg/s)" 1288 "-204.8~204.5 (deg/s)" 1289 "-204.8~204.5 (deg/s)" 1290 "-204.8~204.5 (deg/s)" 1291 "-204.8~204.5 (deg/s)" 1292 "-204.8~204.5 (deg/s)" 1293 "-204.8~204.5 (deg/s)" 1294 "-204.8~204.5 (deg/s)" 1295 "-204.8~204.5 (deg/s)" 1296 "-204.8~204.5 (deg/s)" 1297 "-204.8~204.5 (deg/s)" 1298 "-204.8~204.5 (deg/s)" 1299 "-204.8~204.5 (deg/s)" 1300 "-204.8~204.5 (deg/s)" 1301 "-204.8~204.5 (deg/s)" 1302 "-204.8~204.5 (deg/s)" 1303 "-204.8~204.5 (deg/s)" 1304 "-204.8~204.5 (deg/s)" 1305 "-204.8~204.5 (deg/s)" 1306 "-204.8~204.5 (deg/s)" 1307 "-204.8~204.5 (deg/s)" 1308 "-204.8~204.5 (deg/s)" 1309 "-204.8~204.5 (deg/s)" 1310 "-204.8~204.5 (deg/s)" 1311 "-204.8~204.5 (deg/s)" 1312 "-204.8~204.5 (deg/s)" 1313 "-204.8~204.5 (deg/s)" 1314 "-204.8~204.5 (deg/s)" 1315 "-204.8~204.5 (deg/s)" 1316 "-204.8~204.5 (deg/s)" 1317 "-204.8~204.5 (deg/s)" 1318 "-204.8~204.5 (deg/s)" 1319 "-204.8~204.5 (deg/s)" 1320 "-204.8~204.5 (deg/s)" 1321 "-204.8~204.5 (deg/s)" 1322 "-204.8~204.5 (deg/s)" 1323 "-204.8~204.5 (deg/s)" 1324 "-204.8~204.5 (deg/s)" 1325 "-204.8~204.5 (deg/s)" 1326 "-204.8~204.5 (deg/s)" 1327 "-204.8~204.5 (deg/s)" 1328 "-204.8~204.5 (deg/s)" 1329 "-204.8~204.5 (deg/s)" 1330 "-204.8~204.5 (deg/s)" 1331 "-204.8~204.5 (deg/s)" 1332 "-204.8~204.5 (deg/s)" 1333 "-204.8~204.5 (deg/s)" 1334 "-204.8~204.5 (deg/s)" 1335 "-204.8~204.5 (deg/s)" 1336 "-204.8~204.5 (deg/s)" 1337 "-204.8~204.5 (deg/s)" 1338 "-204.8~204.5 (deg/s)" 1339 "-204.8~204.5 (deg/s)" 1340 "-204.8~204.5 (deg/s)" 1341 "-204.8~204.5 (deg/s)" 1342 "-204.8~204.5 (deg/s)" 1343 "-204.8~204.5 (deg/s)" 1344 "-204.8~204.5 (deg/s)" 1345 "-204.8~204.5 (deg/s)" 1346 "-204.8~204.5 (deg/s)" 1347 "-204.8~204.5 (deg/s)" 1348 "-204.8~204.5 (deg/s)" 1349 "-204.8~204.5 (deg/s)" 1350 "-204.8~204.5 (deg/s)" 1351 "-204.8~204.5 (deg/s)" 1352 "-204.8~204.5 (deg/s)" 1353 "-204.8~204.5 (deg/s)" 1354 "-204.8~204.5 (deg/s)" 1355 "-204.8~204.5 (deg/s)" 1356 "-204.8~204.5 (deg/s)" 1357 "-204.8~204.5 (deg/s)" 1358 "-204.8~204.5 (deg/s)" 1359 "-204.8~204.5 (deg/s)" 1360 "-204.8~204.5 (deg/s)" 1361 "-204.8~204.5 (deg/s)" 1362 "-204.8~204.5 (deg/s)" 1363 "-204.8~204.5 (deg/s)" 1364 "-204.8~204.5 (deg/s)" 1365 "-204.8~204.5 (deg/s)" 1366 "-204.8~204.5 (deg/s)" 1367 "-204.8~204.5 (deg/s)" 1368 "-204.8~204.5 (deg/s)" 1369 "-204.8~204.5 (deg/s)" 1370 "-204.8~204.5 (deg/s)" 1371 "-204.8~204.5 (deg/s)" 1372 "-204.8~204.5 (deg/s)" 1373 "-204.8~204.5 (deg/s)" 1374 "-204.8~204.5 (deg/s)" 1375 "-204.8~204.5 (deg/s)" 1376 "-204.8~204.5 (deg/s)" 1377 "-204.8~204.5 (deg/s)" 1378 "-204.8~204.5 (deg/s)" 1379 "-204.8~204.5 (deg/s)" 1380 "-204.8~204.5 (deg/s)" 1381 "-204.8~204.5 (deg/s)" 1382 "-204.8~204.5 (deg/s)" 1383 "-204.8~204.5 (deg/s)" 1384 "-204.8~204.5 (deg/s)" 1385 "-204.8~204.5 (deg/s)" 1386 "-204.8~204.5 (deg/s)" 1387 "-204.8~204.5 (deg/s)" 1388 "-204.8~204.5 (deg/s)" 1389 "-204.8~204.5 (deg/s)" 1390 "-204.8~204.5 (deg/s)" 1391 "-204.8~204.5 (deg/s)" 1392 "-204.8~204.5 (deg/s)" 1393 "-204.8~204.5 (deg/s)" 1394 "-204.8~204.5 (deg/s)" 1395 "-204.8~204.5 (deg/s)" 1396 "-204.8~204.5 (deg/s)" 1397 "-204.8~204.5 (deg/s)" 1398 "-204.8~204.5 (deg/s)" 1399 "-204.8~204.5 (deg/s)" 1400 "-204.8~204.5 (deg/s)" 1401 "-204.8~204.5 (deg/s)" 1402 "-204.8~204.5 (deg/s)" 1403 "-204.8~204.5 (deg/s)" 1404 "-204.8~204.5 (deg/s)" 1405 "-204.8~204.5 (deg/s)" 1406 "-204.8~204.5 (deg/s)" 1407 "-204.8~204.5 (deg/s)" 1408 "-204.8~204.5 (deg/s)" 1409 "-204.8~204.5 (deg/s)" 1410 "-204.8~204.5 (deg/s)" 1411 "-204.8~204.5 (deg/s)" 1412 "-204.8~204.5 (deg/s)" 1413 "-204.8~204.5 (deg/s)" 1414 "-204.8~204.5 (deg/s)" 1415 "-204.8~204.5 (deg/s)" 1416 "-204.8~204.5 (deg/s)" 1417 "-204.8~204.5 (deg/s)" 1418 "-204.8~204.5 (deg/s)" 1419 "-204.8~204.5 (deg/s)" 1420 "-204.8~204.5 (deg/s)" 1421 "-204.8~204.5 (deg/s)" 1422 "-204.8~204.5 (deg/s)" 1423 "-204.8~204.5 (deg/s)" 1424 "-204.8~204.5 (deg/s)" 1425 "-204.8~204.5 (deg/s)" 1426 "-204.8~204.5 (deg/s)" 1427 "-204.8~204.5 (deg/s)" 1428 "-204.8~204.5 (deg/s)" 1429 "-204.8~204.5 (deg/s)" 1430 "-204.8~204.5 (deg/s)" 1431 "-204.8~204.5 (deg/s)" 1432 "-204.8~204.5 (deg/s)" 1433 "-204.8~204.5 (deg/s)" 1434 "-204.8~204.5 (deg/s)" 1435 "-204.8~204.5 (deg/s)" 1436 "-204.8~204.5 (deg/s)" 1437 "-204.8~204.5 (deg/s)" 1438 "-204.8~204.5 (deg/s)" 1439 "-204.8~204.5 (deg/s)" 1440 "-204.8~204.5 (deg/s)" 1441 "-204.8~204.5 (deg/s)" 1442 "-204.8~204.5 (deg/s)" 1443 "-204.8~204.5 (deg/s)" 1444 "-204.8~204.5 (deg/s)" 1445 "-204.8~204.5 (deg/s)" 1446 "-204.8~204.5 (deg/s)" 1447 "-204.8~204.5 (deg/s)" 1448 "-204.8~204.5 (deg/s)" 1449 "-204.8~204.5 (deg/s)" 1450 "-204.8~204.5 (deg/s)" 1451 "-204.8~204.5 (deg/s)" 1452 "-204.8~204.5 (deg/s)" 1453 "-204.8~204.5 (deg/s)" 1454 "-204.8~204.5 (deg/s)" 1455 "-204.8~204.5 (deg/s)" 1456 "-204.8~204.5 (deg/s)" 1457 "-204.8~204.5 (deg/s)" 1458 "-204.8~204.5 (deg/s)" 1459 "-204.8~204.5 (deg/s)" 1460 "-204.8~204.5 (deg/s)" 1461 "-204.8~204.5 (deg/s)" 1462 "-204.8~204.5 (deg/s)" 1463 "-204.8~204.5 (deg/s)" 1464 "-204.8~204.5 (deg/s)" 1465 "-204.8~204.5 (deg/s)" 1466 "-204.8~204.5 (deg/s)" 1467 "-204.8~204.5 (deg/s)" 1468 "-204.8~204.5 (deg/s)" 1469 "-204.8~204.5 (deg/s)" 1470 "-204.8~204.5 (deg/s)" 1471 "-204.8~204.5 (deg/s)" 1472 "-204.8~204.5 (deg/s)" 1473 "-204.8~204.5 (deg/s)" 1474 "-204.8~204.5 (deg/s)" 1475 "-204.8~204.5 (deg/s)" 1476 "-204.8~204.5 (deg/s)" 1477 "-204.8~204.5 (deg/s)" 1478 "-204.8~204.5 (deg/s)" 1479 "-204.8~204.5 (deg/s)" 1480 "-204.8~204.5 (deg/s)" 1481 "-204.8~204.5 (deg/s)" 1482 "-204.8~204.5 (deg/s)" 1483 "-204.8~204.5 (deg/s)" 1484 "-204.8~204.5 (deg/s)" 1485 "-204.8~204.5 (deg/s)" 1486 "-204.8~204.5 (deg/s)" 1487 "-204.8~204.5 (deg/s)" 1488 "-204.8~204.5 (deg/s)" 1489 "-204.8~204.5 (deg/s)" 1490 "-204.8~204.5 (deg/s)" 1491 "-204.8~204.5 (deg/s)" 1492 "-204.8~204.5 (deg/s)" 1493 "-204.8~204.5 (deg/s)" 1494 "-204.8~204.5 (deg/s)" 1495 "-204.8~204.5 (deg/s)" 1496 "-204.8~204.5 (deg/s)" 1497 "-204.8~204.5 (deg/s)" 1498 "-204.8~204.5 (deg/s)" 1499 "-204.8~204.5 (deg/s)" 1500 "-204.8~204.5 (deg/s)" 1501 "-204.8~204.5 (deg/s)" 1502 "-204.8~204.5 (deg/s)" 1503 "-204.8~204.5 (deg/s)" 1504 "-204.8~204.5 (deg/s)" 1505 "-204.8~204.5 (deg/s)" 1506 "-204.8~204.5 (deg/s)" 1507 "-204.8~204.5 (deg/s)" 1508 "-204.8~204.5 (deg/s)" 1509 "-204.8~204.5 (deg/s)" 1510 "-204.8~204.5 (deg/s)" 1511 "-204.8~204.5 (deg/s)" 1512 "-204.8~204.5 (deg/s)" 1513 "-204.8~204.5 (deg/s)" 1514 "-204.8~204.5 (deg/s)" 1515 "-204.8~204.5 (deg/s)" 1516 "-204.8~204.5 (deg/s)" 1517 "-204.8~204.5 (deg/s)" 1518 "-204.8~204.5 (deg/s)" 1519 "-204.8~204.5 (deg/s)" 1520 "-204.8~204.5 (deg/s)" 1521 "-204.8~204.5 (deg/s)" 1522 "-204.8~204.5 (deg/s)" 1523 "-204.8~204.5 (deg/s)" 1524 "-204.8~204.5 (deg/s)" 1525 "-204.8~204.5 (deg/s)" 1526 "-204.8~204.5 (deg/s)" 1527 "-204.8~204.5 (deg/s)" 1528 "-204.8~204.5 (deg/s)" 1529 "-204.8~204.5 (deg/s)" 1530 "-204.8~204.5 (deg/s)" 1531 "-204.8~204.5 (deg/s)" 1532 "-204.8~204.5 (deg/s)" 1533 "-204.8~204.5 (deg/s)" 1534 "-204.8~204.5 (deg/s)" 1535 "-204.8~204.5 (deg/s)" 1536 "-204.8~204.5 (deg/s)" 1537 "-204.8~204.5 (deg/s)" 1538 "-204.8~204.5 (deg/s)" 1539 "-204.8~204.5 (deg/s)" 1540 "-204.8~204.5 (deg/s)" 1541 "-204.8~204.5 (deg/s)" 1542 "-204.8~204.5 (deg/s)" 1543 "-204.8~204.5 (deg/s)" 1544 "-204.8~204.5 (deg/s)" 1545 "-204.8~204.5 (deg/s)" 1546 "-204.8~204.5 (deg/s)" 1547 "-204.8~204.5 (deg/s)" 1548 "-204.8~204.5 (deg/s)" 1549 "-204.8~204.5 (deg/s)" 1550 "-204.8~204.5 (deg/s)" 1551 "-204.8~204.5 (deg/s)" 1552 "-204.8~204.5 (deg/s)" 1553 "-204.8~204.5 (deg/s)" 1554 "-204.8~204.5 (deg/s)" 1555 "-204.8~204.5 (deg/s)" 1556 "-204.8~204.5 (deg/s)" 1557 "-204.8~204.5 (deg/s)" 1558 "-204.8~204.5 (deg/s)" 1559 "-204.8~204.5 (deg/s)" 1560 "-204.8~204.5 (deg/s)" 1561 "-204.8~204.5 (deg/s)" 1562 "-204.8~204.5 (deg/s)" 1563 "-204.8~204.5 (deg/s)" 1564 "-204.8~204.5 (deg/s)" 1565 "-204.8~204.5 (deg/s)" 1566 "-204.8~204.5 (deg/s)" 1567 "-204.8~204.5 (deg/s)" 1568 "-204.8~204.5 (deg/s)" 1569 "-204.8~204.5 (deg/s)" 1570 "-204.8~204.5 (deg/s)" 1571 "-204.8~204.5 (deg/s)" 1572 "-204.8~204.5 (deg/s)" 1573 "-204.8~204.5 (deg/s)" 1574 "-204.8~204.5 (deg/s)" 1575 "-204.8~204.5 (deg/s)" 1576 "-204.8~204.5 (deg/s)" 1577 "-204.8~204.5 (deg/s)" 1578 "-204.8~204.5 (deg/s)" 1579 "-204.8~204.5 (deg/s)" 1580 "-204.8~204.5 (deg/s)" 1581 "-204.8~204.5 (deg/s)" 1582 "-204.8~204.5 (deg/s)" 1583 "-204.8~204.5 (deg/s)" 1584 "-204.8~204.5 (deg/s)" 1585 "-204.8~204.5 (deg/s)" 1586 "-204.8~204.5 (deg/s)" 1587 "-204.8~204.5 (deg/s)" 1588 "-204.8~204.5 (deg/s)" 1589 "-204.8~204.5 (deg/s)" 1590 "-204.8~204.5 (deg/s)" 1591 "-204.8~204.5 (deg/s)" 1592 "-204.8~204.5 (deg/s)" 1593 "-204.8~204.5 (deg/s)" 1594 "-204.8~204.5 (deg/s)" 1595 "-204.8~204.5 (deg/s)" 1596 "-204.8~204.5 (deg/s)" 1597 "-204.8~204.5 (deg/s)" 1598 "-204.8~204.5 (deg/s)" 1599 "-204.8~204.5 (deg/s)" 1600 "-204.8~204.5 (deg/s)" 1601 "-204.8~204.5 (deg/s)" 1602 "-204.8~204.5 (deg/s)" 1603 "-204.8~204.5 (deg/s)" 1604 "-204.8~204.5 (deg/s)" 1605 "-204.8~204.5 (deg/s)" 1606 "-204.8~204.5 (deg/s)" 1607 "-204.8~204.5 (deg/s)" 1608 "-204.8~204.5 (deg/s)" 1609 "-204.8~204.5 (deg/s)" 1610 "-204.8~204.5 (deg/s)" 1611 "-204.8~204.5 (deg/s)" 1612 "-204.8~204.5 (deg/s)" 1613 "-204.8~204.5 (deg/s)" 1614 "-204.8~204.5 (deg/s)" 1615 "-204.8~204.5 (deg/s)" 1616 "-204.8~204.5 (deg/s)" 1617 "-204.8~204.5 (deg/s)" 1618 "-204.8~204.5 (deg/s)" 1619 "-204.8~204.5 (deg/s)" 1620 "-204.8~204.5 (deg/s)" 1621 "-204.8~204.5 (deg/s)" 1622 "-204.8~204.5 (deg/s)" 1623 "-204.8~204.5 (deg/s)" 1624 "-204.8~204.5 (deg/s)" 1625 "-204.8~204.5 (deg/s)" 1626 "-204.8~204.5 (deg/s)" 1627 "-204.8~204.5 (deg/s)" 1628 "-204.8~204.5 (deg/s)" 1629 "-204.8~204.5 (deg/s)" 1630 "-204.8~204.5 (deg/s)" 1631 "-204.8~204.5 (deg/s)" 1632 "-204.8~204.5 (deg/s)" 1633 "-204.8~204.5 (deg/s)" 1634 "-204.8~204.5 (deg/s)" 1635 "-204.8~204.5 (deg/s)" 1636 "-204.8~204.5 (deg/s)" 1637 "-204.8~204.5 (deg/s)" 1638 "-204.8~204.5 (deg/s)" 1639 "-204.8~204.5 (deg/s)" 1640 "-204.8~204.5 (deg/s)" 1641 "-204.8~204.5 (deg/s)" 1642 "-204.8~204.5 (deg/s)" 1643 "-204.8~204.5 (deg/s)" 1644 "-204.8~204.5 (deg/s)" 1645 "-204.8~204.5 (deg/s)" 1646 "-204.8~204.5 (deg/s)" 1647 "-204.8~204.5 (deg/s)" 1648 "-204.8~204.5 (deg/s)" 1649 "-204.8~204.5 (deg/s)" 1650 "-204.8~204.5 (deg/s)" 1651 "-204.8~204.5 (deg/s)" 1652 "-204.8~204.5 (deg/s)" 1653 "-204.8~204.5 (deg/s)" 1654 "-204.8~204.5 (deg/s)" 1655 "-204.8~204.5 (deg/s)" 1656 "-204.8~204.5 (deg/s)" 1657 "-204.8~204.5 (deg/s)" 1658 "-204.8~204.5 (deg/s)" 1659 "-204.8~204.5 (deg/s)" 1660 "-204.8~204.5 (deg/s)" 1661 "-204.8~204.5 (deg/s)" 1662 "-204.8~204.5 (deg/s)" 1663 "-204.8~204.5 (deg/s)" 1664 "-204.8~204.5 (deg/s)" 1665 "-204.8~204.5 (deg/s)" 1666 "-204.8~204.5 (deg/s)" 1667 "-204.8~204.5 (deg/s)" 1668 "-204.8~204.5 (deg/s)" 1669 "-204.8~204.5 (deg/s)" 1670 "-204.8~204.5 (deg/s)" 1671 "-204.8~204.5 (deg/s)" 1672 "-204.8~204.5 (deg/s)" 1673 "-204.8~204.5 (deg/s)" 1674 "-204.8~204.5 (deg/s)" 1675 "-204.8~204.5 (deg/s)" 1676 "-204.8~204.5 (deg/s)" 1677 "-204.8~204.5 (deg/s)" 1678 "-204.8~204.5 (deg/s)" 1679 "-204.8~204.5 (deg/s)" 1680 "-204.8~204.5 (deg/s)" 1681 "-204.8~204.5 (deg/s)" 1682 "-204.8~204.5 (deg/s)" 1683 "-204.8~204.5 (deg/s)" 1684 "-204.8~204.5 (deg/s)" 1685 "-204.8~204.5 (deg/s)" 1686 "-204.8~204.5 (deg/s)" 1687 "-204.8~204.5 (deg/s)" 1688 "-204.8~204.5 (deg/s)" 1689 "-204.8~204.5 (deg/s)" 1690 "-204.8~204.5 (deg/s)" 1691 "-204.8~204.5 (deg/s)" 1692 "-204.8~204.5 (deg/s)" 1693 "-204.8~204.5 (deg/s)" 1694 "-204.8~204.5 (deg/s)" 1695 "-204.8~204.5 (deg/s)" 1696 "-204.8~204.5 (deg/s)" 1697 "-204.8~204.5 (deg/s)" 1698 "-204.8~204.5 (deg/s)" 1699 "-204.8~204.5 (deg/s)" 1700 "-204.8~204.5 (deg/s)" 1701 "-204.8~204.5 (deg/s)" 1702 "-204.8~204.5 (deg/s)" 1703 "-204.8~204.5 (deg/s)" 1704 "-204.8~204.5 (deg/s)" 1705 "-204.8~204.5 (deg/s)" 1706 "-204.8~204.5 (deg/s)" 1707 "-204.8~204.5 (deg/s)" 1708 "-204.8~204.5 (deg/s)" 1709 "-204.8~204.5 (deg/s)" 1710 "-204.8~204.5 (deg/s)" 1711 "-204.8~204.5 (deg/s)" 1712 "-204.8~204.5 (deg/s)" 1713 "-204.8~204.5 (deg/s)" 1714 "-204.8~204.5 (deg/s)" 1715 "-204.8~204.5 (deg/s)" 1716 "-204.8~204.5 (deg/s)" 1717 "-204.8~204.5 (deg/s)" 1718 "-204.8~204.5 (deg/s)" 1719 "-204.8~204.5 (deg/s)" 1720 "-204.8~204.5 (deg/s)" 1721 "-204.8~204.5 (deg/s)" 1722 "-204.8~204.5 (deg/s)" 1723 "-204.8~204.5 (deg/s)" 1724 "-204.8~204.5 (deg/s)" 1725 "-204.8~204.5 (deg/s)" 1726 "-204.8~204.5 (deg/s)" 1727 "-204.8~204.5 (deg/s)" 1728 "-204.8~204.5 (deg/s)" 1729 "-204.8~204.5 (deg/s)" 1730 "-204.8~204.5 (deg/s)" 1731 "-204.8~204.5 (deg/s)" 1732 "-204.8~204.5 (deg/s)" 1733 "-204.8~204.5 (deg/s)" 1734 "-204.8~204.5 (deg/s)" 1735 "-204.8~204.5 (deg/s)" 1736 "-204.8~204.5 (deg/s)" 1737 "-204.8~204.5 (deg/s)" 1738 "-204.8~204.5 (deg/s)" 1739 "-204.8~204.5 (deg/s)" 1740 "-204.8~204.5 (deg/s)" 1741 "-204.8~204.5 (deg/s)" 1742 "-204.8~204.5 (deg/s)" 1743 "-204.8~204.5 (deg/s)" 1744 "-204.8~204.5 (deg/s)" 1745 "-204.8~204.5 (deg/s)" 1746 "-204.8~204.5 (deg/s)" 1747 "-204.8~204.5 (deg/s)" 1748 "-204.8~204.5 (deg/s)" 1749 "-204.8~204.5 (deg/s)" 1750 "-204.8~204.5 (deg/s)" 1751 "-204.8~204.5 (deg/s)" 1752 "-204.8~204.5 (deg/s)" 1753 "-204.8~204.5 (deg/s)" 1754 "-204.8~204.5 (deg/s)" 1755 "-204.8~204.5 (deg/s)" 1756 "-204.8~204.5 (deg/s)" 1757 "-204.8~204.5 (deg/s)" 1758 "-204.8~204.5 (deg/s)" 1759 "-204.8~204.5 (deg/s)" 1760 "-204.8~204.5 (deg/s)" 1761 "-204.8~204.5 (deg/s)" 1762 "-204.8~204.5 (deg/s)" 1763 "-204.8~204.5 (deg/s)" 1764 "-204.8~204.5 (deg/s)" 1765 "-204.8~204.5 (deg/s)" 1766 "-204.8~204.5 (deg/s)" 1767 "-204.8~204.5 (deg/s)" 1768 "-204.8~204.5 (deg/s)" 1769 "-204.8~204.5 (deg/s)" 1770 "-204.8~204.5 (deg/s)" 1771 "-204.8~204.5 (deg/s)" 1772 "-204.8~204.5 (deg/s)" 1773 "-204.8~204.5 (deg/s)" 1774 "-204.8~204.5 (deg/s)" 1775 "-204.8~204.5 (deg/s)" 1776 "-204.8~204.5 (deg/s)" 1777 "-204.8~204.5 (deg/s)" 1778 "-204.8~204.5 (deg/s)" 1779 "-204.8~204.5 (deg/s)" 1780 "-204.8~204.5 (deg/s)" 1781 "-204.8~204.5 (deg/s)" 1782 "-204.8~204.5 (deg/s)" 1783 "-204.8~204.5 (deg/s)" 1784 "-204.8~204.5 (deg/s)" 1785 "-204.8~204.5 (deg/s)" 1786 "-204.8~204.5 (deg/s)" 1787 "-204.8~204.5 (deg/s)" 1788 "-204.8~204.5 (deg/s)" 1789 "-204.8~204.5 (deg/s)" 1790 "-204.8~204.5 (deg/s)" 1791 "-204.8~204.5 (deg/s)" 1792 "-204.8~204.5 (deg/s)" 1793 "-204.8~204.5 (deg/s)" 1794 "-204.8~204.5 (deg/s)" 1795 "-204.8~204.5 (deg/s)" 1796 "-204.8~204.5 (deg/s)" 1797 "-204.8~204.5 (deg/s)" 1798 "-204.8~204.5 (deg/s)" 1799 "-204.8~204.5 (deg/s)" 1800 "-204.8~204.5 (deg/s)" 1801 "-204.8~204.5 (deg/s)" 1802 "-204.8~204.5 (deg/s)" 1803 "-204.8~204.5 (deg/s)" 1804 "-204.8~204.5 (deg/s)" 1805 "-204.8~204.5 (deg/s)" 1806 "-204.8~204.5 (deg/s)" 1807 "-204.8~204.5 (deg/s)" 1808 "-204.8~204.5 (deg/s)" 1809 "-204.8~204.5 (deg/s)" 1810 "-204.8~204.5 (deg/s)" 1811 "-204.8~204.5 (deg/s)" 1812 "-204.8~204.5 (deg/s)" 1813 "-204.8~204.5 (deg/s)" 1814 "-204.8~204.5 (deg/s)" 1815 "-204.8~204.5 (deg/s)" 1816 "-204.8~204.5 (deg/s)" 1817 "-204.8~204.5 (deg/s)" 1818 "-204.8~204.5 (deg/s)" 1819 "-204.8~204.5 (deg/s)" 1820 "-204.8~204.5 (deg/s)" 1821 "-204.8~204.5 (deg/s)" 1822 "-204.8~204.5 (deg/s)" 1823 "-204.8~204.5 (deg/s)" 1824 "-204.8~204.5 (deg/s)" 1825 "-204.8~204.5 (deg/s)" 1826 "-204.8~204.5 (deg/s)" 1827 "-204.8~204.5 (deg/s)" 1828 "-204.8~204.5 (deg/s)" 1829 "-204.8~204.5 (deg/s)" 1830 "-204.8~204.5 (deg/s)" 1831 "-204.8~204.5 (deg/s)" 1832 "-204.8~204.5 (deg/s)" 1833 "-204.8~204.5 (deg/s)" 1834 "-204.8~204.5 (deg/s)" 1835 "-204.8~204.5 (deg/s)" 1836 "-204.8~204.5 (deg/s)" 1837 "-204.8~204.5 (deg/s)" 1838 "-204.8~204.5 (deg/s)" 1839 "-204.8~204.5 (deg/s)" 1840 "-204.8~204.5 (deg/s)" 1841 "-204.8~204.5 (deg/s)" 1842 "-204.8~204.5 (deg/s)" 1843 "-204.8~204.5 (deg/s)" 1844 "-204.8~204.5 (deg/s)" 1845 "-204.8~204.5 (deg/s)" 1846 "-204.8~204.5 (deg/s)" 1847 "-204.8~204.5 (deg/s)" 1848 "-204.8~204.5 (deg/s)" 1849 "-204.8~204.5 (deg/s)" 1850 "-204.8~204.5 (deg/s)" 1851 "-204.8~204.5 (deg/s)" 1852 "-204.8~204.5 (deg/s)" 1853 "-204.8~204.5 (deg/s)" 1854 "-204.8~204.5 (deg/s)" 1855 "-204.8~204.5 (deg/s)" 1856 "-204.8~204.5 (deg/s)" 1857 "-204.8~204.5 (deg/s)" 1858 "-204.8~204.5 (deg/s)" 1859 "-204.8~204.5 (deg/s)" 1860 "-204.8~204.5 (deg/s)" 1861 "-204.8~204.5 (deg/s)" 1862 "-204.8~204.5 (deg/s)" 1863 "-204.8~204.5 (deg/s)" 1864 "-204.8~204.5 (deg/s)" 1865 "-204.8~204.5 (deg/s)" 1866 "-204.8~204.5 (deg/s)" 1867 "-204.8~204.5 (deg/s)" 1868 "-204.8~204.5 (deg/s)" 1869 "-204.8~204.5 (deg/s)" 1870 "-204.8~204.5 (deg/s)" 1871 "-204.8~204.5 (deg/s)" 1872 "-204.8~204.5 (deg/s)" 1873 "-204.8~204.5 (deg/s)" 1874 "-204.8~204.5 (deg/s)" 1875 "-204.8~204.5 (deg/s)" 1876 "-204.8~204.5 (deg/s)" 1877 "-204.8~204.5 (deg/s)" 1878 "-204.8~204.5 (deg/s)" 1879 "-204.8~204.5 (deg/s)" 1880 "-204.8~204.5 (deg/s)" 1881 "-204.8~204.5 (deg/s)" 1882 "-204.8~204.5 (deg/s)" 1883 "-204.8~204.5 (deg/s)" 1884 "-204.8~204.5 (deg/s)" 1885 "-204.8~204.5 (deg/s)" 1886 "-204.8~204.5 (deg/s)" 1887 "-204.8~204.5 (deg/s)" 1888 "-204.8~204.5 (deg/s)" 1889 "-204.8~204.5 (deg/s)" 1890 "-204.8~204.5 (deg/s)" 1891 "-204.8~204.5 (deg/s)" 1892 "-204.8~204.5 (deg/s)" 1893 "-204.8~204.5 (deg/s)" 1894 "-204.8~204.5 (deg/s)" 1895 "-204.8~204.5 (deg/s)" 1896 "-204.8~204.5 (deg/s)" 1897 "-204.8~204.5 (deg/s)" 1898 "-204.8~204.5 (deg/s)" 1899 "-204.8~204.5 (deg/s)" 1900 "-204.8~204.5 (deg/s)" 1901 "-204.8~204.5 (deg/s)" 1902 "-204.8~204.5 (deg/s)" 1903 "-204.8~204.5 (deg/s)" 1904 "-204.8~204.5 (deg/s)" 1905 "-204.8~204.5 (deg/s)" 1906 "-204.8~204.5 (deg/s)" 1907 "-204.8~204.5 (deg/s)" 1908 "-204.8~204.5 (deg/s)" 1909 "-204.8~204.5 (deg/s)" 1910 "-204.8~204.5 (deg/s)" 1911 "-204.8~204.5 (deg/s)" 1912 "-204.8~204.5 (deg/s)" 1913 "-204.8~204.5 (deg/s)" 1914 "-204.8~204.5 (deg/s)" 1915 "-204.8~204.5 (deg/s)" 1916 "-204.8~204.5 (deg/s)" 1917 "-204.8~204.5 (deg/s)" 1918 "-204.8~204.5 (deg/s)" 1919 "-204.8~204.5 (deg/s)" 1920 "-204.8~204.5 (deg/s)" 1921 "-204.8~204.5 (deg/s)" 1922 "-204.8~204.5 (deg/s)" 1923 "-204.8~204.5 (deg/s)" 1924 "-204.8~204.5 (deg/s)" 1925 "-204.8~204.5 (deg/s)" 1926 "-204.8~204.5 (deg/s)" 1927 "-204.8~204.5 (deg/s)" 1928 "-204.8~204.5 (deg/s)" 1929 "-204.8~204.5 (deg/s)" 1930 "-204.8~204.5 (deg/s)" 1931 "-204.8~204.5 (deg/s)" 1932 "-204.8~204.5 (deg/s)" 1933 "-204.8~204.5 (deg/s)" 1934 "-204.8~204.5 (deg/s)" 1935 "-204.8~204.5 (deg/s)" 1936 "-204.8~204.5 (deg/s)" 1937 "-204.8~204.5 (deg/s)" 1938 "-204.8~204.5 (deg/s)" 1939 "-204.8~204.5 (deg/s)" 1940 "-204.8~204.5 (deg/s)" 1941 "-204.8~204.5 (deg/s)" 1942 "-204.8~204.5 (deg/s)" 1943 "-204.8~204.5 (deg/s)" 1944 "-204.8~204.5 (deg/s)" 1945 "-204.8~204.5 (deg/s)" 1946 "-204.8~204.5 (deg/s)" 1947 "-204.8~204.5 (deg/s)" 1948 "-204.8~204.5 (deg/s)" 1949 "-204.8~204.5 (deg/s)" 1950 "-204.8~204.5 (deg/s)" 1951 "-204.8~204.5 (deg/s)" 1952 "-204.8~204.5 (deg/s)" 1953 "-204.8~204.5 (deg/s)" 1954 "-204.8~204.5 (deg/s)" 1955 "-204.8~204.5 (deg/s)" 1956 "-204.8~204.5 (deg/s)" 1957 "-204.8~204.5 (deg/s)" 1958 "-204.8~204.5 (deg/s)" 1959 "-204.8~204.5 (deg/s)" 1960 "-204.8~204.5 (deg/s)" 1961 "-204.8~204.5 (deg/s)" 1962 "-204.8~204.5 (deg/s)" 1963 "-204.8~204.5 (deg/s)" 1964 "-204.8~204.5 (deg/s)" 1965 "-204.8~204.5 (deg/s)" 1966 "-204.8~204.5 (deg/s)" 1967 "-204.8~204.5 (deg/s)" 1968 "-204.8~204.5 (deg/s)" 1969 "-204.8~204.5 (deg/s)" 1970 "-204.8~204.5 (deg/s)" 1971 "-204.8~204.5 (deg/s)" 1972 "-204.8~204.5 (deg/s)" 1973 "-204.8~204.5 (deg/s)" 1974 "-204.8~204.5 (deg/s)" 1975 "-204.8~204.5 (deg/s)" 1976 "-204.8~204.5 (deg/s)" 1977 "-204.8~204.5 (deg/s)" 1978 "-204.8~204.5 (deg/s)" 1979 "-204.8~204.5 (deg/s)" 1980 "-204.8~204.5 (deg/s)" 1981 "-204.8~204.5 (deg/s)" 1982 "-204.8~204.5 (deg/s)" 1983 "-204.8~204.5 (deg/s)" 1984 "-204.8~204.5 (deg/s)" 1985 "-204.8~204.5 (deg/s)" 1986 "-204.8~204.5 (deg/s)" 1987 "-204.8~204.5 (deg/s)" 1988 "-204.8~204.5 (deg/s)" 1989 "-204.8~204.5 (deg/s)" 1990 "-204.8~204.5 (deg/s)" 1991 "-204.8~204.5 (deg/s)" 1992 "-204.8~204.5 (deg/s)" 1993 "-204.8~204.5 (deg/s)" 1994 "-204.8~204.5 (deg/s)" 1995 "-204.8~204.5 (deg/s)" 1996 "-204.8~204.5 (deg/s)" 1997 "-204.8~204.5 (deg/s)" 1998 "-204.8~204.5 (deg/s)" 1999 "-204.8~204.5 (deg/s)" 2000 "-204.8~204.5 (deg/s)" 2001 "-204.8~204.5 (deg/s)" 2002 "-204.8~204.5 (deg/s)" 2003 "-204.8~204.5 (deg/s)" 2004 "-204.8~204.5 (deg/s)" 2005 "-204.8~204.5 (deg/s)" 2006 "-204.8~204.5 (deg/s)" 2007 "-204.8~204.5 (deg/s)" 2008 "-204.8~204.5 (deg/s)" 2009 "-204.8~204.5 (deg/s)" 2010 "-204.8~204.5 (deg/s)" 2011 "-204.8~204.5 (deg/s)" 2012 "-204.8~204.5 (deg/s)" 2013 "-204.8~204.5 (deg/s)" 2014 "-204.8~204.5 (deg/s)" 2015 "-204.8~204.5 (deg/s)" 2016 "-204.8~204.5 (deg/s)" 2017 "-204.8~204.5 (deg/s)" 2018 "-204.8~204.5 (deg/s)" 2019 "-204.8~204.5 (deg/s)" 2020 "-204.8~204.5 (deg/s)" 2021 "-204.8~204.5 (deg/s)" 2022 "-204.8~204.5 (deg/s)" 2023 "-204.8~204.5 (deg/s)" 2024 "-204.8~204.5 (deg/s)" 2025 "-204.8~204.5 (deg/s)" 2026 "-204.8~204.5 (deg/s)" 2027 "-204.8~204.5 (deg/s)" 2028 "-204.8~204.5 (deg/s)" 2029 "-204.8~204.5 (deg/s)" 2030 "-204.8~204.5 (deg/s)" 2031 "-204.8~204.5 (deg/s)" 2032 "-204.8~204.5 (deg/s)" 2033 "-204.8~204.5 (deg/s)" 2034 "-204.8~204.5 (deg/s)" 2035 "-204.8~204.5 (deg/s)" 2036 "-204.8~204.5 (deg/s)" 2037 "-204.8~204.5 (deg/s)" 2038 "-204.8~204.5 (deg/s)" 2039 "-204.8~204.5 (deg/s)" 2040 "-204.8~204.5 (deg/s)" 2041 "-204.8~204.5 (deg/s)" 2042 "-204.8~204.5 (deg/s)" 2043 "-204.8~204.5 (deg/s)" 2044 "-204.8~204.5 (deg/s)" 2045 "-204.8~204.5 (deg/s)" 2046 "-204.8~204.5 (deg/s)" 2047 "-204.8~204.5 (deg/s)" 2048 "-204.8~204.5 (deg/s)" 2049 "-204.8~204.5 (deg/s)" 2050 "-204.8~204.5 (deg/s)" 2051 "-204.8~204.5 (deg/s)" 2052 "-204.8~204.5 (deg/s)" 2053 "-204.8~204.5 (deg/s)" 2054 "-204.8~204.5 (deg/s)" 2055 "-204.8~204.5 (deg/s)" 2056 "-204.8~204.5 (deg/s)" 2057 "-204.8~204.5 (deg/s)" 2058 "-204.8~204.5 (deg/s)" 2059 "-204.8~204.5 (deg/s)" 2060 "-204.8~204.5 (deg/s)" 2061 "-204.8~204.5 (deg/s)" 2062 "-204.8~204.5 (deg/s)" 2063 "-204.8~204.5 (deg/s)" 2064 "-204.8~204.5 (deg/s)" 2065 "-204.8~204.5 (deg/s)" 2066 "-204.8~204.5 (deg/s)" 2067 "-204.8~204.5 (deg/s)" 2068 "-204.8~204.5 (deg/s)" 2069 "-204.8~204.5 (deg/s)" 2070 "-204.8~204.5 (deg/s)" 2071 "-204.8~204.5 (deg/s)" 2072 "-204.8~204.5 (deg/s)" 2073 "-204.8~204.5 (deg/s)" 2074 "-204.8~204.5 (deg/s)" 2075 "-204.8~204.5 (deg/s)" 2076 "-204.8~204.5 (deg/s)" 2077 "-204.8~204.5 (deg/s)" 2078 "-204.8~204.5 (deg/s)" 2079 "-204.8~204.5 (deg/s)" 2080 "-204.8~204.5 (deg/s)" 2081 "-204.8~204.5 (deg/s)" 2082 "-204.8~204.5 (deg/s)" 2083 "-204.8~204.5 (deg/s)" 2084 "-204.8~204.5 (deg/s)" 2085 "-204.8~204.5 (deg/s)" 2086 "-204.8~204.5 (deg/s)" 2087 "-204.8~204.5 (deg/s)" 2088 "-204.8~204.5 (deg/s)" 2089 "-204.8~204.5 (deg/s)" 2090 "-204.8~204.5 (deg/s)" 2091 "-204.8~204.5 (deg/s)" 2092 "-204.8~204.5 (deg/s)" 2093 "-204.8~204.5 (deg/s)" 2094 "-204.8~204.5 (deg/s)" 2095 "-204.8~204.5 (deg/s)" 2096 "-204.8~204.5 (deg/s)" 2097 "-204.8~204.5 (deg/s)" 2098 "-204.8~204.5 (deg/s)" 2099 "-204.8~204.5 (deg/s)" 2100 "-204.8~204.5 (deg/s)" 2101 "-204.8~204.5 (deg/s)" 2102 "-204.8~204.5 (deg/s)" 2103 "-204.8~204.5 (deg/s)" 2104 "-204.8~204.5 (deg/s)" 2105 "-204.8~204.5 (deg/s)" 2106 "-204.8~204.5 (deg/s)" 2107 "-204.8~204.5 (deg/s)" 2108 "-204.8~204.5 (deg/s)" 2109 "-204.8~204.5 (deg/s)" 2110 "-204.8~204.5 (deg/s)" 2111 "-204.8~204.5 (deg/s)" 2112 "-204.8~204.5 (deg/s)" 2113 "-204.8~204.5 (deg/s)" 2114 "-204.8~204.5 (deg/s)" 2115 "-204.8~204.5 (deg/s)" 2116 "-204.8~204.5 (deg/s)" 2117 "-204.8~204.5 (deg/s)" 2118 "-204.8~204.5 (deg/s)" 2119 "-204.8~204.5 (deg/s)" 2120 "-204.8~204.5 (deg/s)" 2121 "-204.8~204.5 (deg/s)" 2122 "-204.8~204.5 (deg/s)" 2123 "-204.8~204.5 (deg/s)" 2124 "-204.8~204.5 (deg/s)" 2125 "-204.8~204.5 (deg/s)" 2126 "-204.8~204.5 (deg/s)" 2127 "-204.8~204.5 (deg/s)" 2128 "-204.8~204.5 (deg/s)" 2129 "-204.8~204.5 (deg/s)" 2130 "-204.8~204.5 (deg/s)" 2131 "-204.8~204.5 (deg/s)" 2132 "-204.8~204.5 (deg/s)" 2133 "-204.8~204.5 (deg/s)" 2134 "-204.8~204.5 (deg/s)" 2135 "-204.8~204.5 (deg/s)" 2136 "-204.8~204.5 (deg/s)" 2137 "-204.8~204.5 (deg/s)" 2138 "-204.8~204.5 (deg/s)" 2139 "-204.8~204.5 (deg/s)" 2140 "-204.8~204.5 (deg/s)" 2141 "-204.8~204.5 (deg/s)" 2142 "-204.8~204.5 (deg/s)" 2143 "-204.8~204.5 (deg/s)" 2144 "-204.8~204.5 (deg/s)" 2145 "-204.8~204.5 (deg/s)" 2146 "-204.8~204.5 (deg/s)" 2147 "-204.8~204.5 (deg/s)" 2148 "-204.8~204.5 (deg/s)" 2149 "-204.8~204.5 (deg/s)" 2150 "-204.8~204.5 (deg/s)" 2151 "-204.8~204.5 (deg/s)" 2152 "-204.8~204.5 (deg/s)" 2153 "-204.8~204.5 (deg/s)" 2154 "-204.8~204.5 (deg/s)" 2155 "-204.8~204.5 (deg/s)" 2156 "-204.8~204.5 (deg/s)" 2157 "-204.8~204.5 (deg/s)" 2158 "-204.8~204.5 (deg/s)" 2159 "-204.8~204.5 (deg/s)" 2160 "-204.8~204.5 (deg/s)" 2161 "-204.8~204.5 (deg/s)" 2162 "-204.8~204.5 (deg/s)" 2163 "-204.8~204.5 (deg/s)" 2164 "-204.8~204.5 (deg/s)" 2165 "-204.8~204.5 (deg/s)" 2166 "-204.8~204.5 (deg/s)" 2167 "-204.8~204.5 (deg/s)" 2168 "-204.8~204.5 (deg/s)" 2169 "-204.8~204.5 (deg/s)" 2170 "-204.8~204.5 (deg/s)" 2171 "-204.8~204.5 (deg/s)" 2172 "-204.8~204.5 (deg/s)" 2173 "-204.8~204.5 (deg/s)" 2174 "-204.8~204.5 (deg/s)" 2175 "-204.8~204.5 (deg/s)" 2176 "-204.8~204.5 (deg/s)" 2177 "-204.8~204.5 (deg/s)" 2178 "-204.8~204.5 (deg/s)" 2179 "-204.8~204.5 (deg/s)" 2180 "-204.8~204.5 (deg/s)" 2181 "-204.8~204.5 (deg/s)" 2182 "-204.8~204.5 (deg/s)" 2183 "-204.8~204.5 (deg/s)" 2184 "-204.8~204.5 (deg/s)" 2185 "-204.8~204.5 (deg/s)" 2186 "-204.8~204.5 (deg/s)" 2187 "-204.8~204.5 (deg/s)" 2188 "-204.8~204.5 (deg/s)" 2189 "-204.8~204.5 (deg/s)" 2190 "-204.8~204.5 (deg/s)" 2191 "-204.8~204.5 (deg/s)" 2192 "-204.8~204.5 (deg/s)" 2193 "-204.8~204.5 (deg/s)" 2194 "-204.8~204.5 (deg/s)" 2195 "-204.8~204.5 (deg/s)" 2196 "-204.8~204.5 (deg/s)" 2197 "-204.8~204.5 (deg/s)" 2198 "-204.8~204.5 (deg/s)" 2199 "-204.8~204.5 (deg/s)" 2200 "-204.8~204.5 (deg/s)" 2201 "-204.8~204.5 (deg/s)" 2202 "-204.8~204.5 (deg/s)" 2203 "-204.8~204.5 (deg/s)" 2204 "-204.8~204.5 (deg/s)" 2205 "-204.8~204.5 (deg/s)" 2206 "-204.8~204.5 (deg/s)" 2207 "-204.8~204.5 (deg/s)" 2208 "-204.8~204.5 (deg/s)" 2209 "-204.8~204.5 (deg/s)" 2210 "-204.8~204.5 (deg/s)" 2211 "-204.8~204.5 (deg/s)" 2212 "-204.8~204.5 (deg/s)" 2213 "-204.8~204.5 (deg/s)" 2214 "-204.8~204.5 (deg/s)" 2215 "-204.8~204.5 (deg/s)" 2216 "-204.8~204.5 (deg/s)" 2217 "-204.8~204.5 (deg/s)" 2218 "-204.8~204.5 (deg/s)" 2219 "-204.8~204.5 (deg/s)" 2220 "-204.8~204.5 (deg/s)" 2221 "-204.8~204.5 (deg/s)" 2222 "-204.8~204.5 (deg/s)" 2223 "-204.8~204.5 (deg/s)" 2224 "-204.8~204.5 (deg/s)" 2225 "-204.8~204.5 (deg/s)" 2226 "-204.8~204.5 (deg/s)" 2227 "-204.8~204.5 (deg/s)" 2228 "-204.8~204.5 (deg/s)" 2229 "-204.8~204.5 (deg/s)" 2230 "-204.8~204.5 (deg/s)" 2231 "-204.8~204.5 (deg/s)" 2232 "-204.8~204.5 (deg/s)" 2233 "-204.8~204.5 (deg/s)" 2234 "-204.8~204.5 (deg/s)" 2235 "-204.8~204.5 (deg/s)" 2236 "-204.8~204.5 (deg/s)" 2237 "-204.8~204.5 (deg/s)" 2238 "-204.8~204.5 (deg/s)" 2239 "-204.8~204.5 (deg/s)" 2240 "-204.8~204.5 (deg/s)" 2241 "-204.8~204.5 (deg/s)" 2242 "-204.8~204.5 (deg/s)" 2243 "-204.8~204.5 (deg/s)" 2244 "-204.8~204.5 (deg/s)" 2245 "-204.8~204.5 (deg/s)" 2246 "-204.8~204.5 (deg/s)" 2247 "-204.8~204.5 (deg/s)" 2248 "-204.8~204.5 (deg/s)" 2249 "-204.8~204.5 (deg/s)" 2250 "-204.8~204.5 (deg/s)" 2251 "-204.8~204.5 (deg/s)" 2252 "-204.8~204.5 (deg/s)" 2253 "-204.8~204.5 (deg/s)" 2254 "-204.8~204.5 (deg/s)" 2255 "-204.8~204.5 (deg/s)" 2256 "-204.8~204.5 (deg/s)" 2257 "-204.8~204.5 (deg/s)" 2258 "-204.8~204.5 (deg/s)" 2259 "-204.8~204.5 (deg/s)" 2260 "-204.8~204.5 (deg/s)" 2261 "-204.8~204.5 (deg/s)" 2262 "-204.8~204.5 (deg/s)" 2263 "-204.8~204.5 (deg/s)" 2264 "-204.8~204.5 (deg/s)" 2265 "-204.8~204.5 (deg/s)" 2266 "-204.8~204.5 (deg/s)" 2267 "-204.8~204.5 (deg/s)" 2268 "-204.8~204.5 (deg/s)" 2269 "-204.8~204.5 (deg/s)" 2270 "-204.8~204.5 (deg/s)" 2271 "-204.8~204.5 (deg/s)" 2272 "-204.8~204.5 (deg/s)" 2273 "-204.8~204.5 (deg/s)" 2274 "-204.8~204.5 (deg/s)" 2275 "-204.8~204.5 (deg/s)" 2276 "-204.8~204.5 (deg/s)" 2277 "-204.8~204.5 (deg/s)" 2278 "-204.8~204.5 (deg/s)" 2279 "-204.8~204.5 (deg/s)" 2280 "-204.8~204.5 (deg/s)" 2281 "-204.8~204.5 (deg/s)" 2282 "-204.8~204.5 (deg/s)" 2283 "-204.8~204.5 (deg/s)" 2284 "-204.8~204.5 (deg/s)" 2285 "-204.8~204.5 (deg/s)" 2286 "-204.8~204.5 (deg/s)" 2287 "-204.8~204.5 (deg/s)" 2288 "-204.8~204.5 (deg/s)" 2289 "-204.8~204.5 (deg/s)" 2290 "-204.8~204.5 (deg/s)" 2291 "-204.8~204.5 (deg/s)" 2292 "-204.8~204.5 (deg/s)" 2293 "-204.8~204.5 (deg/s)" 2294 "-204.8~204.5 (deg/s)" 2295 "-204.8~204.5 (deg/s)" 2296 "-204.8~204.5 (deg/s)" 2297 "-204.8~204.5 (deg/s)" 2298 "-204.8~204.5 (deg/s)" 2299 "-204.8~204.5 (deg/s)" 2300 "-204.8~204.5 (deg/s)" 2301 "-204.8~204.5 (deg/s)" 2302 "-204.8~204.5 (deg/s)" 2303 "-204.8~204.5 (deg/s)" 2304 "-204.8~204.5 (deg/s)" 2305 "-204.8~204.5 (deg/s)" 2306 "-204.8~204.5 (deg/s)" 2307 "-204.8~204.5 (deg/s)" 2308 "-204.8~204.5 (deg/s)" 2309 "-204.8~204.5 (deg/s)" 2310 "-204.8~204.5 (deg/s)" 2311 "-204.8~204.5 (deg/s)" 2312 "-204.8~204.5 (deg/s)" 2313 "-204.8~204.5 (deg/s)" 2314 "-204.8~204.5 (deg/s)" 2315 "-204.8~204.5 (deg/s)" 2316 "-204.8~204.5 (deg/s)" 2317 "-204.8~204.5 (deg/s)" 2318 "-204.8~204.5 (deg/s)" 2319 "-204.8~204.5 (deg/s)" 2320 "-204.8~204.5 (deg/s)" 2321 "-204.8~204.5 (deg/s)" 2322 "-204.8~204.5 (deg/s)" 2323 "-204.8~204.5 (deg/s)" 2324 "-204.8~204.5 (deg/s)" 2325 "-204.8~204.5 (deg/s)" 2326 "-204.8~204.5 (deg/s)" 2327 "-204.8~204.5 (deg/s)" 2328 "-204.8~204.5 (deg/s)" 2329 "-204.8~204.5 (deg/s)" 2330 "-204.8~204.5 (deg/s)" 2331 "-204.8~204.5 (deg/s)" 2332 "-204.8~204.5 (deg/s)" 2333 "-204.8~204.5 (deg/s)" 2334 "-204.8~204.5 (deg/s)" 2335 "-204.8~204.5 (deg/s)" 2336 "-204.8~204.5 (deg/s)" 2337 "-204.8~204.5 (deg/s)" 2338 "-204.8~204.5 (deg/s)" 2339 "-204.8~204.5 (deg/s)" 2340 "-204.8~204.5 (deg/s)" 2341 "-204.8~204.5 (deg/s)" 2342 "-204.8~204.5 (deg/s)" 2343 "-204.8~204.5 (deg/s)" 2344 "-204.8~204.5 (deg/s)" 2345 "-204.8~204.5 (deg/s)" 2346 "-204.8~204.5 (deg/s)" 2347 "-204.8~204.5 (deg/s)" 2348 "-204.8~204.5 (deg/s)" 2349 "-204.8~204.5 (deg/s)" 2350 "-204.8~204.5 (deg/s)" 2351 "-204.8~204.5 (deg/s)" 2352 "-204.8~204.5 (deg/s)" 2353 "-204.8~204.5 (deg/s)" 2354 "-204.8~204.5 (deg/s)" 2355 "-204.8~204.5 (deg/s)" 2356 "-204.8~204.5 (deg/s)" 2357 "-204.8~204.5 (deg/s)" 2358 "-204.8~204.5 (deg/s)" 2359 "-204.8~204.5 (deg/s)" 2360 "-204.8~204.5 (deg/s)" 2361 "-204.8~204.5 (deg/s)" 2362 "-204.8~204.5 (deg/s)" 2363 "-204.8~204.5 (deg/s)" 2364 "-204.8~204.5 (deg/s)" 2365 "-204.8~204.5 (deg/s)" 2366 "-204.8~204.5 (deg/s)" 2367 "-204.8~204.5 (deg/s)" 2368 "-204.8~204.5 (deg/s)" 2369 "-204.8~204.5 (deg/s)" 2370 "-204.8~204.5 (deg/s)" 2371 "-204.8~204.5 (deg/s)" 2372 "-204.8~204.5 (deg/s)" 2373 "-204.8~204.5 (deg/s)" 2374 "-204.8~204.5 (deg/s)" 2375 "-204.8~204.5 (deg/s)" 2376 "-204.8~204.5 (deg/s)" 2377 "-204.8~204.5 (deg/s)" 2378 "-204.8~204.5 (deg/s)" 2379 "-204.8~204.5 (deg/s)" 2380 "-204.8~204.5 (deg/s)" 2381 "-204.8~204.5 (deg/s)" 2382 "-204.8~204.5 (deg/s)" 2383 "-204.8~204.5 (deg/s)" 2384 "-204.8~204.5 (deg/s)" 2385 "-204.8~204.5 (deg/s)" 2386 "-204.8~204.5 (deg/s)" 2387 "-204.8~204.5 (deg/s)" 2388 "-204.8~204.5 (deg/s)" 2389 "-204.8~204.5 (deg/s)" 2390 "-204.8~204.5 (deg/s)" 2391 "-204.8~204.5 (deg/s)" 2392 "-204.8~204.5 (deg/s)" 2393 "-204.8~204.5 (deg/s)" 2394 "-204.8~204.5 (deg/s)" 2395 "-204.8~204.5 (deg/s)" 2396 "-204.8~204.5 (deg/s)" 2397 "-204.8~204.5 (deg/s)" 2398 "-204.8~204.5 (deg/s)" 2399 "-204.8~204.5 (deg/s)" 2400 "-204.8~204.5 (deg/s)" 2401 "-204.8~204.5 (deg/s)" 2402 "-204.8~204.5 (deg/s)" 2403 "-204.8~204.5 (deg/s)" 2404 "-204.8~204.5 (deg/s)" 2405 "-204.8~204.5 (deg/s)" 2406 "-204.8~204.5 (deg/s)" 2407 "-204.8~204.5 (deg/s)" 2408 "-204.8~204.5 (deg/s)" 2409 "-204.8~204.5 (deg/s)" 2410 "-204.8~204.5 (deg/s)" 2411 "-204.8~204.5 (deg/s)" 2412 "-204.8~204.5 (deg/s)" 2413 "-204.8~204.5 (deg/s)" 2414 "-204.8~204.5 (deg/s)" 2415 "-204.8~204.5 (deg/s)" 2416 "-204.8~204.5 (deg/s)" 2417 "-204.8~204.5 (deg/s)" 2418 "-204.8~204.5 (deg/s)" 2419 "-204.8~204.5 (deg/s)" 2420 "-204.8~204.5 (deg/s)" 2421 "-204.8~204.5 (deg/s)" 2422 "-204.8~204.5 (deg/s)" 2423 "-204.8~204.5 (deg/s)" 2424 "-204.8~204.5 (deg/s)" 2425 "-204.8~204.5 (deg/s)" 2426 "-204.8~204.5 (deg/s)" 2427 "-204.8~204.5 (deg/s)" 2428 "-204.8~204.5 (deg/s)" 2429 "-204.8~204.5 (deg/s)" 2430 "-204.8~204.5 (deg/s)" 2431 "-204.8~204.5 (deg/s)" 2432 "-204.8~204.5 (deg/s)" 2433 "-204.8~204.5 (deg/s)" 2434 "-204.8~204.5 (deg/s)" 2435 "-204.8~204.5 (deg/s)" 2436 "-204.8~204.5 (deg/s)" 2437 "-204.8~204.5 (deg/s)" 2438 "-204.8~204.5 (deg/s)" 2439 "-204.8~204.5 (deg/s)" 2440 "-204.8~204.5 (deg/s)" 2441 "-204.8~204.5 (deg/s)" 2442 "-204.8~204.5 (deg/s)" 2443 "-204.8~204.5 (deg/s)" 2444 "-204.8~204.5 (deg/s)" 2445 "-204.8~204.5 (deg/s)" 2446 "-204.8~204.5 (deg/s)" 2447 "-204.8~204.5 (deg/s)" 2448 "-204.8~204.5 (deg/s)" 2449 "-204.8~204.5 (deg/s)" 2450 "-204.8~204.5 (deg/s)" 2451 "-204.8~204.5 (deg/s)" 2452 "-204.8~204.5 (deg/s)" 2453 "-204.8~204.5 (deg/s)" 2454 "-204.8~204.5 (deg/s)" 2455 "-204.8~204.5 (deg/s)" 2456 "-204.8~204.5 (deg/s)" 2457 "-204.8~204.5 (deg/s)" 2458 "-204.8~204.5 (deg/s)" 2459 "-204.8~204.5 (deg/s)" 2460 "-204.8~204.5 (deg/s)" 2461 "-204.8~204.5 (deg/s)" 2462 "-204.8~204.5 (deg/s)" 2463 "-204.8~204.5 (deg/s)" 2464 "-204.8~204.5 (deg/s)" 2465 "-204.8~204.5 (deg/s)" 2466 "-204.8~204.5 (deg/s)" 2467 "-204.8~204.5 (deg/s)" 2468 "-204.8~204.5 (deg/s)" 2469 "-204.8~204.5 (deg/s)" 2470 "-204.8~204.5 (deg/s)" 2471 "-204.8~204.5 (deg/s)" 2472 "-204.8~204.5 (deg/s)" 2473 "-204.8~204.5 (deg/s)" 2474 "-204.8~204.5 (deg/s)" 2475 "-204.8~204.5 (deg/s)" 2476 "-204.8~204.5 (deg/s)" 2477 "-204.8~204.5 (deg/s)" 2478 "-204.8~204.5 (deg/s)" 2479 "-204.8~204.5 (deg/s)" 2480 "-204.8~204.5 (deg/s)" 2481 "-204.8~204.5 (deg/s)" 2482 "-204.8~204.5 (deg/s)" 2483 "-204.8~204.5 (deg/s)" 2484 "-204.8~204.5 (deg/s)" 2485 "-204.8~204.5 (deg/s)" 2486 "-204.8~204.5 (deg/s)" 2487 "-204.8~204.5 (deg/s)" 2488 "-204.8~204.5 (deg/s)" 2489 "-204.8~204.5 (deg/s)" 2490 "-204.8~204.5 (deg/s)" 2491 "-204.8~204.5 (deg/s)" 2492 "-204.8~204.5 (deg/s)" 2493 "-204.8~204.5 (deg/s)" 2494 "-204.8~204.5 (deg/s)" 2495 "-204.8~204.5 (deg/s)" 2496 "-204.8~204.5 (deg/s)" 2497 "-204.8~204.5 (deg/s)" 2498 "-204.8~204.5 (deg/s)" 2499 "-204.8~204.5 (deg/s)" 2500 "-204.8~204.5 (deg/s)" 2501 "-204.8~204.5 (deg/s)" 2502 "-204.8~204.5 (deg/s)" 2503 "-204.8~204.5 (deg/s)" 2504 "-204.8~204.5 (deg/s)" 2505 "-204.8~204.5 (deg/s)" 2506 "-204.8~204.5 (deg/s)" 2507 "-204.8~204.5 (deg/s)" 2508 "-204.8~204.5 (deg/s)" 2509 "-204.8~204.5 (deg/s)" 2510 "-204.8~204.5 (deg/s)" 2511 "-204.8~204.5 (deg/s)" 2512 "-204.8~204.5 (deg/s)" 2513 "-204.8~204.5 (deg/s)" 2514 "-204.8~204.5 (deg/s)" 2515 "-204.8~204.5 (deg/s)" 2516 "-204.8~204.5 (deg/s)" 2517 "-204.8~204.5 (deg/s)" 2518 "-204.8~204.5 (deg/s)" 2519 "-204.8~204.5 (deg/s)" 2520 "-204.8~204.5 (deg/s)" 2521 "-204.8~204.5 (deg/s)" 2522 "-204.8~204.5 (deg/s)" 2523 "-204.8~204.5 (deg/s)" 2524 "-204.8~204.5 (deg/s)" 2525 "-204.8~204.5 (deg/s)" 2526 "-204.8~204.5 (deg/s)" 2527 "-204.8~204.5 (deg/s)" 2528 "-204.8~204.5 (deg/s)" 2529 "-204.8~204.5 (deg/s)" 2530 "-204.8~204.5 (deg/s)" 2531 "-204.8~204.5 (deg/s)" 2532 "-204.8~204.5 (deg/s)" 2533 "-204.8~204.5 (deg/s)" 2534 "-204.8~204.5 (deg/s)" 2535 "-204.8~204.5 (deg/s)" 2536 "-204.8~204.5 (deg/s)" 2537 "-204.8~204.5 (deg/s)" 2538 "-204.8~204.5 (deg/s)" 2539 "-204.8~204.5 (deg/s)" 2540 "-204.8~204.5 (deg/s)" 2541 "-204.8~204.5 (deg/s)" 2542 "-204.8~204.5 (deg/s)" 2543 "-204.8~204.5 (deg/s)" 2544 "-204.8~204.5 (deg/s)" 2545 "-204.8~204.5 (deg/s)" 2546 "-204.8~204.5 (deg/s)" 2547 "-204.8~204.5 (deg/s)" 2548 "-204.8~204.5 (deg/s)" 2549 "-204.8~204.5 (deg/s)" 2550 "-204.8~204.5 (deg/s)" 2551 "-204.8~204.5 (deg/s)" 2552 "-204.8~204.5 (deg/s)" 2553 "-204.8~204.5 (deg/s)" 2554 "-204.8~204.5 (deg/s)" 2555 "-204.8~204.5 (deg/s)" 2556 "-204.8~204.5 (deg/s)" 2557 "-204.8~204.5 (deg/s)" 2558 "-204.8~204.5 (deg/s)" 2559 "-204.8~204.5 (deg/s)" 2560 "-204.8~204.5 (deg/s)" 2561 "-204.8~204.5 (deg/s)" 2562 "-204.8~204.5 (deg/s)" 2563 "-204.8~204.5 (deg/s)" 2564 "-204.8~204.5 (deg/s)" 2565 "-204.8~204.5 (deg/s)" 2566 "-204.8~204.5 (deg/s)" 2567 "-204.8~204.5 (deg/s)" 2568 "-204.8~204.5 (deg/s)" 2569 "-204.8~204.5 (deg/s)" 2570 "-204.8~204.5 (deg/s)" 2571 "-204.8~204.5 (deg/s)" 2572 "-204.8~204.5 (deg/s)" 2573 "-204.8~204.5 (deg/s)" 2574 "-204.8~204.5 (deg/s)" 2575 "-204.8~204.5 (deg/s)" 2576 "-204.8~204.5 (deg/s)" 2577 "-204.8~204.5 (deg/s)" 2578 "-204.8~204.5 (deg/s)" 2579 "-204.8~204.5 (deg/s)" 2580 "-204.8~204.5 (deg/s)" 2581 "-204.8~204.5 (deg/s)" 2582 "-204.8~204.5 (deg/s)" 2583 "-204.8~204.5 (deg/s)" 2584 "-204.8~204.5 (deg/s)" 2585 "-204.8~204.5 (deg/s)" 2586 "-204.8~204.5 (deg/s)" 2587 "-204.8~204.5 (deg/s)" 2588 "-204.8~204.5 (deg/s)" 2589 "-204.8~204.5 (deg/s)" 2590 "-204.8~204.5 (deg/s)" 2591 "-204.8~204.5 (deg/s)" 2592 "-204.8~204.5 (deg/s)" 2593 "-204.8~204.5 (deg/s)" 2594 "-204.8~204.5 (deg/s)" 2595 "-204.8~204.5 (deg/s)" 2596 "-204.8~204.5 (deg/s)" 2597 "-204.8~204.5 (deg/s)" 2598 "-204.8~204.5 (deg/s)" 2599 "-204.8~204.5 (deg/s)" 2600 "-204.8~204.5 (deg/s)" 2601 "-204.8~204.5 (deg/s)" 2602 "-204.8~204.5 (deg/s)" 2603 "-204.8~204.5 (deg/s)" 2604 "-204.8~204.5 (deg/s)" 2605 "-204.8~204.5 (deg/s)" 2606 "-204.8~204.5 (deg/s)" 2607 "-204.8~204.5 (deg/s)" 2608 "-204.8~204.5 (deg/s)" 2609 "-204.8~204.5 (deg/s)" 2610 "-204.8~204.5 (deg/s)" 2611 "-204.8~204.5 (deg/s)" 2612 "-204.8~204.5 (deg/s)" 2613 "-204.8~204.5 (deg/s)" 2614 "-204.8~204.5 (deg/s)" 2615 "-204.8~204.5 (deg/s)" 2616 "-204.8~204.5 (deg/s)" 2617 "-204.8~204.5 (deg/s)" 2618 "-204.8~204.5 (deg/s)" 2619 "-204.8~204.5 (deg/s)" 2620 "-204.8~204.5 (deg/s)" 2621 "-204.8~204.5 (deg/s)" 2622 "-204.8~204.5 (deg/s)" 2623 "-204.8~204.5 (deg/s)" 2624 "-204.8~204.5 (deg/s)" 2625 "-204.8~204.5 (deg/s)" 2626 "-204.8~204.5 (deg/s)" 2627 "-204.8~204.5 (deg/s)" 2628 "-204.8~204.5 (deg/s)" 2629 "-204.8~204.5 (deg/s)" 2630 "-204.8~204.5 (deg/s)" 2631 "-204.8~204.5 (deg/s)" 2632 "-204.8~204.5 (deg/s)" 2633 "-204.8~204.5 (deg/s)" 2634 "-204.8~204.5 (deg/s)" 2635 "-204.8~204.5 (deg/s)" 2636 "-204.8~204.5 (deg/s)" 2637 "-204.8~204.5 (deg/s)" 2638 "-204.8~204.5 (deg/s)" 2639 "-204.8~204.5 (deg/s)" 2640 "-204.8~204.5 (deg/s)" 2641 "-204.8~204.5 (deg/s)" 2642 "-204.8~204.5 (deg/s)" 2643 "-204.8~204.5 (deg/s)" 2644 "-204.8~204.5 (deg/s)" 2645 "-204.8~204.5 (deg/s)" 2646 "-204.8~204.5 (deg/s)" 2647 "-204.8~204.5 (deg/s)" 2648 "-204.8~204.5 (deg/s)" 2649 "-204.8~204.5 (deg/s)" 2650 "-204.8~204.5 (deg/s)" 2651 "-204.8~204.5 (deg/s)" 2652 "-204.8~204.5 (deg/s)" 2653 "-204.8~204.5 (deg/s)" 2654 "-204.8~204.5 (deg/s)" 2655 "-204.8~204.5 (deg/s)" 2656 "-204.8~204.5 (deg/s)" 2657 "-204.8~204.5 (deg/s)" 2658 "-204.8~204.5 (deg/s)" 2659 "-204.8~204.5 (deg/s)" 2660 "-204.8~204.5 (deg/s)" 2661 "-204.8~204.5 (deg/s)" 2662 "-204.8~204.5 (deg/s)" 2663 "-204.8~204.5 (deg/s)" 2664 "-204.8~204.5 (deg/s)" 2665 "-204.8~204.5 (deg/s)" 2666 "-204.8~204.5 (deg/s)" 2667 "-204.8~204.5 (deg/s)" 2668 "-204.8~204.5 (deg/s)" 2669 "-204.8~204.5 (deg/s)" 2670 "-204.8~204.5 (deg/s)" 2671 "-204.8~204.5 (deg/s)" 2672 "-204.8~204.5 (deg/s)" 2673 "-204.8~204.5 (deg/s)" 2674 "-204.8~204.5 (deg/s)" 2675 "-204.8~204.5 (deg/s)" 2676 "-204.8~204.5 (deg/s)" 2677 "-204.8~204.5 (deg/s)" 2678 "-204.8~204.5 (deg/s)" 2679 "-204.8~204.5 (deg/s)" 2680 "-204.8~204.5 (deg/s)" 2681 "-204.8~204.5 (deg/s)" 2682 "-204.8~204.5 (deg/s)" 2683 "-204.8~204.5 (deg/s)" 2684 "-204.8~204.5 (deg/s)" 2685 "-204.8~204.5 (deg/s)" 2686 "-204.8~204.5 (deg/s)" 2687 "-204.8~204.5 (deg/s)" 2688 "-204.8~204.5 (deg/s)" 2689 "-204.8~204.5 (deg/s)" 2690 "-204.8~204.5 (deg/s)" 2691 "-204.8~204.5 (deg/s)" 2692 "-204.8~204.5 (deg/s)" 2693 "-204.8~204.5 (deg/s)" 2694 "-204.8~204.5 (deg/s)" 2695 "-204.8~204.5 (deg/s)" 2696 "-204.8~204.5 (deg/s)" 2697 "-204.8~204.5 (deg/s)" 2698 "-204.8~204.5 (deg/s)" 2699 "-204.8~204.5 (deg/s)" 2700 "-204.8~204.5 (deg/s)" 2701 "-204.8~204.5 (deg/s)" 2702 "-204.8~204.5 (deg/s)" 2703 "-204.8~204.5 (deg/s)" 2704 "-204.8~204.5 (deg/s)" 2705 "-204.8~204.5 (deg/s)" 2706 "-204.8~204.5 (deg/s)" 2707 "-204.8~204.5 (deg/s)" 2708 "-204.8~204.5 (deg/s)" 2709 "-204.8~204.5 (deg/s)" 2710 "-204.8~204.5 (deg/s)" 2711 "-204.8~204.5 (deg/s)" 2712 "-204.8~204.5 (deg/s)" 2713 "-204.8~204.5 (deg/s)" 2714 "-204.8~204.5 (deg/s)" 2715 "-204.8~204.5 (deg/s)" 2716 "-204.8~204.5 (deg/s)" 2717 "-204.8~204.5 (deg/s)" 2718 "-204.8~204.5 (deg/s)" 2719 "-204.8~204.5 (deg/s)" 2720 "-204.8~204.5 (deg/s)" 2721 "-204.8~204.5 (deg/s)" 2722 "-204.8~204.5 (deg/s)" 2723 "-204.8~204.5 (deg/s)" 2724 "-204.8~204.5 (deg/s)" 2725 "-204.8~204.5 (deg/s)" 2726 "-204.8~204.5 (deg/s)" 2727 "-204.8~204.5 (deg/s)" 2728 "-204.8~204.5 (deg/s)" 2729 "-204.8~204.5 (deg/s)" 2730 "-204.8~204.5 (deg/s)" 2731 "-204.8~204.5 (deg/s)" 2732 "-204.8~204.5 (deg/s)" 2733 "-204.8~204.5 (deg/s)" 2734 "-204.8~204.5 (deg/s)" 2735 "-204.8~204.5 (deg/s)" 2736 "-204.8~204.5 (deg/s)" 2737 "-204.8~204.5 (deg/s)" 2738 "-204.8~204.5 (deg/s)" 2739 "-204.8~204.5 (deg/s)" 2740 "-204.8~204.5 (deg/s)" 2741 "-204.8~204.5 (deg/s)" 2742 "-204.8~204.5 (deg/s)" 2743 "-204.8~204.5 (deg/s)" 2744 "-204.8~204.5 (deg/s)" 2745 "-204.8~204.5 (deg/s)" 2746 "-204.8~204.5 (deg/s)" 2747 "-204.8~204.5 (deg/s)" 2748 "-204.8~204.5 (deg/s)" 2749 "-204.8~204.5 (deg/s)" 2750 "-204.8~204.5 (deg/s)" 2751 "-204.8~204.5 (deg/s)" 2752 "-204.8~204.5 (deg/s)" 2753 "-204.8~204.5 (deg/s)" 2754 "-204.8~204.5 (deg/s)" 2755 "-204.8~204.5 (deg/s)" 2756 "-204.8~204.5 (deg/s)" 2757 "-204.8~204.5 (deg/s)" 2758 "-204.8~204.5 (deg/s)" 2759 "-204.8~204.5 (deg/s)" 2760 "-204.8~204.5 (deg/s)" 2761 "-204.8~204.5 (deg/s)" 2762 "-204.8~204.5 (deg/s)" 2763 "-204.8~204.5 (deg/s)" 2764 "-204.8~204.5 (deg/s)" 2765 "-204.8~204.5 (deg/s)" 2766 "-204.8~204.5 (deg/s)" 2767 "-204.8~204.5 (deg/s)" 2768 "-204.8~204.5 (deg/s)" 2769 "-204.8~204.5 (deg/s)" 2770 "-204.8~204.5 (deg/s)" 2771 "-204.8~204.5 (deg/s)" 2772 "-204.8~204.5 (deg/s)" 2773 "-204.8~204.5 (deg/s)" 2774 "-204.8~204.5 (deg/s)" 2775 "-204.8~204.5 (deg/s)" 2776 "-204.8~204.5 (deg/s)" 2777 "-204.8~204.5 (deg/s)" 2778 "-204.8~204.5 (deg/s)" 2779 "-204.8~204.5 (deg/s)" 2780 "-204.8~204.5 (deg/s)" 2781 "-204.8~204.5 (deg/s)" 2782 "-204.8~204.5 (deg/s)" 2783 "-204.8~204.5 (deg/s)" 2784 "-204.8~204.5 (deg/s)" 2785 "-204.8~204.5 (deg/s)" 2786 "-204.8~204.5 (deg/s)" 2787 "-204.8~204.5 (deg/s)" 2788 "-204.8~204.5 (deg/s)" 2789 "-204.8~204.5 (deg/s)" 2790 "-204.8~204.5 (deg/s)" 2791 "-204.8~204.5 (deg/s)" 2792 "-204.8~204.5 (deg/s)" 2793 "-204.8~204.5 (deg/s)" 2794 "-204.8~204.5 (deg/s)" 2795 "-204.8~204.5 (deg/s)" 2796 "-204.8~204.5 (deg/s)" 2797 "-204.8~204.5 (deg/s)" 2798 "-204.8~204.5 (deg/s)" 2799 "-204.8~204.5 (deg/s)" 2800 "-204.8~204.5 (deg/s)" 2801 "-204.8~204.5 (deg/s)" 2802 "-204.8~204.5 (deg/s)" 2803 "-204.8~204.5 (deg/s)" 2804 "-204.8~204.5 (deg/s)" 2805 "-204.8~204.5 (deg/s)" 2806 "-204.8~204.5 (deg/s)" 2807 "-204.8~204.5 (deg/s)" 2808 "-204.8~204.5 (deg/s)" 2809 "-204.8~204.5 (deg/s)" 2810 "-204.8~204.5 (deg/s)" 2811 "-204.8~204.5 (deg/s)" 2812 "-204.8~204.5 (deg/s)" 2813 "-204.8~204.5 (deg/s)" 2814 "-204.8~204.5 (deg/s)" 2815 "-204.8~204.5 (deg/s)" 2816 "-204.8~204.5 (deg/s)" 2817 "-204.8~204.5 (deg/s)" 2818 "-204.8~204.5 (deg/s)" 2819 "-204.8~204.5 (deg/s)" 2820 "-204.8~204.5 (deg/s)" 2821 "-204.8~204.5 (deg/s)" 2822 "-204.8~204.5 (deg/s)" 2823 "-204.8~204.5 (deg/s)" 2824 "-204.8~204.5 (deg/s)" 2825 "-204.8~204.5 (deg/s)" 2826 "-204.8~204.5 (deg/s)" 2827 "-204.8~204.5 (deg/s)" 2828 "-204.8~204.5 (deg/s)" 2829 "-204.8~204.5 (deg/s)" 2830 "-204.8~204.5 (deg/s)" 2831 "-204.8~204.5 (deg/s)" 2832 "-204.8~204.5 (deg/s)" 2833 "-204.8~204.5 (deg/s)" 2834 "-204.8~204.5 (deg/s)" 2835 "-204.8~204.5 (deg/s)" 2836 "-204.8~204.5 (deg/s)" 2837 "-204.8~204.5 (deg/s)" 2838 "-204.8~204.5 (deg/s)" 2839 "-204.8~204.5 (deg/s)" 2840 "-204.8~204.5 (deg/s)" 2841 "-204.8~204.5 (deg/s)" 2842 "-204.8~204.5 (deg/s)" 2843 "-204.8~204.5 (deg/s)" 2844 "-204.8~204.5 (deg/s)" 2845 "-204.8~204.5 (deg/s)" 2846 "-204.8~204.5 (deg/s)" 2847 "-204.8~204.5 (deg/s)" 2848 "-204.8~204.5 (deg/s)" 2849 "-204.8~204.5 (deg/s)" 2850 "-204.8~204.5 (deg/s)" 2851 "-204.8~204.5 (deg/s)" 2852 "-204.8~204.5 (deg/s)" 2853 "-204.8~204.5 (deg/s)" 2854 "-204.8~204.5 (deg/s)" 2855 "-204.8~204.5 (deg/s)" 2856 "-204.8~204.5 (deg/s)" 2857 "-204.8~204.5 (deg/s)" 2858 "-204.8~204.5 (deg/s)" 2859 "-204.8~204.5 (deg/s)" 2860 "-204.8~204.5 (deg/s)" 2861 "-204.8~204.5 (deg/s)" 2862 "-204.8~204.5 (deg/s)" 2863 "-204.8~204.5 (deg/s)" 2864 "-204.8~204.5 (deg/s)" 2865 "-204.8~204.5 (deg/s)" 2866 "-204.8~204.5 (deg/s)" 2867 "-204.8~204.5 (deg/s)" 2868 "-204.8~204.5 (deg/s)" 2869 "-204.8~204.5 (deg/s)" 2870 "-204.8~204.5 (deg/s)" 2871 "-204.8~204.5 (deg/s)" 2872 "-204.8~204.5 (deg/s)" 2873 "-204.8~204.5 (deg/s)" 2874 "-204.8~204.5 (deg/s)" 2875 "-204.8~204.5 (deg/s)" 2876 "-204.8~204.5 (deg/s)" 2877 "-204.8~204.5 (deg/s)" 2878 "-204.8~204.5 (deg/s)" 2879 "-204.8~204.5 (deg/s)" 2880 "-204.8~204.5 (deg/s)" 2881 "-204.8~204.5 (deg/s)" 2882 "-204.8~204.5 (deg/s)" 2883 "-204.8~204.5 (deg/s)" 2884 "-204.8~204.5 (deg/s)" 2885 "-204.8~204.5 (deg/s)" 2886 "-204.8~204.5 (deg/s)" 2887 "-204.8~204.5 (deg/s)" 2888 "-204.8~204.5 (deg/s)" 2889 "-204.8~204.5 (deg/s)" 2890 "-204.8~204.5 (deg/s)" 2891 "-204.8~204.5 (deg/s)" 2892 "-204.8~204.5 (deg/s)" 2893 "-204.8~204.5 (deg/s)" 2894 "-204.8~204.5 (deg/s)" 2895 "-204.8~204.5 (deg/s)" 2896 "-204.8~204.5 (deg/s)" 2897 "-204.8~204.5 (deg/s)" 2898 "-204.8~204.5 (deg/s)" 2899 "-204.8~204.5 (deg/s)" 2900 "-204.8~204.5 (deg/s)" 2901 "-204.8~204.5 (deg/s)" 2902 "-204.8~204.5 (deg/s)" 2903 "-204.8~204.5 (deg/s)" 2904 "-204.8~204.5 (deg/s)" 2905 "-204.8~204.5 (deg/s)" 2906 "-204.8~204.5 (deg/s)" 2907 "-204.8~204.5 (deg/s)" 2908 "-204.8~204.5 (deg/s)" 2909 "-204.8~204.5 (deg/s)" 2910 "-204.8~204.5 (deg/s)" 2911 "-204.8~204.5 (deg/s)" 2912 "-204.8~204.5 (deg/s)" 2913 "-204.8~204.5 (deg/s)" 2914 "-204.8~204.5 (deg/s)" 2915 "-204.8~204.5 (deg/s)" 2916 "-204.8~204.5 (deg/s)" 2917 "-204.8~204.5 (deg/s)" 2918 "-204.8~204.5 (deg/s)" 2919 "-204.8~204.5 (deg/s)" 2920 "-204.8~204.5 (deg/s)" 2921 "-204.8~204.5 (deg/s)" 2922 "-204.8~204.5 (deg/s)" 2923 "-204.8~204.5 (deg/s)" 2924 "-204.8~204.5 (deg/s)" 2925 "-204.8~204.5 (deg/s)" 2926 "-204.8~204.5 (deg/s)" 2927 "-204.8~204.5 (deg/s)" 2928 "-204.8~204.5 (deg/s)" 2929 "-204.8~204.5 (deg/s)" 2930 "-204.8~204.5 (deg/s)" 2931 "-204.8~204.5 (deg/s)" 2932 "-204.8~204.5 (deg/s)" 2933 "-204.8~204.5 (deg/s)" 2934 "-204.8~204.5 (deg/s)" 2935 "-204.8~204.5 (deg/s)" 2936 "-204.8~204.5 (deg/s)" 2937 "-204.8~204.5 (deg/s)" 2938 "-204.8~204.5 (deg/s)" 2939 "-204.8~204.5 (deg/s)" 2940 "-204.8~204.5 (deg/s)" 2941 "-204.8~204.5 (deg/s)" 2942 "-204.8~204.5 (deg/s)" 2943 "-204.8~204.5 (deg/s)" 2944 "-204.8~204.5 (deg/s)" 2945 "-204.8~204.5 (deg/s)" 2946 "-204.8~204.5 (deg/s)" 2947 "-204.8~204.5 (deg/s)" 2948 "-204.8~204.5 (deg/s)" 2949 "-204.8~204.5 (deg/s)" 2950 "-204.8~204.5 (deg/s)" 2951 "-204.8~204.5 (deg/s)" 2952 "-204.8~204.5 (deg/s)" 2953 "-204.8~204.5 (deg/s)" 2954 "-204.8~204.5 (deg/s)" 2955 "-204.8~204.5 (deg/s)" 2956 "-204.8~204.5 (deg/s)" 2957 "-204.8~204.5 (deg/s)" 2958 "-204.8~204.5 (deg/s)" 2959 "-204.8~204.5 (deg/s)" 2960 "-204.8~204.5 (deg/s)" 2961 "-204.8~204.5 (deg/s)" 2962 "-204.8~204.5 (deg/s)" 2963 "-204.8~204.5 (deg/s)" 2964 "-204.8~204.5 (deg/s)" 2965 "-204.8~204.5 (deg/s)" 2966 "-204.8~204.5 (deg/s)" 2967 "-204.8~204.5 (deg/s)" 2968 "-204.8~204.5 (deg/s)" 2969 "-204.8~204.5 (deg/s)" 2970 "-204.8~204.5 (deg/s)" 2971 "-204.8~204.5 (deg/s)" 2972 "-204.8~204.5 (deg/s)" 2973 "-204.8~204.5 (deg/s)" 2974 "-204.8~204.5 (deg/s)" 2975 "-204.8~204.5 (deg/s)" 2976 "-204.8~204.5 (deg/s)" 2977 "-204.8~204.5 (deg/s)" 2978 "-204.8~204.5 (deg/s)" 2979 "-204.8~204.5 (deg/s)" 2980 "-204.8~204.5 (deg/s)" 2981 "-204.8~204.5 (deg/s)" 2982 "-204.8~204.5 (deg/s)" 2983 "-204.8~204.5 (deg/s)" 2984 "-204.8~204.5 (deg/s)" 2985 "-204.8~204.5 (deg/s)" 2986 "-204.8~204.5 (deg/s)" 2987 "-204.8~204.5 (deg/s)" 2988 "-204.8~204.5 (deg/s)" 2989 "-204.8~204.5 (deg/s)" 2990 "-204.8~204.5 (deg/s)" 2991 "-204.8~204.5 (deg/s)" 2992 "-204.8~204.5 (deg/s)" 2993 "-204.8~204.5 (deg/s)" 2994 "-204.8~204.5 (deg/s)" 2995 "-204.8~204.5 (deg/s)" 2996 "-204.8~204.5 (deg/s)" 2997 "-204.8~204.5 (deg/s)" 2998 "-204.8~204.5 (deg/s)" 2999 "-204.8~204.5 (deg/s)" 3000 "-204.8~204.5 (deg/s)" 3001 "-204.8~204.5 (deg/s)" 3002 "-204.8~204.5 (deg/s)" 3003 "-204.8~204.5 (deg/s)" 3004 "-204.8~204.5 (deg/s)" 3005 "-204.8~204.5 (deg/s)" 3006 "-204.8~204.5 (deg/s)" 3007 "-204.8~204.5 (deg/s)" 3008 "-204.8~204.5 (deg/s)" 3009 "-204.8~204.5 (deg/s)" 3010 "-204.8~204.5 (deg/s)" 3011 "-204.8~204.5 (deg/s)" 3012 "-204.8~204.5 (deg/s)" 3013 "-204.8~204.5 (deg/s)" 3014 "-204.8~204.5 (deg/s)" 3015 "-204.8~204.5 (deg/s)" 3016 "-204.8~204.5 (deg/s)" 3017 "-204.8~204.5 (deg/s)" 3018 "-204.8~204.5 (deg/s)" 3019 "-204.8~204.5 (deg/s)" 3020 "-204.8~204.5 (deg/s)" 3021 "-204.8~204.5 (deg/s)" 3022 "-204.8~204.5 (deg/s)" 3023 "-204.8~204.5 (deg/s)" 3024 "-204.8~204.5 (deg/s)" 3025 "-204.8~204.5 (deg/s)" 3026 "-204.8~204.5 (deg/s)" 3027 "-204.8~204.5 (deg/s)" 3028 "-204.8~204.5 (deg/s)" 3029 "-204.8~204.5 (deg/s)" 3030 "-204.8~204.5 (deg/s)" 3031 "-204.8~204.5 (deg/s)" 3032 "-204.8~204.5 (deg/s)" 3033 "-204.8~204.5 (deg/s)" 3034 "-204.8~204.5 (deg/s)" 3035 "-204.8~204.5 (deg/s)" 3036 "-204.8~204.5 (deg/s)" 3037 "-204.8~204.5 (deg/s)" 3038 "-204.8~204.5 (deg/s)" 3039 "-204.8~204.5 (deg/s)" 3040 "-204.8~204.5 (deg/s)" 3041 "-204.8~204.5 (deg/s)" 3042 "-204.8~204.5 (deg/s)" 3043 "-204.8~204.5 (deg/s)" 3044 "-204.8~204.5 (deg/s)" 3045 "-204.8~204.5 (deg/s)" 3046 "-204.8~204.5 (deg/s)" 3047 "-204.8~204.5 (deg/s)" 3048 "-204.8~204.5 (deg/s)" 3049 "-204.8~204.5 (deg/s)" 3050 "-204.8~204.5 (deg/s)" 3051 "-204.8~204.5 (deg/s)" 3052 "-204.8~204.5 (deg/s)" 3053 "-204.8~204.5 (deg/s)" 3054 "-204.8~204.5 (deg/s)" 3055 "-204.8~204.5 (deg/s)" 3056 "-204.8~204.5 (deg/s)" 3057 "-204.8~204.5 (deg/s)" 3058 "-204.8~204.5 (deg/s)" 3059 "-204.8~204.5 (deg/s)" 3060 "-204.8~204.5 (deg/s)" 3061 "-204.8~204.5 (deg/s)" 3062 "-204.8~204.5 (deg/s)" 3063 "-204.8~204.5 (deg/s)" 3064 "-204.8~204.5 (deg/s)" 3065 "-204.8~204.5 (deg/s)" 3066 "-204.8~204.5 (deg/s)" 3067 "-204.8~204.5 (deg/s)" 3068 "-204.8~204.5 (deg/s)" 3069 "-204.8~204.5 (deg/s)" 3070 "-204.8~204.5 (deg/s)" 3071 "-204.8~204.5 (deg/s)" 3072 "-204.8~204.5 (deg/s)" 3073 "-204.8~204.5 (deg/s)" 3074 "-204.8~204.5 (deg/s)" 3075 "-204.8~204.5 (deg/s)" 3076 "-204.8~204.5 (deg/s)" 3077 "-204.8~204.5 (deg/s)" 3078 "-204.8~204.5 (deg/s)" 3079 "-204.8~204.5 (deg/s)" 3080 "-204.8~204.5 (deg/s)" 3081 "-204.8~204.5 (deg/s)" 3082 "-204.8~204.5 (deg/s)" 3083 "-204.8~204.5 (deg/s)" 3084 "-204.8~204.5 (deg/s)" 3085 "-204.8~204.5 (deg/s)" 3086 "-204.8~204.5 (deg/s)" 3087 "-204.8~204.5 (deg/s)" 3088 "-204.8~204.5 (deg/s)" 3089 "-204.8~204.5 (deg/s)" 3090 "-204.8~204.5 (deg/s)" 3091 "-204.8~204.5 (deg/s)" 3092 "-204.8~204.5 (deg/s)" 3093 "-204.8~204.5 (deg/s)" 3094 "-204.8~204.5 (deg/s)" 3095 "-204.8~204.5 (deg/s)" 3096 "-204.8~204.5 (deg/s)" 3097 "-204.8~204.5 (deg/s)" 3098 "-204.8~204.5 (deg/s)" 3099 "-204.8~204.5 (deg/s)" 3100 "-204.8~204.5 (deg/s)" 3101 "-204.8~204.5 (deg/s)" 3102 "-204.8~204.5 (deg/s)" 3103 "-204.8~204.5 (deg/s)" 3104 "-204.8~204.5 (deg/s)" 3105 "-204.8~204.5 (deg/s)" 3106 "-204.8~204.5 (deg/s)" 3107 "-204.8~204.5 (deg/s)" 3108 "-204.8~204.5 (deg/s)" 3109 "-204.8~204.5 (deg/s)" 3110 "-204.8~204.5 (deg/s)" 3111 "-204.8~204.5 (deg/s)" 3112 "-204.8~204.5 (deg/s)" 3113 "-204.8~204.5 (deg/s)" 3114 "-204.8~204.5 (deg/s)" 3115 "-204.8~204.5 (deg/s)" 3116 "-204.8~204.5 (deg/s)" 3117 "-204.8~204.5 (deg/s)" 3118 "-204.8~204.5 (deg/s)" 3119 "-204.8~204.5 (deg/s)" 3120 "-204.8~204.5 (deg/s)" 3121 "-204.8~204.5 (deg/s)" 3122 "-204.8~204.5 (deg/s)" 3123 "-204.8~204.5 (deg/s)" 3124 "-204.8~204.5 (deg/s)" 3125 "-204.8~204.5 (deg/s)" 3126 "-204.8~204.5 (deg/s)" 3127 "-204.8~204.5 (deg/s)" 3128 "-204.8~204.5 (deg/s)" 3129 "-204.8~204.5 (deg/s)" 3130 "-204.8~204.5 (deg/s)" 3131 "-204.8~204.5 (deg/s)" 3132 "-204.8~204.5 (deg/s)" 3133 "-204.8~204.5 (deg/s)" 3134 "-204.8~204.5 (deg/s)" 3135 "-204.8~204.5 (deg/s)" 3136 "-204.8~204.5 (deg/s)" 3137 "-204.8~204.5 (deg/s)" 3138 "-204.8~204.5 (deg/s)" 3139 "-204.8~204.5 (deg/s)" 3140 "-204.8~204.5 (deg/s)" 3141 "-204.8~204.5 (deg/s)" 3142 "-204.8~204.5 (deg/s)" 3143 "-204.8~204.5 (deg/s)" 3144 "-204.8~204.5 (deg/s)" 3145 "-204.8~204.5 (deg/s)" 3146 "-204.8~204.5 (deg/s)" 3147 "-204.8~204.5 (deg/s)" 3148 "-204.8~204.5 (deg/s)" 3149 "-204.8~204.5 (deg/s)" 3150 "-204.8~204.5 (deg/s)" 3151 "-204.8~204.5 (deg/s)" 3152 "-204.8~204.5 (deg/s)" 3153 "-204.8~204.5 (deg/s)" 3154 "-204.8~204.5 (deg/s)" 3155 "-204.8~204.5 (deg/s)" 3156 "-204.8~204.5 (deg/s)" 3157 "-204.8~204.5 (deg/s)" 3158 "-204.8~204.5 (deg/s)" 3159 "-204.8~204.5 (deg/s)" 3160 "-204.8~204.5 (deg/s)" 3161 "-204.8~204.5 (deg/s)" 3162 "-204.8~204.5 (deg/s)" 3163 "-204.8~204.5 (deg/s)" 3164 "-204.8~204.5 (deg/s)" 3165 "-204.8~204.5 (deg/s)" 3166 "-204.8~204.5 (deg/s)" 3167 "-204.8~204.5 (deg/s)" 3168 "-204.8~204.5 (deg/s)" 3169 "-204.8~204.5 (deg/s)" 3170 "-204.8~204.5 (deg/s)" 3171 "-204.8~204.5 (deg/s)" 3172 "-204.8~204.5 (deg/s)" 3173 "-204.8~204.5 (deg/s)" 3174 "-204.8~204.5 (deg/s)" 3175 "-204.8~204.5 (deg/s)" 3176 "-204.8~204.5 (deg/s)" 3177 "-204.8~204.5 (deg/s)" 3178 "-204.8~204.5 (deg/s)" 3179 "-204.8~204.5 (deg/s)" 3180 "-204.8~204.5 (deg/s)" 3181 "-204.8~204.5 (deg/s)" 3182 "-204.8~204.5 (deg/s)" 3183 "-204.8~204.5 (deg/s)" 3184 "-204.8~204.5 (deg/s)" 3185 "-204.8~204.5 (deg/s)" 3186 "-204.8~204.5 (deg/s)" 3187 "-204.8~204.5 (deg/s)" 3188 "-204.8~204.5 (deg/s)" 3189 "-204.8~204.5 (deg/s)" 3190 "-204.8~204.5 (deg/s)" 3191 "-204.8~204.5 (deg/s)" 3192 "-204.8~204.5 (deg/s)" 3193 "-204.8~204.5 (deg/s)" 3194 "-204.8~204.5 (deg/s)" 3195 "-204.8~204.5 (deg/s)" 3196 "-204.8~204.5 (deg/s)" 3197 "-204.8~204.5 (deg/s)" 3198 "-204.8~204.5 (deg/s)" 3199 "-204.8~204.5 (deg/s)" 3200 "-204.8~204.5 (deg/s)" 3201 "-204.8~204.5 (deg/s)" 3202 "-204.8~204.5 (deg/s)" 3203 "-204.8~204.5 (deg/s)" 3204 "-204.8~204.5 (deg/s)" 3205 "-204.8~204.5 (deg/s)" 3206 "-204.8~204.5 (deg/s)" 3207 "-204.8~204.5 (deg/s)" 3208 "-204.8~204.5 (deg/s)" 3209 "-204.8~204.5 (deg/s)" 3210 "-204.8~204.5 (deg/s)" 3211 "-204.8~204.5 (deg/s)" 3212 "-204.8~204.5 (deg/s)" 3213 "-204.8~204.5 (deg/s)" 3214 "-204.8~204.5 (deg/s)" 3215 "-204.8~204.5 (deg/s)" 3216 "-204.8~204.5 (deg/s)" 3217 "-204.8~204.5 (deg/s)" 3218 "-204.8~204.5 (deg/s)" 3219 "-204.8~204.5 (deg/s)" 3220 "-204.8~204.5 (deg/s)" 3221 "-204.8~204.5 (deg/s)" 3222 "-204.8~204.5 (deg/s)" 3223 "-204.8~204.5 (deg/s)" 3224 "-204.8~204.5 (deg/s)" 3225 "-204.8~204.5 (deg/s)" 3226 "-204.8~204.5 (deg/s)" 3227 "-204.8~204.5 (deg/s)" 3228 "-204.8~204.5 (deg/s)" 3229 "-204.8~204.5 (deg/s)" 3230 "-204.8~204.5 (deg/s)" 3231 "-204.8~204.5 (deg/s)" 3232 "-204.8~204.5 (deg/s)" 3233 "-204.8~204.5 (deg/s)" 3234 "-204.8~204.5 (deg/s)" 3235 "-204.8~204.5 (deg/s)" 3236 "-204.8~204.5 (deg/s)" 3237 "-204.8~204.5 (deg/s)" 3238 "-204.8~204.5 (deg/s)" 3239 "-204.8~204.5 (deg/s)" 3240 "-204.8~204.5 (deg/s)" 3241 "-204.8~204.5 (deg/s)" 3242 "-204.8~204.5 (deg/s)" 3243 "-204.8~204.5 (deg/s)" 3244 "-204.8~204.5 (deg/s)" 3245 "-204.8~204.5 (deg/s)" 3246 "-204.8~204.5 (deg/s)" 3247 "-204.8~204.5 (deg/s)" 3248 "-204.8~204.5 (deg/s)" 3249 "-204.8~204.5 (deg/s)" 3250 "-204.8~204.5 (deg/s)" 3251 "-204.8~204.5 (deg/s)" 3252 "-204.8~204.5 (deg/s)" 3253 "-204.8~204.5 (deg/s)" 3254 "-204.8~204.5 (deg/s)" 3255 "-204.8~204.5 (deg/s)" 3256 "-204.8~204.5 (deg/s)" 3257 "-204.8~204.5 (deg/s)" 3258 "-204.8~204.5 (deg/s)" 3259 "-204.8~204.5 (deg/s)" 3260 "-204.8~204.5 (deg/s)" 3261 "-204.8~204.5 (deg/s)" 3262 "-204.8~204.5 (deg/s)" 3263 "-204.8~204.5 (deg/s)" 3264 "-204.8~204.5 (deg/s)" 3265 "-204.8~204.5 (deg/s)" 3266 "-204.8~204.5 (deg/s)" 3267 "-204.8~204.5 (deg/s)" 3268 "-204.8~204.5 (deg/s)" 3269 "-204.8~204.5 (deg/s)" 3270 "-204.8~204.5 (deg/s)" 3271 "-204.8~204.5 (deg/s)" 3272 "-204.8~204.5 (deg/s)" 3273 "-204.8~204.5 (deg/s)" 3274 "-204.8~204.5 (deg/s)" 3275 "-204.8~204.5 (deg/s)" 3276 "-204.8~204.5 (deg/s)" 3277 "-204.8~204.5 (deg/s)" 3278 "-204.8~204.5 (deg/s)" 3279 "-204.8~204.5 (deg/s)" 3280 "-204.8~204.5 (deg/s)" 3281 "-204.8~204.5 (deg/s)" 3282 "-204.8~204.5 (deg/s)" 3283 "-204.8~204.5 (deg/s)" 3284 "-204.8~204.5 (deg/s)" 3285 "-204.8~204.5 (deg/s)" 3286 "-204.8~204.5 (deg/s)" 3287 "-204.8~204.5 (deg/s)" 3288 "-204.8~204.5 (deg/s)" 3289 "-204.8~204.5 (deg/s)" 3290 "-204.8~204.5 (deg/s)" 3291 "-204.8~204.5 (deg/s)" 3292 "-204.8~204.5 (deg/s)" 3293 "-204.8~204.5 (deg/s)" 3294 "-204.8~204.5 (deg/s)" 3295 "-204.8~204.5 (deg/s)" 3296 "-204.8~204.5 (deg/s)" 3297 "-204.8~204.5 (deg/s)" 3298 "-204.8~204.5 (deg/s)" 3299 "-204.8~204.5 (deg/s)" 3300 "-204.8~204.5 (deg/s)" 3301 "-204.8~204.5 (deg/s)" 3302 "-204.8~204.5 (deg/s)" 3303 "-204.8~204.5 (deg/s)" 3304 "-204.8~204.5 (deg/s)" 3305 "-204.8~204.5 (deg/s)" 3306 "-204.8~204.5 (deg/s)" 3307 "-204.8~204.5 (deg/s)" 3308 "-204.8~204.5 (deg/s)" 3309 "-204.8~204.5 (deg/s)" 3310 "-204.8~204.5 (deg/s)" 3311 "-204.8~204.5 (deg/s)" 3312 "-204.8~204.5 (deg/s)" 3313 "-204.8~204.5 (deg/s)" 3314 "-204.8~204.5 (deg/s)" 3315 "-204.8~204.5 (deg/s)" 3316 "-204.8~204.5 (deg/s)" 3317 "-204.8~204.5 (deg/s)" 3318 "-204.8~204.5 (deg/s)" 3319 "-204.8~204.5 (deg/s)" 3320 "-204.8~204.5 (deg/s)" 3321 "-204.8~204.5 (deg/s)" 3322 "-204.8~204.5 (deg/s)" 3323 "-204.8~204.5 (deg/s)" 3324 "-204.8~204.5 (deg/s)" 3325 "-204.8~204.5 (deg/s)" 3326 "-204.8~204.5 (deg/s)" 3327 "-204.8~204.5 (deg/s)" 3328 "-204.8~204.5 (deg/s)" 3329 "-204.8~204.5 (deg/s)" 3330 "-204.8~204.5 (deg/s)" 3331 "-204.8~204.5 (deg/s)" 3332 "-204.8~204.5 (deg/s)" 3333 "-204.8~204.5 (deg/s)" 3334 "-204.8~204.5 (deg/s)" 3335 "-204.8~204.5 (deg/s)" 3336 "-204.8~204.5 (deg/s)" 3337 "-204.8~204.5 (deg/s)" 3338 "-204.8~204.5 (deg/s)" 3339 "-204.8~204.5 (deg/s)" 3340 "-204.8~204.5 (deg/s)" 3341 "-204.8~204.5 (deg/s)" 3342 "-204.8~204.5 (deg/s)" 3343 "-204.8~204.5 (deg/s)" 3344 "-204.8~204.5 (deg/s)" 3345 "-204.8~204.5 (deg/s)" 3346 "-204.8~204.5 (deg/s)" 3347 "-204.8~204.5 (deg/s)" 3348 "-204.8~204.5 (deg/s)" 3349 "-204.8~204.5 (deg/s)" 3350 "-204.8~204.5 (deg/s)" 3351 "-204.8~204.5 (deg/s)" 3352 "-204.8~204.5 (deg/s)" 3353 "-204.8~204.5 (deg/s)" 3354 "-204.8~204.5 (deg/s)" 3355 "-204.8~204.5 (deg/s)" 3356 "-204.8~204.5 (deg/s)" 3357 "-204.8~204.5 (deg/s)" 3358 "-204.8~204.5 (deg/s)" 3359 "-204.8~204.5 (deg/s)" 3360 "-204.8~204.5 (deg/s)" 3361 "-204.8~204.5 (deg/s)" 3362 "-204.8~204.5 (deg/s)" 3363 "-204.8~204.5 (deg/s)" 3364 "-204.8~204.5 (deg/s)" 3365 "-204.8~204.5 (deg/s)" 3366 "-204.8~204.5 (deg/s)" 3367 "-204.8~204.5 (deg/s)" 3368 "-204.8~204.5 (deg/s)" 3369 "-204.8~204.5 (deg/s)" 3370 "-204.8~204.5 (deg/s)" 3371 "-204.8~204.5 (deg/s)" 3372 "-204.8~204.5 (deg/s)" 3373 "-204.8~204.5 (deg/s)" 3374 "-204.8~204.5 (deg/s)" 3375 "-204.8~204.5 (deg/s)" 3376 "-204.8~204.5 (deg/s)" 3377 "-204.8~204.5 (deg/s)" 3378 "-204.8~204.5 (deg/s)" 3379 "-204.8~204.5 (deg/s)" 3380 "-204.8~204.5 (deg/s)" 3381 "-204.8~204.5 (deg/s)" 3382 "-204.8~204.5 (deg/s)" 3383 "-204.8~204.5 (deg/s)" 3384 "-204.8~204.5 (deg/s)" 3385 "-204.8~204.5 (deg/s)" 3386 "-204.8~204.5 (deg/s)" 3387 "-204.8~204.5 (deg/s)" 3388 "-204.8~204.5 (deg/s)" 3389 "-204.8~204.5 (deg/s)" 3390 "-204.8~204.5 (deg/s)" 3391 "-204.8~204.5 (deg/s)" 3392 "-204.8~204.5 (deg/s)" 3393 "-204.8~204.5 (deg/s)" 3394 "-204.8~204.5 (deg/s)" 3395 "-204.8~204.5 (deg/s)" 3396 "-204.8~204.5 (deg/s)" 3397 "-204.8~204.5 (deg/s)" 3398 "-204.8~204.5 (deg/s)" 3399 "-204.8~204.5 (deg/s)" 3400 "-204.8~204.5 (deg/s)" 3401 "-204.8~204.5 (deg/s)" 3402 "-204.8~204.5 (deg/s)" 3403 "-204.8~204.5 (deg/s)" 3404 "-204.8~204.5 (deg/s)" 3405 "-204.8~204.5 (deg/s)" 3406 "-204.8~204.5 (deg/s)" 3407 "-204.8~204.5 (deg/s)" 3408 "-204.8~204.5 (deg/s)" 3409 "-204.8~204.5 (deg/s)" 3410 "-204.8~204.5 (deg/s)" 3411 "-204.8~204.5 (deg/s)" 3412 "-204.8~204.5 (deg/s)" 3413 "-204.8~204.5 (deg/s)" 3414 "-204.8~204.5 (deg/s)" 3415 "-204.8~204.5 (deg/s)" 3416 "-204.8~204.5 (deg/s)" 3417 "-204.8~204.5 (deg/s)" 3418 "-204.8~204.5 (deg/s)" 3419 "-204.8~204.5 (deg/s)" 3420 "-204.8~204.5 (deg/s)" 3421 "-204.8~204.5 (deg/s)" 3422 "-204.8~204.5 (deg/s)" 3423 "-204.8~204.5 (deg/s)" 3424 "-204.8~204.5 (deg/s)" 3425 "-204.8~204.5 (deg/s)" 3426 "-204.8~204.5 (deg/s)" 3427 "-204.8~204.5 (deg/s)" 3428 "-204.8~204.5 (deg/s)" 3429 "-204.8~204.5 (deg/s)" 3430 "-204.8~204.5 (deg/s)" 3431 "-204.8~204.5 (deg/s)" 3432 "-204.8~204.5 (deg/s)" 3433 "-204.8~204.5 (deg/s)" 3434 "-204.8~204.5 (deg/s)" 3435 "-204.8~204.5 (deg/s)" 3436 "-204.8~204.5 (deg/s)" 3437 "-204.8~204.5 (deg/s)" 3438 "-204.8~204.5 (deg/s)" 3439 "-204.8~204.5 (deg/s)" 3440 "-204.8~204.5 (deg/s)" 3441 "-204.8~204.5 (deg/s)" 3442 "-204.8~204.5 (deg/s)" 3443 "-204.8~204.5 (deg/s)" 3444 "-204.8~204.5 (deg/s)" 3445 "-204.8~204.5 (deg/s)" 3446 "-204.8~204.5 (deg/s)" 3447 "-204.8~204.5 (deg/s)" 3448 "-204.8~204.5 (deg/s)" 3449 "-204.8~204.5 (deg/s)" 3450 "-204.8~204.5 (deg/s)" 3451 "-204.8~204.5 (deg/s)" 3452 "-204.8~204.5 (deg/s)" 3453 "-204.8~204.5 (deg/s)" 3454 "-204.8~204.5 (deg/s)" 3455 "-204.8~204.5 (deg/s)" 3456 "-204.8~204.5 (deg/s)" 3457 "-204.8~204.5 (deg/s)" 3458 "-204.8~204.5 (deg/s)" 3459 "-204.8~204.5 (deg/s)" 3460 "-204.8~204.5 (deg/s)" 3461 "-204.8~204.5 (deg/s)" 3462 "-204.8~204.5 (deg/s)" 3463 "-204.8~204.5 (deg/s)" 3464 "-204.8~204.5 (deg/s)" 3465 "-204.8~204.5 (deg/s)" 3466 "-204.8~204.5 (deg/s)" 3467 "-204.8~204.5 (deg/s)" 3468 "-204.8~204.5 (deg/s)" 3469 "-204.8~204.5 (deg/s)" 3470 "-204.8~204.5 (deg/s)" 3471 "-204.8~204.5 (deg/s)" 3472 "-204.8~204.5 (deg/s)" 3473 "-204.8~204.5 (deg/s)" 3474 "-204.8~204.5 (deg/s)" 3475 "-204.8~204.5 (deg/s)" 3476 "-204.8~204.5 (deg/s)" 3477 "-204.8~204.5 (deg/s)" 3478 "-204.8~204.5 (deg/s)" 3479 "-204.8~204.5 (deg/s)" 3480 "-204.8~204.5 (deg/s)" 3481 "-204.8~204.5 (deg/s)" 3482 "-204.8~204.5 (deg/s)" 3483 "-204.8~204.5 (deg/s)" 3484 "-204.8~204.5 (deg/s)" 3485 "-204.8~204.5 (deg/s)" 3486 "-204.8~204.5 (deg/s)" 3487 "-204.8~204.5 (deg/s)" 3488 "-204.8~204.5 (deg/s)" 3489 "-204.8~204.5 (deg/s)" 3490 "-204.8~204.5 (deg/s)" 3491 "-204.8~204.5 (deg/s)" 3492 "-204.8~204.5 (deg/s)" 3493 "-204.8~204.5 (deg/s)" 3494 "-204.8~204.5 (deg/s)" 3495 "-204.8~204.5 (deg/s)" 3496 "-204.8~204.5 (deg/s)" 3497 "-204.8~204.5 (deg/s)" 3498 "-204.8~204.5 (deg/s)" 3499 "-204.8~204.5 (deg/s)" 3500 "-204.8~204.5 (deg/s)" 3501 "-204.8~204.5 (deg/s)" 3502 "-204.8~204.5 (deg/s)" 3503 "-204.8~204.5 (deg/s)" 3504 "-204.8~204.5 (deg/s)" 3505 "-204.8~204.5 (deg/s)" 3506 "-204.8~204.5 (deg/s)" 3507 "-204.8~204.5 (deg/s)" 3508 "-204.8~204.5 (deg/s)" 3509 "-204.8~204.5 (deg/s)" 3510 "-204.8~204.5 (deg/s)" 3511 "-204.8~204.5 (deg/s)" 3512 "-204.8~204.5 (deg/s)" 3513 "-204.8~204.5 (deg/s)" 3514 "-204.8~204.5 (deg/s)" 3515 "-204.8~204.5 (deg/s)" 3516 "-204.8~204.5 (deg/s)" 3517 "-204.8~204.5 (deg/s)" 3518 "-204.8~204.5 (deg/s)" 3519 "-204.8~204.5 (deg/s)" 3520 "-204.8~204.5 (deg/s)" 3521 "-204.8~204.5 (deg/s)" 3522 "-204.8~204.5 (deg/s)" 3523 "-204.8~204.5 (deg/s)" 3524 "-204.8~204.5 (deg/s)" 3525 "-204.8~204.5 (deg/s)" 3526 "-204.8~204.5 (deg/s)" 3527 "-204.8~204.5 (deg/s)" 3528 "-204.8~204.5 (deg/s)" 3529 "-204.8~204.5 (deg/s)" 3530 "-204.8~204.5 (deg/s)" 3531 "-204.8~204.5 (deg/s)" 3532 "-204.8~204.5 (deg/s)" 3533 "-204.8~204.5 (deg/s)" 3534 "-204.8~204.5 (deg/s)" 3535 "-204.8~204.5 (deg/s)" 3536 "-204.8~204.5 (deg/s)" 3537 "-204.8~204.5 (deg/s)" 3538 "-204.8~204.5 (deg/s)" 3539 "-204.8~204.5 (deg/s)" 3540 "-204.8~204.5 (deg/s)" 3541 "-204.8~204.5 (deg/s)" 3542 "-204.8~204.5 (deg/s)" 3543 "-204.8~204.5 (deg/s)" 3544 "-204.8~204.5 (deg/s)" 3545 "-204.8~204.5 (deg/s)" 3546 "-204.8~204.5 (deg/s)" 3547 "-204.8~204.5 (deg/s)" 3548 "-204.8~204.5 (deg/s)" 3549 "-204.8~204.5 (deg/s)" 3550 "-204.8~204.5 (deg/s)" 3551 "-204.8~204.5 (deg/s)" 3552 "-204.8~204.5 (deg/s)" 3553 "-204.8~204.5 (deg/s)" 3554 "-204.8~204.5 (deg/s)" 3555 "-204.8~204.5 (deg/s)" 3556 "-204.8~204.5 (deg/s)" 3557 "-204.8~204.5 (deg/s)" 3558 "-204.8~204.5 (deg/s)" 3559 "-204.8~204.5 (deg/s)" 3560 "-204.8~204.5 (deg/s)" 3561 "-204.8~204.5 (deg/s)" 3562 "-204.8~204.5 (deg/s)" 3563 "-204.8~204.5 (deg/s)" 3564 "-204.8~204.5 (deg/s)" 3565 "-204.8~204.5 (deg/s)" 3566 "-204.8~204.5 (deg/s)" 3567 "-204.8~204.5 (deg/s)" 3568 "-204.8~204.5 (deg/s)" 3569 "-204.8~204.5 (deg/s)" 3570 "-204.8~204.5 (deg/s)" 3571 "-204.8~204.5 (deg/s)" 3572 "-204.8~204.5 (deg/s)" 3573 "-204.8~204.5 (deg/s)" 3574 "-204.8~204.5 (deg/s)" 3575 "-204.8~204.5 (deg/s)" 3576 "-204.8~204.5 (deg/s)" 3577 "-204.8~204.5 (deg/s)" 3578 "-204.8~204.5 (deg/s)" 3579 "-204.8~204.5 (deg/s)" 3580 "-204.8~204.5 (deg/s)" 3581 "-204.8~204.5 (deg/s)" 3582 "-204.8~204.5 (deg/s)" 3583 "-204.8~204.5 (deg/s)" 3584 "-204.8~204.5 (deg/s)" 3585 "-204.8~204.5 (deg/s)" 3586 "-204.8~204.5 (deg/s)" 3587 "-204.8~204.5 (deg/s)" 3588 "-204.8~204.5 (deg/s)" 3589 "-204.8~204.5 (deg/s)" 3590 "-204.8~204.5 (deg/s)" 3591 "-204.8~204.5 (deg/s)" 3592 "-204.8~204.5 (deg/s)" 3593 "-204.8~204.5 (deg/s)" 3594 "-204.8~204.5 (deg/s)" 3595 "-204.8~204.5 (deg/s)" 3596 "-204.8~204.5 (deg/s)" 3597 "-204.8~204.5 (deg/s)" 3598 "-204.8~204.5 (deg/s)" 3599 "-204.8~204.5 (deg/s)" 3600 "-204.8~204.5 (deg/s)" 3601 "-204.8~204.5 (deg/s)" 3602 "-204.8~204.5 (deg/s)" 3603 "-204.8~204.5 (deg/s)" 3604 "-204.8~204.5 (deg/s)" 3605 "-204.8~204.5 (deg/s)" 3606 "-204.8~204.5 (deg/s)" 3607 "-204.8~204.5 (deg/s)" 3608 "-204.8~204.5 (deg/s)" 3609 "-204.8~204.5 (deg/s)" 3610 "-204.8~204.5 (deg/s)" 3611 "-204.8~204.5 (deg/s)" 3612 "-204.8~204.5 (deg/s)" 3613 "-204.8~204.5 (deg/s)" 3614 "-204.8~204.5 (deg/s)" 3615 "-204.8~204.5 (deg/s)" 3616 "-204.8~204.5 (deg/s)" 3617 "-204.8~204.5 (deg/s)" 3618 "-204.8~204.5 (deg/s)" 3619 "-204.8~204.5 (deg/s)" 3620 "-204.8~204.5 (deg/s)" 3621 "-204.8~204.5 (deg/s)" 3622 "-204.8~204.5 (deg/s)" 3623 "-204.8~204.5 (deg/s)" 3624 "-204.8~204.5 (deg/s)" 3625 "-204.8~204.5 (deg/s)" 3626 "-204.8~204.5 (deg/s)" 3627 "-204.8~204.5 (deg/s)" 3628 "-204.8~204.5 (deg/s)" 3629 "-204.8~204.5 (deg/s)" 3630 "-204.8~204.5 (deg/s)" 3631 "-204.8~204.5 (deg/s)" 3632 "-204.8~204.5 (deg/s)" 3633 "-204.8~204.5 (deg/s)" 3634 "-204.8~204.5 (deg/s)" 3635 "-204.8~204.5 (deg/s)" 3636 "-204.8~204.5 (deg/s)" 3637 "-204.8~204.5 (deg/s)" 3638 "-204.8~204.5 (deg/s)" 3639 "-204.8~204.5 (deg/s)" 3640 "-204.8~204.5 (deg/s)" 3641 "-204.8~204.5 (deg/s)" 3642 "-204.8~204.5 (deg/s)" 3643 "-204.8~204.5 (deg/s)" 3644 "-204.8~204.5 (deg/s)" 3645 "-204.8~204.5 (deg/s)" 3646 "-204.8~204.5 (deg/s)" 3647 "-204.8~204.5 (deg/s)" 3648 "-204.8~204.5 (deg/s)" 3649 "-204.8~204.5 (deg/s)" 3650 "-204.8~204.5 (deg/s)" 3651 "-204.8~204.5 (deg/s)" 3652 "-204.8~204.5 (deg/s)" 3653 "-204.8~204.5 (deg/s)" 3654 "-204.8~204.5 (deg/s)" 3655 "-204.8~204.5 (deg/s)" 3656 "-204.8~204.5 (deg/s)" 3657 "-204.8~204.5 (deg/s)" 3658 "-204.8~204.5 (deg/s)" 3659 "-204.8~204.5 (deg/s)" 3660 "-204.8~204.5 (deg/s)" 3661 "-204.8~204.5 (deg/s)" 3662 "-204.8~204.5 (deg/s)" 3663 "-204.8~204.5 (deg/s)" 3664 "-204.8~204.5 (deg/s)" 3665 "-204.8~204.5 (deg/s)" 3666 "-204.8~204.5 (deg/s)" 3667 "-204.8~204.5 (deg/s)" 3668 "-204.8~204.5 (deg/s)" 3669 "-204.8~204.5 (deg/s)" 3670 "-204.8~204.5 (deg/s)" 3671 "-204.8~204.5 (deg/s)" 3672 "-204.8~204.5 (deg/s)" 3673 "-204.8~204.5 (deg/s)" 3674 "-204.8~204.5 (deg/s)" 3675 "-204.8~204.5 (deg/s)" 3676 "-204.8~204.5 (deg/s)" 3677 "-204.8~204.5 (deg/s)" 3678 "-204.8~204.5 (deg/s)" 3679 "-204.8~204.5 (deg/s)" 3680 "-204.8~204.5 (deg/s)" 3681 "-204.8~204.5 (deg/s)" 3682 "-204.8~204.5 (deg/s)" 3683 "-204.8~204.5 (deg/s)" 3684 "-204.8~204.5 (deg/s)" 3685 "-204.8~204.5 (deg/s)" 3686 "-204.8~204.5 (deg/s)" 3687 "-204.8~204.5 (deg/s)" 3688 "-204.8~204.5 (deg/s)" 3689 "-204.8~204.5 (deg/s)" 3690 "-204.8~204.5 (deg/s)" 3691 "-204.8~204.5 (deg/s)" 3692 "-204.8~204.5 (deg/s)" 3693 "-204.8~204.5 (deg/s)" 3694 "-204.8~204.5 (deg/s)" 3695 "-204.8~204.5 (deg/s)" 3696 "-204.8~204.5 (deg/s)" 3697 "-204.8~204.5 (deg/s)" 3698 "-204.8~204.5 (deg/s)" 3699 "-204.8~204.5 (deg/s)" 3700 "-204.8~204.5 (deg/s)" 3701 "-204.8~204.5 (deg/s)" 3702 "-204.8~204.5 (deg/s)" 3703 "-204.8~204.5 (deg/s)" 3704 "-204.8~204.5 (deg/s)" 3705 "-204.8~204.5 (deg/s)" 3706 "-204.8~204.5 (deg/s)" 3707 "-204.8~204.5 (deg/s)" 3708 "-204.8~204.5 (deg/s)" 3709 "-204.8~204.5 (deg/s)" 3710 "-204.8~204.5 (deg/s)" 3711 "-204.8~204.5 (deg/s)" 3712 "-204.8~204.5 (deg/s)" 3713 "-204.8~204.5 (deg/s)" 3714 "-204.8~204.5 (deg/s)" 3715 "-204.8~204.5 (deg/s)" 3716 "-204.8~204.5 (deg/s)" 3717 "-204.8~204.5 (deg/s)" 3718 "-204.8~204.5 (deg/s)" 3719 "-204.8~204.5 (deg/s)" 3720 "-204.8~204.5 (deg/s)" 3721 "-204.8~204.5 (deg/s)" 3722 "-204.8~204.5 (deg/s)" 3723 "-204.8~204.5 (deg/s)" 3724 "-204.8~204.5 (deg/s)" 3725 "-204.8~204.5 (deg/s)" 3726 "-204.8~204.5 (deg/s)" 3727 "-204.8~204.5 (deg/s)" 3728 "-204.8~204.5 (deg/s)" 3729 "-204.8~204.5 (deg/s)" 3730 "-204.8~204.5 (deg/s)" 3731 "-204.8~204.5 (deg/s)" 3732 "-204.8~204.5 (deg/s)" 3733 "-204.8~204.5 (deg/s)" 3734 "-204.8~204.5 (deg/s)" 3735 "-204.8~204.5 (deg/s)" 3736 "-204.8~204.5 (deg/s)" 3737 "-204.8~204.5 (deg/s)" 3738 "-204.8~204.5 (deg/s)" 3739 "-204.8~204.5 (deg/s)" 3740 "-204.8~204.5 (deg/s)" 3741 "-204.8~204.5 (deg/s)" 3742 "-204.8~204.5 (deg/s)" 3743 "-204.8~204.5 (deg/s)" 3744 "-204.8~204.5 (deg/s)" 3745 "-204.8~204.5 (deg/s)" 3746 "-204.8~204.5 (deg/s)" 3747 "-204.8~204.5 (deg/s)" 3748 "-204.8~204.5 (deg/s)" 3749 "-204.8~204.5 (deg/s)" 3750 "-204.8~204.5 (deg/s)" 3751 "-204.8~204.5 (deg/s)" 3752 "-204.8~204.5 (deg/s)" 3753 "-204.8~204.5 (deg/s)" 3754 "-204.8~204.5 (deg/s)" 3755 "-204.8~204.5 (deg/s)" 3756 "-204.8~204.5 (deg/s)" 3757 "-204.8~204.5 (deg/s)" 3758 "-204.8~204.5 (deg/s)" 3759 "-204.8~204.5 (deg/s)" 3760 "-204.8~204.5 (deg/s)" 3761 "-204.8~204.5 (deg/s)" 3762 "-204.8~204.5 (deg/s)" 3763 "-204.8~204.5 (deg/s)" 3764 "-204.8~204.5 (deg/s)" 3765 "-204.8~204.5 (deg/s)" 3766 "-204.8~204.5 (deg/s)" 3767 "-204.8~204.5 (deg/s)" 3768 "-204.8~204.5 (deg/s)" 3769 "-204.8~204.5 (deg/s)" 3770 "-204.8~204.5 (deg/s)" 3771 "-204.8~204.5 (deg/s)" 3772 "-204.8~204.5 (deg/s)" 3773 "-204.8~204.5 (deg/s)" 3774 "-204.8~204.5 (deg/s)" 3775 "-204.8~204.5 (deg/s)" 3776 "-204.8~204.5 (deg/s)" 3777 "-204.8~204.5 (deg/s)" 3778 "-204.8~204.5 (deg/s)" 3779 "-204.8~204.5 (deg/s)" 3780 "-204.8~204.5 (deg/s)" 3781 "-204.8~204.5 (deg/s)" 3782 "-204.8~204.5 (deg/s)" 3783 "-204.8~204.5 (deg/s)" 3784 "-204.8~204.5 (deg/s)" 3785 "-204.8~204.5 (deg/s)" 3786 "-204.8~204.5 (deg/s)" 3787 "-204.8~204.5 (deg/s)" 3788 "-204.8~204.5 (deg/s)" 3789 "-204.8~204.5 (deg/s)" 3790 "-204.8~204.5 (deg/s)" 3791 "-204.8~204.5 (deg/s)" 3792 "-204.8~204.5 (deg/s)" 3793 "-204.8~204.5 (deg/s)" 3794 "-204.8~204.5 (deg/s)" 3795 "-204.8~204.5 (deg/s)" 3796 "-204.8~204.5 (deg/s)" 3797 "-204.8~204.5 (deg/s)" 3798 "-204.8~204.5 (deg/s)" 3799 "-204.8~204.5 (deg/s)" 3800 "-204.8~204.5 (deg/s)" 3801 "-204.8~204.5 (deg/s)" 3802 "-204.8~204.5 (deg/s)" 3803 "-204.8~204.5 (deg/s)" 3804 "-204.8~204.5 (deg/s)" 3805 "-204.8~204.5 (deg/s)" 3806 "-204.8~204.5 (deg/s)" 3807 "-204.8~204.5 (deg/s)" 3808 "-204.8~204.5 (deg/s)" 3809 "-204.8~204.5 (deg/s)" 3810 "-204.8~204.5 (deg/s)" 3811 "-204.8~204.5 (deg/s)" 3812 "-204.8~204.5 (deg/s)" 3813 "-204.8~204.5 (deg/s)" 3814 "-204.8~204.5 (deg/s)" 3815 "-204.8~204.5 (deg/s)" 3816 "-204.8~204.5 (deg/s)" 3817 "-204.8~204.5 (deg/s)" 3818 "-204.8~204.5 (deg/s)" 3819 "-204.8~204.5 (deg/s)" 3820 "-204.8~204.5 (deg/s)" 3821 "-204.8~204.5 (deg/s)" 3822 "-204.8~204.5 (deg/s)" 3823 "-204.8~204.5 (deg/s)" 3824 "-204.8~204.5 (deg/s)" 3825 "-204.8~204.5 (deg/s)" 3826 "-204.8~204.5 (deg/s)" 3827 "-204.8~204.5 (deg/s)" 3828 "-204.8~204.5 (deg/s)" 3829 "-204.8~204.5 (deg/s)" 3830 "-204.8~204.5 (deg/s)" 3831 "-204.8~204.5 (deg/s)" 3832 "-204.8~204.5 (deg/s)" 3833 "-204.8~204.5 (deg/s)" 3834 "-204.8~204.5 (deg/s)" 3835 "-204.8~204.5 (deg/s)" 3836 "-204.8~204.5 (deg/s)" 3837 "-204.8~204.5 (deg/s)" 3838 "-204.8~204.5 (deg/s)" 3839 "-204.8~204.5 (deg/s)" 3840 "-204.8~204.5 (deg/s)" 3841 "-204.8~204.5 (deg/s)" 3842 "-204.8~204.5 (deg/s)" 3843 "-204.8~204.5 (deg/s)" 3844 "-204.8~204.5 (deg/s)" 3845 "-204.8~204.5 (deg/s)" 3846 "-204.8~204.5 (deg/s)" 3847 "-204.8~204.5 (deg/s)" 3848 "-204.8~204.5 (deg/s)" 3849 "-204.8~204.5 (deg/s)" 3850 "-204.8~204.5 (deg/s)" 3851 "-204.8~204.5 (deg/s)" 3852 "-204.8~204.5 (deg/s)" 3853 "-204.8~204.5 (deg/s)" 3854 "-204.8~204.5 (deg/s)" 3855 "-204.8~204.5 (deg/s)" 3856 "-204.8~204.5 (deg/s)" 3857 "-204.8~204.5 (deg/s)" 3858 "-204.8~204.5 (deg/s)" 3859 "-204.8~204.5 (deg/s)" 3860 "-204.8~204.5 (deg/s)" 3861 "-204.8~204.5 (deg/s)" 3862 "-204.8~204.5 (deg/s)" 3863 "-204.8~204.5 (deg/s)" 3864 "-204.8~204.5 (deg/s)" 3865 "-204.8~204.5 (deg/s)" 3866 "-204.8~204.5 (deg/s)" 3867 "-204.8~204.5 (deg/s)" 3868 "-204.8~204.5 (deg/s)" 3869 "-204.8~204.5 (deg/s)" 3870 "-204.8~204.5 (deg/s)" 3871 "-204.8~204.5 (deg/s)" 3872 "-204.8~204.5 (deg/s)" 3873 "-204.8~204.5 (deg/s)" 3874 "-204.8~204.5 (deg/s)" 3875 "-204.8~204.5 (deg/s)" 3876 "-204.8~204.5 (deg/s)" 3877 "-204.8~204.5 (deg/s)" 3878 "-204.8~204.5 (deg/s)" 3879 "-204.8~204.5 (deg/s)" 3880 "-204.8~204.5 (deg/s)" 3881 "-204.8~204.5 (deg/s)" 3882 "-204.8~204.5 (deg/s)" 3883 "-204.8~204.5 (deg/s)" 3884 "-204.8~204.5 (deg/s)" 3885 "-204.8~204.5 (deg/s)" 3886 "-204.8~204.5 (deg/s)" 3887 "-204.8~204.5 (deg/s)" 3888 "-204.8~204.5 (deg/s)" 3889 "-204.8~204.5 (deg/s)" 3890 "-204.8~204.5 (deg/s)" 3891 "-204.8~204.5 (deg/s)" 3892 "-204.8~204.5 (deg/s)" 3893 "-204.8~204.5 (deg/s)" 3894 "-204.8~204.5 (deg/s)" 3895 "-204.8~204.5 (deg/s)" 3896 "-204.8~204.5 (deg/s)" 3897 "-204.8~204.5 (deg/s)" 3898 "-204.8~204.5 (deg/s)" 3899 "-204.8~204.5 (deg/s)" 3900 "-204.8~204.5 (deg/s)" 3901 "-204.8~204.5 (deg/s)" 3902 "-204.8~204.5 (deg/s)" 3903 "-204.8~204.5 (deg/s)" 3904 "-204.8~204.5 (deg/s)" 3905 "-204.8~204.5 (deg/s)" 3906 "-204.8~204.5 (deg/s)" 3907 "-204.8~204.5 (deg/s)" 3908 "-204.8~204.5 (deg/s)" 3909 "-204.8~204.5 (deg/s)" 3910 "-204.8~204.5 (deg/s)" 3911 "-204.8~204.5 (deg/s)" 3912 "-204.8~204.5 (deg/s)" 3913 "-204.8~204.5 (deg/s)" 3914 "-204.8~204.5 (deg/s)" 3915 "-204.8~204.5 (deg/s)" 3916 "-204.8~204.5 (deg/s)" 3917 "-204.8~204.5 (deg/s)" 3918 "-204.8~204.5 (deg/s)" 3919 "-204.8~204.5 (deg/s)" 3920 "-204.8~204.5 (deg/s)" 3921 "-204.8~204.5 (deg/s)" 3922 "-204.8~204.5 (deg/s)" 3923 "-204.8~204.5 (deg/s)" 3924 "-204.8~204.5 (deg/s)" 3925 "-204.8~204.5 (deg/s)" 3926 "-204.8~204.5 (deg/s)" 3927 "-204.8~204.5 (deg/s)" 3928 "-204.8~204.5 (deg/s)" 3929 "-204.8~204.5 (deg/s)" 3930 "-204.8~204.5 (deg/s)" 3931 "-204.8~204.5 (deg/s)" 3932 "-204.8~204.5 (deg/s)" 3933 "-204.8~204.5 (deg/s)" 3934 "-204.8~204.5 (deg/s)" 3935 "-204.8~204.5 (deg/s)" 3936 "-204.8~204.5 (deg/s)" 3937 "-204.8~204.5 (deg/s)" 3938 "-204.8~204.5 (deg/s)" 3939 "-204.8~204.5 (deg/s)" 3940 "-204.8~204.5 (deg/s)" 3941 "-204.8~204.5 (deg/s)" 3942 "-204.8~204.5 (deg/s)" 3943 "-204.8~204.5 (deg/s)" 3944 "-204.8~204.5 (deg/s)" 3945 "-204.8~204.5 (deg/s)" 3946 "-204.8~204.5 (deg/s)" 3947 "-204.8~204.5 (deg/s)" 3948 "-204.8~204.5 (deg/s)" 3949 "-204.8~204.5 (deg/s)" 3950 "-204.8~204.5 (deg/s)" 3951 "-204.8~204.5 (deg/s)" 3952 "-204.8~204.5 (deg/s)" 3953 "-204.8~204.5 (deg/s)" 3954 "-204.8~204.5 (deg/s)" 3955 "-204.8~204.5 (deg/s)" 3956 "-204.8~204.5 (deg/s)" 3957 "-204.8~204.5 (deg/s)" 3958 "-204.8~204.5 (deg/s)" 3959 "-204.8~204.5 (deg/s)" 3960 "-204.8~204.5 (deg/s)" 3961 "-204.8~204.5 (deg/s)" 3962 "-204.8~204.5 (deg/s)" 3963 "-204.8~204.5 (deg/s)" 3964 "-204.8~204.5 (deg/s)" 3965 "-204.8~204.5 (deg/s)" 3966 "-204.8~204.5 (deg/s)" 3967 "-204.8~204.5 (deg/s)" 3968 "-204.8~204.5 (deg/s)" 3969 "-204.8~204.5 (deg/s)" 3970 "-204.8~204.5 (deg/s)" 3971 "-204.8~204.5 (deg/s)" 3972 "-204.8~204.5 (deg/s)" 3973 "-204.8~204.5 (deg/s)" 3974 "-204.8~204.5 (deg/s)" 3975 "-204.8~204.5 (deg/s)" 3976 "-204.8~204.5 (deg/s)" 3977 "-204.8~204.5 (deg/s)" 3978 "-204.8~204.5 (deg/s)" 3979 "-204.8~204.5 (deg/s)" 3980 "-204.8~204.5 (deg/s)" 3981 "-204.8~204.5 (deg/s)" 3982 "-204.8~204.5 (deg/s)" 3983 "-204.8~204.5 (deg/s)" 3984 "-204.8~204.5 (deg/s)" 3985 "-204.8~204.5 (deg/s)" 3986 "-204.8~204.5 (deg/s)" 3987 "-204.8~204.5 (deg/s)" 3988 "-204.8~204.5 (deg/s)" 3989 "-204.8~204.5 (deg/s)" 3990 "-204.8~204.5 (deg/s)" 3991 "-204.8~204.5 (deg/s)" 3992 "-204.8~204.5 (deg/s)" 3993 "-204.8~204.5 (deg/s)" 3994 "-204.8~204.5 (deg/s)" 3995 "-204.8~204.5 (deg/s)" 3996 "-204.8~204.5 (deg/s)" 3997 "-204.8~204.5 (deg/s)" 3998 "-204.8~204.5 (deg/s)" 3999 "-204.8~204.5 (deg/s)" 4000 "-204.8~204.5 (deg/s)" 4001 "-204.8~204.5 (deg/s)" 4002 "-204.8~204.5 (deg/s)" 4003 "-204.8~204.5 (deg/s)" 4004 "-204.8~204.5 (deg/s)" 4005 "-204.8~204.5 (deg/s)" 4006 "-204.8~204.5 (deg/s)" 4007 "-204.8~204.5 (deg/s)" 4008 "-204.8~204.5 (deg/s)" 4009 "-204.8~204.5 (deg/s)" 4010 "-204.8~204.5 (deg/s)" 4011 "-204.8~204.5 (deg/s)" 4012 "-204.8~204.5 (deg/s)" 4013 "-204.8~204.5 (deg/s)" 4014 "-204.8~204.5 (deg/s)" 4015 "-204.8~204.5 (deg/s)" 4016 "-204.8~204.5 (deg/s)" 4017 "-204.8~204.5 (deg/s)" 4018 "-204.8~204.5 (deg/s)" 4019 "-204.8~204.5 (deg/s)" 4020 "-204.8~204.5 (deg/s)" 4021 "-204.8~204.5 (deg/s)" 4022 "-204.8~204.5 (deg/s)" 4023 "-204.8~204.5 (deg/s)" 4024 "-204.8~204.5 (deg/s)" 4025 "-204.8~204.5 (deg/s)" 4026 "-204.8~204.5 (deg/s)" 4027 "-204.8~204.5 (deg/s)" 4028 "-204.8~204.5 (deg/s)" 4029 "-204.8~204.5 (deg/s)" 4030 "-204.8~204.5 (deg/s)" 4031 "-204.8~204.5 (deg/s)" 4032 "-204.8~204.5 (deg/s)" 4033 "-204.8~204.5 (deg/s)" 4034 "-204.8~204.5 (deg/s)" 4035 "-204.8~204.5 (deg/s)" 4036 "-204.8~204.5 (deg/s)" 4037 "-204.8~204.5 (deg/s)" 4038 "-204.8~204.5 (deg/s)" 4039 "-204.8~204.5 (deg/s)" 4040 "-204.8~204.5 (deg/s)" 4041 "-204.8~204.5 (deg/s)" 4042 "-204.8~204.5 (deg/s)" 4043 "-204.8~204.5 (deg/s)" 4044 "-204.8~204.5 (deg/s)" 4045 "-204.8~204.5 (deg/s)" 4046 "-204.8~204.5 (deg/s)" 4047 "-204.8~204.5 (deg/s)" 4048 "-204.8~204.5 (deg/s)" 4049 "-204.8~204.5 (deg/s)" 4050 "-204.8~204.5 (deg/s)" 4051 "-204.8~204.5 (deg/s)" 4052 "-204.8~204.5 (deg/s)" 4053 "-204.8~204.5 (deg/s)" 4054 "-204.8~204.5 (deg/s)" 4055 "-204.8~204.5 (deg/s)" 4056 "-204.8~204.5 (deg/s)" 4057 "-204.8~204.5 (deg/s)" 4058 "-204.8~204.5 (deg/s)" 4059 "-204.8~204.5 (deg/s)" 4060 "-204.8~204.5 (deg/s)" 4061 "-204.8~204.5 (deg/s)" 4062 "-204.8~204.5 (deg/s)" 4063 "-204.8~204.5 (deg/s)" 4064 "-204.8~204.5 (deg/s)" 4065 "-204.8~204.5 (deg/s)" 4066 "-204.8~204.5 (deg/s)" 4067 "-204.8~204.5 (deg/s)" 4068 "-204.8~204.5 (deg/s)" 4069 "-204.8~204.5 (deg/s)" 4070 "-204.8~204.5 (deg/s)" 4071 "-204.8~204.5 (deg/s)" 4072 "-204.8~204.5 (deg/s)" 4073 "-204.8~204.5 (deg/s)" 4074 "-204.8~204.5 (deg/s)" 4075 "-204.8~204.5 (deg/s)" 4076 "-204.8~204.5 (deg/s)" 4077 "-204.8~204.5 (deg/s)" 4078 "-204.8~204.5 (deg/s)" 4079 "-204.8~204.5 (deg/s)" 4080 "-204.8~204.5 (deg/s)" 4081 "-204.8~204.5 (deg/s)" 4082 "-204.8~204.5 (deg/s)" 4083 "-204.8~204.5 (deg/s)" 4084 "-204.8~204.5 (deg/s)" 4085 "-204.8~204.5 (deg/s)" 4086 "-204.8~204.5 (deg/s)" 4087 "-204.8~204.5 (deg/s)" 4088 "-204.8~204.5 (deg/s)" 4089 "-204.8~204.5 (deg/s)" 4090 "-204.8~204.5 (deg/s)" 4091 "-204.8~204.5 (deg/s)" 4092 "-204.8~204.5 (deg/s)" 4093 "-204.8~204.5 (deg/s)" 4094 "Not used" 4095 "Invalid" ;
VAL_ 234 LKAS_SysSta 0 "System OFF" 1 "Low Vehicle Speed" 2 "System Unavailable" 3 "MDPS Control_Full Lane Recognized" 4 "Full Lane Recognized" 5 "Left Line Recognized" 6 "Right Line Recognized" 7 "MDPS Control_Left Line Recognized" 8 "MDPS Control_Right Line Recognized" 9 "System Not Calibrated" 14 "Not used" 15 "System Failure(Error indicator)" ;
VAL_ 234 LKAS_SysWrnSta 0 "No Info" 4 "Hands-Off Warning" 9 "System Automatic off" 14 "Not used" 15 "Error indicator" ;
VAL_ 234 LKAS_LHWrnSta 0 "No Warning" 1 "HAPTIC Warning and Display" 2 "Acoustic Warning and Display" 3 "Acoustic Warning in AMP and Display" ;
VAL_ 234 LKAS_RHWrnSta 0 "No Warning" 1 "HAPTIC Warning and Display" 2 "Acoustic Warning and Display" 3 "Acoustic Warning in AMP and Display" ;
VAL_ 234 LKAS_ActToiSta 0 "De-activate TOI" 1 "Activate TOI" 2 "Not used" 3 "Error indicator" ;
VAL_ 234 LKAS_ToiFltSta 0 "No Fault" 1 "Fault Present" 2 "Not used" 3 "Error indicator" ;
VAL_ 234 LKAS_OptUsmSta 0 "Invalid" 1 "LDW" 2 "Standard LKA" 3 "Active LKA" 4 "LDWS Only (None LKAS)" 6 "Not used" 7 "Error indicator" ;
VAL_ 234 HBA_SysSta 0 "None(HBA off)" 1 "HBA On & High Bean Off" 2 "HBA On & High Bean On" 7 "System Fail" ;
VAL_ 234 HBA_SysOptSta 0 "None HBA Option (Default)" 1 "HBA System Enable" 2 "Not used" 3 "Error indicator" ;
VAL_ 234 HBA_IndLmpReq 0 "HBA Indicator Lamp Off" 1 "HBA Indicator Lamp On" 2 "Not used" 3 "Error indicator" ;
VAL_ 234 FCWS_SysSta 0 "System Off" 1 "System On (Unrecognition of vehicle)" 2 "System On (Recognition of vehicle)" 3 "System On (Collision Warning)" 4 "Temporary system invalid" 7 "System Fail" ;
VAL_ 234 FCWS_OptUsmSta 0 "None FCW Option" 1 "System Disable" 2 "System Enable(Early)" 3 "System Enable(Normal)" 4 "System Enable(Late)" 5 "Reserved" 6 "Reserved" 7 "Invalid/" ;
VAL_ 234 FCWS_CllsnWrnSta 0 "No warning" 1 "Collision warning" 2 "Reserved" 3 "Error indicator" ;
VAL_ 234 FCWS_DbsReq 0 "FCWS DBS READY (Default)" 1 "FCW DBS ACT" 2 "Not used" 3 "Error indicator" ;
VAL_ 234 AEBref_FusFuncSta 0 "Normal" 1 "Fusion Disabled" 2 "SCC Communication Error" 3 "Error indicator" ;
VAL_ 234 DAA_SysSta 0 "System OFF" 1 "Attention Level  1" 2 "Attention Level  2" 3 "Attention Level  3" 4 "Attention Level  4" 5 "Attention Level  5" 6 "Reserved" 7 "Reserved" 8 "Reserved" 9 "Reserved" 10 "Reserved" 11 "Reserved" 12 "Reserved" 13 "Reserved" 14 "System Standby" 15 "System Fail" ;
VAL_ 234 DAA_OptUsmSta 0 "None AA option (Default)" 1 "System OFF" 2 "Late" 3 "Normal" 4 "Early" 5 "Reserved" 6 "Reserved" 7 "Invalid" ;
VAL_ 234 DAA_WrnMsgSta 0 "No Warning" 1 "Rest Recommend Warning" 2 "Reserved" 3 "Reserved" 4 "Reserved" 5 "Reserved" 6 "Not used" 7 "Error indicator" ;
VAL_ 234 DAA_WrnSndSta 0 "No Warning Sound" 1 "Rest Recommend Warning Sound" 2 "Reserved" 3 "Reserved" 4 "Reserved" 5 "Reserved" 6 "Not used" 7 "Error indicator" ;
VAL_ 234 DAA_TimeRstReq 0 "No signal" 1 "Time reset" 2 "Not used" 3 "Error indicator" ;
VAL_ 389 SLIF_SysSta 0 "TSR Information Valid (default)" 1 "TSR Information Temporary Unavailable" 2 "Reserved" 3 "TSR Information Invalid/Failure" ;
VAL_ 389 SLIF_OptUsmSta 0 "None SLIF Option (default)" 1 "System Disable by USM" 2 "System Enable by USM" 3 "Error indicator" ;
VAL_ 389 SLIF_NoPassingInfoDis 0 "None Display (Default)" 1 "No Passing Zone Display" 2 "Not used" 3 "Error indicator" ;
VAL_ 389 SLIF_Spd4CluDis 0 "No Recognition (default)" 1 "1~252" 2 "1~252" 3 "1~252" 4 "1~252" 5 "1~252" 6 "1~252" 7 "1~252" 8 "1~252" 9 "1~252" 10 "1~252" 11 "1~252" 12 "1~252" 13 "1~252" 14 "1~252" 15 "1~252" 16 "1~252" 17 "1~252" 18 "1~252" 19 "1~252" 20 "1~252" 21 "1~252" 22 "1~252" 23 "1~252" 24 "1~252" 25 "1~252" 26 "1~252" 27 "1~252" 28 "1~252" 29 "1~252" 30 "1~252" 31 "1~252" 32 "1~252" 33 "1~252" 34 "1~252" 35 "1~252" 36 "1~252" 37 "1~252" 38 "1~252" 39 "1~252" 40 "1~252" 41 "1~252" 42 "1~252" 43 "1~252" 44 "1~252" 45 "1~252" 46 "1~252" 47 "1~252" 48 "1~252" 49 "1~252" 50 "1~252" 51 "1~252" 52 "1~252" 53 "1~252" 54 "1~252" 55 "1~252" 56 "1~252" 57 "1~252" 58 "1~252" 59 "1~252" 60 "1~252" 61 "1~252" 62 "1~252" 63 "1~252" 64 "1~252" 65 "1~252" 66 "1~252" 67 "1~252" 68 "1~252" 69 "1~252" 70 "1~252" 71 "1~252" 72 "1~252" 73 "1~252" 74 "1~252" 75 "1~252" 76 "1~252" 77 "1~252" 78 "1~252" 79 "1~252" 80 "1~252" 81 "1~252" 82 "1~252" 83 "1~252" 84 "1~252" 85 "1~252" 86 "1~252" 87 "1~252" 88 "1~252" 89 "1~252" 90 "1~252" 91 "1~252" 92 "1~252" 93 "1~252" 94 "1~252" 95 "1~252" 96 "1~252" 97 "1~252" 98 "1~252" 99 "1~252" 100 "1~252" 101 "1~252" 102 "1~252" 103 "1~252" 104 "1~252" 105 "1~252" 106 "1~252" 107 "1~252" 108 "1~252" 109 "1~252" 110 "1~252" 111 "1~252" 112 "1~252" 113 "1~252" 114 "1~252" 115 "1~252" 116 "1~252" 117 "1~252" 118 "1~252" 119 "1~252" 120 "1~252" 121 "1~252" 122 "1~252" 123 "1~252" 124 "1~252" 125 "1~252" 126 "1~252" 127 "1~252" 128 "1~252" 129 "1~252" 130 "1~252" 131 "1~252" 132 "1~252" 133 "1~252" 134 "1~252" 135 "1~252" 136 "1~252" 137 "1~252" 138 "1~252" 139 "1~252" 140 "1~252" 141 "1~252" 142 "1~252" 143 "1~252" 144 "1~252" 145 "1~252" 146 "1~252" 147 "1~252" 148 "1~252" 149 "1~252" 150 "1~252" 151 "1~252" 152 "1~252" 153 "1~252" 154 "1~252" 155 "1~252" 156 "1~252" 157 "1~252" 158 "1~252" 159 "1~252" 160 "1~252" 161 "1~252" 162 "1~252" 163 "1~252" 164 "1~252" 165 "1~252" 166 "1~252" 167 "1~252" 168 "1~252" 169 "1~252" 170 "1~252" 171 "1~252" 172 "1~252" 173 "1~252" 174 "1~252" 175 "1~252" 176 "1~252" 177 "1~252" 178 "1~252" 179 "1~252" 180 "1~252" 181 "1~252" 182 "1~252" 183 "1~252" 184 "1~252" 185 "1~252" 186 "1~252" 187 "1~252" 188 "1~252" 189 "1~252" 190 "1~252" 191 "1~252" 192 "1~252" 193 "1~252" 194 "1~252" 195 "1~252" 196 "1~252" 197 "1~252" 198 "1~252" 199 "1~252" 200 "1~252" 201 "1~252" 202 "1~252" 203 "1~252" 204 "1~252" 205 "1~252" 206 "1~252" 207 "1~252" 208 "1~252" 209 "1~252" 210 "1~252" 211 "1~252" 212 "1~252" 213 "1~252" 214 "1~252" 215 "1~252" 216 "1~252" 217 "1~252" 218 "1~252" 219 "1~252" 220 "1~252" 221 "1~252" 222 "1~252" 223 "1~252" 224 "1~252" 225 "1~252" 226 "1~252" 227 "1~252" 228 "1~252" 229 "1~252" 230 "1~252" 231 "1~252" 232 "1~252" 233 "1~252" 234 "1~252" 235 "1~252" 236 "1~252" 237 "1~252" 238 "1~252" 239 "1~252" 240 "1~252" 241 "1~252" 242 "1~252" 243 "1~252" 244 "1~252" 245 "1~252" 246 "1~252" 247 "1~252" 248 "1~252" 249 "1~252" 250 "1~252" 251 "1~252" 252 "1~252" 253 "Unlimited Speed" 254 "Reserved" 255 "Invalid" ;
VAL_ 389 SLIF_Spd4NaviDis 0 "No Recognition (default)" 1 "1~252" 2 "1~252" 3 "1~252" 4 "1~252" 5 "1~252" 6 "1~252" 7 "1~252" 8 "1~252" 9 "1~252" 10 "1~252" 11 "1~252" 12 "1~252" 13 "1~252" 14 "1~252" 15 "1~252" 16 "1~252" 17 "1~252" 18 "1~252" 19 "1~252" 20 "1~252" 21 "1~252" 22 "1~252" 23 "1~252" 24 "1~252" 25 "1~252" 26 "1~252" 27 "1~252" 28 "1~252" 29 "1~252" 30 "1~252" 31 "1~252" 32 "1~252" 33 "1~252" 34 "1~252" 35 "1~252" 36 "1~252" 37 "1~252" 38 "1~252" 39 "1~252" 40 "1~252" 41 "1~252" 42 "1~252" 43 "1~252" 44 "1~252" 45 "1~252" 46 "1~252" 47 "1~252" 48 "1~252" 49 "1~252" 50 "1~252" 51 "1~252" 52 "1~252" 53 "1~252" 54 "1~252" 55 "1~252" 56 "1~252" 57 "1~252" 58 "1~252" 59 "1~252" 60 "1~252" 61 "1~252" 62 "1~252" 63 "1~252" 64 "1~252" 65 "1~252" 66 "1~252" 67 "1~252" 68 "1~252" 69 "1~252" 70 "1~252" 71 "1~252" 72 "1~252" 73 "1~252" 74 "1~252" 75 "1~252" 76 "1~252" 77 "1~252" 78 "1~252" 79 "1~252" 80 "1~252" 81 "1~252" 82 "1~252" 83 "1~252" 84 "1~252" 85 "1~252" 86 "1~252" 87 "1~252" 88 "1~252" 89 "1~252" 90 "1~252" 91 "1~252" 92 "1~252" 93 "1~252" 94 "1~252" 95 "1~252" 96 "1~252" 97 "1~252" 98 "1~252" 99 "1~252" 100 "1~252" 101 "1~252" 102 "1~252" 103 "1~252" 104 "1~252" 105 "1~252" 106 "1~252" 107 "1~252" 108 "1~252" 109 "1~252" 110 "1~252" 111 "1~252" 112 "1~252" 113 "1~252" 114 "1~252" 115 "1~252" 116 "1~252" 117 "1~252" 118 "1~252" 119 "1~252" 120 "1~252" 121 "1~252" 122 "1~252" 123 "1~252" 124 "1~252" 125 "1~252" 126 "1~252" 127 "1~252" 128 "1~252" 129 "1~252" 130 "1~252" 131 "1~252" 132 "1~252" 133 "1~252" 134 "1~252" 135 "1~252" 136 "1~252" 137 "1~252" 138 "1~252" 139 "1~252" 140 "1~252" 141 "1~252" 142 "1~252" 143 "1~252" 144 "1~252" 145 "1~252" 146 "1~252" 147 "1~252" 148 "1~252" 149 "1~252" 150 "1~252" 151 "1~252" 152 "1~252" 153 "1~252" 154 "1~252" 155 "1~252" 156 "1~252" 157 "1~252" 158 "1~252" 159 "1~252" 160 "1~252" 161 "1~252" 162 "1~252" 163 "1~252" 164 "1~252" 165 "1~252" 166 "1~252" 167 "1~252" 168 "1~252" 169 "1~252" 170 "1~252" 171 "1~252" 172 "1~252" 173 "1~252" 174 "1~252" 175 "1~252" 176 "1~252" 177 "1~252" 178 "1~252" 179 "1~252" 180 "1~252" 181 "1~252" 182 "1~252" 183 "1~252" 184 "1~252" 185 "1~252" 186 "1~252" 187 "1~252" 188 "1~252" 189 "1~252" 190 "1~252" 191 "1~252" 192 "1~252" 193 "1~252" 194 "1~252" 195 "1~252" 196 "1~252" 197 "1~252" 198 "1~252" 199 "1~252" 200 "1~252" 201 "1~252" 202 "1~252" 203 "1~252" 204 "1~252" 205 "1~252" 206 "1~252" 207 "1~252" 208 "1~252" 209 "1~252" 210 "1~252" 211 "1~252" 212 "1~252" 213 "1~252" 214 "1~252" 215 "1~252" 216 "1~252" 217 "1~252" 218 "1~252" 219 "1~252" 220 "1~252" 221 "1~252" 222 "1~252" 223 "1~252" 224 "1~252" 225 "1~252" 226 "1~252" 227 "1~252" 228 "1~252" 229 "1~252" 230 "1~252" 231 "1~252" 232 "1~252" 233 "1~252" 234 "1~252" 235 "1~252" 236 "1~252" 237 "1~252" 238 "1~252" 239 "1~252" 240 "1~252" 241 "1~252" 242 "1~252" 243 "1~252" 244 "1~252" 245 "1~252" 246 "1~252" 247 "1~252" 248 "1~252" 249 "1~252" 250 "1~252" 251 "1~252" 252 "1~252" 253 "Unlimited Speed" 254 "Reserved" 255 "Invalid" ;
VAL_ 389 ABSDref_LftLnQualSta 0 "Very Low Quality" 1 "Low Quality" 2 "High Quality" 3 "Very High Quality" 6 "Not used" 7 "Error indicator" ;
VAL_ 389 ABSDref_LftLnDptSta 0 "No Left Line Departure" 1 "Left Line Departure" 2 "Not used" 3 "Error Indicator" ;
VAL_ 389 ABSDref_RtLnQualSta 0 "Very Low Quality" 1 "Low Quality" 2 "High Quality" 3 "Very High Quality" 4 "Reserved" 5 "Reserved" 6 "Not used" 7 "Error indicator" ;
VAL_ 389 ABSDref_RtLnDptSta 0 "No Left Line Departure" 1 "Left Line Departure" 2 "Not used" 3 "Error Indicator" ;
VAL_ 389 HDAref_SysSta 0 "Not Applied" 1 "Function Off" 2 "Function On" 3 "HDA fail" 4 "Reserved" 5 "Reserved" 6 "Not used" 7 "Error indicator" ;
VAL_ 389 HDAref_AutoSetSpdSta 0 "Auto Set Speed OFF" 1 "Auto Set Speed ON" 2 "Not used" 3 "Error indicator" ;
VAL_ 389 HDAref_CntrlModSta 0 "OFF" 1 "Ready" 2 "Active" 3 "Reserved" 4 "Reserved" 5 "Reserved" 6 "Reserved" 7 "Invalid" ;
VAL_ 389 HDAref_InfoDis 0 "no pop-up" 1 "system start pop-up" 2 "system auto disengaged pop-up by highway off" 3 "system auto disengaged pop-up" 4 "Reserved" 5 "Reserved" 6 "Reserved" 7 "Invalid" ;
VAL_ 389 HDAref_AutoSetSpdUpdtSta 0 "Auto Set Speed Update OFF" 1 "Auto Set Speed Update ON" 2 "Not used" 3 "Error indicator" ;
VAL_ 389 HDAref_LnGdActSta 0 "Not active" 1 "Active" 2 "Not used" 3 "Error indicator" ;
VAL_ 389 HDAref_LnDetSta 0 "No lane" 1 "Left lane" 2 "Right lane" 3 "Full lane" ;
VAL_ 314 SPAS_ModDis 0 "No display" 1 "PAS display" 2 "SPAS display" 3 "SPAS displaly" 4 "Reserved" 5 "Reserved" 6 "Not used" 7 "Error Indicator" ;
VAL_ 314 SPAS_ModSelSeqDis 0 "Default" 1 "Domestic" 2 "EU LHD" 3 "EU RHD" 4 "Reserved" 5 "Reserved" 6 "Not used" 7 "Error Indicator" ;
VAL_ 314 SPAS_HmiStaDis 0 "No Display" 1 "Parking mode selection - right perpendicular" 2 "Parking mode selection - left perpendicular" 3 "Parking mode selection - right parallel" 4 "Parking mode selection - left parallel" 5 "Parking mode selection - OFF" 6 "Requesting go forward for detecting parking space" 7 "Detecting parking space - right perpendicular" 8 "Detecting parking space - left perpendicular" 9 "Detecting parking space - right parallel" 10 "Detecting parking space - left parallel" 13 "Requesting stop of vehicle in perpendicular parking" 14 "Requesting Steering Wheel to left side in right perpendicular parking" 15 "Requesting Steering Wheel to right side in left perpendicular parking" 17 "Finishing parking space - right perpendicular" 18 "Finishing parking space - left perpendicular" 19 "Finishing parking space - right parallel" 20 "Finishing parking space - left parallel" 23 "Automatic steering activation" 25 "Requesting gear shift to forward during automatic steering activation" 26 "Requesting gear shift to backward during automatic steering activation" 28 "Finishing automatic steering activation" 30 "System auto-canceled" 31 "System failed" 32 "Over speed of vehicle" 33 "Requesting EPB AUTO-HOLD OFF" 34 "System deactivation by TRAILER MODE" 35 "System deactivation by TCS OFF" 37 "Parking out mode selection - OFF" 38 "Parking out mode selection - left" 39 "Parking out mode selection - right" 40 "Detecting parking out space - left" 41 "Detecting parking out space - right" 42 "Requesting gear shift to backward in parking out mode after detecting parking out space" 44 "Automatic steering activation for parking out" 46 "Requesting gear shift to forward in parking out mode" 47 "Requesting gear shift to backward in parking out mode" 49 "Finishing automatic steering activation for parking out" 50 "System auto-canceled in parking out mode" 51 "Informing parking space - right perpendicular" 52 "Informing parking space - left perpendicular" 53 "Informing parking space - right parallel" 54 "Informing parking space - left parallel" 62 "Not used" 63 "Error Indicator" ;
VAL_ 314 SPAS_FrLftWrngDis 0 "OFF (No warning)" 1 "1’st warning level" 2 "2’nd warning level" 3 "3’nd warning level (the closest status with obstacle)" 4 "Reserved" 5 "Reserved" 6 "Not used" 7 "Error Indicator" ;
VAL_ 314 SPAS_FrCtrWrngDis 0 "OFF (No warning)" 1 "1’st warning level" 2 "2’nd warning level" 3 "3’nd warning level (the closest status with obstacle)" 4 "Reserved" 5 "Reserved" 6 "Not used" 7 "Error Indicator" ;
VAL_ 314 SPAS_FrRtWrngDis 0 "OFF (No warning)" 1 "1’st warning level" 2 "2’nd warning level" 3 "3’nd warning level (the closest status with obstacle)" 4 "Reserved" 5 "Reserved" 6 "Not used" 7 "Error Indicator" ;
VAL_ 314 SPAS_RrLftWrngDis 0 "OFF (No warning)" 1 "1’st warning level" 2 "2’nd warning level" 3 "3’nd warning level (the closest status with obstacle)" 4 "Reserved" 5 "Reserved" 6 "Not used" 7 "Error Indicator" ;
VAL_ 314 SPAS_RrCtrWrngDis 0 "OFF (No warning)" 1 "1’st warning level" 2 "2’nd warning level" 3 "3’nd warning level (the closest status with obstacle)" 4 "Reserved" 5 "Reserved" 6 "Not used" 7 "Error Indicator" ;
VAL_ 314 SPAS_RrRtWrngDis 0 "OFF (No warning)" 1 "1’st warning level" 2 "2’nd warning level" 3 "3’nd warning level (the closest status with obstacle)" 4 "Reserved" 5 "Reserved" 6 "Not used" 7 "Error Indicator" ;
VAL_ 314 SPAS_BpAlrmReq 0 "No warning alarm" 1 "SPAS or PAS Failure State warning alarm" 3 "Change to TGS “R” warning alarm" 4 "SPAS parking complete warning alarm" 7 "“Stop” message during SPAS function warning alarm" 8 "“Scan complete” message warning" 9 "“System abort” message during SPAS driving warning alarm" 10 "“Gear Shift to Backward” warning alarm" 11 "“Gear Shift to Forward” warning alarm" 12 "SPAS parking out complete warning alarm" 30 "Not used" 31 "Error Indicator" ;
VAL_ 314 SPAS_AlrmVlmLvlReq 0 "Default" 1 "Level 1" 2 "Level 2" 3 "Level 3" 4 "Reserved" 5 "Reserved" 6 "Not used" 7 "Error Indicator" ;
VAL_ 314 SPAS_AlrmVlmDeratingReq 0 "OFF (deactivation of warning alarm)" 1 "ON (activation of warning alarm)" 2 "Not used" 3 "Error Indicator" ;
VAL_ 314 SPAS_FrAlrmReq 0 "OFF(No warning alarm)" 1 "’st warning alarm level" 2 "2’nd warning alarm level" 3 "3’nd warning alarm level (the closest status with obstacle)" ;
VAL_ 314 SPAS_RrWrngAlrmReq 0 "OFF(No warning alarm)" 1 "1’st warning alarm level" 2 "2’nd warning alarm level" 3 "3’nd warning alarm level (the closest status with obstacle)" ;
VAL_ 314 SPAS_FrLftWrngAlrmReq 0 "OFF(No warning alarm)" 1 "1’st warning alarm level" 2 "2’nd warning alarm level" 3 "3’nd warning alarm level (the closest status with obstacle)" ;
VAL_ 314 SPAS_FrCtrWrngAlrmReq 0 "OFF(No warning alarm)" 1 "1’st warning alarm level" 2 "2’nd warning alarm level" 3 "3’nd warning alarm level (the closest status with obstacle)" ;
VAL_ 314 SPAS_FrRtWrngAlrmReq 0 "OFF(No warning alarm)" 1 "1’st warning alarm level" 2 "2’nd warning alarm level" 3 "3’nd warning alarm level (the closest status with obstacle)" ;
VAL_ 314 SPAS_RrLftWrngAlrmReq 0 "OFF(No warning alarm)" 1 "1’st warning alarm level" 2 "2’nd warning alarm level" 3 "3’nd warning alarm level (the closest status with obstacle)" ;
VAL_ 314 SPAS_RrCtrWrngAlrmReq 0 "OFF(No warning alarm)" 1 "1’st warning alarm level" 2 "2’nd warning alarm level" 3 "3’nd warning alarm level (the closest status with obstacle)" ;
VAL_ 314 SPAS_RrRtWrngAlrmReq 0 "OFF(No warning alarm)" 1 "1’st warning alarm level" 2 "2’nd warning alarm level" 3 "3’nd warning alarm level (the closest status with obstacle)" ;
VAL_ 314 SPAS_Sta 0 "Reserved" 1 "SPAS_Init" 2 "SPAS_NewStart" 3 "SPAS_Standby" 4 "SPAS_Active" 5 "SPAS_Angle_Control_Active" 6 "SPAS_Failure" 7 "SPAS_Abort" 8 "Reserved" 9 "Reserved" 10 "Reserved" 11 "Reserved" 12 "Reserved" 13 "Reserved" 14 "Not used" 15 "Error Indicator" ;
VAL_ 314 SPAS_TestModSta 0 "SPAS is not in Test Mode" 1 "SPAS is in Test Mode" 2 "Not used" 3 "Error Indicator" ;
VAL_ 96 ABS_ActvSta 0 "ABS control inactive" 1 "ABS control active" 2 "Not used" 3 "Error Indicator" ;
VAL_ 96 ABS_DfctvSta 0 "ABS is not defective" 1 "ABS is defective" 2 "Not used" 3 "Error Indicator" ;
VAL_ 96 ABS_DiagSta 0 "ABS/TCS/ESC is not diagnostic mode" 1 "ABS/TCS/ESC is diagnostic mode" 2 "Not used" 3 "Error Indicator" ;
VAL_ 96 EBD_DfctvSta 0 "EBD is not defective" 1 "EBD is defective" 2 "Not used" 3 "Error Indicator" ;
VAL_ 96 TCS_CtrlSta 0 "TCS Inactive" 1 "TCS Active" 2 "Not used" 3 "Error Indicator" ;
VAL_ 96 TCS_DfctvSta 0 "TCS is not defective" 1 "TCS is defective (failed)" 2 "Not used" 3 "Error Indicator" ;
VAL_ 96 TCS_DisableSta 0 "TCS is enabled by user" 1 "TCS is disabled by user" 2 "Not used" 3 "Error Indicator" ;
VAL_ 96 TCS_Req 0 "Passive" 1 "TCS/ESC control active" 2 "Not used" 3 "Error Indicator" ;
VAL_ 96 TCS_GearShftCharacteristicVal 0 "passive (gear change allowed)" 1 "active (gear change not allowed)" 2 "Not used" 3 "Error Indicator" ;
VAL_ 96 MSR_FuncReq 0 "Passive or TCS function" 1 "MSR control active" 2 "Not used" 3 "Error Indicator" ;
VAL_ 96 TCS_PreActvSta 0 "-" 1 "Pre TCS Active" 2 "Not used" 3 "Error Indicator" ;
VAL_ 96 TCS_ManufacturerVal 0 "Using both TQI_TCS and TQI_SLW_TCS" 1 "Using TQI_TCS only (Not using TQI_SLW_TCS)" 2 "Not used" 3 "Error Indicator" ;
VAL_ 96 ESC_CtrlSta 0 "ESC inactive" 1 "ESC active" 2 "Not used" 3 "Error Indicator" ;
VAL_ 96 ESC_DfctvSta 0 "ESC is not defective" 1 "ESC is defective (failed)" 2 "Not used" 3 "Error Indicator" ;
VAL_ 96 ESC_DisableSta 0 "ESC enabled by user (SW On)0x1" 2 "Not used" 3 "Error Indicator" ;
VAL_ 96 HAC_CtrlSta 0 "HAC is Inactive" 1 "HAC is Active" 2 "Not used" 3 "Error Indicator" ;
VAL_ 96 HAC_DfctvSta 0 "HAC is not defective" 1 "HAC is defective (failed)" 2 "Not used" 3 "Error Indicator" ;
VAL_ 96 HAC_StdbySta 0 "HAC is not stand by (SW OFF) If SW is applied" 1 "HAC is stand by (SW ON) If SW is applied" 2 "Not used" 3 "Error Indicator" ;
VAL_ 96 DBC_CtrlSta 0 "DBC is Inactive" 1 "DBC is Active" 2 "Not used" 3 "Error Indicator" ;
VAL_ 96 DBC_DfctvSta 0 "DBC is not defective" 1 "DBC is defective (failed)" 2 "Not used" 3 "Error Indicator" ;
VAL_ 96 DBC_StdbySta 0 "DBC is not stand by (SW OFF)" 1 "DBC is stand by (SW ON)" 2 "Not used" 3 "Error Indicator" ;
VAL_ 96 ESC_VsmCtrlModSta 0 "Inactive" 1 "Mode 1 (sensor value overlay mode)" 2 "Mode 2 (output torque overlay mode)" 3 "Mode 3 (Particular control)" ;
VAL_ 96 ESC_VsmActvSta 0 "VSM control inactive" 1 "VSM control active" 2 "Not used" 3 "Error Indicator" ;
VAL_ 96 ESC_VsmDfctvSta 0 "VSM is not defective" 1 "VSM is defective" 2 "Not used" 3 "Error Indicator" ;
VAL_ 96 ESC_StrTqReq 4095 "Error" ;
VAL_ 96 ABS_WrngLmpSta 0 "ABS Warning lamp OFF" 1 "ABS Warning lamp ON" 2 "Not used" 3 "Error Indicator" ;
VAL_ 96 EBD_WrngLmpSta 0 "EBD Warning lamp OFF" 1 "EBD Warning lamp ON" 2 "Not used" 3 "Error Indicator" ;
VAL_ 96 TCS_LmpSta 0 "TCS/ESC Function/Warning Lamp OFF" 1 "TCS/ESC Function/Warning Lamp ON" 2 "TCS/ESC Function/Warning Lamp BLINKING(2Hz)" 3 "Error Indicator" ;
VAL_ 96 TCS_OffLmpSta 0 "TCS/ESC OFF SW Lamp OFF" 1 "TCS/ESC OFF SW Lamp ON" 2 "Not used" 3 "Error Indicator" ;
VAL_ 96 ESC_OffTempSta 0 "Normal Mode" 1 "Sports Mode" 2 "Off Mode" 3 "ESC OFF SW is defective (failed)" ;
VAL_ 96 DBC_FuncLmpSta 0 "DBC Function lamp OFF" 1 "DBC Function lamp ON" 2 "DBC Function lamp BLINKING(2Hz)" 3 "Error Indicator" ;
VAL_ 96 DBC_WrngLmpSta 0 "DBC Warning lamp OFF" 1 "DBC Warning lamp ON" 2 "Not used" 3 "Error Indicator" ;
VAL_ 96 AVH_CluDis 0 "AVH is off" 1 "AUTO HOLD to be deactivated Press Brake Pedal" 2 "Press Brake Pedal to Release AUTO HOLD" 3 "AUTO HOLD cannot be activated Close Door, Hood, Trunk" 4 "AUTO HOLD cannot be deactivated, Close Door" ;
VAL_ 96 AVH_AlrmReq 0 "No alarm" 1 "On AVH Activation, Vehicle is not secured and driver is still inside = comfortable tone" 2 "Not used" 3 "Error Indicator" ;
VAL_ 96 AVH_ActvStaLmpDis 0 "Lamp On" 1 "Lamp Off" 2 "Not used" 3 "Error Indicator" ;
VAL_ 96 AVH_LmpDis 0 "AVH Off (Lamp Status" 1 "AVH failure (Lamp Status" 2 "AVH ACTIVE (Lamp Status" 3 "AVH READY (Lamp Status" 4 "Lamp Status" 5 "Lamp Status" 6 "Lamp Status" ;
VAL_ 96 AWD_TransmsnTqLimModSta 0 "Maximum limitation mode" 1 "Minimum limitation mode" 2 "Not used" 3 "Error Indicator" ;
VAL_ 96 AWD_CltchDtyLimVal 255 "Error" ;
VAL_ 96 AWD_RrWhlDtyLimReq 0 "No request from ESC" 1 "Request duty limit from ESC" 2 "Not used" 3 "Error Indicator" ;
VAL_ 96 AWD_FastOpnCrdnShftCltchReq 0 "Passive" 1 "Clutch off" 2 "Torque limit" 3 "Error" ;
VAL_ 96 AWD_CrdnShftTqLimVal 65535 "Error" ;
VAL_ 96 EPB_ActvReq 0 "No request" 1 "Release request" 2 "Close request in comfort mode" 3 "Close request in secure mode" ;
VAL_ 96 EPB_StaReq 0 "REQ_EPB_ACT signal is invalid" 1 "REQ_EPB_ACT signal is valid" 2 "Not used" 3 "Error Indicator" ;
VAL_ 96 LDM_Sta 0 "ESC ready to DBF/AVH (requested by switch)" 1 "ESC can’t perform DBF/AVH (requested by switch)" 2 "Not used" 3 "Error Indicator" ;
VAL_ 96 ECD_ActvSta 0 "ECD is not active" 1 "ECD is active(operating)" 2 "Not used" 3 "Error Indicator" ;
VAL_ 96 AVH_Sta 0 "No apply" 1 "Vehicle is held by the service brake" 2 "Being released" 3 "Error Indicator" ;
VAL_ 96 ESC_CylPrsrVal 4095 "Error" ;
VAL_ 96 ESC_CylPrsrSta 0 "Master cylinder pressure signal is invalid" 1 "Master cylinder pressure signal is valid" 2 "Not used" 3 "Error Indicator" ;
VAL_ 96 ESC_CylPrsrDiagSta 0 "Master cylinder pressure is not available temporarily" 1 "Master cylinder pressure signal is available" 2 "Not used" 3 "Error Indicator" ;
VAL_ 96 ESC_CylPrsrFlagSta 0 "Off" 1 "On" 2 "Not used" 3 "Error Indicator" ;
VAL_ 96 ESS_Sta 0 "ESS control 'inactive' (Normal condition)" 1 "ESS control 'active' (Emergency stop condition)" 2 "ESS system is defective" 3 "ESS extended function active (Hazard lamp blinking)" ;
VAL_ 96 ESC_BrkLtActvSta 0 "No request" 1 "Activate brake lights" 2 "Not used" 3 "Error Indicator" ;
VAL_ 96 ESC_BrkCtrlSta 0 "Brake control is not in activation" 1 "Brake control is in activation" 2 "Not used" 3 "Error Indicator" ;
