AUTOSAR XML (schema 00047)
# (C) 2021 HYUNDAI AUTOEVER Corp.
package /AUTRON
  ecuc definition collection ParameterDefinition_LinSM: module=LinSM
  module definition LinSM [0..1]: post-build-variant-support=true, refined-module-def=LinSM, variants pre-compile  # Configuration of the Lin State Manager module.
    container LinSMConfigSet: category=CHANGEABLE  # This container contains the configuration parameters and sub containers of the AUTOSAR LinSm module.
      integer LinSMModeRequestRepetitionMax: 0..255, category=CHANGEABLE, post-build-variant-value=true, set at pre-compile, default-value=0  # Specifies the maximal amount of mode request repetitions without a respective mode indication from the LinIf module until the LinSM module reports a Development Error to the Det and tries to go back to no communication.
      container LinSMChannel [1..*]: category=CHANGEABLE  # Describes each LIN channel the LinSM is connected to.
        float LinSMConfirmationTimeout: 0..Inf, category=CHANGEABLE, set at pre-compile, default-value=0  # Timeout in seconds for the goto sleep, wakeup and schedule request calls to LinIf. The timeout must be longer than a goto-sleep command on the bus (i.e. it is bit rate dependent).
        enumeration LinSMNodeType: {MASTER, SLAVE}, category=CHANGEABLE, set at pre-compile, default-value=MASTER  # Specifies the LIN node type of this channel.
        float LinSMSilenceAfterWakeupTimeout [0..1]: 0..Inf, category=CHANGEABLE, set at pre-compile, default-value=0  # Timeout in seconds after a failed wakeup sequence until a new wakeup process is started.
        boolean LinSMTransceiverPassiveMode [0..1]: category=CHANGEABLE, multiplicity set at pre-compile, set at pre-compile, default-value=false  # Selects STANDBY (true) or SLEEP (false) transceiver mode when entering LINSM_NO_COM.
        reference LinSMComMNetworkHandleRef: category=CHANGEABLE, set at pre-compile, requires-symbolic-name-value=true, destination=ComMChannel  # Unique handle to identify one certain LIN network. Reference to one of the network handles configured in the ComM.
        container LinSMSchedule [0..*]: category=CHANGEABLE  # The schedule references to a schedule that is located in the LinIf configuration. Moreover, the PDU groups are located in the COM configuration. Note that there are two references to PDU groups. The simple reason is that a PDU group is only allowed to contain one direction (TX or RX). | Only applicable to LIN master nodes.
          integer LinSMScheduleIndex: 0..255, category=CHANGEABLE, set at pre-compile, symbolic-name-value=true, default-value=0  # This index parameter can be used by the BswM as a SymbolicNameReference target. The LinSM just forwards the request from the BswM to LinIf. Note that the value of the LinSMScheduleIndex shall be the same as the value from the LinIf.
          reference LinSMScheduleIndexRef: category=CHANGEABLE, post-build-variant-value=true, set at pre-compile, requires-symbolic-name-value=true, destination=LinIfScheduleTable  # Reference to a schedule table in the LinIf configuration
    container LinSMGeneral: category=CHANGEABLE  # This container contains general parameters of LIN State Manager module.
      boolean LinSMDevErrorDetect: category=CHANGEABLE, set at pre-compile, default-value=false  # Switches the development error detection and notification on or off. | * true: detection and notification is enabled. * false: detection and notification is disabled.
      float LinSMMainProcessingPeriod: 0..Inf, category=CHANGEABLE, set at pre-compile, default-value=0.005  # Fixed period that the MainFunction shall be called.
      boolean LinSMVersionInfoApi: category=CHANGEABLE, set at pre-compile, default-value=false  # Switches the LinSM_GetVersionInfo function ON or OFF.
