AUTOSAR XML (schema 00047)
# (C) 2021 HYUNDAI AUTOEVER Corp.
package /AUTRON
  ecuc definition collection ParameterDefinition_LinTrcv: module=LinTrcv
  module definition LinTrcv [0..*]: refined-module-def=LinTrcv, variants pre-compile  # Configuration of LIN Transceiver Driver module
    container LinTrcvChannel [1..*]: category=CHANGEABLE  # Container gives LIN transceiver driver information about a single LIN transceiver channel. Any LIN transceiver driver has such LIN transceiver channels.
      integer LinTrcvChannelId: 0..255, category=CHANGEABLE, set at pre-compile, symbolic-name-value=true, default-value=0  # Unique identifier of the LIN Transceiver Channel.
      boolean LinTrcvChannelUsed: category=CHANGEABLE, set at pre-compile, default-value=true  # Shall the related LIN transceiver channel be used? | True: Is used False Is not used
      boolean LinTrcvWakeupByBusUsed: category=CHANGEABLE, set at pre-compile, default-value=false  # Is wake up by bus supported? If LIN transceiver hardware does not support wake up by bus value is always FALSE. If LIN transceiver hardware supports wake up by bus value is TRUE or FALSE depending whether it is used or not. | TRUE = Is used. FALSE = Is not used.
      boolean LinTrcvStandbyModeUsed: category=CHANGEABLE, default-value=true  # Switches LinTrcv support StandbyMode or not If LIN transceiver hardware supports StandbyMode value is TRUE or FALSE depending whether it is used or not. | TRUE = StandbyMode is used. FALSE = StandbyMode is not used.
      reference LinTrcvChannelEcucPartitionRef [0..1]: category=NOT_SUPPORTED, scope=ECU, multiplicity set at pre-compile, post-build-variant-multiplicity=true, post-build-variant-value=true, set at pre-compile, destination=EcucPartition  # Maps one single Lin transceiver channel to zero or one ECUC partitions. The ECUC partition referenced is a subset of the ECUC partitions where the Lin transceiver driver is mapped to. Tags: atp.Status=draft
      reference LinTrcvIcuChannelRef [0..1]: category=NOT_SUPPORTED, scope=ECU, multiplicity set at pre-compile, set at pre-compile, requires-symbolic-name-value=true, destination=IcuChannel  # Reference to the IcuChannel to enable/disable the interrupts for wakeups. | Reference to the IcuChannel to enable/disable the interrupts for wakeups. This parameter is not used in current implementation. is not refered by hardware
      reference LinTrcvWakeupSourceRef [0..1]: category=CHANGEABLE, scope=ECU, multiplicity set at pre-compile, set at pre-compile, requires-symbolic-name-value=true, destination=EcuMWakeupSource  # Reference to a wakeup source in the EcuM configuration. This reference is only needed if LinTrcvWakeupByBusUsed is true. Implementation Type: reference to EcuM_WakeupSourceType.
      choice container LinTrcvAccess  # Container gives LIN transceiver driver access about a single LIN transceiver channel.
        container LinTrcvDioAccess [0..1]: category=CHANGEABLE  # Container gives LIN transceiver driver information about accessing ports and port pins. In addition relation between LIN transceiver hardware pin names and Dio port access information is given. If a LIN transceiver hardware has no Dio interface, there is no instance of this container.
          container LinTrcvDioChannelAccess [1..*]: category=CHANGEABLE  # Container gives DIO channel access by single Lin transceiver channel.
            string LinTrcvHardwareInterfaceName: category=CHANGEABLE, set at pre-compile  # LIN transceiver hardware interface name. It is typically the name of a pin. From a Dio point of view it is either a port, a single channel or a channel group. Depending on this fact either LINTRCV_DIO_PORT_SYMBOLIC_NAME or LINTRCV_DIO_CHANNEL_SYMBOLIC_NAME or LINTRCV_DIO_CHANNEL_GROUP_SYMBOLIC_NAME shall reference a Dio configuration. The LIN transceiver driver implementation description shall list up this name for the appropriate LIN transceiver hardware. | EN : Pin used for switching to Normal Mode. Wk : Pin used for causing an internal Wake Up. RxD : Pin used for reading wake type. TxD : Pin used for reading wake type.
            choice reference LinTrcvDioSymRefName: category=CHANGEABLE, set at pre-compile, destination=[DioChannel, DioChannelGroup, DioPort]  # Choice Reference to a DIO Port, DIO Channel or DIO Channel Group. This reference replaces the LINTRCV_DIO_PORT_SYM_NAME, LINTRCV_DIO_CHANNEL_SYM_NAME and LINTRCV_DIO_GROUP_SYM_NAME references in the Lin Trcv SWS.
        container LinTrcvSpiSequence [0..1]: category=NOT_SUPPORTED  # Container gives LIN transceiver driver information about one SPI sequence. | One SPI sequence used by LIN transceiver driver is in exclusive use for it. No other driver is allowed to access this sequence. LIN transceiver driver may use one sequence to access n LIN transceiver hardwares chips of the same type or n sequences are used to access one single LIN transceiver hardware chip. If a LIN transceiver hardware has no SPI interface, there is no instance of this container.
          reference LinTrcvSpiSequenceName: category=NOT_SUPPORTED, set at pre-compile, requires-symbolic-name-value=true, destination=SpiSequence  # Reference to a Spi sequence configuration container.
    container LinTrcvGeneral: category=CHANGEABLE  # Container gives LIN transceiver driver basic information.
      boolean LinTrcvDevErrorDetect: category=CHANGEABLE, set at pre-compile, default-value=false  # Switches the development error detection and notification on or off. | * true: detection and notification is enabled. * false: detection and notification is disabled.
      integer LinTrcvIndex: 0..255, category=CHANGEABLE, set at pre-compile, default-value=0  # Specifies the InstanceId of this module instance. If only one instance is present it shall have the Id 0.
      enumeration LinTrcvTimerType [0..1]: {None, Timer_1us16bit}, category=CHANGEABLE, multiplicity set at pre-compile, set at pre-compile, default-value=Timer_1us16bit  # Type of the Time Service Predefined Timer.
      boolean LinTrcvVersionInfoApi: category=CHANGEABLE, set at pre-compile, default-value=false  # Switches version information API on and off. If switched off, function need not be present in compiled code. | True: Is used False: Is not used
      float LinTrcvWaitTime [0..1]: 0..2.55E-4, category=CHANGEABLE, multiplicity set at pre-compile, set at pre-compile, default-value=0.000050  # Wait time for transceiver state changes in seconds.
      boolean LinTrcvWakeUpSupport: category=CHANGEABLE, set at pre-compile, default-value=false  # Informs whether wake up is supported or not. In case wake up is not supported by LIN transceiver hardware the setting shall be false. The wake up ability may be switched on or off for each channel of one LIN transceiver by LinTrcvWakeupSourceRef. | True: Is used False: Is not used
      reference LinTrcvEcucPartitionRef [0..*]: category=NOT_SUPPORTED, scope=ECU, multiplicity set at pre-compile, post-build-variant-multiplicity=true, post-build-variant-value=true, set at pre-compile, destination=EcucPartition  # Maps the Lin transceiver driver to zero or multiple ECUC partitions to make the modules API available in this partition. The Lin transceiver driver will operate as an independent instance in each of the partitions. Tags: atp.Status=draft
