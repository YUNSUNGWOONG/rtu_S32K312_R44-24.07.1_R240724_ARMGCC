AUTOSAR XML (schema 00047)
# (C) 2021 HYUNDAI AUTOEVER Corp.
package /AUTRON
  module definition Tm [0..1]: scope=ECU, refined-module-def=Tm, variants pre-compile  # Configuration of the Time Service module.
    container TmGeneral  # General configuration of Time Service module.
      boolean TmDevErrorDetect: set at pre-compile, default-value=false  # Switches the development error detection and notification on or off.
      boolean TmEnablePredefTimer100us32bit: scope=ECU, set at pre-compile  # Specifies if the Predef Timer 100µs32bit shall be enabled (functionality and set of API services). ON or OFF.
      boolean TmEnablePredefTimer1us16bit: scope=ECU, set at pre-compile  # Specifies if the Predef Timer 1µs16bit shall be enabled (functionality and set of API services). ON or OFF.
      boolean TmEnablePredefTimer1us24bit: scope=ECU, set at pre-compile  # Specifies if the Predef Timer 1µs24bit shall be enabled (functionality and set of API services). ON or OFF.
      boolean TmEnablePredefTimer1us32bit: scope=ECU, set at pre-compile  # Specifies if the Predef Timer 1µs32bit shall be enabled (functionality and set of API services). ON or OFF.
      boolean TmVersionInfoApi: set at pre-compile, default-value=false  # Adds / removes the service Tm_GetVersionInfo() from the code. ON or OFF.
      boolean TmWaitLoop: set at pre-compile, default-value=false  # Enable/Disable Wait Loop in API: Tm_BusyWait1us16bit. Tm_BusyWait1us24bit. Tm_BusyWait1us32bit. Tm_BusyWait100us32bit.
      integer TmWaitLoopNumber: 0..65535, set at pre-compile, symbolic-name-value=true  # This parameter specifies Number iterator of Wait Loop.
  ecuc definition collection ParameterDefinition_Tm: module=Tm
