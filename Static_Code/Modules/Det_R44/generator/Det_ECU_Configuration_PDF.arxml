AUTOSAR XML (schema 00047)
# (C) 2019 HYUNDAI AUTRON Co., Ltd.
# Confidential Proprietary Information. Distribution Limited.
# Do Not Copy Without Prior Permission
package /AUTRON
  module definition Det [0..1]: refined-module-def=Det, variants pre-compile  # Det configuration includes the functions to be called at notification. On one | side the application functions are specified and in general it can be decided whether Dlt shall be called at each call of Det.
    container DetConfigSet [0..1]  # Configuration set container for Det.
      container DetModule [0..*]  # This container describes a non BSW module that is using the Det via Service Interface.
        integer DetModuleId: 4096..65535, set at pre-compile, symbolic-name-value=true  # Unique identifier of the error reporting component. When reporting errors to the DET, a symbolic name derived from the moduleID has to be used to identify the reporter.
        container DetModuleInstance [1..*]: multiplicity set at pre-compile, post-build-variant-multiplicity=true  # Describes the Instance used for the according Service Port. | It shall be used to differentiate software component instances when multiple instantiation is used.
          integer DetInstanceId: 0..255, set at pre-compile, default-value=0  # Describes the InstanceId used for the according Service Port. | It shall be used to differentiate software component instances when multiple instantiation is used. Else it shall be set to 0.
    container DetGeneral  # Generic configuration parameters of the Det module.
      boolean DetForwardToDlt [0..1]: multiplicity set at pre-compile, set at pre-compile  # Only if the parameter is present and set to true, the Det requires the Dlt interface and forwards it's call to the function Dlt_DetForwardErrorTrace. In this case the optional interface to Dlt_Det is required.
      boolean DetVersionInfoApi: set at pre-compile, default-value=false  # Pre-processor switch to enable / disable the API to read out the modules version information. | true: Version info API enabled. false: Version info API disabled.
      integer DetRamBufferSize: set at pre-compile, default-value=0  # Pre-processor switch to enable / disable the API to read out the modules version information.
    container DetNotification [0..1]  # Configuration of the notification functions.
      function name DetErrorHook [0..*]: multiplicity set at pre-compile, set at pre-compile  # Optional list of functions to be called by the Default Error Tracer in context of each call of Det_ReportError. | The type of these functions shall be identical the type of Det_ReportError itself: Std_ReturnType (*f)(uint16, uint8, uint8, uint8).
      function name DetReportRuntimeErrorCallout [0..*]: set at pre-compile  # This parameter defines the existence and the names of callout functions for the corresponding runtime error handler. | The type of these functions shall be identical the type of Det_ReportRuntimeError itself: Std_ReturnType (*f)(uint16, uint8, uint8, uint8)
      function name DetReportTransientFaultCallout [0..*]: set at pre-compile  # This parameter defines the existence and the names of callout functions for the corresponding transient fault handler. | The type of these functions shall be identical the type of Det_ReportTransientFault itself: Std_ReturnType (*f)(uint16, uint8, uint8, uint8)
  ecuc definition collection ParameterDefinition_Det: module=Det
