AUTOSAR XML (schema 00047)
# (C) 2021 HYUNDAI AUTOEVER Corp.
package /AUTRON
  ecuc definition collection ParameterDefinition_NvM: module=NvM
  module definition NvM [0..1]: refined-module-def=NvM, variants link-time/pre-compile  # Configuration of the NvM (NvRam Manager) module.
    container NvMBlockDescriptor [1..65536]  # Container for a management structure to configure the composition of a given NVRAM Block Management Type. Its multiplicity describes the number of configured NVRAM blocks, one block is required to be configured. The NVRAM block descriptors are condensed in the NVRAM block descriptor table.
      enumeration NvMBlockCrcType [0..1]: {NVM_CRC16, NVM_CRC32, NVM_CRC8}, multiplicity set at link in variant link-time / pre-compile in variant pre-compile, set at link in variant link-time / pre-compile in variant pre-compile  # Defines CRC data width for the NVRAM block. Default: NVM_CRC16, i.e. CRC16 will be used if NVM_BLOCK_USE_CRC==true
      string NvMBlockHeaderInclude [0..1]: multiplicity set at link in variant link-time / pre-compile in variant pre-compile, set at link in variant link-time / pre-compile in variant pre-compile  # Defines the header file where the owner of the NVRAM block has the declarations of the permanent RAM data block, ROM data block (if configured) and the callback function prototype for each configured callback. If no permanent RAM block, ROM block or callback functions are configured then this configuration parameter shall be ignored.
      integer NvMBlockJobPriority: 0..255, set at link in variant link-time / pre-compile in variant pre-compile  # Defines the job priority for a NVRAM block (0 = Immediate priority).
      integer NvMReadAllOrder [0..1]: 1..65535, set at pre-compile, symbolic-name-value=true  # Reading order when executing ReadAll function. If NvMNvramBlockIdentifier of this block is "1", NvMReadAllOrder should be blank.
      integer NvMWriteAllOrder [0..1]: 1..65535, set at pre-compile, symbolic-name-value=true  # Writing order when executing WriteAll function. If NvMNvramBlockIdentifier of this block is "1", NvMWriteAllOrder should be blank.
      enumeration NvMBlockManagementType: {NVM_BLOCK_DATASET, NVM_BLOCK_NATIVE, NVM_BLOCK_REDUNDANT}, set at link in variant link-time / pre-compile in variant pre-compile  # Defines the block management type for the NVRAM block.[NVM137]
      boolean NvMBlockUseAutoValidation: set at link in variant link-time / pre-compile in variant pre-compile, default-value=false  # Defines whether the RAM Block shall be auto validated during shutdown phase. | true: if auto validation mechanism is used, false: otherwise
      boolean NvMBlockUseCrc: set at link in variant link-time / pre-compile in variant pre-compile  # Defines CRC usage for the NVRAM block, i.e. memory space for CRC is reserved in RAM and NV memory. | true: CRC will be used for this NVRAM block. false: CRC will not be used for this NVRAM block.
      boolean NvMBlockUseCRCCompMechanism: set at link in variant link-time / pre-compile in variant pre-compile, default-value=false  # Defines whether the CRC of the RAM Block shall be compared during a write job with the CRC which was calculated during the last successful read or write job. | true: if compare mechanism is used, false: otherwise
      boolean NvMBlockUseSetRamBlockStatus: set at link in variant link-time / pre-compile in variant pre-compile  # Defines if NvMSetRamBlockStatusApi shall be used for this block or not. | Note: If NvMSetRamBlockStatusApi is disabled this configuration parameter shall be ignored. true: calling of NvMSetRamBlockStatus for this RAM block shall set the status of the RAM block. false: calling of NvMSetRamBlockStatus for this RAM block shall be ignored.
      boolean NvMBlockUseSyncMechanism: set at link in variant link-time / pre-compile in variant pre-compile, default-value=false  # Defines whether an explicit synchronization mechanism with a RAM mirror and callback routines for transferring data to and from NvM module's RAM mirror is used for NV block. true if synchronization mechanism is used, false otherwise.
      boolean NvMBlockWriteProt: set at link in variant link-time / pre-compile in variant pre-compile  # Defines an initial write protection of the NV block | true: Initial block write protection is enabled. false: Initial block write protection is disabled.
      boolean NvMBswMBlockStatusInformation: set at link in variant link-time / pre-compile in variant pre-compile, default-value=false  # This parameter specifies whether BswM is informed about the current status of the specified block. | True: Call BswM_NvM_CurrentBlockMode on changes False: Don't inform BswM at all
      boolean NvMCalcRamBlockCrc [0..1]: multiplicity set at link in variant link-time / pre-compile in variant pre-compile, set at link in variant link-time / pre-compile in variant pre-compile  # Defines CRC (re)calculation for the permanent RAM block or NVRAM blocks which are configured to use explicit synchronization mechanism. | true: CRC will be (re)calculated for this permanent RAM block. false: CRC will not be (re)calculated for this permanent RAM block.
      function name NvMInitBlockCallback [0..1]: multiplicity set at link in variant link-time / pre-compile in variant pre-compile, set at link in variant link-time / pre-compile in variant pre-compile  # Entry address of a block specific callback routine which shall be called if no ROM data is available for initialization of the NVRAM block. | If not configured, no specific callback routine shall be called for initialization of the NVRAM block with default data.
      integer NvMMaxNumOfReadRetries: 0..7, set at link in variant link-time / pre-compile in variant pre-compile, default-value=0  # Defines the maximum number of read retries.
      integer NvMMaxNumOfWriteRetries: 0..7, set at link in variant link-time / pre-compile in variant pre-compile  # Defines the maximum number of write retries for a NVRAM block with [ECUC_NvM_00061]. Regardless of configuration a consistency check (and maybe write retries) are always forced for each block which is processed by the request NvM_WriteAll and NvM_WriteBlock.
      integer NvMNvBlockBaseNumber: 1..65534, set at link in variant link-time / pre-compile in variant pre-compile  # Configuration parameter to perform the link between the NVM_NVRAM_BLOCK_IDENTIFIER used by the SW-Cs and the FEE_BLOCK_NUMBER expected by the memory abstraction modules. The parameter value equals the FEE_BLOCK_NUMBER or EA_BLOCK_NUMBER shifted to the right by NvMDatasetSelectionBits bits. (ref. to chapter 7.1.2.1). | Calculation Formula: value = TargetBlockReference.[Ea/Fee]BlockConfiguration.[Ea/Fee]BlockNumber >> NvMDatasetSelectionBits
      integer NvMNvBlockLength: 1..65535, set at link in variant link-time / pre-compile in variant pre-compile  # Defines the NV block data length in bytes. | Note: The implementer can add the attribute 'withAuto' to the parameter definition which indicates that the length can be calculated by the generator automatically (e.g. by using the sizeof operator). When 'withAuto' is set to 'true' for this parameter definition the 'isAutoValue' can be set to 'true'. If 'isAutoValue' is set to 'true' the actual value will not be considered during ECU Configuration but will be (re-)calculated by the code generator and stored in the value attribute afterwards.
      integer NvMNvBlockNum: 1..255, set at link in variant link-time / pre-compile in variant pre-compile  # Defines the number of multiple NV blocks in a contiguous area according to the given block management type. | 1-255 For NVRAM blocks to be configured of block management type NVM_BLOCK_DATASET. The actual range is limited according to SWS_NvM_00444. 1 For NVRAM blocks to be configured of block management type NVM_BLOCK_NATIVE 2 For NVRAM blocks to be configured of block management type NVM_BLOCK_REDUNDANT
      integer NvMNvramBlockIdentifier: 1..65535, set at pre-compile, symbolic-name-value=true  # Identification of a NVRAM block via a unique block identifier. | Implementation Type: NvM_BlockIdType. min = 2 max = 2^(16- NVM_DATASET_SELECTION_BITS)-1 Reserved NVRAM block IDs: 0 -> to derive multi block request results via NvM_GetErrorStatus 1 -> redundant NVRAM block which holds the configuration ID (generation tool should check that this block is correctly configured from type,CRC and size point of view)
      integer NvMNvramDeviceId: 0..1, set at link in variant link-time / pre-compile in variant pre-compile  # Defines the NVRAM device ID where the NVRAM block is located. | Calculation Formula: value = TargetBlockReference.[Ea/Fee]BlockConfiguration.[Ea/Fee]DeviceIndex
      string NvMRamBlockDataAddress [0..1]: multiplicity set at link in variant link-time / pre-compile in variant pre-compile, set at link in variant link-time / pre-compile in variant pre-compile  # Defines the start address of the RAM block data. | If this is not configured, no permanent RAM data block is available for the selected block management type.
      function name NvMReadRamBlockFromNvCallback [0..1]: multiplicity set at link in variant link-time / pre-compile in variant pre-compile, set at link in variant link-time / pre-compile in variant pre-compile  # Entry address of a block specific callback routine which shall be called in order to let the application copy data from the NvM module's mirror to RAM block. | Implementation type: Std_ReturnType E_OK: copy was successful E_NOT_OK: copy was not successful, callback routine to be called again
      boolean NvMResistantToChangedSw: set at link in variant link-time / pre-compile in variant pre-compile  # Defines whether a NVRAM block shall be treated resistant to configuration changes or not. If there is no default data available at configuration time then the application shall be responsible for providing the default initialization data. In this case the application has to use NvM_GetErrorStatus()to be able to distinguish between first initialization and corrupted data. | true: NVRAM block is resistant to changed software. false: NVRAM block is not resistant to changed software.
      string NvMRomBlockDataAddress [0..1]: multiplicity set at link in variant link-time / pre-compile in variant pre-compile, set at link in variant link-time / pre-compile in variant pre-compile  # Defines the start address of the ROM block data. | If not configured, no ROM block is available for the selected block management type.
      integer NvMRomBlockNum: 0..254, set at link in variant link-time / pre-compile in variant pre-compile  # Defines the number of multiple ROM blocks in a contiguous area according to the given block management type. | 0-254 For NVRAM blocks to be configured of block management type NVM_BLOCK_DATASET. The actual range is limited according to SWS_NvM_00444. 0-1 For NVRAM blocks to be configured of block management type NVM_BLOCK_NATIVE 0-1 For NVRAM blocks to be configured of block management type NVM_BLOCK_REDUNDANT
      boolean NvMSelectBlockForFirstInitAll [0..1]: multiplicity set at link in variant link-time / pre-compile in variant pre-compile, set at link in variant link-time / pre-compile in variant pre-compile, default-value=false  # Defines whether a block will be processed or not by NvM_FirstInitAll. A block can be configured to be processed even if it doesn't have permanent RAM and/or explicit synchronization. | TRUE: block will be processed by NvM_FirstInitAll FALSE: block will not be processed by NvM_FirstInitAll
      boolean NvMSelectBlockForReadAll [0..1]: multiplicity set at link in variant link-time / pre-compile in variant pre-compile, set at link in variant link-time / pre-compile in variant pre-compile  # Defines whether a NVRAM block shall be processed during NvM_ReadAll or not. This configuration parameter has only influence on those NVRAM blocks which are configured to have a permanent RAM block or which are configured to use explicit synchronization mechanism. | true: NVRAM block shall be processed by NvM_ReadAll false: NVRAM block shall not be processed by NvM_ReadAll
      boolean NvMSelectBlockForWriteAll [0..1]: multiplicity set at link in variant link-time / pre-compile in variant pre-compile, set at link in variant link-time / pre-compile in variant pre-compile  # Defines whether a NVRAM block shall be processed during NvM_WriteAll or not. This configuration parameter has only influence on those NVRAM blocks which are configured to have a permanent RAM block or which are configured to use explicit synchronization mechanism. | true: NVRAM block shall be processed by NvM_WriteAll false: NVRAM block shall not be processed by NvM_WriteAll
      function name NvMSingleBlockCallback [0..1]: multiplicity set at link in variant link-time / pre-compile in variant pre-compile, set at link in variant link-time / pre-compile in variant pre-compile  # Entry address of the block specific callback routine which shall be invoked on termination of each asynchronous single block request [NVM113].
      boolean NvMStaticBlockIDCheck: set at link in variant link-time / pre-compile in variant pre-compile, default-value=false  # Defines if the Static Block ID check is enabled. | false: Static Block ID check is disabled. true: Static Block ID check is enabled.
      boolean NvMWriteBlockOnce: set at link in variant link-time / pre-compile in variant pre-compile  # Defines write protection after first write. The NVRAM manager sets the write protection bit either after the NV block was written the first time or if the block was already written and it is detected as valid and consistent during a read for it. [NVM276]. | true: Defines write protection after first write is enabled. false: Defines write protection after first write is disabled.
      function name NvMWriteRamBlockToNvCallback [0..1]: multiplicity set at link in variant link-time / pre-compile in variant pre-compile, set at link in variant link-time / pre-compile in variant pre-compile  # Entry address of a block specific callback routine which shall be called in order to let the application copy data from RAM block to NvM module's mirror. | Implementation type: Std_ReturnType E_OK: copy was successful E_NOT_OK: copy was not successful, callback routine to be called again
      boolean NvMWriteVerification: set at link in variant link-time / pre-compile in variant pre-compile, default-value=false  # Defines if Write Verification is enabled. | false: Write verification is disabled. true: Write Verification is enabled.
      integer NvMWriteVerificationDataSize: 1..65535, set at link in variant link-time / pre-compile in variant pre-compile  # Defines the number of bytes to compare in each step when comparing the content of a RAM Block and a block read back.
      boolean NvMDefaultROMCRCEnabled: origin=AUTRON
      choice container NvMTargetBlockReference  # This parameter is just a container for the parameters for EA and FEE
        container NvMEaRef [0..1]  # EEPROM Abstraction
          reference NvMNameOfEaBlock: set at link in variant link-time / pre-compile in variant pre-compile, requires-symbolic-name-value=true, destination=EaBlockConfiguration  # reference to EaBlock
        container NvMFeeRef [0..1]  # Flash EEPROM Emulation
          reference NvMNameOfFeeBlock: set at link in variant link-time / pre-compile in variant pre-compile, requires-symbolic-name-value=true, destination=FeeBlockConfiguration  # reference to FeeBlock
    container NvMCommon  # Container for common configuration options.
      enumeration NvMApiConfigClass: {NVM_API_CONFIG_CLASS_1, NVM_API_CONFIG_CLASS_2, NVM_API_CONFIG_CLASS_3}, set at pre-compile  # Preprocessor switch to enable some API calls which are related to NVM API configuration classes.
      boolean NvMBswMMultiBlockJobStatusInformation: set at link in variant link-time / pre-compile in variant pre-compile, default-value=true  # This parameter specifies whether BswM is informed about the current status of the multiblock job. | True: call BswM_NvM_CurrentJobMode if ReadAll and WriteAll are started, finished, canceled False: do not inform BswM at all
      integer NvMCompiledConfigId: 0..65535, set at pre-compile  # Configuration ID regarding the NV memory layout. This configuration ID shall be published as e.g. a SW-C shall have the possibility to write it to NV memory.
      integer NvMCrcNumOfBytes: 1..65535, set at link in variant link-time / pre-compile in variant pre-compile  # If CRC is configured for at least one NVRAM block, this parameter defines the maximum number of bytes which shall be processed within one cycle of job processing.
      integer NvMDatasetSelectionBits: 0..8, set at link in variant link-time / pre-compile in variant pre-compile  # Defines the number of least significant bits which shall be used to address a certain dataset of a NVRAM block within the interface to the memory hardware abstraction. | 0..8: Number of bits which are used for dataset or redundant block addressing. 0: No dataset or redundant NVRAM blocks are configured at all, no selection bits required. 1: In case of redundant NVRAM blocks are configured, but no dataset NVRAM blocks.
      boolean NvMDevErrorDetect: set at pre-compile, default-value=false  # Switches the development error detection and notification on or off. | * true: detection and notification is enabled. * false: detection and notification is disabled.
      boolean NvMDrvModeSwitch: set at link in variant link-time / pre-compile in variant pre-compile  # Preprocessor switch to enable switching memory drivers to fast mode during performing NvM_ReadAll and NvM_WriteAll | true: Fast mode enabled. false: Fast mode disabled.
      boolean NvMDynamicConfiguration: set at link in variant link-time / pre-compile in variant pre-compile  # Preprocessor switch to enable the dynamic configuration management handling by the NvM_ReadAll request. | true: Dynamic configuration management handling enabled. false: Dynamic configuration management handling disabled. This parameter affects all NvM processing related to Block with ID 1 and all processing related to Resistant to Changed Software. If the Dynamic Configuration is disabled, Block 1 cannot be used by NvM.
      boolean NvMJobPrioritization: set at link in variant link-time / pre-compile in variant pre-compile  # Preprocessor switch to enable job prioritization handling | true: Job prioritization handling enabled. false: Job prioritization handling disabled.
      float NvMMainFunctionPeriod: 0..Inf, scope=ECU, set at pre-compile  # The period between successive calls to the main function in seconds.
      function name NvMMultiBlockCallback [0..1]: multiplicity set at link in variant link-time / pre-compile in variant pre-compile, set at link in variant link-time / pre-compile in variant pre-compile  # Entry address of the common callback routine which shall be invoked on termination of each asynchronous multi block request
      boolean NvMPollingMode: set at link in variant link-time / pre-compile in variant pre-compile  # Preprocessor switch to enable/disable the polling mode in the NVRAM Manager and at the same time disable/enable the callback functions useable by lower layers | true: Polling mode enabled, callback function usage disabled. false: Polling mode disabled, callback function usage enabled.
      integer NvMRepeatMirrorOperations: 0..7, set at link in variant link-time / pre-compile in variant pre-compile, default-value=0  # Defines the number of retries to let the application copy data to or from the NvM module's mirror before postponing the current job.
      boolean NvMSetRamBlockStatusApi: set at pre-compile  # Preprocessor switch to enable the API NvM_SetRamBlockStatus. | true: API NvM_SetRamBlockStatus enabled. false: API NvM_SetRamBlockStatus disabled.
      integer NvMSizeImmediateJobQueue [0..1]: 1..65535, multiplicity set at link in variant link-time / pre-compile in variant pre-compile, set at link in variant link-time / pre-compile in variant pre-compile  # Defines the number of queue entries for the immediate priority job queue. If NVM_JOB_PRIORITIZATION is switched OFF this parameter shall be out of scope.
      integer NvMSizeStandardJobQueue: 1..65535, set at link in variant link-time / pre-compile in variant pre-compile  # Defines the number of queue entries for the standard job queue.
      boolean NvMVersionInfoApi: set at pre-compile, default-value=false  # Pre-processor switch to enable / disable the API to read out the modules version information [NVM285], [NVM286]. | true: Version info API enabled. false: Version info API disabled.
      boolean NvMReadAllOrderSupport [0..1]: set at pre-compile, default-value=false  # Pre-processor switch to enable / disable the support user defined order when using ReadAll functions. | true: Order support enabled. false: Order support disabled.
      boolean NvMWriteAllOrderSupport [0..1]: set at pre-compile, default-value=false  # Pre-processor switch to enable / disable the support user defined order when using WriteAll functions. | true: Order support enabled. false: Order support disabled.
      boolean NvMDefaultROMCRCEnabled
      function name NvMUserWdgToggleFunction [0..1]: origin=AUTRON  # This parameter specifies the callback function name without parameters. The callback function is used for User Watchdog Reset in initialization step.
      function name NvMUserJobFunction [0..1]: origin=AUTRON  # This parameter specifies the function name without parameters. The parameters are specified during configuration time, and cannot be changed during run time. Any return value passed by the callout will be ignored.
      choice reference NvMMainfunctionTriggerRef [0..1]: set at pre-compile, origin=AUTRON, destination=OsAlarm  # Reference to a OsAlarm for the Memory servicing routine implementation.
      container NvMUserIncludeFiles
        string NvMUserIncludeFiles: origin=AUTRON
    container NvmDemEventParameterRefs [0..1]  # Container for the references to DemEventParameter elements which shall be invoked using the API Dem_SetEventStatus in case the corresponding error occurs. The EventId is taken from the referenced DemEventParameter's DemEventId symbolic value. The standardized errors are provided in this container and can be extended by vendor-specific error references.
      reference NVM_E_HARDWARE [0..1]: scope=ECU, multiplicity set at pre-compile, set at pre-compile, requires-symbolic-name-value=true, destination=DemEventParameter  # Reference to the DemEventParameter which shall be issued when the hardware error has occured.
      reference NVM_E_INTEGRITY_FAILED [0..1]: scope=ECU, multiplicity set at pre-compile, set at pre-compile, requires-symbolic-name-value=true, destination=DemEventParameter  # Reference to the DemEventParameter which shall be issued when the error "API request integrity failed" has occurred.
      reference NVM_E_LOSS_OF_REDUNDANCY [0..1]: scope=ECU, multiplicity set at pre-compile, set at pre-compile, requires-symbolic-name-value=true, destination=DemEventParameter  # Reference to the DemEventParameter which shall be issued when the error "loss of redundancy" has occurred.
      reference NVM_E_REQ_FAILED [0..1]: scope=ECU, multiplicity set at pre-compile, set at pre-compile, requires-symbolic-name-value=true, destination=DemEventParameter  # Reference to the DemEventParameter which shall be issued when the error "API request failed" has occurred.
      reference NVM_E_VERIFY_FAILED [0..1]: scope=ECU, multiplicity set at pre-compile, set at pre-compile, requires-symbolic-name-value=true, destination=DemEventParameter  # Reference to the DemEventParameter which shall be issued when the error "Write Verification failed" has occurred.
      reference NVM_E_WRITE_PROTECTED [0..1]: scope=ECU, multiplicity set at pre-compile, set at pre-compile, requires-symbolic-name-value=true, destination=DemEventParameter  # Reference to the DemEventParameter which shall be issued when the error "write attempt to NVRAM block with write protection" has occurred.
      reference NVM_E_WRONG_BLOCK_ID [0..1]: scope=ECU, multiplicity set at pre-compile, set at pre-compile, requires-symbolic-name-value=true, destination=DemEventParameter  # Reference to the DemEventParameter which shall be issued when the error "Static Block ID check failed" has occurred.
