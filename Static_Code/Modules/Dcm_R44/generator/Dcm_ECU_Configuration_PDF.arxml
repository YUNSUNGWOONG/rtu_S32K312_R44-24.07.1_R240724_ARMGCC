AUTOSAR XML (schema 00047)
# (C) 2019-2020 HYUNDAI AUTRON Co., Ltd.
# Confidential Proprietary Information. Distribution Limited.
# Do Not Copy Without Prior Permission
package /AUTRON
  ecuc definition collection DcmParameterDefinition: module=Dcm
  module definition Dcm [0..1]: post-build-variant-support=true, refined-module-def=Dcm, variants link-time/post-build/pre-compile  # Configuration of the Dcm (Diagnostic Communications Manager) module.
    container DcmConfigSet  # This container contains the configuration parameters and sub containers of the DCM module supporting multiple configuration sets.
      container DcmDsd  # These parameters configure the Diagnostic Service Dispatcher submodule.
        container DcmDsdServiceRequestManufacturerNotification [0..*]: requires-index=true  # The name of this container is used to define the name of the R-Port through which the DCM accesses the interface ServiceRequestNotification. | The R-Port is named ServiceRequestManufacturerNotification_{Name} where {Name} is the name of the container DcmDsdServiceRequestManufacturerNotification. The lowerMultiplicity is 0: If container DcmDsdServiceRequestManufacturerNotification does not exist the Indication API is not available.
        container DcmDsdServiceRequestSupplierNotification [0..*]: requires-index=true  # The name of this container is used to define the name of the R-Port through which the DCM accesses the interface ServiceRequestNotification. | The R-Port is named ServiceRequestSupplierNotification_<SWC> where <SWC> is the name of the container DcmDsdServiceRequestSupplierNotification. The lowerMultiplicity is 0: If the container DcmDsdRequestSupplierNotification does not exist the Indication API is not available.
        container DcmDsdServiceTable [1..256]  # This container contains the configuration (DSD parameters) for a Service Identifier Table. | Note: It is allowed to add OBD services to a DcmDsdServiceTable related to a UDS Protocol. But it is not allowed to add UDS services to a DcmDsdServiceTable related to an OBD Protocol.
          integer DcmDsdSidTabId: 0..255, scope=ECU, set at link in variant link-time / pre-compile in variant post-build+pre-compile  # Due to using possibly more service tables, the unique DcmDsdSidTabId can be used to identify them.
          container DcmDsdService [1..*]  # This container contains the configuration (DSD parameters) for a Service.
            integer DcmDsdServiceRole [0..1]: 0..4294967295, scope=ECU, multiplicity set at link in variant link-time / post-build in variant post-build / pre-compile in variant pre-compile, post-build-variant-multiplicity=true, post-build-variant-value=true, set at link in variant link-time / post-build in variant post-build / pre-compile in variant pre-compile  # Bitfield were each bit represents one dedicated role. A diagnostic service is granted access if the bit value is 1. If a bit value is 0, the service is not allowed to be executed for that role.
            boolean DcmDsdServiceUsed: post-build-variant-value=true, set at link in variant link-time / post-build in variant post-build / pre-compile in variant pre-compile, default-value=true  # Allows to activate or deactivate the usage of a Service. This parameter can be used for multi-purpose ECUs. | true - service is available false - service is not available
            function name DcmDsdSidTabFnc [0..1]: scope=ECU, multiplicity set at link in variant link-time / pre-compile in variant post-build+pre-compile, set at link in variant link-time / pre-compile in variant post-build+pre-compile  # Callback function of the ECU Supplier specific component for the particular service. The function's prototype is as described for <Module>_<DiagnosticService>. If this parameter is not configured, the service is handled Dcm-internally.
            integer DcmDsdSidTabServiceId: 0..255, scope=ECU, set at link in variant link-time / pre-compile in variant post-build+pre-compile  # Identifier of the service. | The possible service identifiers are defined in ISO 14229-1 and ISO 15031-5.
            boolean DcmDsdSidTabSubfuncAvail: scope=ECU, set at link in variant link-time / pre-compile in variant post-build+pre-compile  # Information about whether the service has subfunctions or not. This parameter is used for the handling of the "suppressPosRspMsgIndicationBit" as defined in ISO 14229-1, which can be used as a reference for the configuration. | true - service has subfunctions, suppressPosRspMsgIndicationBit is available false - service has no subfunctions, suppressPosRspMsgIndicationBit is not available
            reference DcmDsdSidTabModeRuleRef [0..1]: scope=ECU, multiplicity set at link in variant link-time / pre-compile in variant post-build+pre-compile, set at link in variant link-time / pre-compile in variant post-build+pre-compile, destination=DcmModeRule  # Reference to a DcmDspModeRule which controls the execution of the service. If there is no reference configured, no mode rule check shall be performed.
            reference DcmDsdSidTabSecurityLevelRef [0..*]: scope=ECU, multiplicity set at link in variant link-time / pre-compile in variant post-build+pre-compile, origin=AUTOSAR_ECUC V1.0.0, set at link in variant link-time / pre-compile in variant post-build+pre-compile, destination=DcmDspSecurityRow  # Reference to a Security Level in which the service is allowed to be executed. Multiple references are allowed for a service. | Please refer to ISO 14229-1, ISO 15031-5 and chapter "Verification of the Service Security Access levels." If there is no reference configured, no service security verification shall be performed.
            reference DcmDsdSidTabSessionLevelRef [0..*]: scope=ECU, multiplicity set at link in variant link-time / pre-compile in variant post-build+pre-compile, origin=AUTOSAR_ECUC V1.0.0, set at link in variant link-time / pre-compile in variant post-build+pre-compile, destination=DcmDspSessionRow  # Reference to a Session Level in which the service is allowed to be executed. Multiple references are allowed for a service. | Please refer to ISO 14229-1, ISO 15031-5 and chapter "Verification of the Diagnostic Session". If there is no reference configured, no diagnostic session verification shall be performed.
            container DcmDsdSubService [0..*]  # This container contains the configuration (DSD parameters) for a subservice of a service. Only those services may have subservices, which have the DcmDsdSidTabSubfuncAvail configured as TRUE.
              function name DcmDsdSubServiceFnc [0..1]: multiplicity set at link in variant link-time / pre-compile in variant post-build+pre-compile, set at link in variant link-time / pre-compile in variant post-build+pre-compile  # Callback function of the ECU Supplier specific component for the particular service. The function's prototype is as described for <Module>_<DiagnosticService>_<SubService>. | If this parameter is not configured, the subservice is handled Dcm-internally.
              integer DcmDsdSubServiceId: 0..127, scope=ECU, set at link in variant link-time / pre-compile in variant post-build+pre-compile  # Identifier of the subservice. | The possible subservice identifiers are defined in ISO 14229-1 and ISO 15031-5.
              integer DcmDsdSubServiceRole [0..1]: 0..4294967295, scope=ECU, multiplicity set at link in variant link-time / post-build in variant post-build / pre-compile in variant pre-compile, post-build-variant-multiplicity=true, post-build-variant-value=true, set at link in variant link-time / post-build in variant post-build / pre-compile in variant pre-compile  # Bitfield were each bit represents one dedicated role. A sub-function of a diagnostic service is granted access if the bit value is 1. If a bit value is 0, the service is not allowed to be executed for that role.
              boolean DcmDsdSubServiceUsed: post-build-variant-value=true, set at link in variant link-time / post-build in variant post-build / pre-compile in variant pre-compile, default-value=true  # Allows to activate or deactivate the usage of a Subservice. This parameter can be used for multi-purpose ECUs. | true - subservice is available false - subservice is not available.
              reference DcmDsdSubServiceModeRuleRef [0..1]: scope=ECU, multiplicity set at link in variant link-time / pre-compile in variant post-build+pre-compile, set at link in variant link-time / pre-compile in variant post-build+pre-compile, destination=DcmModeRule  # Reference to a DcmDspModeRule which controls the execution of the subservice. | If there is no reference configured, no mode rule check shall be performed.
              reference DcmDsdSubServiceSecurityLevelRef [0..*]: scope=ECU, multiplicity set at link in variant link-time / pre-compile in variant post-build+pre-compile, set at link in variant link-time / pre-compile in variant post-build+pre-compile, destination=DcmDspSecurityRow  # Reference to a Security Level in which the subservice is allowed to be executed. Multiple references are allowed for a subservice. | Please refer to ISO 14229-1, ISO 15031-5 and chapter "Verification of the Service Security Access levels." If there is no reference configured, no subservice security verification shall be performed.
              reference DcmDsdSubServiceSessionLevelRef [0..*]: scope=ECU, multiplicity set at link in variant link-time / pre-compile in variant post-build+pre-compile, set at link in variant link-time / pre-compile in variant post-build+pre-compile, destination=DcmDspSessionRow  # Reference to a Session Level in which the subservice is allowed to be executed. Multiple references are allowed for a subservice. | Please refer to ISO 14229-1, ISO 15031-5 and chapter "Verification of the Diagnostic Session". If there is no reference configured, no diagnostic session verification shall be performed.
      container DcmDsl  # These parameters configure the Diagnostic Session Layer submodule.
        container DcmDslBuffer [1..256]  # This container contains the configuration of a diagnostic buffer.
          integer DcmDslBufferSize: 8..4294967294, scope=ECU, set at pre-compile  # Size of the diagnostic buffer in bytes. | For a linear buffer the size shall be as large as the longest diagnostic message (request or response). For a paged buffer the size has impacts on the application performance.
        container DcmDslCallbackDCMRequestService [0..*]  # Each DcmDslCallbackDCMRequestService container defines an R-Port with the CallbackDCMRequestServices interface which the Dcm uses to ask permission for protocol changes from the application software. The R-Port has the name CallbackDCMRequestServices_<SWC> where <SWC> is the name of this container.
        container DcmDslDiagResp  # This container contains the configuration of the automatic requestCorrectlyReceivedResponsePending response management in the Dcm.
          integer DcmDslDiagRespMaxNumRespPend: 0..255, scope=ECU, origin=AUTOSAR_ECUC V1.0.0, set at link in variant link-time / pre-compile in variant post-build+pre-compile  # Maximum number of negative responses with response code 0x78 (requestCorrectlyReceivedResponsePending) allowed for a request. If Dcm reaches this limit, an automatic 0x10 (generalReject) final response will be trasmitted and the service processing will be cancelled.
          boolean DcmDslDiagRespOnSecondDeclinedRequest: scope=ECU, origin=AUTOSAR_ECUC V1.0.0, set at link in variant link-time / pre-compile in variant post-build+pre-compile  # Defines the reaction upon a second request (ClientB) that can not be processed (e.g. due to priority assessment). | TRUE: when the second request (Client B) can not be processed, it shall be answered with NRC21 BusyRepeatRequest. FALSE: when the second request (Client B) can not be processed, it shall not be responded.
        container DcmDslProtocol  # This container contains the configurations of the diagnostic protocols used in Dcm.
          container DcmDslProtocolRow [1..*]  # This container contains the configuration of one particular diagnostic protocol used in Dcm.
            integer DcmDslProtocolMaximumResponseSize [0..1]: 1..65535, scope=ECU, multiplicity set at pre-compile, set at pre-compile, default-value=4095  # This parameter is mandatory and defines the maximum length of the response message in case DcmPagedBufferEnabled == TRUE
            integer DcmDslProtocolPriority: 0..255, scope=ECU, set at link in variant link-time / pre-compile in variant post-build+pre-compile  # Protocol priority used during protocol preemption. A higher priority protocol may preempt a lower priority protocol. | Lower numeric values represent higher protocol priority: 0 - Highest protocol priority 255 - Lowest protocol priority
            boolean DcmDslProtocolRowUsed: post-build-variant-value=true, set at link in variant link-time / post-build in variant post-build / pre-compile in variant pre-compile, default-value=true  # Allows to activate or deactivate the usage of a Protocol. This parameter can be used for multi-purpose ECUs. | true - protocol is available false - protocol is not available.
            enumeration DcmDslProtocolTransType [0..1]: {TYPE1, TYPE2}, scope=ECU, origin=AUTOSAR_ECUC V1.0.0, set at link in variant link-time / pre-compile in variant post-build+pre-compile  # This parameter is used only if the protocol is of type DCM_ROE_ON_xxx. It selects the transmission type of the protocol.
            enumeration DcmDslProtocolType: {DCM_OBD_ON_CAN, DCM_OBD_ON_FLEXRAY, DCM_OBD_ON_IP, DCM_PERIODICTRANS_ON_CAN, DCM_PERIODICTRANS_ON_FLEXRAY, DCM_PERIODICTRANS_ON_IP, DCM_ROE_ON_CAN, DCM_ROE_ON_FLEXRAY, DCM_ROE_ON_IP, DCM_SUPPLIER_1, DCM_SUPPLIER_10, DCM_SUPPLIER_11, DCM_SUPPLIER_12, DCM_SUPPLIER_13, DCM_OBD_ON_UDS, DCM_ZEV_ON_UDS, DCM_SUPPLIER_2, DCM_SUPPLIER_3, DCM_SUPPLIER_4, DCM_SUPPLIER_5, DCM_SUPPLIER_6, DCM_SUPPLIER_7, DCM_SUPPLIER_8, DCM_SUPPLIER_9, DCM_UDS_ON_CAN, DCM_UDS_ON_FLEXRAY, DCM_UDS_ON_IP, DCM_UDS_ON_LIN}, scope=ECU, set at pre-compile, symbolic-name-value=true  # The diagnostic protocol type for the DCM DSL protocol that is being configured. | Implementation Type: Dcm_ProtocolType
            integer DcmDspProtocolEcuAddr [0..1]: 0..65535, scope=ECU, set at pre-compile  # Ecu source address used for diagnostic communication. This parameter is required for Generic Connections.
            boolean DcmSendRespPendOnRestart: set at link in variant link-time / pre-compile in variant post-build+pre-compile, default-value=true  # If set to TRUE, the Dcm will send a NRC 0x78 before a transition to bootloader or performing an ECU reset. If set to False, no 0x78 is send in this case.
            float DcmTimStrP2ServerAdjust: 0..1, scope=ECU, set at link in variant link-time / pre-compile in variant post-build+pre-compile  # This parameter is used to guarantee that the diagnostic response is available on the bus before reaching P2 by adjusting the current DcmDspSessionP2ServerMax. | This parameter mainly represents the software architecture dependent communication delay between the time the transmission is initiated by DCM and the time when the message is actually transmitted to the bus. The parameter value is defined in seconds and must be a multiple of DcmTaskTime.
            float DcmTimStrP2StarServerAdjust: 0..5, scope=ECU, set at link in variant link-time / pre-compile in variant post-build+pre-compile  # This parameter is used to guarantee that the diagnostic response is available on the bus before reaching P2Star by adjusting the current DcmDspSessionP2StarServerMax. | This parameter mainly represents the software architecture dependent communication delay between the time the transmission is initiated by DCM and the time when the message is actually transmitted to the bus. The parameter value is defined in seconds and must be a multiple of DcmTaskTime.
            reference DcmDemClientRef [0..1]: scope=ECU, multiplicity set at pre-compile, set at pre-compile, destination=DemClient  # Reference to DemClient in Dem configuration. | Used by the Dem to distinguish different client calls.
            reference DcmDslProtocolRxBufferRef: scope=ECU, set at link in variant link-time / pre-compile in variant post-build+pre-compile, destination=DcmDslBuffer  # Reference to a configured diagnostic buffer that is used for diagnostic request reception for the protocol.
            reference DcmDslProtocolSIDTable: scope=ECU, set at link in variant link-time / pre-compile in variant post-build+pre-compile, destination=DcmDsdServiceTable  # Reference to a service table that is used for diagnostic request processing for this protocol.
            reference DcmDslProtocolTxBufferRef: scope=ECU, set at link in variant link-time / pre-compile in variant post-build+pre-compile, destination=DcmDslBuffer  # Reference to a configured diagnostic buffer that is used for diagnostic response transmission for the protocol.
            choice container DcmDslConnection [1..*]  # This container contains the configuration of a communication channel for one particular protocol. | Note that it is allowed to communicate with multiple testers, therefore multiple connections may be configured for a protocol.
              container DcmDslMainConnection [0..1]  # This container contains the configuration for a main connection of a diagnostic protocol. Additionally it may contain references to ROE and Periodic connections if the protocol type or protocol transmission type needs them.
                integer DcmDslProtocolRxConnectionId: 0..65535, scope=ECU, multiplicity set at pre-compile, set at link in variant link-time / pre-compile in variant post-build+pre-compile, symbolic-name-value=true  # Unique identifier of the tester which uses this connection for diagnostic communication.
                integer DcmDslProtocolRxTesterSourceAddr [0..1]: 0..65535, scope=ECU, multiplicity set at pre-compile, set at link in variant link-time / pre-compile in variant post-build+pre-compile  # Tester source address uniquely describes a client and will be used e.g within the jump to Bootloader interfaces. This parameter is not required for generic connections (DcmPdus with MetaDataLength >= 1).
                integer DcmDslProtocolAuthenticationConnectionId [0..1]: 0..65535, set at pre-compile, symbolic-name-value=true  # Unique identifier of the main connection which uses this connection for Diagnostic Authentication Service.
                reference DcmDslPeriodicTransmissionConRef [0..1]: scope=ECU, multiplicity set at pre-compile, origin=AUTOSAR_ECUC V1.0.0, set at link in variant link-time / pre-compile in variant post-build+pre-compile, destination=DcmDslPeriodicTransmission  # Reference to a periodic transmission connection which is used for the processing of periodic transmission events.
                reference DcmDslProtocolComMChannelRef: scope=ECU, set at link in variant link-time / pre-compile in variant post-build+pre-compile, destination=ComMChannel  # Reference to the ComMChannel on which the DcmDslProtocolRxPdu is received and the DcmDslProtocolTxPdu is transmitted.
                reference DcmDslROEConnectionRef [0..1]: scope=ECU, multiplicity set at pre-compile, origin=AUTOSAR_ECUC V1.0.0, set at link in variant link-time / pre-compile in variant post-build+pre-compile, destination=DcmDslResponseOnEvent  # Reference to a ResponseOnEvent connection which is used for the processing of ResponseOnEvent events.
                container DcmDslProtocolRx [1..*]  # This container contains the configuration parameters of a reception channel in a diagnostic connection. | The PDU referenced by this reception channel can consume meta data items of type SOURCE_ADDRESS_16 and TARGET_ADDRESS_16.
                  enumeration DcmDslProtocolRxAddrType: {DCM_FUNCTIONAL_TYPE, DCM_PHYSICAL_TYPE}, scope=ECU, set at link in variant link-time / pre-compile in variant post-build+pre-compile  # Selects the addressing type of the reception channel. Physical addressing is used for 1:1 communication, functional addressing is used for 1:N communication. | For details refer to ISO 14229-1.
                  integer DcmDslProtocolRxPduId: 0..65535, scope=ECU, set at pre-compile, symbolic-name-value=true  # Identifier of the PDU that is used for this reception channel.
                  reference DcmDslProtocolRxPduRef: scope=ECU, set at link in variant link-time / pre-compile in variant post-build+pre-compile, destination=Pdu  # Reference to a Pdu in EcuC that is used for this reception channel.
                container DcmDslProtocolTx [0..1]  # This container contains the configuration parameters of a transmission channel in a diagnostic connection. | The PDU referenced by this transmission channel can produce meta data items of type TARGET_ADDRESS_16 and SOURCE_ADDRESS_16.
                  integer DcmDslTxConfirmationPduId: 0..65535, scope=ECU, set at pre-compile, symbolic-name-value=true  # Identifier of the PDU that is used by the lower level module for transmission confirmation of responses on this channel.
                  reference DcmDslProtocolTxPduRef: scope=ECU, set at link in variant link-time / pre-compile in variant post-build+pre-compile, destination=Pdu  # Reference to a Pdu in EcuC that is used for this transmission channel.
              container DcmDslPeriodicTransmission [0..1]  # This container contains the configuration of a periodic transmission connection.
                container DcmDslPeriodicConnection [0..*]  # This container contains the configuration of a transmission channel for a periodic transmission connection. | The PDU referenced by this transmission channel can produce meta data items of type TARGET_ADDRESS_16 and SOURCE_ADDRESS_16.
                  integer DcmDslPeriodicTxConfirmationPduId: 0..65535, scope=ECU, set at pre-compile, symbolic-name-value=true  # Identifier of the PDU that is used by the lower level module for transmission confirmation of responses on this channel.
                  reference DcmDslPeriodicTxPduRef: scope=ECU, set at link in variant link-time / pre-compile in variant post-build+pre-compile, destination=Pdu  # Reference to a Pdu in EcuC that is used for this periodic transmission channel.
              container DcmDslResponseOnEvent [0..1]  # This container contains the configuration of a ResponseOnEvent connection. | The PDU referenced by this transmission channel can produce meta data items of type TARGET_ADDRESS_16 and SOURCE_ADDRESS_16.
                integer DcmDslRoeTxConfirmationPduId [0..1]: 0..65535, scope=ECU, multiplicity set at pre-compile, set at pre-compile, symbolic-name-value=true  # Identifier of the PDU that is used by the lower level module for transmission confirmation of responses on this connection.
                reference DcmDslRoeTxPduRef [0..1]: scope=ECU, multiplicity set at pre-compile, set at link in variant link-time / pre-compile in variant post-build+pre-compile, destination=Pdu  # Reference to a Pdu in EcuC that is used for this ResponseOnEvent transmission connection.
      container DcmDsp [0..1]  # These parameters apply to Diagnostic Service Processing. There will always be one set of these parameters per Dcm. | Please note: Although the multiplicity is set to 0..1. It can be expected that this container exists in any valid DCM configuration.
        enumeration DcmDspDataDefaultEndianness: {BIG_ENDIAN, LITTLE_ENDIAN, OPAQUE}, set at link in variant link-time / pre-compile in variant post-build+pre-compile  # Defines the default endianness belonging to a DID, RID or PID if the corresponding data does not define an endianness.
        boolean DcmDspDDDIDcheckPerSourceDID [0..1]: multiplicity set at link in variant link-time / pre-compile in variant post-build+pre-compile, set at link in variant link-time / pre-compile in variant post-build+pre-compile  # Defines the check for session, security and mode dependencies per source DIDs with a ReadDataByIdentifier (0x22). | true: Dcm module shall check the session, security and mode dependencies per source DIDs with a ReadDataByIdentifier (0x22) with DID in the range 0xF200 to 0xF3FF false: Dcm module shall not check the session, security and mode dependencies per source DIDs with a ReadDataByIdentifier (0x22) with DID in the range 0xF200 to 0xF3FF
        boolean DcmDspEnableObdMirror: scope=ECU, set at link in variant link-time / pre-compile in variant post-build+pre-compile, default-value=false  # DcmDspEnableObdMirror defines whether a DID inside the OBD range (F400-F4FF) and the OBD InfoType range (F800-F8FF) shall get the DID value as defined for OBD on reception of the UDS Service ReadDataByIdentifier (0x22), or not. | It also defines whether a RID inside the OBD range (E000-E0FF) shall handle the RID as defined for OBD on reception of the UDS Service RoutineControl (0x31), or not.
        integer DcmDspMaxDidToRead [0..1]: 1..65535, scope=ECU, multiplicity set at link in variant link-time / pre-compile in variant post-build+pre-compile, set at link in variant link-time / pre-compile in variant post-build+pre-compile  # Indicates the maximum allowed DIDs in a single "ReadDataByIdentifier" request.
        integer DcmDspMaxPeriodicDidToRead [0..1]: 1..65535, multiplicity set at link in variant link-time / pre-compile in variant post-build+pre-compile, set at link in variant link-time / pre-compile in variant post-build+pre-compile  # Indicates the maximum allowed periodicDIDs which can be read in a single "ReadDataByPeriodicIdentifier" request.
        integer DcmDspPowerDownTime [0..1]: 0..255, scope=ECU, multiplicity set at link in variant link-time / pre-compile in variant post-build+pre-compile, set at link in variant link-time / pre-compile in variant post-build+pre-compile  # This parameter indicates to the client the minimum time of the stand-by sequence the server will remain in the power-down sequence. | The resolution of this parameter is one second per count. The following values are valid: 00 - FE hex: 0 - 254 s powerDownTime; FF hex: indicates a failure or time not available. This value needs to be defined by the integrator according to the ECU capabilities. This parameter has to be available if the service EcuReset, sub-service enableRapidPowerShutDown is configured.
        container DcmDspAuthentication [0..1]  # This container contains the configuration for the UDS service Authentication (0x29).
          integer DcmDspAuthenticationDeauthenticatedRole: 1..4294967295, scope=ECU, set at pre-compile  # Role used for service authentication verification in the deauthenticated state.
          integer DcmDspAuthenticationDataBufferLength [0..1]: 1..65535, scope=ECU, set at link in variant link-time / pre-compile in variant post-build+pre-compile  # The buffer length to get data from KeyM and Csm.
          float DcmDspAuthenticationDefaultSessionTimeOut [0..1]: 0..Inf, scope=ECU, multiplicity set at pre-compile, set at pre-compile  # Defines the number of seconds after which the Dcm makes a transition to deauthenticated state, in case of no active communication.
          float DcmDspAuthenticationAsyncTimeOut: 0..Inf, scope=ECU, multiplicity set at pre-compile, set at pre-compile  # Defines the number of seconds waiting time after Dcm call a asynchronous function.
          integer DcmDspAuthenticationGeneralNRC [0..1]: 0..255, scope=ECU, set at pre-compile  # Defines the NRC that shall be send as replacement of all ISO 14229-1 defined NRCs in case of invalid certificate or content.
          integer DcmDspAuthenticationRoleSize: 1..4, scope=ECU, set at pre-compile  # Defines the size in bytes for the role element within a certificate.
          integer DcmDspAuthenticationWhiteListDIDMaxSize [0..1]: 1..255, scope=ECU, set at pre-compile  # Defines the maximum size in bytes for the white list element within a certificate.
          integer DcmDspAuthenticationWhiteListMemorySelectionMaxSize [0..1]: 1..255, scope=ECU, set at pre-compile  # Defines the maximum size in bytes for the white list element within a certificate.
          integer DcmDspAuthenticationWhiteListRIDMaxSize [0..1]: 1..255, scope=ECU, set at pre-compile  # Defines the maximum size in bytes for the white list element within a certificate.
          integer DcmDspAuthenticationWhiteListServicesMaxSize [0..1]: 1..255, scope=ECU, set at pre-compile  # Defines the maximum size in bytes for the white list element within a certificate.
          reference DcmDspAuthenticationGeneralNRCModeRuleRef [0..1]: scope=ECU, multiplicity set at pre-compile, set at pre-compile, destination=DcmModeRule  # Mode rule that defines if the general NRC shall be send for all failures due to invalid certificate or content.
          reference DcmDspAuthenticationPersistStateModeRuleRef [0..1]: scope=ECU, multiplicity set at pre-compile, set at pre-compile, destination=DcmModeRule  # References a mode rule that defines if the authentication state shall be persisted in non-volatile memory.
          reference DcmDspAuthenticationPersitStateNvMBlockIdRef [0..1]: scope=ECU, multiplicity set at pre-compile, set at pre-compile, destination=NvMBlockDescriptor  # References a NvM Block Id that persist authentication state in non-volatile memory.
          container DcmDspAuthenticationConnection [0..*]  # This container contains the authentication configuration use for a dsl connection.
            reference DcmDspAuthenticationCertificatePublicKeyStoreJobRef: scope=ECU, multiplicity set at pre-compile, set at pre-compile, destination=CsmJob  # Reference to a CsmJob used to store the public key within the Csm.
            reference DcmDspAuthenticationClientCertificateRef: scope=ECU, multiplicity set at pre-compile, set at pre-compile, destination=KeyMCertificate  # Reference to a KeyMCertificate used to handle the client certificate for this connection.
            reference DcmDspAuthenticationClientChallengeSignJobRef: scope=ECU, multiplicity set at pre-compile, set at pre-compile, destination=CsmJob  # Reference to a job used to sign the client challenge.
            reference DcmDspAuthenticationConnectionCertificateRef: scope=ECU, multiplicity set at pre-compile, set at pre-compile, destination=KeyMCertificate  # Reference to a KeyMCertificate used to store the certificate within the KeyM.
            reference DcmDspAuthenticationConnectionMainConnectionRef: scope=ECU, multiplicity set at pre-compile, set at pre-compile, destination=DcmDslMainConnection  # Reference to the dsl diagnostic connection that uses this authentication configuration.
            reference DcmDspAuthenticationECUCertificateKeyElementRef [0..1]: scope=ECU, multiplicity set at pre-compile, set at pre-compile, destination=CryptoKeyElement  # Reference to a CryptoKeyElement used as server certificate during bi-directional authentication.
            reference DcmDspAuthenticationECUCertificateRef [0..1]: scope=ECU, multiplicity set at pre-compile, set at pre-compile, destination=CsmKey  # Reference to a KeyMCertificate with the server certificate for bi-directional authentication.
            reference DcmDspAuthenticationPublicKeyElementRef: scope=ECU, multiplicity set at pre-compile, set at pre-compile, destination=KeyMCertificateElement  # Reference to a certificate data element with the public key in the certificate.
            reference DcmDspAuthenticationRandomJobRef: scope=ECU, multiplicity set at pre-compile, set at pre-compile, destination=CsmJob  # Reference to a certificate parse job used to parse the authentication certificate.
            reference DcmDspAuthenticationRoleElementRef: scope=ECU, multiplicity set at pre-compile, set at pre-compile, destination=KeyMCertificateElement  # Reference to a certificate data element with the role in the certificate.
            reference DcmDspAuthenticationTargetIdentificationModeRuleRef [0..1]: scope=ECU, multiplicity set at pre-compile, set at pre-compile, destination=DcmModeRule  # Reference to a mode rule that is used to evaluate the target identification.
            reference DcmDspAuthenticationVerifyProofOfOwnerShipClientJobRef: scope=ECU, multiplicity set at pre-compile, set at pre-compile, destination=CsmJob  # Reference to a CsmJob used to verify the proof of ownership client in the Csm.
            reference DcmDspAuthenticationWhiteListDIDElementRef [0..1]: scope=ECU, multiplicity set at pre-compile, set at pre-compile, destination=KeyMCertificateElement  # Reference to a certificate data element with the white list for data identifiers in the certificate.
            reference DcmDspAuthenticationWhiteListMemorySelectionElementRef [0..1]: scope=ECU, multiplicity set at pre-compile, set at pre-compile, destination=KeyMCertificateElement  # Reference to a certificate data element with the white list for user defined memory selection in the certificate.
            reference DcmDspAuthenticationWhiteListRIDElementRef [0..1]: scope=ECU, multiplicity set at pre-compile, set at pre-compile, destination=KeyMCertificateElement  # Reference to a certificate data element with the white list for routine identifiers in the certificate.
            reference DcmDspAuthenticationWhiteListServicesElementRef: scope=ECU, multiplicity set at pre-compile, set at pre-compile, destination=KeyMCertificateElement  # Reference to a certificate data element with the white list in the certificate.
          container DcmDspAuthenticationConnectionES [0..*]  # This container contains the authentication configuration use for a dsl connection, when using ES specification for Authentication service
            integer DcmDspAuthenticationAuthenticatedRole: 1..4294967295, scope=ECU, set at pre-compile  # Role used for service authentication verification in the Authenticated state.
            string DcmDspAuthenticationWLServicesWithoutSubfunction: set at pre-compile, default-value=0  # Value of the white list services data which has no subfunction (hex number). example: 34 35 36
            string DcmDspAuthenticationWLServicesWithSubfunction: set at pre-compile, default-value=0  # Value of the white list services data which has subfunction (hex number). example: 19 01 19 02 11 01 11 02
            string DcmDspAuthenticationWLDID [0..1]: set at pre-compile, default-value=0  # Value of the white list DIDs data (hex number). example: F1 90 03 31 F4 01 - DID 0xF190 : read and write - DID 0x32F4: only read
            string DcmDspAuthenticationWLRID [0..1]: set at pre-compile, default-value=0  # Value of the white list DIDs data (hex number). example: 1A 90 03 02 8A 01 - RID 0x1A90 : startRoutine and stopRoutine - DID 0x32F4: only startRoutine
            string DcmDspAuthenticationWLMemorySelection [0..1]: set at pre-compile, default-value=0
            function name DcmDspAuthenticationUniDirectionalFunc: scope=ECU
            function name DcmDspAuthenticationProofOfOwnerShipClientFunc: scope=ECU
            integer DcmDspAuthenticationCertificateClientSize: 1..4294967295  # Size of the ClientCertificate used in subfunction UniDirectional (in bytes)
            integer DcmDspAuthenticationProofOfOwnerShipClientSize: 1..4294967295  # Size of the ProofOfOwnerShipClient used in subfunction ProofOfOwnerShip (in bytes)
            integer DcmDspAuthenticationChallengeServerSize: 1..4294967295  # Size of the return data ChallengeServer used in subfunction UniDirectional (in bytes)
            enumeration DcmDspAuthenticationUsePort [0..1]: {USE_ASYNCH_CLIENT_SERVER, USE_ASYNCH_FNC}, set at pre-compile  # This parameter defines which kind of interface shall be used for Authentication NRC.
            function name DcmDspAuthenticationDeauthenticationFailedFunc [0..1]: set at pre-compile  # Function name for request to GetCompare Fnc.
            function name DcmDspAuthenticationSettingAccessRightsFailedFunc [0..1]: set at pre-compile  # Function name for request to Authentication NRC 5A: Setting Access Rights Failed Fnc
            reference DcmDspAuthenticationConnectionMainConnectionRef: scope=ECU, multiplicity set at pre-compile, set at pre-compile, destination=DcmDslMainConnection  # Reference to the dsl diagnostic connection that uses this authentication configuration.
        container DcmDspClearDTC [0..1]  # This container contains the configuration for the Clear DTC service.
          function name DcmDspClearDTCCheckFnc [0..1]: scope=ECU, multiplicity set at pre-compile, set at pre-compile  # Callback function for condition check, manufacturer / supplier specific checks on the groupOfDTC, which is requested to clear. | This parameter is related to the interface : Xxx_ClearDTCCheckFnc.
          reference DcmDspClearDTCModeRuleRef [0..1]: scope=ECU, multiplicity set at link in variant link-time / pre-compile in variant post-build+pre-compile, set at link in variant link-time / pre-compile in variant post-build+pre-compile, destination=DcmModeRule  # Reference to DcmModeRule | Mode rule which controls to clear the DTCs. If there is no reference, no check of the mode rule shall be done.
        container DcmDspComControl [0..1]  # Provides the configuration of the CommunicationControl mechanism.
          container DcmDspComControlAllChannel [0..*]  # Collection of ComM channels which shall be controlled if all networks are addressed.
            boolean DcmDspComControlAllChannelUsed: post-build-variant-value=true, set at link in variant link-time / post-build in variant post-build / pre-compile in variant pre-compile, default-value=true  # Allow to activate or deactivate the usage of a ComM channel collection to be controlled, for multi purpose ECUs | true = ComM channel collection used false = ComM channel collection not used
            reference DcmDspAllComMChannelRef: scope=ECU, post-build-variant-value=true, set at link in variant link-time / post-build in variant post-build / pre-compile in variant pre-compile, destination=ComMChannel  # Reference to ComM channel.
          container DcmDspComControlSetting [0..1]  # Provide the configuration of the Communication control.
            reference DcmDspComControlCommunicationReEnableModeRuleRef [0..1]: scope=ECU, multiplicity set at link in variant link-time / pre-compile in variant post-build+pre-compile, set at link in variant link-time / pre-compile in variant post-build+pre-compile, destination=DcmModeRule  # Reference to DcmModeRule Mode rule which controls re-enabling | of communication by DCM. [ref. SWS_Dcm_00753]
          container DcmDspComControlSpecificChannel [0..*]  # Assigns subnet number to ComM channel which will be controlled.
            boolean DcmDspComControlSpecificChannelUsed: post-build-variant-value=true, set at link in variant link-time / post-build in variant post-build / pre-compile in variant pre-compile, default-value=true  # Allow to activate or deactivate the usage of a Subnet assigned to the ComM channel which will be controlled, for multi purpose ECUs. | true = Subnet used false = Subnet not used
            integer DcmDspSubnetNumber: 1..14, scope=ECU, set at pre-compile  # Subnet Number which controls the specific ComMChannel.
            reference DcmDspSpecificComMChannelRef: scope=ECU, post-build-variant-value=true, set at link in variant link-time / post-build in variant post-build / pre-compile in variant pre-compile, destination=ComMChannel  # Reference to ComM channel.
          container DcmDspComControlSubNode [0..65535]  # This container gives information about the node identification number and the ComM channel used to address a sub-network.
            integer DcmDspComControlSubNodeId: 1..65535, scope=ECU, set at link in variant link-time / pre-compile in variant post-build+pre-compile  # The node identification number DcmDspComControlSubNodeId is addressed by the CommunicationControl (0x28) request.
            boolean DcmDspComControlSubNodeUsed: post-build-variant-value=true, set at link in variant link-time / post-build in variant post-build / pre-compile in variant pre-compile, default-value=true  # This parameter determines if a node control function is available or not.
            reference DcmDspComControlSubNodeComMChannelRef: scope=ECU, post-build-variant-value=true, set at link in variant link-time / post-build in variant post-build / pre-compile in variant pre-compile, destination=ComMChannel  # This parameter references a ComM channel where this node is connected to.
        container DcmDspCommonAuthorization [0..*]  # This container contains the configuration (parameters) for the common Authorization being equal for several services / sub-services.
          reference DcmDspCommonAuthorizationModeRuleRef [0..1]: scope=ECU, multiplicity set at link in variant link-time / pre-compile in variant post-build+pre-compile, set at link in variant link-time / pre-compile in variant post-build+pre-compile, destination=DcmModeRule  # Reference to DcmModeRule | Mode rule which controls this service/ sub-service. If there is no reference, no check of the mode rule shall be done.
          reference DcmDspCommonAuthorizationSecurityLevelRef [0..*]: scope=ECU, multiplicity set at link in variant link-time / pre-compile in variant post-build+pre-compile, set at link in variant link-time / pre-compile in variant post-build+pre-compile, destination=DcmDspSecurityRow  # Reference to DcmDspSecurityRow | Security levels allowed to control this service/ sub-service. If there is no reference, no check of security level shall be done.
          reference DcmDspCommonAuthorizationSessionRef [0..*]: scope=ECU, multiplicity set at link in variant link-time / pre-compile in variant post-build+pre-compile, set at link in variant link-time / pre-compile in variant post-build+pre-compile, destination=DcmDspSessionRow  # Reference to DcmDspSessionRow | Sessions allowed to control this service/ sub-service. If there is no reference, no check of session level shall be done.
        container DcmDspControlDTCSetting [0..1]  # Provide the configuration of the ControlDTCSetting mechanism.
          boolean DcmSupportDTCSettingControlOptionRecord [0..1]: scope=ECU, multiplicity set at pre-compile, set at pre-compile, default-value=false  # This configuration switch defines if the DTCSettingControlOptionRecord is in general supported in the request message or not.
          reference DcmDspControlDTCSettingReEnableModeRuleRef [0..1]: scope=ECU, multiplicity set at link in variant link-time / pre-compile in variant post-build+pre-compile, set at link in variant link-time / pre-compile in variant post-build+pre-compile, destination=DcmModeRule  # Reference to DcmModeRule | Mode rule which controls re-enabling of controlDTCsetting by DCM. The DCM module shall execute a ControlDTCSetting.Off (call Dem_EnableDTCSetting()) in case that the referenced mode rule is not fulfilled anymore.
        container DcmDspData [0..*]  # This container contains the configuration (parameters) of a Data belonging to a DID
          integer DcmDspDataByteSize [0..1]: 0..65535, scope=ECU, multiplicity set at link in variant link-time / pre-compile in variant post-build+pre-compile, set at link in variant link-time / pre-compile in variant post-build+pre-compile  # Defines the array length in bytes or the the maximum array length for variable datalengths.
          function name DcmDspDataConditionCheckReadFnc [0..1]: scope=ECU, multiplicity set at pre-compile, set at pre-compile  # Function name to demand application if the conditions (e.g. System state) to read the DID are correct. (ConditionCheckRead-function). | Multiplicity shall be equal to parameter DcmDspDataReadFnc. This parameter is related to the interface Xxx_ConditionCheckRead.
          boolean DcmDspDataConditionCheckReadFncUsed [0..1]: multiplicity set at pre-compile, set at pre-compile  # This parameter determines if a condition check function is available or not.
          function name DcmDspDataEcuSignal [0..1]: scope=ECU, multiplicity set at pre-compile, set at pre-compile  # Function name to control the access to a certain ECU Signal by the DCM. (IoHwAb_Dcm_<symbolic name of ECU signal>-function).
          enumeration DcmDspDataEndianness [0..1]: {BIG_ENDIAN, LITTLE_ENDIAN, OPAQUE}, multiplicity set at link in variant link-time / pre-compile in variant post-build+pre-compile, set at link in variant link-time / pre-compile in variant post-build+pre-compile  # Defines the endianness of the data belonging to a DID in a diagnostic request or response message.
          function name DcmDspDataFreezeCurrentStateFnc [0..1]: scope=ECU, multiplicity set at pre-compile, set at pre-compile  # Function name to request to application to freeze the current state of an IOControl. (FreezeCurrentState-function). | This parameter is related to the interface Xxx_FreezeCurrentState.
          function name DcmDspDataGetScalingInfoFnc [0..1]: scope=ECU, multiplicity set at pre-compile, set at pre-compile  # Function name to request to application the scaling information of the DID. (GetScalingInformation-function). | This parameter is related to the interface Xxxx_GetScalingInformation.
          function name DcmDspDataReadDataLengthFnc [0..1]: scope=ECU, multiplicity set at pre-compile, set at pre-compile  # Function name to request from application the data length of a DID. (ReadDataLength-function). | This parameter is related to the interface Xxx_ReadDataLength.
          function name DcmDspDataReadEcuSignal [0..1]: scope=ECU, multiplicity set at pre-compile, set at pre-compile  # Function name for read access to a certain ECU Signal by the DCM. (IoHwAb_Dcm_Read<EcuSignalName>-function). | Only relevant if DcmDspDataUsePort==USE_ECU_SIGNAL.
          function name DcmDspDataReadFnc [0..1]: multiplicity set at pre-compile, set at pre-compile  # Function name to request from application the data value of a DID. | (ReadData-function). This parameter is related to the interface Xxx_ReadData.
          function name DcmDspDataResetToDefaultFnc [0..1]: scope=ECU, multiplicity set at pre-compile, set at pre-compile  # Function name to request to application to reset an IOControl to default value. (ResetToDefault-function). | This parameter is related to the interface Xxx_ResetToDefault.
          function name DcmDspDataReturnControlToEcuFnc [0..1]: scope=ECU, multiplicity set at pre-compile, set at pre-compile  # Function name to request to application to return control to ECU of an IOControl. (ReturnControlToECU-function). | This parameter is related to the interface Xxx_ReturnControlToECU.
          function name DcmDspDataShortTermAdjustmentFnc [0..1]: scope=ECU, multiplicity set at pre-compile, set at pre-compile  # Function name to request to application to adjust the IO signal. (ShortTermAdjustment-function). | This parameter is related to the interface Xxx_ShortTermAdjustment.
          enumeration DcmDspDataType: {BOOLEAN, SINT16, SINT16_N, SINT32, SINT32_N, SINT8, SINT8_N, UINT16, UINT16_N, UINT32, UINT32_N, UINT8, UINT8_DYN, UINT8_N}, scope=ECU, set at link in variant link-time / pre-compile in variant post-build+pre-compile  # Provide the implementation data type of data belonging to a DID.
          enumeration DcmDspDataUsePort: {USE_BLOCK_ID, USE_DATA_ASYNCH_CLIENT_SERVER, USE_DATA_ASYNCH_CLIENT_SERVER_ERROR, USE_DATA_ASYNCH_FNC, USE_DATA_ASYNCH_FNC_ERROR, USE_DATA_SENDER_RECEIVER, USE_DATA_SENDER_RECEIVER_AS_SERVICE, USE_DATA_SYNCH_CLIENT_SERVER, USE_DATA_SYNCH_FNC, USE_ECU_SIGNAL}, scope=ECU, set at pre-compile  # Defines which interface shall be used to access the data.
          function name DcmDspDataWriteFnc [0..1]: scope=ECU, multiplicity set at pre-compile, set at pre-compile  # Function name to request application to write the data value of a DID. (WriteData-function). | This parameter is related to the interface Xxx_WriteData.
          add info DcmDspOdxDataDescription [0..1]: multiplicity set at pre-compile, set at pre-compile  # Defines additional description for ODX documentation
          reference DcmDspDataBlockIdRef [0..1]: scope=ECU, multiplicity set at pre-compile, origin=AUTOSAR_ECUC V1.0.0, set at pre-compile, destination=NvMBlockDescriptor  # NRAM blockId to access the data. | Only relevant if DcmDspDataUsePort==USE_BLOCK_ID.
          reference DcmDspDataInfoRef [0..1]: scope=ECU, set at pre-compile, destination=DcmDspDataInfo  # Reference to 1 DcmDspDataInfo
          choice container DcmDspDiagnosisScaling [0..1]  # This container contains the configuration (parameters) of an alternative Diagnosis Representation. Out if this the scaling between Diagnosis and ECU internal representation and vice versa can be calculated.
            container DcmDspAlternativeDataInterface [0..1]  # This container contains the configuration (parameters) of an alternative Diagnosis Representation by the means of a VariableDataPrototoype in a DataInterface. | Additionally a reference to PortInterfaceMapping can be defined which provide already the mapping rules between the VariableDataPrototoype in a DataInterface used by the software component (DcmDspExternalSRDataElementClass) and the intended Diagnosis Representation defined by DcmDataElement.
              foreign reference DcmDataElement: set at pre-compile, destination-type=VARIABLE-DATA-PROTOTYPE  # Alternative Diagnosis Representation for the data defined by the means of a VariableDataPrototoype in a DataInterface. | The CompuMethod of the data type of the referenced VariableDataPrototype will be applied to the data type of the VariableDataPrototype in the interface used by the Dcm.
              foreign reference DcmPortInterfaceMapping [0..1]: multiplicity set at pre-compile, set at pre-compile, destination-type=PORT-INTERFACE-MAPPING  # Optional reference to PortInterfaceMapping which defines the mapping rules. | The PortInterfaceMapping is used to get the DataPrototypeMapping that describes a conversion between the data prototype referenced by DcmDataElement and the data prototype referenced from DcmDspExternalSRDataElementClass.
            container DcmDspAlternativeDataType [0..1]  # This container contains the configuration (parameters) of an alternative Diagnosis Representation by the means of an ApplicationDataType. | Additionally the definition of a text table mapping can be a defined for ApplicationDataTypes with a CompuMethod of category TEXTTABLE and SCALE_LINEAR_AND_TEXTTABLE.
              foreign reference DcmApplicationDataType: set at pre-compile, destination-type=APPLICATION-DATA-TYPE  # Alternative Diagnosis Representation for the data defined by the means of a ApplicationDataType of category VALUE, BOOLEAN or ARRAY. | The CompuMethod that applies to the referenced ApplicationDataType in case of category VALUE or BOOLEAN will be applied to the data type of the VariableDataPrototype in the interface used by the Dcm.
              container DcmDspTextTableMapping [0..*]  # The purpose of the DcmDspTextTableMapping is to associate a texttable value defined in the context of the Dcm to a texttable value defined in the context of a CompuMethod referenced by a DataType that shall be taken to create a dataElement in a SenderReceiverInterface. By this means it is possible to create a primitive version of a TexttableMapping (which can only be applied if a dataElement already exists). | In other words, the DcmDspTextTableMapping provides a similar mechanism to the TexttableMapping in a situation where the TexttableMapping cannot be applied since the SenderReceiverInterface for the PortPrototype on the Dcm ServiceComponent does not yet exist.
                integer DcmDspDiagnosisRepresentationDataValue: 0..18446744073709551615, scope=ECU, set at pre-compile  # The data value in the diagnosis representation.
                integer DcmDspInternalDataValue: 0..18446744073709551615, scope=ECU, set at pre-compile  # The ECU internal data value.
            container DcmDspAlternativeDiagnosticDataElement [0..1]  # This container contains the configuration (parameters) of an alternative Diagnosis Representation by the means of Diagnostic Extract.
              foreign reference DcmDspDiagnosticDataElementRef: set at pre-compile, destination-type=DIAGNOSTIC-DATA-ELEMENT  # Alternative Diagnosis Representation for the data defined by the means of a DiagnosticDataElement in the Diagnostic Extract. | This EcucForeignReference enables the access to all SwDataDefProps, in particular BaseType, CompuMethod and DataConstr The CompuMethod and DataConstr that applies to the referenced DiagnosticDataElement will be applied to the data type of the VariableDataPrototype in the interface used by the Dcm. The mapped ImplementationDataType needs to match the given BaseType.
          container DcmDspDidDataSupportInfo [0..1]  # This container defines the supported information.
            integer DcmDspDidDataSupportInfoBit: 0..255, scope=ECU, set at link in variant link-time / pre-compile in variant post-build+pre-compile  # Referenced Bit of the SupportInfo
            reference DcmDspDidDataSupportInfoRef: scope=ECU, multiplicity set at link in variant link-time / pre-compile in variant post-build+pre-compile, set at link in variant link-time / pre-compile in variant post-build+pre-compile, destination=DcmDspDidSupportInfo  # Reference to DcmDspDidSupportInfo
          choice container DcmDspExternalSRDataElementClass [0..1]  # This container defines the source of data in a provided port which shall be read respectively the target of data in a required port which shall be written. | This container shall contain either one DcmSubElementInDataElementInstance OR DcmDataElementInstance OR DcmSubElementInImplDataElementInstance reference.
            container DcmDataElementInstance [0..1]  # Instance Reference to the primitive data in a port where the data element is typed with an ApplicationPrimitveDataType or an ImplementationDataType.
              instance reference DcmDataElementInstanceRef: set at pre-compile, destination-context=ROOT-SW-COMPOSITION-PROTOTYPE SW-COMPONENT-PROTOTYPE PORT-PROTOTYPE, destination-type=AUTOSAR-DATA-PROTOTYPE  # Instance Reference to the primitive or array data which shall be read or written. | Supported are VariableDataPrototypes in SenderReceiverInterfaces and NvDataInterfaces and ParameterDataPrototypes in ParameterInterfaces (read only). This reference is applicable if the AutosarDataPrototype is typed with a ApplicationPrimitiveDataType of category VALUE or BOOLEAN or ApplicationArrayDataType or if the AutosarDataPrototype is typed with a ImplementationDataType of category VALUE, ARRAY or TYPE_REFERENCE that in turn boils down to VALUE or ARRAY
            container DcmSubElementInDataElementInstance [0..1]  # Instance Reference to the primitve sub-element (at any level) of composite data in a port where the data element is typed with an ApplicationCompositeDataType.
              instance reference DcmSubElementInDataElementInstanceRef: set at pre-compile, destination-context=ROOT-SW-COMPOSITION-PROTOTYPE SW-COMPONENT-PROTOTYPE PORT-PROTOTYPE AUTOSAR-DATA-PROTOTYPE APPLICATION-COMPOSITE-ELEMENT-DATA-PROTOTYPE*, destination-type=APPLICATION-COMPOSITE-ELEMENT-DATA-PROTOTYPE  # Instance Reference to the primitve sub-element (at any level) of composite data in a port which shall be read. | Supported are VariableDataPrototypes in SenderReceiverInterfaces and NvDataInterfaces and ParameterDataPrototypes in ParameterInterfaces (read only). This reference is applicable if the AutosarDataPrototype is typed with a ApplicationCompositeDataType.
            container DcmSubElementInImplDataElementInstance [0..1]  # Instance Reference to the primitve sub-element (at any level) of composite data in a port where the data element is typed with an ImplementationDataType.
              instance reference DcmSubElementInImplDataElementInstanceRef: set at pre-compile, destination-context=ROOT-SW-COMPOSITION-PROTOTYPE SW-COMPONENT-PROTOTYPE PORT-PROTOTYPE AUTOSAR-DATA-PROTOTYPE IMPLEMENTATION-DATA-TYPE-ELEMENT*, destination-type=IMPLEMENTATION-DATA-TYPE-ELEMENT  # Instance Reference to the primitve sub-element (at any level) of composite data in a port which shall be read. | Supported are VariableDataPrototypes in SenderReceiverInterfaces and NvDataInterfaces and ParameterDataPrototypes in ParameterInterfaces (read only). This reference is applicable if the AutosarDataPrototype is typed with a ImplementationDataType of category STRUCTURE or ARRAY. Please note that in case of ARRAY the index attribute in the target reference has to be set to select a single array element.
        container DcmDspDataInfo [0..*]  # This container contains the configuration (parameters) of one Data.
          integer DcmDspDataScalingInfoSize [0..1]: 0..4294967295, scope=ECU, multiplicity set at link in variant link-time / pre-compile in variant post-build+pre-compile, set at link in variant link-time / pre-compile in variant post-build+pre-compile  # If Scaling information service is available for this Data, it provides the size in bytes of the scaling information.
        container DcmDspDid [0..*]  # This container contains the configuration (parameters) of the DID.
          integer DcmDspDidIdentifier: 0..65535, scope=ECU, set at link in variant link-time / pre-compile in variant post-build+pre-compile  # 2 byte Identifier of the DID | Within each DcmConfigSet all DcmDspDidIdentifier values shall be unique.
          integer DcmDspDidSize [0..1]: 0..65535, scope=ECU, set at link in variant link-time / pre-compile in variant post-build+pre-compile  # Length of a DID in byte(s).
          boolean DcmDspDidUsed: scope=ECU, post-build-variant-value=true, set at link in variant link-time / post-build in variant post-build / pre-compile in variant pre-compile  # Allow to activate or deactivate the usage of a DID, for multi purpose ECUs | true = DID available false = DID not available
          enumeration DcmDspDidUsePort: {USE_ATOMIC_NV_DATA_INTERFACE, USE_ATOMIC_SENDER_RECEIVER_INTERFACE, USE_ATOMIC_SENDER_RECEIVER_INTERFACE_AS_SERVICE, USE_DATA_ELEMENT_SPECIFIC_INTERFACES}, set at pre-compile, default-value=USE_DATA_ELEMENT_SPECIFIC_INTERFACES  # Selects application interface type for DID data elements between a single operation for all data elements or data element specific operations.
          reference DcmDspDidInfoRef: scope=ECU, set at link in variant link-time / pre-compile in variant post-build+pre-compile, destination=DcmDspDidInfo  # Reference to DcmDspDidInfo containing information on this DID.
          reference DcmDspDidRef [0..*]: scope=ECU, multiplicity set at link in variant link-time / pre-compile in variant post-build+pre-compile, requires-index=true, set at link in variant link-time / pre-compile in variant post-build+pre-compile, destination=DcmDspDid  # Reference to DcmDspDid in case this DID refer to one or serveral other DID's
          container DcmDspDidSignal [0..*]  # This container defines the reference to 1 DcmDspData container and position relevant for this DID.
            integer DcmDspDidByteOffset: 0..65535, scope=ECU, set at link in variant link-time / pre-compile in variant post-build+pre-compile  # Defines the absolute byte offset of the data defined by DcmDspDidDataRef reference to DcmDspData container in the DID.
            reference DcmDspDidDataRef: scope=ECU, set at link in variant link-time / pre-compile in variant post-build+pre-compile, destination=DcmDspData  # Reference to 1 DcmDspData container relevant for this DID.
          container DcmDspDidSupportInfo [0..1]  # This container defines the support information to declare the usability of the data bytes within the DIDs
            integer DcmDspDidSupportInfoLen: 0..255, scope=ECU, set at link in variant link-time / pre-compile in variant post-build+pre-compile  # Length of the support information in bytes.
            integer DcmDspDidSupportInfoPos: 0..255, scope=ECU, set at link in variant link-time / pre-compile in variant post-build+pre-compile  # Length of the support information in bytes.
        container DcmDspDidInfo [0..*]  # This container contains the configuration (parameters) of the DID's Info
          integer DcmDspDDDIDMaxElements [0..1]: 1..255, multiplicity set at link in variant link-time / pre-compile in variant post-build+pre-compile, set at link in variant link-time / pre-compile in variant post-build+pre-compile  # Maximum number of source elements of a DDDID.
          boolean DcmDspDidDynamicallyDefined: scope=ECU, set at link in variant link-time / pre-compile in variant post-build+pre-compile  # Indicates if this DID can be dynamically defined | true = DID can be dynamically defined false = DID can not be dynamically defined
          container DcmDspDidControl [0..1]  # This container contains the configuration (parameters) of the DID control.
            enumeration DcmDspDidControlMask: {DCM_CONTROLMASK_EXTERNAL, DCM_CONTROLMASK_INTERNAL, DCM_CONTROLMASK_NO}, scope=ECU, set at pre-compile, default-value=DCM_CONTROLMASK_INTERNAL  # This indicates the presence of "controlEnableMask" in SWC service interfaces and defines how the Dcm treats a service request.
            integer DcmDspDidControlMaskSize [0..1]: 1..4294967294, scope=ECU, set at pre-compile  # The value defines the size of the controlEnableMaskRecord in bytes.
            integer DcmDspDidControlRole [0..1]: 0..4294967295, scope=ECU, multiplicity set at link in variant link-time / post-build in variant post-build / pre-compile in variant pre-compile, post-build-variant-multiplicity=true, post-build-variant-value=true, set at link in variant link-time / post-build in variant post-build / pre-compile in variant pre-compile  # Bitfield were each bit represents one dedicated role. A DID is granted IOcontrol access if the bit value is 1. If a bit value is 0, the DID is not allowed to be controlled for that role.
            boolean DcmDspDidFreezeCurrentState: scope=ECU, set at pre-compile  # This indicates the presence of "FreezeCurrentState".
            boolean DcmDspDidResetToDefault: scope=ECU, set at pre-compile  # This indicates the presence of "ResetToDefault".
            boolean DcmDspDidShortTermAdjustment: scope=ECU, set at pre-compile  # This indicates the presence of "ShortTermAdjustment".
            reference DcmDspDidControlModeRuleRef [0..1]: scope=ECU, multiplicity set at link in variant link-time / pre-compile in variant post-build+pre-compile, set at link in variant link-time / pre-compile in variant post-build+pre-compile, destination=DcmModeRule  # Reference to DcmModeRule | Mode rule which controls this DID. If there is no reference, no check of the mode rule shall be done.
            reference DcmDspDidControlSecurityLevelRef [0..*]: scope=ECU, multiplicity set at link in variant link-time / pre-compile in variant post-build+pre-compile, set at link in variant link-time / pre-compile in variant post-build+pre-compile, destination=DcmDspSecurityRow  # Reference to DcmDspSecurityRow | Security levels allowed to control this DID. If there is no reference, no check of security level shall be done.
            reference DcmDspDidControlSessionRef [0..*]: scope=ECU, multiplicity set at link in variant link-time / pre-compile in variant post-build+pre-compile, set at link in variant link-time / pre-compile in variant post-build+pre-compile, destination=DcmDspSessionRow  # Reference to DcmDspSessionRow | Sessions allowed to control this DID. If there is no reference, no check of session level shall be done.
            container DcmDspDidControlEnableMask [0..32]  # The shortname of the container value defines the symbol of the controlMask.
              integer DcmDspDidControlMaskBitPosition: 0..31, scope=ECU, set at pre-compile  # Defines the position of the bit in the controlMask starting from most significant bit (MSB first) to least significant bit. | This Bit endianness is identical to the controlMask in UDS. The DcmDspDidControlMaskSize should be considered for most significant bit.
          container DcmDspDidRead [0..1]  # This container contains the configuration (parameters) of the DID read.
            integer DcmDspDidReadRole [0..1]: 0..4294967295, scope=ECU, multiplicity set at link in variant link-time / post-build in variant post-build / pre-compile in variant pre-compile, post-build-variant-multiplicity=true, post-build-variant-value=true, set at link in variant link-time / post-build in variant post-build / pre-compile in variant pre-compile  # Bitfield were each bit represents one dedicated role. A DID is granted read access if the bit value is 1. If a bit value is 0, the DID is not allowed to be read for that role. | Reading DIDs is possible by different UDS services. This setting applies to all possible DID read operations.
            reference DcmDspDidReadModeRuleRef [0..1]: scope=ECU, multiplicity set at link in variant link-time / pre-compile in variant post-build+pre-compile, set at link in variant link-time / pre-compile in variant post-build+pre-compile, destination=DcmModeRule  # Reference to DcmModeRule | Mode rule which controls to read this DID. If there is no reference, no check of the mode rule shall be done.
            reference DcmDspDidReadSecurityLevelRef [0..*]: scope=ECU, multiplicity set at link in variant link-time / pre-compile in variant post-build+pre-compile, set at link in variant link-time / pre-compile in variant post-build+pre-compile, destination=DcmDspSecurityRow  # Reference to DcmDspSecurityRow Referenced security levels are allowed to read this DID. | If there is no reference, no check of security level shall be done.
            reference DcmDspDidReadSessionRef [0..*]: scope=ECU, multiplicity set at link in variant link-time / pre-compile in variant post-build+pre-compile, set at link in variant link-time / pre-compile in variant post-build+pre-compile, destination=DcmDspSessionRow  # Reference to DcmDspSessionRow Referenced sessions are allowed to read this DID. | If there is no reference, no check of session level shall be done.
          container DcmDspDidWrite [0..1]  # This container contains the configuration (parameters) of the DID write.
            integer DcmDspDidWriteRole [0..1]: 0..4294967295, scope=ECU, multiplicity set at link in variant link-time / post-build in variant post-build / pre-compile in variant pre-compile, post-build-variant-multiplicity=true, post-build-variant-value=true, set at link in variant link-time / post-build in variant post-build / pre-compile in variant pre-compile  # Bitfield were each bit represents one dedicated role. A DID is granted write access if the bit value is 1. If a bit value is 0, the DID is not allowed to be written for that role.
            reference DcmDspDidWriteModeRuleRef [0..1]: scope=ECU, multiplicity set at link in variant link-time / pre-compile in variant post-build+pre-compile, set at link in variant link-time / pre-compile in variant post-build+pre-compile, destination=DcmModeRule  # Reference to DcmModeRule | Mode rule which controls to write this DID. If there is no reference, no check of the mode rule shall be done.
            reference DcmDspDidWriteSecurityLevelRef [0..*]: scope=ECU, multiplicity set at link in variant link-time / pre-compile in variant post-build+pre-compile, set at link in variant link-time / pre-compile in variant post-build+pre-compile, destination=DcmDspSecurityRow  # Reference to DcmDspSecurityRow Referenced security levels are allowed to wirte this DID. | If there is no reference, no check of security level shall be done.
            reference DcmDspDidWriteSessionRef [0..*]: scope=ECU, multiplicity set at link in variant link-time / pre-compile in variant post-build+pre-compile, set at link in variant link-time / pre-compile in variant post-build+pre-compile, destination=DcmDspSessionRow  # Reference to DcmDspSessionRow Referenced sessions are allowed to write this DID. | If there is no reference, no check of session level shall be done.
        container DcmDspDidRange [0..*]  # This container defines the DID Range
          boolean DcmDspDidRangeHasGaps: scope=ECU, set at link in variant link-time / pre-compile in variant post-build+pre-compile  # Parameter specifying if there are gaps in the DID range (parameter set to TRUE) or not (parameter set to FALSE)
          integer DcmDspDidRangeIdentifierLowerLimit: 0..65535, scope=ECU, set at link in variant link-time / pre-compile in variant post-build+pre-compile  # Lower limit of DID range.
          integer DcmDspDidRangeIdentifierUpperLimit: 0..65535, scope=ECU, set at link in variant link-time / pre-compile in variant post-build+pre-compile  # Upper limit of DID range.
          function name DcmDspDidRangeIsDidAvailableFnc [0..1]: scope=ECU, multiplicity set at pre-compile, set at pre-compile  # Function name to request from application if a specific DID is available within the range or not. | Only relevant if DcmDspDidRangeUsePort is set to false. This parameter is related to the interface Xxx_IsDidAvailable.
          integer DcmDspDidRangeMaxDataLength: 0..65535, scope=ECU, set at link in variant link-time / pre-compile in variant post-build+pre-compile  # Maximum data length in bytes
          function name DcmDspDidRangeReadDataLengthFnc [0..1]: scope=ECU, multiplicity set at pre-compile, set at pre-compile  # Function name to request from application the length of the data of a range DID. | Only relevant if DcmDspDidRangeUsePort is set to false. This parameter is related to the interface Xxx_ReadDidRangeDataLength.
          function name DcmDspDidRangeReadDidFnc [0..1]: scope=ECU, multiplicity set at pre-compile, set at pre-compile  # Function name to request from application the data range value of a DID.(ReadData-function). | Only relevant if DcmDspDidRangeUsePort is set to false. This parameter is related to the interface Xxx_ReadDidData.
          boolean DcmDspDidRangeUsePort: scope=ECU, set at pre-compile  # When the parameter DcmDspDidRangeUsePort is set to true the DCM will access the Data using an R-Port requiring a PortInteface DataServices_DIDRange. In that case, DcmDspDidRangeIsDidAvailableFnc, DcmDspDidRangeReadDidFnc and DcmDspDidRangeWriteDidFnc are ignored and the RTE APIs are used. When the parameter DcmDspDidRangeUsePort is false, the DCM calls the functions defined in DcmDspDidRangeIsDidAvailableFnc, DcmDspDidRangeReadDidFnc and DcmDspDidRangeWriteDidFnc.
          function name DcmDspDidRangeWriteDidFnc [0..1]: scope=ECU, multiplicity set at pre-compile, set at pre-compile  # Function name to request application to write the data range value of a DID.(WriteData-function). | Only relevant if DcmDspDidRangeUsePort is set to false. This parameter is related to the interface Xxx_WriteDidData.
          reference DcmDspDidRangeInfoRef: scope=ECU, set at link in variant link-time / pre-compile in variant post-build+pre-compile, destination=DcmDspDidInfo  # Reference to DcmDspDidInfo containing information on this DID Range.
        container DcmDspEcuReset [0..1]  # This container contains the configuration for DcmDspEcuReset service
          container DcmDspEcuResetRow [1..*]  # This container contains the configuration for each DcmDspEcuReset subservice.
            integer DcmDspEcuResetId: 0..127, scope=ECU, multiplicity set at link in variant link-time / pre-compile in variant post-build+pre-compile, set at link in variant link-time / pre-compile in variant post-build+pre-compile  # Defines the subfunction ID
            enumeration DcmResponseToEcuReset: {AFTER_RESET, BEFORE_RESET}, scope=ECU, set at pre-compile  # Defines the answer to EcuReset service should come: Before or after the reset.
        container DcmDspMemory [0..1]  # This container contains the configuration of the memory access.
          container DcmDspAddressAndLengthFormatIdentifier [0..1]  # This container contains the configuration of the supported AddressAndLengthFormatIdentifiers for memory access.
            integer DcmDspSupportedAddressAndLengthFormatIdentifier [1..*]: 0..255, scope=ECU, multiplicity set at link in variant link-time / pre-compile in variant post-build+pre-compile, set at link in variant link-time / pre-compile in variant post-build+pre-compile  # This parameter defines the supported AddressAndLengthFormatIdentifier of the request message.
          container DcmDspMemoryIdInfo [1..*]  # Provides the value of memory identifier used to select the desired memory device | This container contains the configuration of the memory access requested through diagnostic services : ReadMemoryByAddress, WriteMemoryByAddress, and DynamicallyDefineDataIdentifier
            integer DcmDspMemoryIdValue [0..1]: 0..255, scope=ECU, multiplicity set at link in variant link-time / pre-compile in variant post-build+pre-compile, set at link in variant link-time / pre-compile in variant post-build+pre-compile  # Value of the memory device identifier used. | Each DcmDspMemoryIdInfo should have a unique ID. The MemoryIdValue is retrieved from the request messages (RMBA,WMBA,RD,RU,DDDI) according to ISO-14229-1 with the most significant byte of the request parameter memoryAddress.
            container DcmDspReadMemoryRangeByLabelInfo [0..*]  # Provides a memory range allowed for reading via labels (lower and higher address configured as strings).
              string DcmDspReadMemoryRangeByLabelHigh: set at pre-compile, regular-expression=[a-zA-Z0-9_]([a-zA-Z0-9\._])*  # High memory address as label (string) of a range allowed for reading.
              string DcmDspReadMemoryRangeByLabelLow: set at pre-compile, regular-expression=[a-zA-Z0-9_]([a-zA-Z0-9\._])*  # Low memory address as label (string) of a range allowed for reading.
              reference DcmDspReadMemoryRangeModeRuleRef [0..1]: scope=ECU, multiplicity set at link in variant link-time / pre-compile in variant post-build+pre-compile, set at link in variant link-time / pre-compile in variant post-build+pre-compile, destination=DcmModeRule  # Reference to DcmModeRule | Mode rule which controls read access on this memory address. If there is no reference, no check of the mode rule shall be done.
              reference DcmDspReadMemoryRangeSecurityLevelRef [0..*]: scope=ECU, multiplicity set at link in variant link-time / pre-compile in variant post-build+pre-compile, set at link in variant link-time / pre-compile in variant post-build+pre-compile, destination=DcmDspSecurityRow  # Link to the Security Access Levels needed for read access on this memory address. If there is no reference, no check of security level shall be done.
              reference DcmDspReadMemoryRangeSessionLevelRef [0..*]: scope=ECU, multiplicity set at link in variant link-time / pre-compile in variant post-build+pre-compile, set at link in variant link-time / pre-compile in variant post-build+pre-compile, destination=DcmDspSessionRow  # Link to the session level needed for access to this memory address range. | If there is no reference, no check of session level shall be done.
            container DcmDspReadMemoryRangeInfo [0..*]  # Provides the range of memory address allowed for reading
              integer DcmDspReadMemoryRangeHigh: 0..4294967294, scope=ECU, set at link in variant link-time / pre-compile in variant post-build+pre-compile  # High memory address of a range allowed for reading
              integer DcmDspReadMemoryRangeLow: 0..4294967294, scope=ECU, set at link in variant link-time / pre-compile in variant post-build+pre-compile  # Low memory address of a range allowed for reading
              reference DcmDspReadMemoryRangeModeRuleRef [0..1]: scope=ECU, multiplicity set at link in variant link-time / pre-compile in variant post-build+pre-compile, set at link in variant link-time / pre-compile in variant post-build+pre-compile, destination=DcmModeRule  # Reference to DcmModeRule | Mode rule which controls read access on this memory address. If there is no reference, no check of the mode rule shall be done.
              reference DcmDspReadMemoryRangeSecurityLevelRef [0..*]: scope=ECU, multiplicity set at link in variant link-time / pre-compile in variant post-build+pre-compile, set at link in variant link-time / pre-compile in variant post-build+pre-compile, destination=DcmDspSecurityRow  # Link to the Security Access Levels needed for read access on this memory address. If there is no reference, no check of security level shall be done.
              reference DcmDspReadMemoryRangeSessionLevelRef [0..*]: scope=ECU, multiplicity set at link in variant link-time / pre-compile in variant post-build+pre-compile, set at link in variant link-time / pre-compile in variant post-build+pre-compile, destination=DcmDspSessionRow  # Link to the session level needed for access to this memory address range. | If there is no reference, no check of session level shall be done.
            container DcmDspWriteMemoryRangeByLabelInfo [0..*]  # Provides a memory range allowed for writing via labels (lower and higher address configured as strings).
              string DcmDspWriteMemoryRangeByLabelHigh: set at pre-compile, regular-expression=[a-zA-Z0-9_]([a-zA-Z0-9\._])*  # High memory address as label (string) of a range allowed for writing.
              string DcmDspWriteMemoryRangeByLabelLow: set at pre-compile, regular-expression=[a-zA-Z0-9_]([a-zA-Z0-9\._])*  # Low memory address as label (string) of a range allowed for writing.
              reference DcmDspWriteMemoryRangeModeRuleRef [0..1]: scope=ECU, multiplicity set at link in variant link-time / pre-compile in variant post-build+pre-compile, set at link in variant link-time / pre-compile in variant post-build+pre-compile, destination=DcmModeRule  # Reference to DcmModeRule | Mode rule which controls write access on this memory address. If there is no reference, no check of the mode rule shall be done.
              reference DcmDspWriteMemoryRangeSecurityLevelRef [0..*]: scope=ECU, multiplicity set at link in variant link-time / pre-compile in variant post-build+pre-compile, set at link in variant link-time / pre-compile in variant post-build+pre-compile, destination=DcmDspSecurityRow  # Link to the Security Access Levels needed for write access on this memory address. If there is no reference, no check of security level shall be done.
              reference DcmDspWriteMemoryRangeSessionLevelRef [0..*]: scope=ECU, multiplicity set at link in variant link-time / pre-compile in variant post-build+pre-compile, set at link in variant link-time / pre-compile in variant post-build+pre-compile, destination=DcmDspSessionRow  # Link to the session level needed for access to this memory address range. | If there is no reference, no check of session level shall be done.
            container DcmDspWriteMemoryRangeInfo [0..*]  # Provides the range of memory address allowed for writting.
              integer DcmDspWriteMemoryRangeHigh: 0..4294967294, scope=ECU, set at link in variant link-time / pre-compile in variant post-build+pre-compile  # High memory address of a range allowed for writing.
              integer DcmDspWriteMemoryRangeLow: 0..4294967294, scope=ECU, set at link in variant link-time / pre-compile in variant post-build+pre-compile  # Low memory address of a range allowed for writing
              reference DcmDspWriteMemoryRangeModeRuleRef [0..1]: scope=ECU, multiplicity set at link in variant link-time / pre-compile in variant post-build+pre-compile, set at link in variant link-time / pre-compile in variant post-build+pre-compile, destination=DcmModeRule  # Reference to DcmModeRule | Mode rule which controls write access on this memory address. If there is no reference, no check of the mode rule shall be done.
              reference DcmDspWriteMemoryRangeSecurityLevelRef [0..*]: scope=ECU, multiplicity set at link in variant link-time / pre-compile in variant post-build+pre-compile, set at link in variant link-time / pre-compile in variant post-build+pre-compile, destination=DcmDspSecurityRow  # Link to the Security Access Levels needed for write access on this memory address. If there is no reference, no check of security level shall be done.
              reference DcmDspWriteMemoryRangeSessionLevelRef [0..*]: scope=ECU, multiplicity set at link in variant link-time / pre-compile in variant post-build+pre-compile, set at link in variant link-time / pre-compile in variant post-build+pre-compile, destination=DcmDspSessionRow  # Link to the session level needed for access to this memory address range. | If there is no reference, no check of session level shall be done.
        container DcmDspMemoryTransfer [0..1]  # This container contains the configuration of the memory transfer.
          function name DcmDspMemoryTransferFnc [0..1]: scope=ECU, multiplicity set at pre-compile, set at pre-compile  # Function name for memory transfer services. | Only relevant if DcmDspMemoryTransferUsePort is set to false.
          boolean DcmDspMemoryTransferUsePort: scope=ECU, set at pre-compile, default-value=false  # If this parameter is set to true, the Dcm uses a port requiring a PortInterface UploadDownload. | If the parameter is false, the DCM uses the according C-API callouts.
          container DcmDspAddressAndLengthFormatIdentifier [0..1]  # This container contains the configuration of the supported AddressAndLengthFormatIdentifiers for memory access.
            integer DcmDspSupportedAddressAndLengthFormatIdentifier [1..*]: 0..255, scope=ECU, multiplicity set at link in variant link-time / pre-compile in variant post-build+pre-compile, set at link in variant link-time / pre-compile in variant post-build+pre-compile  # This parameter defines the supported AddressAndLengthFormatIdentifier of the request message.
          container DcmDspMemoryTransferIdInfo [1..*]  # Provides the value of memory identifier used to select the desired memory device | This container contains the configuration of the memory access requested through diagnostic services : RequestDownload, RequestUpload, TransferData, RequestTransferExit
            integer DcmDspMemoryIdValue [0..1]: 0..255, scope=ECU, multiplicity set at link in variant link-time / pre-compile in variant post-build+pre-compile, set at link in variant link-time / pre-compile in variant post-build+pre-compile  # Value of the memory device identifier used. | Each DcmDspMemoryIdInfo should have a unique ID. The MemoryIdValue is retrieved from the request messages (RMBA,WMBA,RD,RU,DDDI) according to ISO-14229-1 with the most significant byte of the request parameter memoryAddress.
        container DcmDspPeriodicTransmission [0..1]  # This container contains the configuration (parameters) for Periodic Transmission Scheduler.
          integer DcmDspMaxPeriodicDidScheduler: 1..255, set at link in variant link-time / pre-compile in variant post-build+pre-compile  # Defines the maximum number of periodicDataIdentifiers that can be scheduled concurrently.
          float DcmDspPeriodicTransmissionFastRate [0..1]: 1E-4..0.255, multiplicity set at pre-compile, set at link in variant link-time / pre-compile in variant post-build+pre-compile  # This parameter give the transmission rate of the requested periodicDataIdentifiers to be used if the parameter transmissionMode given in the ReadDataByPeriodicID request is equal to 0x03 ("sendAtFastRate"). This parameter value in seconds have to be configured as a multiple of DcmTaskTime. | min: A negative value and zero is not allowed.
          float DcmDspPeriodicTransmissionMediumRate [0..1]: 1E-4..0.255, multiplicity set at pre-compile, set at link in variant link-time / pre-compile in variant post-build+pre-compile  # This parameter give the transmission rate of the requested periodicDataIdentifiers to be used if the parameter transmissionMode given in the ReadDataByPeriodicID request is equal to 0x02 ("sendAtMediumRate"). This parameter value in seconds have to be configured as a multiple of DcmTaskTime. | min: A negative value and zero is not allowed.
          float DcmDspPeriodicTransmissionSlowRate [0..1]: 1E-4..0.255, multiplicity set at pre-compile, set at link in variant link-time / pre-compile in variant post-build+pre-compile  # This parameter give the transmission rate of the requested periodicDataIdentifiers to be used if the parameter transmissionMode given in the ReadDataByPeriodicID request is equal to 0x01 ("sendAtSlowRate"). This parameter value in seconds have to be configured as a multiple of DcmTaskTime. | min: A negative value and zero is not allowed.
        container DcmDspPid [0..*]  # This container defines the availability of a PID to the DCM.
          integer DcmDspPidIdentifier: 0..255, scope=ECU, set at link in variant link-time / pre-compile in variant post-build+pre-compile  # 1 byte Identifier of the PID | Within each DcmConfigSet all DcmDspPidIdentifier values shall be unique.
          enumeration DcmDspPidService: {DCM_SERVICE_01, DCM_SERVICE_01_02, DCM_SERVICE_02}, scope=ECU, set at link in variant link-time / pre-compile in variant post-build+pre-compile  # Indicates if a PID is used with service $01 and/or $02
          integer DcmDspPidSize: 0..255, scope=ECU, set at link in variant link-time / pre-compile in variant post-build+pre-compile  # Length of a PID in byte(s).
          boolean DcmDspPidUsed: scope=ECU, post-build-variant-value=true, set at link in variant link-time / post-build in variant post-build / pre-compile in variant pre-compile  # Allow to activate or deactivate the usage of a PID, for multi purpose ECUs | true = PID is available false = PID is not available
          container DcmDspPidData [1..*]  # This container defines the parameter for a Signal in the PID.
            integer DcmDspPidByteOffset: 0..255, scope=ECU, set at link in variant link-time / pre-compile in variant post-build+pre-compile  # This is the position in bytes of the PID structure and will not start at position 0 in case a support information is available (for packeted PIDs).
            integer DcmDspPidDataByteSize [0..1]: 0..255, scope=ECU, multiplicity set at link in variant link-time / pre-compile in variant post-build+pre-compile, set at link in variant link-time / pre-compile in variant post-build+pre-compile  # Defines the array length in bytes or the the maximum array length for variable datalengths.
            container DcmDspPidDataSupportInfo [0..1]  # This container defines the supported information.
              integer DcmDspPidDataSupportInfoBit: 0..255, scope=ECU, set at link in variant link-time / pre-compile in variant post-build+pre-compile  # Referenced Bit of the SupportInfo
              reference DcmDspPidDataSupportInfoRef: scope=ECU, set at link in variant link-time / pre-compile in variant post-build+pre-compile, destination=DcmDspPidSupportInfo  # Reference to DcmDspPidSupportInfo
            container DcmDspPidService01 [0..1]  # Contains specific configuration parameter of PID for service $01. This container exists only if DcmDspPidService is set to DCM_SERVICE_01 or DCM_SERVICE_01_02.
              enumeration DcmDspPidDataEndianness [0..1]: {BIG_ENDIAN, LITTLE_ENDIAN, OPAQUE}, scope=ECU, multiplicity set at pre-compile, set at pre-compile  # Defines the endianness of the data belonging to a PID in a diagnostic response message. | If no DcmDspPidDataEndianness is defined the value of DcmDspDataDefaultEndianness is applicable.
              function name DcmDspPidDataReadFnc [0..1]: scope=ECU, multiplicity set at pre-compile, set at pre-compile  # Function name for reading PID data value. | This is only relevant if DcmDspPidDataUsePort==USE_DATA_SYNCH_FNC. This parameter is related to the interface Xxx_ReadData.
              enumeration DcmDspPidDataType: {BOOLEAN, SINT16, SINT16_N, SINT32, SINT32_N, SINT8, SINT8_N, UINT16, UINT16_N, UINT32, UINT32_N, UINT8, UINT8_N}, scope=ECU, multiplicity set at link in variant link-time / pre-compile in variant post-build+pre-compile, set at link in variant link-time / pre-compile in variant post-build+pre-compile  # Provide the implementation data type of data belonging to a PID.
              enumeration DcmDspPidDataUsePort: {USE_DATA_SENDER_RECEIVER, USE_DATA_SENDER_RECEIVER_AS_SERVICE, USE_DATA_SYNCH_CLIENT_SERVER, USE_DATA_SYNCH_FNC}, scope=ECU, set at pre-compile  # If this parameter is set to USE_DATA_SYNCH_FNC, the Dcm will use the function defined in DcmDspPidDataReadFnc to get the PID data value. | If this parameter is set to USE_DATA_SYNCH_CLIENT_SERVER, the Dcm will have an R-Port requiring the interface DataServices_{Data}. If this parameter is set to USE_DATA_SENDER_RECEIVER or USE_DATA_SENDER_RECEIVER_AS_SERVICE, the DCM will have an R-Port requiring a SenderReceiverInterface. The R-Port is named DataServices_{Data} where {Data} is the name of the container DcmDspPidData.
              choice container DcmDspDiagnosisScaling [0..1]  # This container contains the configuration (parameters) of an alternative Diagnosis Representation. Out if this the scaling between Diagnosis and ECU internal representation and vice versa can be calculated.
                container DcmDspAlternativeDataInterface [0..1]  # This container contains the configuration (parameters) of an alternative Diagnosis Representation by the means of a VariableDataPrototoype in a DataInterface. | Additionally a reference to PortInterfaceMapping can be defined which provide already the mapping rules between the VariableDataPrototoype in a DataInterface used by the software component (DcmDspExternalSRDataElementClass) and the intended Diagnosis Representation defined by DcmDataElement.
                  foreign reference DcmDataElement: set at pre-compile, destination-type=VARIABLE-DATA-PROTOTYPE  # Alternative Diagnosis Representation for the data defined by the means of a VariableDataPrototoype in a DataInterface. | The CompuMethod of the data type of the referenced VariableDataPrototype will be applied to the data type of the VariableDataPrototype in the interface used by the Dcm.
                  foreign reference DcmPortInterfaceMapping [0..1]: multiplicity set at pre-compile, set at pre-compile, destination-type=PORT-INTERFACE-MAPPING  # Optional reference to PortInterfaceMapping which defines the mapping rules. | The PortInterfaceMapping is used to get the DataPrototypeMapping that describes a conversion between the data prototype referenced by DcmDataElement and the data prototype referenced from DcmDspExternalSRDataElementClass.
                container DcmDspAlternativeDataType [0..1]  # This container contains the configuration (parameters) of an alternative Diagnosis Representation by the means of an ApplicationDataType. | Additionally the definition of a text table mapping can be a defined for ApplicationDataTypes with a CompuMethod of category TEXTTABLE and SCALE_LINEAR_AND_TEXTTABLE.
                  foreign reference DcmApplicationDataType: set at pre-compile, destination-type=APPLICATION-DATA-TYPE  # Alternative Diagnosis Representation for the data defined by the means of a ApplicationDataType of category VALUE, BOOLEAN or ARRAY. | The CompuMethod that applies to the referenced ApplicationDataType in case of category VALUE or BOOLEAN will be applied to the data type of the VariableDataPrototype in the interface used by the Dcm.
                  container DcmDspTextTableMapping [0..*]  # The purpose of the DcmDspTextTableMapping is to associate a texttable value defined in the context of the Dcm to a texttable value defined in the context of a CompuMethod referenced by a DataType that shall be taken to create a dataElement in a SenderReceiverInterface. By this means it is possible to create a primitive version of a TexttableMapping (which can only be applied if a dataElement already exists). | In other words, the DcmDspTextTableMapping provides a similar mechanism to the TexttableMapping in a situation where the TexttableMapping cannot be applied since the SenderReceiverInterface for the PortPrototype on the Dcm ServiceComponent does not yet exist.
                    integer DcmDspDiagnosisRepresentationDataValue: 0..18446744073709551615, scope=ECU, set at pre-compile  # The data value in the diagnosis representation.
                    integer DcmDspInternalDataValue: 0..18446744073709551615, scope=ECU, set at pre-compile  # The ECU internal data value.
                container DcmDspAlternativeDiagnosticDataElement [0..1]  # This container contains the configuration (parameters) of an alternative Diagnosis Representation by the means of Diagnostic Extract.
                  foreign reference DcmDspDiagnosticDataElementRef: set at pre-compile, destination-type=DIAGNOSTIC-DATA-ELEMENT  # Alternative Diagnosis Representation for the data defined by the means of a DiagnosticDataElement in the Diagnostic Extract. | This EcucForeignReference enables the access to all SwDataDefProps, in particular BaseType, CompuMethod and DataConstr The CompuMethod and DataConstr that applies to the referenced DiagnosticDataElement will be applied to the data type of the VariableDataPrototype in the interface used by the Dcm. The mapped ImplementationDataType needs to match the given BaseType.
              choice container DcmDspPidService01ExternalSRDataElementClass [0..1]  # This container defines the source of data in a provided port which shall be read respectively the target of data in a required port which shall be written. | This container shall contain either one DcmSubElementInDataElementInstance OR DcmDataElementInstance OR DcmSubElementInImplDataElementInstance reference.
                container DcmDataElementInstance [0..1]  # Instance Reference to the primitive data in a port where the data element is typed with an ApplicationPrimitveDataType or an ImplementationDataType.
                  instance reference DcmDataElementInstanceRef: set at pre-compile, destination-context=ROOT-SW-COMPOSITION-PROTOTYPE SW-COMPONENT-PROTOTYPE PORT-PROTOTYPE, destination-type=AUTOSAR-DATA-PROTOTYPE  # Instance Reference to the primitive or array data which shall be read or written. | Supported are VariableDataPrototypes in SenderReceiverInterfaces and NvDataInterfaces and ParameterDataPrototypes in ParameterInterfaces (read only). This reference is applicable if the AutosarDataPrototype is typed with a ApplicationPrimitiveDataType of category VALUE or BOOLEAN or ApplicationArrayDataType or if the AutosarDataPrototype is typed with a ImplementationDataType of category VALUE, ARRAY or TYPE_REFERENCE that in turn boils down to VALUE or ARRAY
                container DcmSubElementInDataElementInstance [0..1]  # Instance Reference to the primitve sub-element (at any level) of composite data in a port where the data element is typed with an ApplicationCompositeDataType.
                  instance reference DcmSubElementInDataElementInstanceRef: set at pre-compile, destination-context=ROOT-SW-COMPOSITION-PROTOTYPE SW-COMPONENT-PROTOTYPE PORT-PROTOTYPE AUTOSAR-DATA-PROTOTYPE APPLICATION-COMPOSITE-ELEMENT-DATA-PROTOTYPE*, destination-type=APPLICATION-COMPOSITE-ELEMENT-DATA-PROTOTYPE  # Instance Reference to the primitve sub-element (at any level) of composite data in a port which shall be read. | Supported are VariableDataPrototypes in SenderReceiverInterfaces and NvDataInterfaces and ParameterDataPrototypes in ParameterInterfaces (read only). This reference is applicable if the AutosarDataPrototype is typed with a ApplicationCompositeDataType.
                container DcmSubElementInImplDataElementInstance [0..1]  # Instance Reference to the primitve sub-element (at any level) of composite data in a port where the data element is typed with an ImplementationDataType.
                  instance reference DcmSubElementInImplDataElementInstanceRef: set at pre-compile, destination-context=ROOT-SW-COMPOSITION-PROTOTYPE SW-COMPONENT-PROTOTYPE PORT-PROTOTYPE AUTOSAR-DATA-PROTOTYPE IMPLEMENTATION-DATA-TYPE-ELEMENT*, destination-type=IMPLEMENTATION-DATA-TYPE-ELEMENT  # Instance Reference to the primitve sub-element (at any level) of composite data in a port which shall be read. | Supported are VariableDataPrototypes in SenderReceiverInterfaces and NvDataInterfaces and ParameterDataPrototypes in ParameterInterfaces (read only). This reference is applicable if the AutosarDataPrototype is typed with a ImplementationDataType of category STRUCTURE or ARRAY. Please note that in case of ARRAY the index attribute in the target reference has to be set to select a single array element.
            container DcmDspPidService02 [0..1]  # Contains specific configuration parameter of PID for service $02. This container exists only if DcmDspPidService is set to DCM_SERVICE_02 or DCM_SERVICE_01_02.
              reference DcmDspPidDataDemRef [0..1]: scope=ECU, multiplicity set at link in variant link-time / pre-compile in variant post-build+pre-compile, set at link in variant link-time / pre-compile in variant post-build+pre-compile, destination=DemPidDataElement  # Reference to DemPidDataElement in DEM configuration. Allows to link the DCM PID and DEM PID configuration for Mode $02.
          container DcmDspPidSupportInfo [0..*]  # This container defines the support information (typically byte A) to declare the usability of the data bytes within the so-called packeted PIDs (e.g. PID$68).
            integer DcmDspPidSupportInfoLen: 0..255, scope=ECU, set at link in variant link-time / pre-compile in variant post-build+pre-compile  # Length of the support information in bytes.
            integer DcmDspPidSupportInfoPos: 0..255, scope=ECU, set at link in variant link-time / pre-compile in variant post-build+pre-compile  # Position of the support information in bytes.
        container DcmDspReadDTCInformation [0..1]  # This container contains the configuration for the UDS service ReadDTCInformation (0x19).
          boolean DcmDspReadDTCInformationSupportedObdUdsDtcSeparation [0..1]: set at pre-compile  # If this parameter is set to true, the OBD UDS DTC separation is enabled. If this parameter is not configured or set to false, the OBD UDS DTC separation is disabled.
          container DcmDspReadDTCInformationUserDefinedFaultMemory [0..255]  # This container contains the configuration for user defined fault memories in DcmDspReadDTCInformation.
            integer DcmDspReadDTCInformationUserDefinedFaultMemoryId: 0..255, scope=ECU, set at pre-compile  # Identifier used by external tester to identify the User defined event Memory.
            integer DcmDspReadDTCInformationUserDefinedFaultMemoryRole [0..1]: 0..4294967295, scope=ECU, multiplicity set at link in variant link-time / post-build in variant post-build / pre-compile in variant pre-compile, post-build-variant-multiplicity=true, post-build-variant-value=true, set at link in variant link-time / post-build in variant post-build / pre-compile in variant pre-compile  # Bitfield were each bit represents one dedicated role. A user defined fault memory is granted access if the bit value is 1. If a bit value is 0, it is not allowed for that role.
        container DcmDspRequestControl [0..*]  # This container contains the configuration (parameters) of the "Request control of on-board system, test or component" service (Service $08). | The DCM will request the control using an R-Port requiring a PortInteface RequestControlServices_{Tid}. The R-Port is named RequestControlServices_{Tid} where {Tid} is the name of the container DcmDspRequestControl.
          integer DcmDspRequestControlInBufferSize: 0..255, scope=ECU, set at link in variant link-time / pre-compile in variant post-build+pre-compile  # Number of bytes to be provided in the input buffer of the interface RequestControlServices_{Tid} for OBD Service $08
          integer DcmDspRequestControlInfoByte [0..1]: 0..255, scope=ECU, set at link in variant link-time / pre-compile in variant post-build+pre-compile  # Manufacturer specific value reported to the tester for the record identifiers 0xE000 to OxE1FF. (WWH-OBD use cases)
          integer DcmDspRequestControlOutBufferSize: 0..255, scope=ECU, set at link in variant link-time / pre-compile in variant post-build+pre-compile  # Number of bytes to be provided in the output buffer of the interface RequestControlServices_{Tid} for OBD Service $08
          integer DcmDspRequestControlTestId: 0..255, scope=ECU, set at link in variant link-time / pre-compile in variant post-build+pre-compile  # Test Id for Service $08
        container DcmDspRequestFileTransfer [0..1]  # This container contains the configuration for RequestFileTransfer. | This container only exists if RequestFileTransfer is configured.
          integer DcmRequestFileTransferFileSizeOrDirInfoParameterLength: 1..4, scope=ECU, set at pre-compile, default-value=4  # Defines the length (number of bytes, i.e. the value of fileSizeOrDirInfoParameterLength) of the fileSizeUncompressedOrDirInfoLength and fileSizeCompressed in the response of RequestFileTransfer.
          integer DcmRequestFileTransferLengthFormatIdentifier: 1..4, scope=ECU, set at pre-compile, default-value=4  # Defines the length (number of bytes) of the maxNumberOfBlockLength parameter in the response of RequestFileTransfer.
          integer DcmRequestFileTransferMaxFileAndDirName [0..1]: 1..65535, scope=ECU, set at pre-compile, default-value=1  # Defines the maximum size allowed for the FileAndDirName parameter with RTE interfaces used for RequestFileTransfer.
          boolean DcmRequestFileTransferUsePort: scope=ECU, set at pre-compile, default-value=false  # Defines if a C/S or C function call shall be used for RequestFileTransfer processing.
        container DcmDspRoe [0..1]  # Provide the configuration of the ResponseOnEvent mechanism.
          float DcmDspRoeInterMessageTime: 0..5, set at link in variant link-time / pre-compile in variant post-build+pre-compile  # Provide the minimum time in seconds between two transmissions of ROE event. It is used for the delay between two different consecutive Roe transmissions.
          reference DcmDspRoeEventNvMBlockIdRef [0..1]: set at link in variant link-time / pre-compile in variant post-build+pre-compile, destination=NvMBlockDescriptor  # References a NvM Block Id that store roe event in non-volatile memory.
          container DcmDspRoeEvent [1..255]  # This container contains a list of all supported Roe eventTypeRecords which are accepted by this ECU. | At most one DcmDspRoeEvent container is allowed to define a DcmDspRoeEventProperties container with the choice DcmDspRoeOnDTCStatusChange.
            integer DcmDspRoeEventId: 0..254, set at pre-compile, symbolic-name-value=true  # EventId for a global identification of this ROE event it is used within APIs Dcm_TriggerOnEvent() and the ModeDeclarationGroup. | The ratio Ids should be sequentially ordered beginning with 0 and no gaps in between.
            enumeration DcmDspRoeInitialEventStatus: {DCM_ROE_CLEARED, DCM_ROE_STOPPED}, set at link in variant link-time / pre-compile in variant post-build+pre-compile, default-value=DCM_ROE_CLEARED  # Initial Roe status of this RoeEvent
            choice container DcmDspRoeEventProperties  # This container contains the properties of Roe eventTypeRecords. | In one DcmDspRoeEventProperties container one DcmDspRoeOnDTCStatusChange or DcmDspRoeOnChangeOfDataIdentifier container shall be defined.
              container DcmDspRoeOnChangeOfDataIdentifier [0..1]  # This container contains the eventTypeRecord supported for onChangeOfDataIdentifier eventType.
                reference DcmDspRoeDidRef: set at link in variant link-time / pre-compile in variant post-build+pre-compile, destination=DcmDspDid  # Reference to a Did which is watched.
              container DcmDspRoeOnDTCStatusChange [0..1]  # This container contains the eventTypeRecord supported for onDTCStatusChange eventType.
                integer DcmDspRoeDTCStatusMask [0..1]: 0..255, set at pre-compile  # Value of the relevant DTCStatusMask
          container DcmDspRoeEventWindowTime [1..*]  # This container configures the available EventWindowTime in this Ecu. | This container contains a sub-set of EventWindowTimes supported by the Dcm, to limit the Ecu resources.
            enumeration DcmDspRoeEventWindowTime: {DCM_ROE_EVENT_WINDOW_CURRENT_AND_FOLLOWING_CYCLE, DCM_ROE_EVENT_WINDOW_CURRENT_CYCLE, DCM_ROE_EVENT_WINDOW_INFINITE}, set at pre-compile  # Value of the EventWindowTime
        container DcmDspRoutine [0..*]  # This container contains the configuration (parameters) for Routines
          integer DcmDspRoutineIdentifier: 0..65535, scope=ECU, set at link in variant link-time / pre-compile in variant post-build+pre-compile  # 2 bytes Identifier of the RID | Within each DcmConfigSet all DcmDspRoutineIdentifier values shall be unique.
          integer DcmDspRoutineInfoByte [0..1]: 0..255, scope=ECU, set at link in variant link-time / pre-compile in variant post-build+pre-compile  # Manufacturer specific value reported to the tester for the record identifiers 0xE000 to OxE1FF. (OBD use cases)
          boolean DcmDspRoutineUsed: scope=ECU, post-build-variant-value=true, set at link in variant link-time / post-build in variant post-build / pre-compile in variant pre-compile  # Allow to activate or deactivate the usage of a Routine, for multi purpose ECUs | True = Routine is available False = Routine is not available
          boolean DcmDspRoutineUsePort: scope=ECU, multiplicity set at pre-compile, set at pre-compile  # If this parameter is set to true, the DCM uses a port requiring a PortInterface RoutineServices_{RoutineName}. | The R-Port is named RoutineServices_{RoutineName} where {RoutineName} is the name of the container DcmDspRoutine In that case, the configuration must not provide function names in DcmDspStartRoutineFnc, DcmDspStopRoutineFnc or DcmDspRequestResultsRoutineFnc. If this is false, the DCM expects to find the names of the functions to be used in DcmDspStartRoutineFnc, DcmDspStopRoutineFnc or DcmDspRequestResultsRoutineFnc.
          container DcmDspRequestRoutineResults [0..1]  # Provides the configuration of RequestResult subservice for RoutineControl service. | Existence indicates that the RequestRoutineResults in the RoutineControl is supported.
            boolean DcmDspRequestRoutineResultsConfirmationEnabled [0..1]: scope=ECU, multiplicity set at pre-compile, set at pre-compile, default-value=false  # Allows to enable/disable the confirmation function to indicate the transmission of a response to a RequestRoutineResults request
            function name DcmDspRequestRoutineResultsConfirmationFnc [0..1]: scope=ECU, multiplicity set at pre-compile, set at pre-compile  # C-function to call if a transmission confirmation is needed by the issuer (BSW module)
            function name DcmDspRequestRoutineResultsFnc [0..1]: scope=ECU, multiplicity set at pre-compile, set at pre-compile  # Function name for request to application the results of a routine. (Routine_RequestResults-function) | This parameter is related to the interface Xxx_RequestResults.
            integer DcmDspRequestRoutineResultsRole [0..1]: 0..4294967295, scope=ECU, multiplicity set at link in variant link-time / post-build in variant post-build / pre-compile in variant pre-compile, post-build-variant-multiplicity=true, post-build-variant-value=true, set at link in variant link-time / post-build in variant post-build / pre-compile in variant pre-compile  # Bitfield were each bit represents one dedicated role. A RoutineControl with sub-function requestResults is granted access if the bit value is 1. If a bit value is 0, the routine is not allowed for that role.
            reference DcmDspRequestRoutineResultsCommonAuthorizationRef [0..1]: scope=ECU, multiplicity set at link in variant link-time / pre-compile in variant post-build+pre-compile, set at link in variant link-time / pre-compile in variant post-build+pre-compile, destination=DcmDspCommonAuthorization  # Reference to DcmDspCommonAuthorization | Common authorization configuration taken from the referenced DcmDspRequestRoutineResultsCommonAuthorizationRef. If there is no reference, no check on the commonly defined authorization conditions shall be done to get the routine result.
            container DcmDspRequestRoutineResultsIn [0..1]  # Provide description of input parameter of RequestResult subservice for RoutineControl service.
              container DcmDspRequestRoutineResultsInSignal [1..*]: requires-index=true  # Provides description of a routine signal used in RoutineControl service. | The ordering defined via the index attribute of the subcontainers in this list represents the order of the dataIn_n elements in the XXX_RequestResult function call.
                integer DcmDspRoutineParameterSize [0..1]: 0..65535, scope=ECU, multiplicity set at link in variant link-time / pre-compile in variant post-build+pre-compile, set at link in variant link-time / pre-compile in variant post-build+pre-compile  # Provide the size of a RoutineControl parameter in bytes
                enumeration DcmDspRoutineSignalEndianness [0..1]: {BIG_ENDIAN, LITTLE_ENDIAN, OPAQUE}, scope=ECU, multiplicity set at link in variant link-time / pre-compile in variant post-build+pre-compile, set at link in variant link-time / pre-compile in variant post-build+pre-compile  # Defines the endianness of the data belonging to a Routine In Signal for RequestResult subfunction.
                integer DcmDspRoutineSignalPos: 0..65535, scope=ECU, set at link in variant link-time / pre-compile in variant post-build+pre-compile  # Provide the position of the signal in the RoutineControl request/response. | The position is defined in bits.
                enumeration DcmDspRoutineSignalType: {BOOLEAN, SINT16, SINT16_N, SINT32, SINT32_N, SINT8, SINT8_N, UINT16, UINT16_N, UINT32, UINT32_N, UINT8, UINT8_N, VARIABLE_LENGTH}, scope=ECU, set at link in variant link-time / pre-compile in variant post-build+pre-compile  # Provide the type of the signal in the RoutineControl request/response.
                choice container DcmDspArgumentScaling [0..1]  # This container contains the configuration (arguments) of an alternative Diagnosis Representation. Out if this the scaling between Diagnosis and ECU internal representation and vice versa can be calculated.
                  container DcmDspAlternativeArgumentData [0..1]  # This container contains the configuration (parameters) of an alternative Diagnosis Representation by the means of a ArgumentDataPrototype.
                    foreign reference DcmDataElement: set at pre-compile, destination-type=ARGUMENT-DATA-PROTOTYPE  # Alternative Diagnosis Representation for the data defined by the means of a ArgumentDataPrototype. | The CompuMethod of the data type of the referenced ArgumentDataPrototype will be applied to the data type of the ArgumentDataPrototype in the interface used by the Dcm.
                  container DcmDspAlternativeDataType [0..1]  # This container contains the configuration (parameters) of an alternative Diagnosis Representation by the means of an ApplicationDataType. | Additionally the definition of a text table mapping can be a defined for ApplicationDataTypes with a CompuMethod of category TEXTTABLE and SCALE_LINEAR_AND_TEXTTABLE.
                    foreign reference DcmApplicationDataType: set at pre-compile, destination-type=APPLICATION-DATA-TYPE  # Alternative Diagnosis Representation for the data defined by the means of a ApplicationDataType of category VALUE, BOOLEAN or ARRAY. | The CompuMethod that applies to the referenced ApplicationDataType in case of category VALUE or BOOLEAN will be applied to the data type of the VariableDataPrototype in the interface used by the Dcm.
                    container DcmDspTextTableMapping [0..*]  # The purpose of the DcmDspTextTableMapping is to associate a texttable value defined in the context of the Dcm to a texttable value defined in the context of a CompuMethod referenced by a DataType that shall be taken to create a dataElement in a SenderReceiverInterface. By this means it is possible to create a primitive version of a TexttableMapping (which can only be applied if a dataElement already exists). | In other words, the DcmDspTextTableMapping provides a similar mechanism to the TexttableMapping in a situation where the TexttableMapping cannot be applied since the SenderReceiverInterface for the PortPrototype on the Dcm ServiceComponent does not yet exist.
                      integer DcmDspDiagnosisRepresentationDataValue: 0..18446744073709551615, scope=ECU, set at pre-compile  # The data value in the diagnosis representation.
                      integer DcmDspInternalDataValue: 0..18446744073709551615, scope=ECU, set at pre-compile  # The ECU internal data value.
                  container DcmDspAlternativeDiagnosticDataElement [0..1]  # This container contains the configuration (parameters) of an alternative Diagnosis Representation by the means of Diagnostic Extract.
                    foreign reference DcmDspDiagnosticDataElementRef: set at pre-compile, destination-type=DIAGNOSTIC-DATA-ELEMENT  # Alternative Diagnosis Representation for the data defined by the means of a DiagnosticDataElement in the Diagnostic Extract. | This EcucForeignReference enables the access to all SwDataDefProps, in particular BaseType, CompuMethod and DataConstr The CompuMethod and DataConstr that applies to the referenced DiagnosticDataElement will be applied to the data type of the VariableDataPrototype in the interface used by the Dcm. The mapped ImplementationDataType needs to match the given BaseType.
            container DcmDspRequestRoutineResultsOut [0..1]  # Provide description of output parameter of RequestResult subservice for RoutineControl service.
              container DcmDspRequestRoutineResultsOutSignal [1..*]: requires-index=true  # Provides description of a routine signal used in RoutineControl service. | The ordering defined via the index attribute of the subcontainers in this list represents the order of the dataOutN elements in the XXX_RequestResult function call.
                integer DcmDspRoutineParameterSize [0..1]: 0..65535, scope=ECU, multiplicity set at link in variant link-time / pre-compile in variant post-build+pre-compile, set at link in variant link-time / pre-compile in variant post-build+pre-compile  # Provide the size of a RoutineControl parameter in bytes
                enumeration DcmDspRoutineSignalEndianness [0..1]: {BIG_ENDIAN, LITTLE_ENDIAN, OPAQUE}, scope=ECU, multiplicity set at link in variant link-time / pre-compile in variant post-build+pre-compile, set at link in variant link-time / pre-compile in variant post-build+pre-compile  # Defines the endianness of the data belonging to a Routine Out Signal for RequestResult subfunction.
                integer DcmDspRoutineSignalPos: 0..65535, scope=ECU, set at link in variant link-time / pre-compile in variant post-build+pre-compile  # Provide the position of the signal in the RoutineControl request/response. | The position is defined in bits.
                enumeration DcmDspRoutineSignalType: {BOOLEAN, SINT16, SINT16_N, SINT32, SINT32_N, SINT8, SINT8_N, UINT16, UINT16_N, UINT32, UINT32_N, UINT8, UINT8_N, VARIABLE_LENGTH}, scope=ECU, set at link in variant link-time / pre-compile in variant post-build+pre-compile  # Provide the type of the signal in the RoutineControl request/response.
                choice container DcmDspArgumentScaling [0..1]  # This container contains the configuration (arguments) of an alternative Diagnosis Representation. Out if this the scaling between Diagnosis and ECU internal representation and vice versa can be calculated.
                  container DcmDspAlternativeArgumentData [0..1]  # This container contains the configuration (parameters) of an alternative Diagnosis Representation by the means of a ArgumentDataPrototype.
                    foreign reference DcmDataElement: set at pre-compile, destination-type=ARGUMENT-DATA-PROTOTYPE  # Alternative Diagnosis Representation for the data defined by the means of a ArgumentDataPrototype. | The CompuMethod of the data type of the referenced ArgumentDataPrototype will be applied to the data type of the ArgumentDataPrototype in the interface used by the Dcm.
                  container DcmDspAlternativeDataType [0..1]  # This container contains the configuration (parameters) of an alternative Diagnosis Representation by the means of an ApplicationDataType. | Additionally the definition of a text table mapping can be a defined for ApplicationDataTypes with a CompuMethod of category TEXTTABLE and SCALE_LINEAR_AND_TEXTTABLE.
                    foreign reference DcmApplicationDataType: set at pre-compile, destination-type=APPLICATION-DATA-TYPE  # Alternative Diagnosis Representation for the data defined by the means of a ApplicationDataType of category VALUE, BOOLEAN or ARRAY. | The CompuMethod that applies to the referenced ApplicationDataType in case of category VALUE or BOOLEAN will be applied to the data type of the VariableDataPrototype in the interface used by the Dcm.
                    container DcmDspTextTableMapping [0..*]  # The purpose of the DcmDspTextTableMapping is to associate a texttable value defined in the context of the Dcm to a texttable value defined in the context of a CompuMethod referenced by a DataType that shall be taken to create a dataElement in a SenderReceiverInterface. By this means it is possible to create a primitive version of a TexttableMapping (which can only be applied if a dataElement already exists). | In other words, the DcmDspTextTableMapping provides a similar mechanism to the TexttableMapping in a situation where the TexttableMapping cannot be applied since the SenderReceiverInterface for the PortPrototype on the Dcm ServiceComponent does not yet exist.
                      integer DcmDspDiagnosisRepresentationDataValue: 0..18446744073709551615, scope=ECU, set at pre-compile  # The data value in the diagnosis representation.
                      integer DcmDspInternalDataValue: 0..18446744073709551615, scope=ECU, set at pre-compile  # The ECU internal data value.
                  container DcmDspAlternativeDiagnosticDataElement [0..1]  # This container contains the configuration (parameters) of an alternative Diagnosis Representation by the means of Diagnostic Extract.
                    foreign reference DcmDspDiagnosticDataElementRef: set at pre-compile, destination-type=DIAGNOSTIC-DATA-ELEMENT  # Alternative Diagnosis Representation for the data defined by the means of a DiagnosticDataElement in the Diagnostic Extract. | This EcucForeignReference enables the access to all SwDataDefProps, in particular BaseType, CompuMethod and DataConstr The CompuMethod and DataConstr that applies to the referenced DiagnosticDataElement will be applied to the data type of the VariableDataPrototype in the interface used by the Dcm. The mapped ImplementationDataType needs to match the given BaseType.
          container DcmDspStartRoutine [0..1]  # Provides the configuration of Start subservice for RoutineControl service.
            boolean DcmDspStartRoutineConfirmationEnabled [0..1]: scope=ECU, multiplicity set at pre-compile, set at pre-compile, default-value=false  # Allows to enable/disable the confirmation function to indicate the transmission of a response to a StartRoutine request
            function name DcmDspStartRoutineConfirmationFnc [0..1]: scope=ECU, multiplicity set at pre-compile, set at pre-compile  # C-function to call if a transmission confirmation is needed by the issuer (BSW module)
            function name DcmDspStartRoutineFnc [0..1]: scope=ECU, multiplicity set at pre-compile, set at pre-compile  # Function name for request to application to start a routine. (Routine_Start-function) | This parameter is related to the interface Xxx_Start.
            integer DcmDspStartRoutineRole [0..1]: 0..4294967295, scope=ECU, multiplicity set at link in variant link-time / post-build in variant post-build / pre-compile in variant pre-compile, post-build-variant-multiplicity=true, post-build-variant-value=true, set at link in variant link-time / post-build in variant post-build / pre-compile in variant pre-compile  # Bitfield were each bit represents one dedicated role. A RoutineControl with sub-function startRoutine is granted access if the bit value is 1. If a bit value is 0, the routine is not allowed for that role.
            reference DcmDspStartRoutineCommonAuthorizationRef [0..1]: scope=ECU, multiplicity set at link in variant link-time / pre-compile in variant post-build+pre-compile, set at link in variant link-time / pre-compile in variant post-build+pre-compile, destination=DcmDspCommonAuthorization  # Reference to DcmDspCommonAuthorization | Common authorization configuration taken from the referenced DcmDspStartRoutineCommonAuthorizationRef. If there is no reference, no check on the commonly defined authorization conditions shall be done to start the routine.
            container DcmDspStartRoutineIn [0..1]  # Provide description of input parameter of Start subservice for RoutineControl service
              container DcmDspStartRoutineInSignal [1..*]: requires-index=true  # Provide description of a routine signal used in RoutineControl service. | The ordering defined via the index attribute of the subcontainers in this list represents the order of the dataInN elements in the XXX_Start function call.
                integer DcmDspRoutineParameterSize [0..1]: 0..65535, scope=ECU, multiplicity set at link in variant link-time / pre-compile in variant post-build+pre-compile, set at link in variant link-time / pre-compile in variant post-build+pre-compile  # Provide the size of a RoutineControl parameter in bytes
                enumeration DcmDspRoutineSignalEndianness [0..1]: {BIG_ENDIAN, LITTLE_ENDIAN, OPAQUE}, scope=ECU, multiplicity set at link in variant link-time / pre-compile in variant post-build+pre-compile, set at link in variant link-time / pre-compile in variant post-build+pre-compile  # Defines the endianness of the data belonging to a Routine In Signal for Start subfunction.
                integer DcmDspRoutineSignalPos: 0..65535, scope=ECU, set at link in variant link-time / pre-compile in variant post-build+pre-compile  # Provide the position of the signal in the RoutineControl request/response. | The position is defined in bits.
                enumeration DcmDspRoutineSignalType: {BOOLEAN, SINT16, SINT16_N, SINT32, SINT32_N, SINT8, SINT8_N, UINT16, UINT16_N, UINT32, UINT32_N, UINT8, UINT8_N, VARIABLE_LENGTH}, scope=ECU, set at link in variant link-time / pre-compile in variant post-build+pre-compile  # Provide the type of the signal in the RoutineControl request/response.
                choice container DcmDspArgumentScaling [0..1]  # This container contains the configuration (arguments) of an alternative Diagnosis Representation. Out if this the scaling between Diagnosis and ECU internal representation and vice versa can be calculated.
                  container DcmDspAlternativeArgumentData [0..1]  # This container contains the configuration (parameters) of an alternative Diagnosis Representation by the means of a ArgumentDataPrototype.
                    foreign reference DcmDataElement: set at pre-compile, destination-type=ARGUMENT-DATA-PROTOTYPE  # Alternative Diagnosis Representation for the data defined by the means of a ArgumentDataPrototype. | The CompuMethod of the data type of the referenced ArgumentDataPrototype will be applied to the data type of the ArgumentDataPrototype in the interface used by the Dcm.
                  container DcmDspAlternativeDataType [0..1]  # This container contains the configuration (parameters) of an alternative Diagnosis Representation by the means of an ApplicationDataType. | Additionally the definition of a text table mapping can be a defined for ApplicationDataTypes with a CompuMethod of category TEXTTABLE and SCALE_LINEAR_AND_TEXTTABLE.
                    foreign reference DcmApplicationDataType: set at pre-compile, destination-type=APPLICATION-DATA-TYPE  # Alternative Diagnosis Representation for the data defined by the means of a ApplicationDataType of category VALUE, BOOLEAN or ARRAY. | The CompuMethod that applies to the referenced ApplicationDataType in case of category VALUE or BOOLEAN will be applied to the data type of the VariableDataPrototype in the interface used by the Dcm.
                    container DcmDspTextTableMapping [0..*]  # The purpose of the DcmDspTextTableMapping is to associate a texttable value defined in the context of the Dcm to a texttable value defined in the context of a CompuMethod referenced by a DataType that shall be taken to create a dataElement in a SenderReceiverInterface. By this means it is possible to create a primitive version of a TexttableMapping (which can only be applied if a dataElement already exists). | In other words, the DcmDspTextTableMapping provides a similar mechanism to the TexttableMapping in a situation where the TexttableMapping cannot be applied since the SenderReceiverInterface for the PortPrototype on the Dcm ServiceComponent does not yet exist.
                      integer DcmDspDiagnosisRepresentationDataValue: 0..18446744073709551615, scope=ECU, set at pre-compile  # The data value in the diagnosis representation.
                      integer DcmDspInternalDataValue: 0..18446744073709551615, scope=ECU, set at pre-compile  # The ECU internal data value.
                  container DcmDspAlternativeDiagnosticDataElement [0..1]  # This container contains the configuration (parameters) of an alternative Diagnosis Representation by the means of Diagnostic Extract.
                    foreign reference DcmDspDiagnosticDataElementRef: set at pre-compile, destination-type=DIAGNOSTIC-DATA-ELEMENT  # Alternative Diagnosis Representation for the data defined by the means of a DiagnosticDataElement in the Diagnostic Extract. | This EcucForeignReference enables the access to all SwDataDefProps, in particular BaseType, CompuMethod and DataConstr The CompuMethod and DataConstr that applies to the referenced DiagnosticDataElement will be applied to the data type of the VariableDataPrototype in the interface used by the Dcm. The mapped ImplementationDataType needs to match the given BaseType.
            container DcmDspStartRoutineOut [0..1]  # Provide description of output parameter of Start subservice for RoutineControl service.
              container DcmDspStartRoutineOutSignal [1..*]: requires-index=true  # Provide description of a routine signal used in RoutineControl service. | The ordering defined via the index attribute of the subcontainers in this list represents the order of the dataOutN elements in the XXX_Start function call.
                integer DcmDspRoutineParameterSize [0..1]: 0..65535, scope=ECU, multiplicity set at link in variant link-time / pre-compile in variant post-build+pre-compile, set at link in variant link-time / pre-compile in variant post-build+pre-compile  # Provide the size of a RoutineControl parameter in bytes
                enumeration DcmDspRoutineSignalEndianness [0..1]: {BIG_ENDIAN, LITTLE_ENDIAN, OPAQUE}, scope=ECU, multiplicity set at link in variant link-time / pre-compile in variant post-build+pre-compile, set at link in variant link-time / pre-compile in variant post-build+pre-compile  # Defines the endianness of the data belonging to a Routine Out Signal for Start subfunction.
                integer DcmDspRoutineSignalPos [0..1]: 0..65535, scope=ECU, multiplicity set at link in variant link-time / pre-compile in variant post-build+pre-compile, set at link in variant link-time / pre-compile in variant post-build+pre-compile  # Provide the position of the signal in the RoutineControl request/response. | The position is defined in bits.
                enumeration DcmDspRoutineSignalType: {BOOLEAN, SINT16, SINT16_N, SINT32, SINT32_N, SINT8, SINT8_N, UINT16, UINT16_N, UINT32, UINT32_N, UINT8, UINT8_N, VARIABLE_LENGTH}, scope=ECU, set at link in variant link-time / pre-compile in variant post-build+pre-compile  # Provide the type of the signal in the RoutineControl request/response.
                choice container DcmDspArgumentScaling [0..1]  # This container contains the configuration (arguments) of an alternative Diagnosis Representation. Out if this the scaling between Diagnosis and ECU internal representation and vice versa can be calculated.
                  container DcmDspAlternativeArgumentData [0..1]  # This container contains the configuration (parameters) of an alternative Diagnosis Representation by the means of a ArgumentDataPrototype.
                    foreign reference DcmDataElement: set at pre-compile, destination-type=ARGUMENT-DATA-PROTOTYPE  # Alternative Diagnosis Representation for the data defined by the means of a ArgumentDataPrototype. | The CompuMethod of the data type of the referenced ArgumentDataPrototype will be applied to the data type of the ArgumentDataPrototype in the interface used by the Dcm.
                  container DcmDspAlternativeDataType [0..1]  # This container contains the configuration (parameters) of an alternative Diagnosis Representation by the means of an ApplicationDataType. | Additionally the definition of a text table mapping can be a defined for ApplicationDataTypes with a CompuMethod of category TEXTTABLE and SCALE_LINEAR_AND_TEXTTABLE.
                    foreign reference DcmApplicationDataType: set at pre-compile, destination-type=APPLICATION-DATA-TYPE  # Alternative Diagnosis Representation for the data defined by the means of a ApplicationDataType of category VALUE, BOOLEAN or ARRAY. | The CompuMethod that applies to the referenced ApplicationDataType in case of category VALUE or BOOLEAN will be applied to the data type of the VariableDataPrototype in the interface used by the Dcm.
                    container DcmDspTextTableMapping [0..*]  # The purpose of the DcmDspTextTableMapping is to associate a texttable value defined in the context of the Dcm to a texttable value defined in the context of a CompuMethod referenced by a DataType that shall be taken to create a dataElement in a SenderReceiverInterface. By this means it is possible to create a primitive version of a TexttableMapping (which can only be applied if a dataElement already exists). | In other words, the DcmDspTextTableMapping provides a similar mechanism to the TexttableMapping in a situation where the TexttableMapping cannot be applied since the SenderReceiverInterface for the PortPrototype on the Dcm ServiceComponent does not yet exist.
                      integer DcmDspDiagnosisRepresentationDataValue: 0..18446744073709551615, scope=ECU, set at pre-compile  # The data value in the diagnosis representation.
                      integer DcmDspInternalDataValue: 0..18446744073709551615, scope=ECU, set at pre-compile  # The ECU internal data value.
                  container DcmDspAlternativeDiagnosticDataElement [0..1]  # This container contains the configuration (parameters) of an alternative Diagnosis Representation by the means of Diagnostic Extract.
                    foreign reference DcmDspDiagnosticDataElementRef: set at pre-compile, destination-type=DIAGNOSTIC-DATA-ELEMENT  # Alternative Diagnosis Representation for the data defined by the means of a DiagnosticDataElement in the Diagnostic Extract. | This EcucForeignReference enables the access to all SwDataDefProps, in particular BaseType, CompuMethod and DataConstr The CompuMethod and DataConstr that applies to the referenced DiagnosticDataElement will be applied to the data type of the VariableDataPrototype in the interface used by the Dcm. The mapped ImplementationDataType needs to match the given BaseType.
          container DcmDspStopRoutine [0..1]  # Provides the configuration of Stop subservice for RoutineControl service. | Existence indicates that the StopRoutine in the RoutineControl is supported.
            boolean DcmDspStopRoutineConfirmationEnabled [0..1]: scope=ECU, multiplicity set at pre-compile, set at pre-compile, default-value=false  # Allows to enable/disable the confirmation function to indicate the transmission of a response to a StopRoutine request
            function name DcmDspStopRoutineConfirmationFnc [0..1]: scope=ECU, multiplicity set at pre-compile, set at pre-compile  # C-function to call if a transmission confirmation is needed by the issuer (BSW module)
            function name DcmDspStopRoutineFnc [0..1]: scope=ECU, multiplicity set at pre-compile, set at pre-compile  # Function name for request to application to stop a routine. (Routine_Stop-function) | This parameter is related to the interface Xxx_Stop.
            integer DcmDspStopRoutineRole [0..1]: 0..4294967295, scope=ECU, multiplicity set at link in variant link-time / post-build in variant post-build / pre-compile in variant pre-compile, post-build-variant-multiplicity=true, post-build-variant-value=true, set at link in variant link-time / post-build in variant post-build / pre-compile in variant pre-compile  # Bitfield were each bit represents one dedicated role. A RoutineControl with sub-function stopRoutine is granted access if the bit value is 1. If a bit value is 0, the routine is not allowed for that role.
            reference DcmDspStopRoutineCommonAuthorizationRef [0..1]: scope=ECU, multiplicity set at link in variant link-time / pre-compile in variant post-build+pre-compile, set at link in variant link-time / pre-compile in variant post-build+pre-compile, destination=DcmDspCommonAuthorization  # Reference to DcmDspCommonAuthorization | Common authorization configuration taken from the referenced DcmDspStopRoutineCommonAuthorizationRef. If there is no reference, no check on the commonly defined authorization conditions shall be done to stop the routine.
            container DcmDspStopRoutineIn [0..1]  # Provide description of input parameter of Stop subservice for RoutineControl service.
              container DcmDspStopRoutineInSignal [1..*]: requires-index=true  # Provide description of a routine signal used in RoutineControl service. | The ordering defined via the index attribute of the subcontainers in this list represents the order of the dataInN elements in the XXX_Stop function call.
                integer DcmDspRoutineParameterSize [0..1]: 0..65535, scope=ECU, multiplicity set at link in variant link-time / pre-compile in variant post-build+pre-compile, set at link in variant link-time / pre-compile in variant post-build+pre-compile  # Provide the size of a RoutineControl parameter in bytes
                enumeration DcmDspRoutineSignalEndianness [0..1]: {BIG_ENDIAN, LITTLE_ENDIAN, OPAQUE}, scope=ECU, multiplicity set at link in variant link-time / pre-compile in variant post-build+pre-compile, set at link in variant link-time / pre-compile in variant post-build+pre-compile  # Defines the endianness of the data belonging to a Routine In Signal for Stop subfunction.
                integer DcmDspRoutineSignalPos: 0..65535, scope=ECU, set at link in variant link-time / pre-compile in variant post-build+pre-compile  # Provide the position of the signal in the RoutineControl request/response. | The position is defined in bits.
                enumeration DcmDspRoutineSignalType: {BOOLEAN, SINT16, SINT16_N, SINT32, SINT32_N, SINT8, SINT8_N, UINT16, UINT16_N, UINT32, UINT32_N, UINT8, UINT8_N, VARIABLE_LENGTH}, scope=ECU, set at link in variant link-time / pre-compile in variant post-build+pre-compile  # Provide the type of the signal in the RoutineControl request/response.
                choice container DcmDspArgumentScaling [0..1]  # This container contains the configuration (arguments) of an alternative Diagnosis Representation. Out if this the scaling between Diagnosis and ECU internal representation and vice versa can be calculated.
                  container DcmDspAlternativeArgumentData [0..1]  # This container contains the configuration (parameters) of an alternative Diagnosis Representation by the means of a ArgumentDataPrototype.
                    foreign reference DcmDataElement: set at pre-compile, destination-type=ARGUMENT-DATA-PROTOTYPE  # Alternative Diagnosis Representation for the data defined by the means of a ArgumentDataPrototype. | The CompuMethod of the data type of the referenced ArgumentDataPrototype will be applied to the data type of the ArgumentDataPrototype in the interface used by the Dcm.
                  container DcmDspAlternativeDataType [0..1]  # This container contains the configuration (parameters) of an alternative Diagnosis Representation by the means of an ApplicationDataType. | Additionally the definition of a text table mapping can be a defined for ApplicationDataTypes with a CompuMethod of category TEXTTABLE and SCALE_LINEAR_AND_TEXTTABLE.
                    foreign reference DcmApplicationDataType: set at pre-compile, destination-type=APPLICATION-DATA-TYPE  # Alternative Diagnosis Representation for the data defined by the means of a ApplicationDataType of category VALUE, BOOLEAN or ARRAY. | The CompuMethod that applies to the referenced ApplicationDataType in case of category VALUE or BOOLEAN will be applied to the data type of the VariableDataPrototype in the interface used by the Dcm.
                    container DcmDspTextTableMapping [0..*]  # The purpose of the DcmDspTextTableMapping is to associate a texttable value defined in the context of the Dcm to a texttable value defined in the context of a CompuMethod referenced by a DataType that shall be taken to create a dataElement in a SenderReceiverInterface. By this means it is possible to create a primitive version of a TexttableMapping (which can only be applied if a dataElement already exists). | In other words, the DcmDspTextTableMapping provides a similar mechanism to the TexttableMapping in a situation where the TexttableMapping cannot be applied since the SenderReceiverInterface for the PortPrototype on the Dcm ServiceComponent does not yet exist.
                      integer DcmDspDiagnosisRepresentationDataValue: 0..18446744073709551615, scope=ECU, set at pre-compile  # The data value in the diagnosis representation.
                      integer DcmDspInternalDataValue: 0..18446744073709551615, scope=ECU, set at pre-compile  # The ECU internal data value.
                  container DcmDspAlternativeDiagnosticDataElement [0..1]  # This container contains the configuration (parameters) of an alternative Diagnosis Representation by the means of Diagnostic Extract.
                    foreign reference DcmDspDiagnosticDataElementRef: set at pre-compile, destination-type=DIAGNOSTIC-DATA-ELEMENT  # Alternative Diagnosis Representation for the data defined by the means of a DiagnosticDataElement in the Diagnostic Extract. | This EcucForeignReference enables the access to all SwDataDefProps, in particular BaseType, CompuMethod and DataConstr The CompuMethod and DataConstr that applies to the referenced DiagnosticDataElement will be applied to the data type of the VariableDataPrototype in the interface used by the Dcm. The mapped ImplementationDataType needs to match the given BaseType.
            container DcmDspStopRoutineOut [0..1]  # Provide description of output parameter of Stop subservice for RoutineControl service.
              container DcmDspStopRoutineOutSignal [1..*]: requires-index=true  # Provide description of a routine signal used in RoutineControl service. | The ordering defined via the index attribute of the subcontainers in this list represents the order of the dataOutN elements in the XXX_Stop function call.
                integer DcmDspRoutineParameterSize [0..1]: 0..65535, scope=ECU, multiplicity set at link in variant link-time / pre-compile in variant post-build+pre-compile, set at link in variant link-time / pre-compile in variant post-build+pre-compile  # Provide the size of a RoutineControl parameter in bytes
                enumeration DcmDspRoutineSignalEndianness [0..1]: {BIG_ENDIAN, LITTLE_ENDIAN, OPAQUE}, scope=ECU, multiplicity set at link in variant link-time / pre-compile in variant post-build+pre-compile, set at link in variant link-time / pre-compile in variant post-build+pre-compile  # Defines the endianness of the data belonging to a Routine Out Signal for Stop subfunction.
                integer DcmDspRoutineSignalPos: 0..65535, scope=ECU, set at link in variant link-time / pre-compile in variant post-build+pre-compile  # Provide the position of the signal in the RoutineControl request/response. | The position is defined in bits.
                enumeration DcmDspRoutineSignalType: {BOOLEAN, SINT16, SINT16_N, SINT32, SINT32_N, SINT8, SINT8_N, UINT16, UINT16_N, UINT32, UINT32_N, UINT8, UINT8_N, VARIABLE_LENGTH}, scope=ECU, set at link in variant link-time / pre-compile in variant post-build+pre-compile  # Provide the type of the signal in the RoutineControl request/response.
                choice container DcmDspArgumentScaling [0..1]  # This container contains the configuration (arguments) of an alternative Diagnosis Representation. Out if this the scaling between Diagnosis and ECU internal representation and vice versa can be calculated.
                  container DcmDspAlternativeArgumentData [0..1]  # This container contains the configuration (parameters) of an alternative Diagnosis Representation by the means of a ArgumentDataPrototype.
                    foreign reference DcmDataElement: set at pre-compile, destination-type=ARGUMENT-DATA-PROTOTYPE  # Alternative Diagnosis Representation for the data defined by the means of a ArgumentDataPrototype. | The CompuMethod of the data type of the referenced ArgumentDataPrototype will be applied to the data type of the ArgumentDataPrototype in the interface used by the Dcm.
                  container DcmDspAlternativeDataType [0..1]  # This container contains the configuration (parameters) of an alternative Diagnosis Representation by the means of an ApplicationDataType. | Additionally the definition of a text table mapping can be a defined for ApplicationDataTypes with a CompuMethod of category TEXTTABLE and SCALE_LINEAR_AND_TEXTTABLE.
                    foreign reference DcmApplicationDataType: set at pre-compile, destination-type=APPLICATION-DATA-TYPE  # Alternative Diagnosis Representation for the data defined by the means of a ApplicationDataType of category VALUE, BOOLEAN or ARRAY. | The CompuMethod that applies to the referenced ApplicationDataType in case of category VALUE or BOOLEAN will be applied to the data type of the VariableDataPrototype in the interface used by the Dcm.
                    container DcmDspTextTableMapping [0..*]  # The purpose of the DcmDspTextTableMapping is to associate a texttable value defined in the context of the Dcm to a texttable value defined in the context of a CompuMethod referenced by a DataType that shall be taken to create a dataElement in a SenderReceiverInterface. By this means it is possible to create a primitive version of a TexttableMapping (which can only be applied if a dataElement already exists). | In other words, the DcmDspTextTableMapping provides a similar mechanism to the TexttableMapping in a situation where the TexttableMapping cannot be applied since the SenderReceiverInterface for the PortPrototype on the Dcm ServiceComponent does not yet exist.
                      integer DcmDspDiagnosisRepresentationDataValue: 0..18446744073709551615, scope=ECU, set at pre-compile  # The data value in the diagnosis representation.
                      integer DcmDspInternalDataValue: 0..18446744073709551615, scope=ECU, set at pre-compile  # The ECU internal data value.
                  container DcmDspAlternativeDiagnosticDataElement [0..1]  # This container contains the configuration (parameters) of an alternative Diagnosis Representation by the means of Diagnostic Extract.
                    foreign reference DcmDspDiagnosticDataElementRef: set at pre-compile, destination-type=DIAGNOSTIC-DATA-ELEMENT  # Alternative Diagnosis Representation for the data defined by the means of a DiagnosticDataElement in the Diagnostic Extract. | This EcucForeignReference enables the access to all SwDataDefProps, in particular BaseType, CompuMethod and DataConstr The CompuMethod and DataConstr that applies to the referenced DiagnosticDataElement will be applied to the data type of the VariableDataPrototype in the interface used by the Dcm. The mapped ImplementationDataType needs to match the given BaseType.
        container DcmDspSecurity  # This container contains the configuration ( DSP parameter) for security level configuration (per security level) | Description This container contains Rows of DcmDspSecurityRow
          float DcmDspSecurityMaxAttemptCounterReadoutTime: 0..65535, set at link in variant link-time / pre-compile in variant post-build+pre-compile  # Delay, in seconds, from startup (measured from the first call of the Dcm_MainFunction()), allowed for all AttemptCounter values to be obtained from the Application. | Must be a multiple of the DcmTaskTime. min: A value equal to the DcmTaskTime
          container DcmDspSecurityRow [0..31]  # Definition of a single Row of configuration for security level configuration (per security level) | The name of this container is used to define the name of the R-Port through which the DCM accesses the interface SecurityAccess_{SecurityLevel}. The R-Port is named SecurityAccess_{SecurityLevel} where {SecurityLevel} is the name of the container DcmDspSecurityRow. If there is no reference, no check of security level shall be done.
            integer DcmDspSecurityADRSize [0..1]: 1..4294967295, multiplicity set at link in variant link-time / pre-compile in variant post-build+pre-compile, set at link in variant link-time / pre-compile in variant post-build+pre-compile  # Size in bytes of the AccessDataRecord used in GetSeed
            boolean DcmDspSecurityAttemptCounterEnabled: scope=ECU, set at link in variant link-time / pre-compile in variant post-build+pre-compile  # This configuration parameter controls the existence of the APIs to set / get the attempt counter values towards application (Xxx_SetSecurityAttemptCounter() / Xxx_GetSecurityAttemptCounter()). | In case of enabled, the security attempt counter values are passed to application, whenever there is a change in the value. This allows storing the values in nonvolatile RAM and restoring them at ECU startup.
            function name DcmDspSecurityCompareKeyFnc [0..1]: multiplicity set at link in variant link-time / pre-compile in variant post-build+pre-compile, set at link in variant link-time / pre-compile in variant post-build+pre-compile  # Function name to request the result of a key comparison. | Parameter is only relevant if DcmDspSecurityUsePort=="USE_ ASYNCH_FNC". This parameter is related to the interface Xxx_CompareKey.
            float DcmDspSecurityDelayTime: 0..65535, set at link in variant link-time / pre-compile in variant post-build+pre-compile  # Delay time after failed security access in seconds. | This is started after DcmDspSecurityNumAttDelay number of failed security accesses. min: A negative value is not allowed.
            float DcmDspSecurityDelayTimeOnBoot: 0..65535, origin=AUTOSAR_ECUC V1.0.0, set at link in variant link-time / pre-compile in variant post-build+pre-compile  # Value of the delay timer in case of 'power on' in seconds. | This delay indicates the time at ECU boot power-on time during which the Dcm does not accept a security access. min: A negative value is not allowed.
            function name DcmDspSecurityGetAttemptCounterFnc [0..1]: multiplicity set at link in variant link-time / pre-compile in variant post-build+pre-compile, set at link in variant link-time / pre-compile in variant post-build+pre-compile  # Function name to request the value of an attempt counter. | This parameter is related to the interface Xxx_ GetSecurityAttemptCounter.
            function name DcmDspSecurityGetSeedFnc [0..1]: multiplicity set at link in variant link-time / pre-compile in variant post-build+pre-compile, set at link in variant link-time / pre-compile in variant post-build+pre-compile  # Callout function name used to request a seed. | This parameter is related to the interface Xxx_GetSeed.
            integer DcmDspSecurityKeySize: 1..4294967295, set at link in variant link-time / pre-compile in variant post-build+pre-compile  # size of the security key (in Bytes).
            integer DcmDspSecurityLevel: 1..63, set at pre-compile, symbolic-name-value=true  # Value of Security level. | The locked state cannot be configured explicitly. 1,2,3...63: configuration dependent - Conversion formula to calculate SecurityLevel out of tester requested SecurityAccessType parameter: SecurityLevel = (SecurityAccessType (requestSeed) + 1) / 2 Type: Dcm_SecLevelType
            integer DcmDspSecurityNumAttDelay [0..1]: 1..255, set at link in variant link-time / pre-compile in variant post-build+pre-compile  # Number of failed security accesses after which the delay time is activated
            integer DcmDspSecuritySeedSize: 1..4294967295, set at link in variant link-time / pre-compile in variant post-build+pre-compile  # size of the security seed (in Bytes).
            function name DcmDspSecuritySetAttemptCounterFnc [0..1]: multiplicity set at link in variant link-time / pre-compile in variant post-build+pre-compile, set at link in variant link-time / pre-compile in variant post-build+pre-compile  # Function name to set the value of an attempt counter. | This parameter is related to the interface Xxx_ SetSecurityAttemptCounter.
            enumeration DcmDspSecurityUsePort: {USE_ASYNCH_CLIENT_SERVER, USE_ASYNCH_FNC}, set at pre-compile  # Defines which kind of interface shall be used for security access.
        container DcmDspCsmInfo [0..1]  # This container contains the configuration for using csm | Description This container contains Rows of DcmDspCsmInfoRow
          container DcmDspCsmInfoRow [0..31]  # Definition of a single Row of configuration for security level configuration (per security level) | The name of this container is used to define the name of the R-Port through which the DCM accesses the interface SecurityAccess_<LEVEL>. The R-Port is named SecurityAccess_<LEVEL> where _<LEVEL> is the name of the container DcmDspSecurityRow. If there is no reference, no check of security level shall be done.
            boolean DcmDspCsmInfoCnrUsedSha1 [0..1]: multiplicity set at pre-compile, set at pre-compile  # This parameter determines if CnR Logic used SHA1 or not.
            reference DcmDspCsmPublicKeyRef [0..1]: scope=ECU, multiplicity set at pre-compile, set at pre-compile, destination=CsmKey  # Reference to a CsmKey used to store the public key within the Csm. This configuation should set when Crypto Version is CRYPTO_R44.
            reference DcmDspCsmCertVerifyJobRef [0..1]: scope=ECU, multiplicity set at pre-compile, set at pre-compile, destination=CsmJob  # Reference to a CsmJob used to verify certificate signature. This configuation should set when Crypto Version is CRYPTO_R44.
            reference DcmDspCsmCrlVerifyJobRef [0..1]: scope=ECU, multiplicity set at pre-compile, set at pre-compile, destination=CsmJob  # Reference to a CsmJob used to verify CRL signature. This configuation should set when Crypto Version is CRYPTO_R44.
            reference DcmDspCsmCrlHashJobRef [0..1]: scope=ECU, multiplicity set at pre-compile, set at pre-compile, destination=CsmJob  # Reference to a CsmJob used to verify CRL signature. This configuation should set when Crypto Version is CRYPTO_R44.
            reference DcmDspCsmRandomSeedKeyRef [0..1]: scope=ECU, multiplicity set at pre-compile, set at pre-compile, destination=CsmKey  # Reference to a CsmKey used to store the Random Seed key within the Csm. This configuation should set when Crypto Version is CRYPTO_R44.
            reference DcmDspCsmRandomJobRef [0..1]: scope=ECU, multiplicity set at pre-compile, set at pre-compile, destination=CsmJob  # Reference to a CsmJob used to generate random number. This configuation should set when Crypto Version is CRYPTO_R44.
            reference DcmDspCsmCnrPublicKeyRef [0..1]: scope=ECU, multiplicity set at pre-compile, set at pre-compile, destination=CsmKey  # Reference to a CsmJob used to store the CnR public key within the Csm. This configuation should set when Crypto Version is CRYPTO_R44.
            reference DcmDspCsmCnrVerifyJobRef [0..1]: scope=ECU, multiplicity set at pre-compile, set at pre-compile, destination=CsmJob  # Reference to a CsmJob used to verify CnR signature.
        container DcmDspSession  # Parent container holding single rows to configure particular sessions
          container DcmDspSessionRow [0..31]  # This container holds all parameters needed to configure a single session
            enumeration DcmDspSessionForBoot: {DCM_NO_BOOT, DCM_OEM_BOOT, DCM_OEM_BOOT_RESPAPP, DCM_SYS_BOOT, DCM_SYS_BOOT_RESPAPP}, origin=AUTOSAR_ECUC V1.0.0, set at link in variant link-time / pre-compile in variant post-build+pre-compile  # This parameter defines whether this diagnostic session allows to jump to Bootloader (OEM Bootloader or System Supplier Bootloader) and determines, from which unit the final response will be sent. | If this diagnostic session doesn't allow to jump to Bootloader the value DCM_NO_BOOT shall be chosen.
            integer DcmDspSessionLevel: 1..126, set at pre-compile, symbolic-name-value=true  # subFunction value of the DiagnosticSession. | 0, 127 and all values above 127 are reserved by ISO
            float DcmDspSessionP2ServerMax: 0..1, set at link in variant link-time / pre-compile in variant post-build+pre-compile  # This is the session value for P2ServerMax in seconds (per Session). | The AUTOSAR configuration standard is to use SI units, so this parameter is defined as a float value in seconds. DCM configuration tools must convert this float value to the appropriate value format for the use in the software implementation of DCM. This value is reported to the tester within the response to the 'Session Control' service.
            float DcmDspSessionP2StarServerMax: 0..100, set at link in variant link-time / pre-compile in variant post-build+pre-compile  # This is the session value for P2*ServerMax in seconds (per Session). | The AUTOSAR configuration standard is to use SI units, so this parameter is defined as a float value in seconds. DCM configuration tools must convert this float value to the appropriate value format for the use in the software implementation of DCM. This value is reported to the tester within the response to the 'Session Control' service.
        container DcmDspVehInfo [0..*]  # This container contains the configuration (parameters) for one single VehicleInfoType of service $09
          integer DcmDspVehInfoInfoType: 0..255, scope=ECU, set at link in variant link-time / pre-compile in variant post-build+pre-compile  # value of InfoType. | Within each DcmConfigSet all DcmDspVehInfoInfoType values shall be unique.
          boolean DcmDspVehInfoNODIProvResp [0..1]: set at pre-compile, default-value=false  # Indicate the Dcm, which side is responsible to fill the number of data items (NODI), Dcm or the provider of the InfoType data. In case the responsibility is on provider side, only one DcmDspVehInfoData container is allowed. | * true: Provider is responsible for providing the number of data items parameter * false or not existing: Dcm is responsible for providing the number of data items parameter
          container DcmDspVehInfoData [1..*]  # Data Item of an InfoType; ShortName is post-fix of the port interface name.
            integer DcmDspVehInfoDataOrder: 0..255, scope=ECU, set at pre-compile  # Defines the order of the data item in the InfoType; values: 0..255; first data item having the order number 0; the next 1 and so on. | The configuration of order needs to be unique per InfoType.
            function name DcmDspVehInfoDataReadFnc [0..1]: scope=ECU, multiplicity set at pre-compile, set at pre-compile  # Callout function name for reading InfoType data item. Only required in case parameter 'DcmDspVehInfoDataUsePort' is set to 'false'
            integer DcmDspVehInfoDataSize: 0..255, scope=ECU, set at pre-compile  # Size in bytes of the InfoType data item.
            boolean DcmDspVehInfoDataUsePort: scope=ECU, set at pre-compile  # When this parameter is set to true the DCM will access the Data using an R-Port requiring a PortInterface IInfotypeServices_{VehInfoData}. | The R-Port is named InfotypeServices_{VehInfoData} where {VEHINFODATA} is the name of the container DcmDspVehInfoData. In that case, the DcmDspVehInfoDataReadFnc is ignored and the RTE APIs are used. When this parameter is set to false, the DCM calls the function defined in DcmDspVehInfoDataReadFnc.
        container DcmRequestTransferExit [0..1]  # This container contains the configuration (parameters) for RequestTransferExit (0x37) Service
          boolean DcmTransferRequestParameterRecordUsed: scope=ECU, set at pre-compile, default-value=false  # Allow user using TransferRequestParameterRecord data or not . | If the this parameter set to true, the data after SID will be used.
          integer DcmDspTransferRequestParameterRecordSize [0..1]: 0..65535, scope=ECU, set at pre-compile, default-value=0  # Size of supported the transfer of data in 0x37 service in bytes. | Size of transferRequestParameterRecord data in the request. This parameter is available when DcmTransferRequestParameterRecordUsed set to true
        container DcmDspCallbackPresentDate [0..1]  # The name of this container is used to define the name of the R-Port through which the DCM access the interface CallbackDCMPresentDate. | The R-Port is named CallbackDCMPresentDate_<SWC> where _<SWC> is the name of the container DcmDspCallbackPresentDate
      container DcmPageBufferCfg  # This container contains the configuration (parameters) for Page Buffer handling
        boolean DcmPagedBufferEnabled: scope=ECU, set at pre-compile  # Allow to enable or disable the Paged buffer mechanism. | true = Paged buffer handling enabled false = Paged Buffer handling disabled
      container DcmProcessingConditions [0..1]  # This container contains the configuration for mode arbitration functionality of the Dcm
        container DcmModeCondition [1..*]  # This container contains the configuration of a mode condition or an environmental conditions which can be used as argument in DcmModeRules. | One DcmModeCondition shall contain either one DcmSwcModeRef or one DcmBswModeRef or one DcmSwcSRDataElementRef. Please note that the Dcm acts as well as mode manager. Therefore the references DcmSwcModeRef or one DcmBswModeRef. might point to provided ModeDeclarationGroupPrototypes of the Dcm itself as well as to provided ModeDeclarationGroupPrototypes of other Bsw Modules or software components. In case of a configured DcmSwcModeRef or DcmBswModeRef only the DcmConditionType DCM_EQUALS or DCM_EQUALS_NOT are applicable. In case of DcmSwcSRDataElementRef all literals of DcmConditionType are possible.
          enumeration DcmConditionType: {DCM_EQUALS, DCM_EQUALS_NOT, DCM_GREATER_OR_EQUAL, DCM_GREATER_THAN, DCM_LESS_OR_EQUAL, DCM_LESS_THAN}, set at pre-compile  # This parameter specifies what kind of comparison that is made for the evaluation of the mode condition.
          instance reference DcmBswModeRef [0..1]: multiplicity set at pre-compile, set at pre-compile, destination-context=MODE-DECLARATION-GROUP-PROTOTYPE, destination-type=MODE-DECLARATION  # This parameter references a mode of a ModeDeclarationGroupPrototype provided by a Basic Software Module used for the condition. | Please note that such ModeDeclarationGroupPrototype are owned by a Basic Software Module Description in the role providedModeGroup.
          reference DcmModeConditionCertificateCompareElementRef [0..1]: scope=ECU, multiplicity set at pre-compile, set at pre-compile, destination=KeyMCertificateElement  # Reference to a certificate data element that provides the compare value.
          instance reference DcmSwcModeRef [0..1]: multiplicity set at pre-compile, set at pre-compile, destination-context=ROOT-SW-COMPOSITION-PROTOTYPE SW-COMPONENT-PROTOTYPE P-PORT-PROTOTYPE MODE-DECLARATION-GROUP-PROTOTYPE, destination-type=MODE-DECLARATION  # This parameter references a mode in a particular mode request port of a software component that is used for the condition.
          choice reference DcmSwcSRDataElementRef [0..1]: multiplicity set at pre-compile, set at pre-compile, destination=[DcmDspExternalSRDataElementClass/DcmDataElementInstance, DcmDspExternalSRDataElementClass/DcmSubElementInDataElementInstance, DcmDspExternalSRDataElementClass/DcmSubElementInImplDataElementInstance, DcmDspPidService01ExternalSRDataElementClass/DcmDataElementInstance, DcmDspPidService01ExternalSRDataElementClass/DcmSubElementInDataElementInstance, DcmDspPidService01ExternalSRDataElementClass/DcmSubElementInImplDataElementInstance]  # Reference to environmental conditions. | It is possible to reference a S/R Receiver-Port to read physical values and compare (equal, greater, less,...) them with a configured value that is defined by DcmSwcDataElementValue.
          choice container DcmSwcDataElementValue  # This container contains the configuration of a compare value.
            container DcmSwcDataElementArray [0..1]  # This container contains the configuration of a array compare value.
              container DcmSwcDataElementArrayElement [0..*]  # This container contains the configuration of a array element compare value.
                integer DcmSwcDataElementArrayElementIndex: 0..18446744073709551615, set at pre-compile  # Index to an element of the compare value array.
                integer DcmSwcDataElementArrayElementValue: 0..18446744073709551615, set at pre-compile  # Value of an array element compare value.
            container DcmSwcDataElementPrimitive [0..1]  # This container contains the configuration of a primitive compare value.
              integer DcmSwcDataElementPrimitiveValue: 0..18446744073709551615, set at pre-compile  # Primitive compare value.
        container DcmModeRule [1..*]  # This container contains the configuration of a mode rule which represents a logical expression with DcmModeConditions or other DcmModeRules as arguments. | All arguments are processed with the operator defined by DcmLogicalOperator, for instance: Argument_A AND Argument_B AND Argument_C
          enumeration DcmLogicalOperator [0..1]: {DCM_AND, DCM_OR}, multiplicity set at pre-compile, set at pre-compile  # This parameter specifies the logical operator to be used in the logical expression. If the expression only consists of a single condition this parameter shall not be used.
          integer DcmModeRuleNrcValue [0..1]: 1..255, scope=ECU, multiplicity set at link in variant link-time / pre-compile in variant pre-compile, set at link in variant link-time / pre-compile in variant pre-compile  # Optional parameter which defines the NRC to be sent in case the mode rule condition is not valid.
          choice reference DcmArgumentRef [1..*]: multiplicity set at pre-compile, requires-index=true, set at pre-compile, destination=[DcmModeCondition, DcmModeRule]  # This is a choice reference either to a mode condition or a an other mode rule serving as sub-expression.
    container DcmGeneral  # Contains general configuration parameters valid for the entire Dcm module.
      boolean DcmDDDIDStorage [0..1]: multiplicity set at pre-compile, set at pre-compile, default-value=false  # This configuration switch defines, whether DDDID definition is stored non-volatile or not. | true: DDDID are stored non-volatile false: DDDID are only maintained volatile
      boolean DcmDevErrorDetect: set at pre-compile, default-value=false  # Switches the development error detection and notification on or off. | * true: detection and notification is enabled. * false: detection and notification is disabled.
      string DcmHeaderFileInclusion [0..*]: scope=ECU, multiplicity set at pre-compile, set at pre-compile, regular-expression=[a-zA-Z0-9_]([a-zA-Z0-9\._])*  # Name of the header file(s) to be included by the Dcm module containing the used C-callback declarations.
      boolean DcmRespondAllRequest: scope=ECU, set at pre-compile  # If set to FALSE the Dcm will not respond to diagnostic request that contains a service ID which is in the range from 0x40 to 0x7F or in the range from 0xC0 to 0xFF (Response IDs).
      float DcmTaskTime: 0..Inf, set at link in variant link-time / pre-compile in variant post-build+pre-compile  # Allow to configure the time for the periodic cyclic task. Please note: This configuration value shall be equal to the value in the RTE module. | The AUTOSAR configuration standard is to use SI units, so this parameter is defined as float value in seconds. Dcm configuration tools must convert this float value to the appropriate value format for the use in the software implementation of Dcm. min: A negative value and zero is not allowed. upperMultiplicity: Exactly one TaskTime must be specified per configuration. lowerMultiplicity: Exactly one TaskTime must be specified per configuration.
      boolean DcmVersionInfoApi: set at pre-compile, default-value=false  # Preprocessor switch to enable or disable the output Version info of the functionality.
      enumeration DcmStandardSupport: {DCM_ISO14229_SUPPORT, DCM_ES95486_SUPPORT, DCM_ES96590_SUPPORT, DCM_ES95486_02_SUPPORT, DCM_ES95486_50_SUPPORT, DCM_QZN04_SUPPORT}, set at pre-compile  # Defines the standard behavior of Dcm module. | DCM_ISO14229_SUPPORT : The behavior of DCM complies with ISO14229. DCM_ES95486_SUPPORT : The behavior of DCM complies with ES95486. DCM_ES96590_SUPPORT : The behavior of DCM complies with ES96590. DCM_ES95486_02_SUPPORT : The behavior of DCM complies with ES95486_02. DCM_ES95486_50_SUPPORT : The behavior of DCM complies with ES95486_50. DCM_QZN04_SUPPORT : The behavior of DCM complies with QZN04.
      boolean DcmAutronFblUsed [0..1]: set at pre-compile, symbolic-name-value=true, default-value=true  # This parameter determines which to use the AUTRON FBL. | true = Use the AUTRON FBL. false = Not use the AUTRON FBL.
      boolean DcmRemainUnlockCondition [0..1]: set at pre-compile, symbolic-name-value=true, default-value=false  # When the CGW (ICU, ESU, CCU) transitions from the extendedDiagnosticSession to the non-default session, the security right should not be initialized. | true = Remain unlock condition. false = Change unlock condition.
      boolean DcmParallelProtocolProcessing [0..1]: set at pre-compile, origin=DcmParallelProtocolProcessing, default-value=false  # If set to FALSE the Dcm will not support parallel protocol processing. | true: support parallel protocol processing. false: not support parallel protocol processing.
      boolean DcmDemIntegrated [0..1]: set at pre-compile, symbolic-name-value=true, default-value=false  # This is the vendor specific option. If the Dem module is not integrated, than check this value to False. | True = Integrated Dem module. false = Not integrated Dem module.
      boolean DcmNvmIntegrated [0..1]: set at pre-compile, symbolic-name-value=true, default-value=false  # This is the vendor specific option. If the NvM module is not integrated, than check this value to False. | True = Integrated NvM module. false = Not integrated NvM module.
      reference DcmVinRef [0..1]: multiplicity set at pre-compile, set at pre-compile, destination=DcmDspDid  # Reference to the Did containing the VIN Information. | This parameter is needed for function Dcm_GetVin
      reference DcmDDDIDStorageBlockIdRef [0..1]: scope=ECU, multiplicity set at pre-compile, set at pre-compile, destination=NvMBlockDescriptor  # NRAM blockId to store the data of DDDID. | Only relevant if DcmDDDIDStorage is configured as true.
