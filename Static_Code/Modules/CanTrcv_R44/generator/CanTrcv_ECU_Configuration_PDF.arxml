AUTOSAR XML (schema 00047)
# (C) 2021 HYUNDAI AUTOEVER Corp.
package /AUTRON
  ecuc definition collection ParameterDefinition_CanTrcv: module=CanTrcv
  module definition CanTrcv [0..*]: post-build-variant-support=true, refined-module-def=CanTrcv, variants pre-compile/post-build-selectable  # Configuration of the CanTrcv (CAN Transceiver driver) module.
    container CanTrcvConfigSet  # This container contains the configuration parameters and sub containers of the AUTOSAR WdgM module.
      integer CanTrcvSPICommRetries: 0..255, post-build-variant-value=true, set at link in variant link-time / post-build in variant post-build / pre-compile in variant pre-compile, default-value=0  # Indicates the maximum number of communication retries in case of a failed SPI communication (applies both to timed out communication and to errors/NACK in the response data). | If configured value is '0', no retry is allowed (communication is expected to succeed at first try).
      integer CanTrcvSPICommTimeout: 0..100, post-build-variant-value=true, set at link in variant link-time / post-build in variant post-build / pre-compile in variant pre-compile, default-value=0  # Indicates the maximum time allowed to the CanTrcv for replying (either positively or negatively) to a SPI command. | Timeout is configured in milliseconds. Timeout value of '0' means that no specific timeout is to be used by CanTrcv and the communication is executed at the best of the SPI HW capacity.
      container CanTrcvChannel [1..*]  # Container gives CAN transceiver driver information about a single CAN | transceiver (channel).
        integer CanTrcvChannelId: 0..255, scope=ECU, set at pre-compile, symbolic-name-value=true  # Unique identifier of the CAN Transceiver Channel.
        boolean CanTrcvChannelUsed: set at pre-compile, default-value=true  # Shall the related CAN transceiver channel be used?
        boolean CanTrcvControlsPowerSupply: set at pre-compile, default-value=false  # Is ECU power supply controlled by this transceiver? | TRUE = Controlled by transceiver. FALSE = Not controlled by transceiver.
        boolean CanTrcvHwPnSupport: set at pre-compile, default-value=false  # Indicates whether the HW supports the selective wake-up function | TRUE = Selective wakeup feature is supported by the transceiver FALSE = Selective wakeup functionality is not available in transceiver
        enumeration CanTrcvInitState: {CANTRCV_OP_MODE_NORMAL, CANTRCV_OP_MODE_SLEEP, CANTRCV_OP_MODE_STANDBY}, set at pre-compile, default-value=CANTRCV_OP_MODE_NORMAL  # State of CAN transceiver after call to CanTrcv_Init.
        integer CanTrcvMaxBaudrate: 0..12000, set at pre-compile  # Indicates the data transfer rate in kbps. | Maximum data transfer rate in kbps for transceiver hardware type. Only used for validation purposes. This value can be used by configuration tools.
        boolean CanTrcvWakeupByBusUsed [0..1]: multiplicity set at pre-compile, set at pre-compile, default-value=false  # Is wake up by bus supported? If CAN transceiver hardware does not support wake up by bus value is always FALSE. If CAN transceiver hardware supports wake up by bus value is TRUE or FALSE depending whether it is used or not. | TRUE = Is used. FALSE = Is not used.
        boolean CanTrcvSleepModeUsed [0..1]: set at pre-compile, origin=AUTRON, default-value=false  # If you check this, you should use SleepMode instead of StandByMode. | TRUE = SleepMode used. FALSE = StandByMode used.
        enumeration CanTrcvHwDevName: {NCV7342, TJA1040, TJA1041, TJA1041A, TJA1042, TJA1043, TJA1463, TJA1044, TJA1050, TJA1051, TJA1054, TJA1054A, TJA1055, TJA1057, TJA1145, TLE6250G, TLE6251DS, TLE6251G, TLE62513G, TLE62542G, TLE62543G, TLE7250G, TLE7250LE, TLE9250SJ, TLE9251VSJ, TLE9255W, UJA1169, ARISU_CAN0, ARISU_CAN1, ARISU_CAN2, ARISU_CAN3, TJA1059, TCAN1043A, TCAN1044, TCAN1057, TCAN1145}, set at pre-compile, origin=AUTRON  # Device Name of CAN transceiver.
        reference CanTrcvChannelEcucPartitionRef [0..1]: scope=ECU, multiplicity set at pre-compile, post-build-variant-multiplicity=true, post-build-variant-value=true, set at pre-compile, destination=EcucPartition  # Maps the CAN transceiver channel to zero or one ECUC partitions. The ECUC partition referenced is a subset of the ECUC partitions where the CAN transceiver driver is mapped to. Tags: atp.Status=draft
        reference CanTrcvIcuChannelRef [0..1]: multiplicity set at pre-compile, set at pre-compile, requires-symbolic-name-value=true, destination=IcuChannel  # Reference to the IcuChannel to enable/disable the interrupts | for wakeups.
        reference CanTrcvPorWakeupSourceRef [0..1]: scope=ECU, multiplicity set at pre-compile, set at pre-compile, requires-symbolic-name-value=true, destination=EcuMWakeupSource  # Symbolic name reference to specify the wakeup sources that should be used in the calls to EcuM_SetWakeupEvent as specified in [SWS_CanTrcv_00183] and [SWS_CanTrcv_00184]. | This reference is mandatory if the HW supports POR or SYSERR flags
        reference CanTrcvSyserrWakeupSourceRef [0..1]: scope=ECU, multiplicity set at pre-compile, set at pre-compile, requires-symbolic-name-value=true, destination=EcuMWakeupSource  # Symbolic name reference to specify the wakeup sources that should be used in the calls to EcuM_SetWakeupEvent as specified in [SWS_CanTrcv_00183] and [SWS_CanTrcv_00184] | This reference is mandatory if the HW supports POR or SYSERR flags
        reference CanTrcvWakeupSourceRef [0..1]: scope=ECU, multiplicity set at pre-compile, set at pre-compile, requires-symbolic-name-value=true, destination=EcuMWakeupSource  # Reference to a wakeup source in the EcuM configuration. | This reference is only needed if CanTrcvWakeupByBusUsed is true.
        choice container CanTrcvAccess  # Container gives CanTrcv Driver information about access to a single CAN transceiver.
          container CanTrcvDioAccess [0..1]  # Container gives CAN transceiver driver information about accessing ports and port pins. In addition relation between CAN transceiver hardware pin names and Dio port access information is given. | If a CAN transceiver hardware has no Dio interface, there is no instance of this container.
            container CanTrcvDioChannelAccess [1..*]  # Container gives DIO channel access by single Can transceiver channel.
              string CanTrcvHardwareInterfaceName: set at pre-compile  # CAN transceiver hardware interface name. It is typically the name of a pin. From a Dio point of view it is either a port, a single channel or a channel group. Depending on this fact either | NCV7342, TJA1040, TJA1042, TJA1044, TLE6251DS, TJA1050, TJA1051, TJA1057, TLE9250SJ, TLE9251VSJ: + The first pin is STB/S. + The second pin is RXD. TLE6250G: + The first pin is INH. TLE7250G, TLE7250LE: + The first pin is NEN. + The second pin is RXD. TJA1041, TJA1041A, TJA1043, TJA1054, TJA1054A, TJA1055, TLE62513G, TLE6251G, TLE62542G, TLE62543G: + The first pin is STB/NSTB. + The second pin is EN/ENT. + The third pin is NERR.
              choice reference CanTrcvDioSymNameRef: set at pre-compile, destination=[DioChannel, DioChannelGroup, DioPort]  # Choice Reference to a DIO Port, DIO Channel or DIO Channel Group. This reference replaces the CANTRCV_DIO_PORT_SYM_NAME, CANTRCV_DIO_CHANNEL_SYM_NAME and CANTRCV_DIO_GROUP_SYM_NAME references in the Can Trcv SWS.
          container CanTrcvSpiAccess [0..1]  # Container gives CAN transceiver driver information about accessing Spi. If a CAN transceiver hardware has no Spi interface, there is no instance of this container.
            container CanTrcvSpiSequence [1..*]  # Container gives CAN transceiver driver information about one SPI sequence. | One SPI sequence used by CAN transceiver driver is in exclusive use for it. No other driver is allowed to access this sequence. CAN transceiver driver may use one sequence to access n CAN transceiver hardwares chips of the same type or n sequences are used to access one single CAN transceiver hardware chip. If a CAN transceiver hardware has no SPI interface, there is no instance of this container.
              boolean CanTrcvSpiAccessSynchronous [0..1]: multiplicity set at pre-compile, set at pre-compile, default-value=false  # This parameter is used to define whether the access to the Spi sequence is synchronous or asynchronous. | true: SPI access is synchronous. false: SPI access is asynchronous.
              enumeration CanTrcvArisucanModeOnStop [0..1]: {ARISU_CANTRCV_WAKECAPABLE, ARISU_CANTRCV_OFF}, set at pre-compile, origin=AUTRON  # Arisu-Can opersation mode on Stop.
              enumeration CanTrcvArisucanModeOnSleep [0..1]: {ARISU_CANTRCV_WAKECAPABLE, ARISU_CANTRCV_OFF}, set at pre-compile, origin=AUTRON  # Arisu-Can opersation mode on Sleep.
              enumeration CanTrcvArisucanModeOnNormal [0..1]: {ARISU_CANTRCV_NORMAL, ARISU_CANTRCV_WAKECAPABLE, ARISU_CANTRCV_OFF}, set at pre-compile, origin=AUTRON  # Arisu-Can opersation mode on Normal.
              enumeration CanTrcvXJA11XXCanModeOnNormal [0..1]: {XJA11XX_CAN_OFFLINE_MODE, XJA11XX_CAN_ACTIVE_UNDERVOLTAGE_MODE, XJA11XX_CAN_ACTIVE_UNDERVOLTAGE_DISABLE_MODE}, set at pre-compile, origin=AUTRON  # XJA11XX CAN mode on Normal
              enumeration CanTrcvLocalWakeupDirection [0..1]: {NEGATIVE_EDGE, POSITIVE_EDGE}, set at pre-compile, origin=AUTRON  # Local wake-up direction. This parameter only valid when CanTrcvHwDevName is TJA1145/UJA1169/TLE9255W/TCAN1145.
              reference CanTrcvSpiSequenceName [0..*]: multiplicity set at pre-compile, set at pre-compile, requires-symbolic-name-value=true, destination=SpiSequence  # Reference to a Spi sequence configuration container.
              choice reference CanTrcvSpiCSGpioNameRef [0..1]: destination=[DioChannel, DioChannelGroup, DioPort]  # Choice Reference to a DIO Port, DIO Channel or DIO Channel Group. This reference replaces the CANTRCV_DIO_PORT_SYM_NAME, CANTRCV_DIO_CHANNEL_SYM_NAME and CANTRCV_DIO_GROUP_SYM_NAME references in the Can Trcv SWS.
        container CanTrcvDemEventParameterRefs [0..1]  # Container for the references to DemEventParameter elements which shall be invoked using the API Dem_SetEventStatus in case the corresponding error occurs. The EventId is taken from the referenced DemEventParameter's DemEventId symbolic value. The standardized errors are provided in this container and can be extended by vendor-specific error references.
          reference CANTRCV_E_BUS_ERROR [0..1]: scope=ECU, multiplicity set at pre-compile, set at pre-compile, requires-symbolic-name-value=true, destination=DemEventParameter  # Reference to the DemEventParameter which shall be issued when bus error has occurred.
        container CanTrcvPartialNetwork [0..1]: post-build-changeable=true  # Container gives CAN transceiver driver information about the configuration of Partial Networking functionality.
          integer CanTrcvBaudRate: 0..12000, post-build-variant-value=true, set at link in variant link-time / post-build in variant post-build / pre-compile in variant pre-compile  # Indicates the data transfer rate in kbps.
          boolean CanTrcvBusErrFlag: post-build-variant-value=true, set at link in variant link-time / post-build in variant post-build / pre-compile in variant pre-compile, default-value=false  # Indicates if the Bus Error (BUSERR) flag is managed by the BSW. This flag is set if a bus failure is detected by the transceiver. | TRUE = Supported by transceiver and managed by BSW. FALSE = Not managed by BSW.
          boolean CanTrcvPnCanIdIsExtended: post-build-variant-value=true, set at link in variant link-time / post-build in variant post-build / pre-compile in variant pre-compile, default-value=false  # Indicates whether extended or standard ID is used. | TRUE = Extended Can identifier is used. FALSE = Standard Can identifier is used
          boolean CanTrcvPnEnabled: post-build-variant-value=true, set at link in variant link-time / post-build in variant post-build / pre-compile in variant pre-compile, default-value=false  # Indicates whether the selective wake-up function is enabled or disabled in HW. | TRUE = Selective wakeup feature is enabled in the transceiver hardware FALSE = Selective wakeup feature is disabled in the transceiver hardware
          integer CanTrcvPnFrameCanId: 0..4294967295, post-build-variant-value=true, set at link in variant link-time / post-build in variant post-build / pre-compile in variant pre-compile  # CAN ID of the Wake-up Frame (WUF).
          integer CanTrcvPnFrameCanIdMask: 0..4294967295, post-build-variant-value=true, set at link in variant link-time / post-build in variant post-build / pre-compile in variant pre-compile  # ID Mask for the selective activation of the transceiver. It is used to enableFrame Wake-up (WUF) on a group of IDs.
          integer CanTrcvPnFrameDlc: 0..8, post-build-variant-value=true, set at link in variant link-time / post-build in variant post-build / pre-compile in variant pre-compile  # Data Length of the Wake-up Frame (WUF).
          boolean CanTrcvPowerOnFlag: post-build-variant-value=true, set at link in variant link-time / post-build in variant post-build / pre-compile in variant pre-compile, default-value=false  # Description: Indicates if the Power On Reset (POR) flag is available and is managed by the transceiver. | TRUE = Supported by Hardware. FALSE = Not supported by Hardware
          boolean CanTrcvPnDlcMatchingCondition: post-build-variant-value=true, set at link in variant link-time / pre-compile in variant pre-compile / post-build in variant post-build, default-value=false  # Enabled or disabled DLC matching condition for wake-up(data length code and data field)
          container CanTrcvPnFrameDataMaskSpec [0..8]  # Defines data payload mask to be used on the received payload in order to determine if the transceiver must be woken up by the received Wake-up Frame (WUF).
            integer CanTrcvPnFrameDataMask: 0..255, post-build-variant-value=true, set at link in variant link-time / post-build in variant post-build / pre-compile in variant pre-compile  # Defines the n byte (Byte0 = LSB) of the data payload mask to be used on the received payload in order to determine if the transceiver must be woken up by the received Wake-up Frame (WUF).
            integer CanTrcvPnFrameDataMaskIndex: 0..7, post-build-variant-value=true, set at link in variant link-time / post-build in variant post-build / pre-compile in variant pre-compile  # holds the position n in frame of the mask-part
    container CanTrcvGeneral  # Container gives CAN transceiver driver basic information.
      boolean CanTrcvDevErrorDetect: set at pre-compile, default-value=false  # Switches the development error detection and notification on or off. | * true: detection and notification is enabled. * false: detection and notification is disabled.
      integer CanTrcvIndex: 0..255, set at pre-compile  # Specifies the InstanceId of this module instance. If only one instance is present it shall have the Id 0.
      float CanTrcvMainFunctionDiagnosticsPeriod [0..1]: 0.001..Inf, multiplicity set at pre-compile, set at pre-compile  # This parameter describes the period for cyclic call to CanTrcv_MainFunctionDiagnostics. Unit is seconds.
      float CanTrcvMainFunctionPeriod [0..1]: 0.001..Inf, multiplicity set at pre-compile, set at pre-compile  # This parameter describes the period for cyclic call to CanTrcv_MainFunction. Unit is seconds.
      enumeration CanTrcvTimerType [0..1]: {None, Timer_1us16bit}, multiplicity set at pre-compile, set at pre-compile  # Type of the Time Service Predefined Timer.
      boolean CanTrcvVersionInfoApi: set at pre-compile, default-value=false  # Switches version information API on and off. If switched off, function need not be present in compiled code.
      float CanTrcvWaitTime [0..1]: 0..2.55E-4, multiplicity set at pre-compile, set at pre-compile  # Wait time for transceiver state changes in seconds.
      enumeration CanTrcvWakeUpSupport: {CANTRCV_WAKEUP_BY_POLLING, CANTRCV_WAKEUP_NOT_SUPPORTED}, set at pre-compile  # Informs whether wake up is supported by polling or not supported. In case no | wake up is supported by the hardware, setting has to be NOT_SUPPORTED. Only in the case of wake up supported by polling, function CanTrcv_MainFunction has to be present and to be invoked by the scheduler.
      boolean ArisuCanPwmAutoSupport [0..1]: set at pre-compile, origin=AUTRON, default-value=false  # ARISU-CAN PWM AUTO Function on and off. | True: #define ARISU-CAN PWM_AUTO On. False: #define ARISU-CAN PWM_AUTO Off.
      boolean CanTrcvSpiLessAR42: set at pre-compile, default-value=true  # CanTrcv Support SPI MCAL Less than AR42 Version | True: Support SPI MCAL AR4.0 Version False: Support SPI MCAL AR4.2 or Higher Version .
