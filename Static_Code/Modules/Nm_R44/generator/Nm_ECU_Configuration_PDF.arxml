AUTOSAR XML (schema 00047)
# (C) 2021 HYUNDAI AUTOEVER Corp.
# Confidential Proprietary Information. Distribution Limited.
# Do Not Copy Without Prior Permission
package /AUTRON
  ecuc definition collection AUTOSARParameterDefinition_Nm: module=Nm
  module definition Nm [0..1]: category=STANDARDIZED_MODULE_DEFINITION, post-build-variant-support=true, refined-module-def=Nm, variants pre-compile/post-build-selectable  # The Generic Network Management Interface module
    container NmChannelConfig [1..*]: post-build-variant-multiplicity=true  # This container contains the configuration (parameters) of the bus channel(s). The channel parameter shall be harmonized within the whole communication stack.
      boolean NmActiveCoordinator [0..1]: multiplicity set at pre-compile, post-build-variant-multiplicity=true, post-build-variant-value=true, set at pre-compile  # This parameter indicates whether a NM channel - part of a Nm Coordination cluster - will be coordinated actively (NmActiveCoordinator = TRUE) or passively (NmActiveCoordinator = FALSE).
      boolean NmChannelSleepMaster: post-build-variant-value=true, set at pre-compile  # This parameter shall be set to indicate if the sleep of this network can be absolutely decided by the local node only and that no other nodes can oppose that decision. | If this parameter is set to TRUE, the Nm shall assume that the channel is always ready to go to sleep and that no calls to Nm_RemoteSleepIndication or Nm_RemoteSleepCancellation will be made from the <BusNm> representing this channel. If this parameter is set to FALSE, the Nm shall not assume that the network is ready to sleep until a call has been made to Nm_RemoteSleepCancellation.
      boolean NmComUserDataSupport [0..1]: multiplicity set at pre-compile, post-build-variant-multiplicity=true, post-build-variant-value=true, set at pre-compile, default-value=false  # This parameter indicates whether on a NM channel user data is accessed via Com signals or by SetUserData API.
      integer NmCoordClusterIndex [0..1]: 0..255, multiplicity set at pre-compile, post-build-variant-multiplicity=true, post-build-variant-value=true, set at pre-compile  # If this parameter is undefined for a channel, the corresponding bus does not belong to an NM coordination cluster.
      boolean NmPassiveModeEnabled: post-build-variant-value=true, set at pre-compile  # This parameter indicates whether a NM channel is active,e.g. can request communication and keep the bus awake, or passive, e.g. can just be woken up and kept awake by other ECUs.
      boolean NmStateReportEnabled: post-build-variant-value=true, set at pre-compile  # Specifies if the NMS shall be set for the corresponding network. | false: No NMS shall be set true: The NMS shall be set
      boolean NmSynchronizingNetwork: post-build-variant-value=true, set at pre-compile  # If this parameter is true, then this network is a synchronizing network for the NM coordination cluster which it belongs to. The network is expected to call Nm_SynchronizationPoint() at regular intervals.
      function name NmPduRxIndUserCallout [0..1]: multiplicity set at pre-compile, origin=AUTRON, set at pre-compile  # Name of the callout function to be called if Nm_PduRxIndication() is called.
      function name NmStateChangeIndUserCallout [0..1]: multiplicity set at pre-compile, origin=AUTRON, set at pre-compile  # Name of the callout function to be called if Nm_StateChangeNotification() is called.
      function name NmRepeatMsgIndUserCallout [0..1]: multiplicity set at pre-compile, origin=AUTRON, set at pre-compile  # Name of the callout function to be called if Nm_RepeatMessageIndication() is called.
      function name NmTxTimeoutExceptionUserCallout [0..1]: multiplicity set at pre-compile, origin=AUTRON, set at pre-compile  # Name of the callout function to be called if Nm_TxTimeoutException() is called.
      reference NmComMChannelRef: post-build-variant-value=true, set at pre-compile, requires-symbolic-name-value=true, destination=ComMChannel  # Reference to the corresponding ComM Channel.
      reference NmStateReportSignalRef [0..1]: multiplicity set at pre-compile, post-build-variant-multiplicity=true, post-build-variant-value=true, set at pre-compile, requires-symbolic-name-value=true, destination=ComSignal  # Reference to the signal for setting the NMS by calling Com_SendSignal for the respective channel.
      choice container NmBusType
        container NmGenericBusNmConfig [0..1]: post-build-variant-multiplicity=true
          string NmGenericBusNmPrefix: post-build-variant-value=true, set at pre-compile  # The prefix which identifies the generic <BusNm>. This will be used to determine the API name to be called by Nm for the provided interfaces of the <BusNm>. This string will used for the module prefix before the "_" character in the API call name.
          float NmGenericBusNmShutdownTime: 0..65.535, post-build-variant-value=true, set at pre-compile  # This parameter shall be | used to calculate shutdown delay time.
        container NmStandardBusNmConfig [0..1]: post-build-variant-multiplicity=true
          enumeration NmStandardBusType: {NM_BUSNM_CANNM, NM_BUSNM_FRNM, NM_BUSNM_J1939NM, NM_BUSNM_LOCALNM, NM_BUSNM_UDPNM}, post-build-variant-value=true, set at pre-compile  # Identifies the bus type of the channel for standard AUTOSAR <BusNm>s and is used to determine which set of API calls to be called by Nm for the <BusNm>s. | Note: The Ethernet bus' NM is UdpNm !
    container NmGlobalConfig  # This container contains all global configuration parameters of the Nm Interface.
      container NmGlobalConstants
        integer NmNumberOfChannels: 1..255, post-build-variant-value=true, set at pre-compile  # Number of NM channels allowed within one ECU.
      container NmGlobalFeatures
        boolean NmBusSynchronizationEnabled: post-build-variant-value=true, set at pre-compile  # Pre-processor switch for enabling bus synchronization support of the <BusNm>s. This feature is required for NM Coordinator nodes only.
        function name NmCarWakeUpCallout [0..1]: multiplicity set at pre-compile, post-build-variant-multiplicity=true, post-build-variant-value=true, set at pre-compile  # Name of the callout function to be called if Nm_CarWakeUpIndication() is called. If this parameter is not configured, the Nm will call BswM_Nm_CarWakeUpIndication.
        boolean NmCarWakeUpRxEnabled: post-build-variant-value=true, set at pre-compile, default-value=false  # Enables or disables CWU detection. | FALSE - CarWakeUp not supported TRUE - CarWakeUp supported
        boolean NmComControlEnabled: post-build-variant-value=true, set at pre-compile  # Pre-processor switch for enabling the Communication Control support.
        boolean NmCoordinatorSupportEnabled: post-build-variant-value=true, set at pre-compile, default-value=false  # Pre-processor switch for enabling NM Coordinator support.
        boolean NmCoordinatorSyncSupport: post-build-variant-value=true, set at pre-compile  # Enables/disables the coordinator synchronisation support.
        float NmGlobalCoordinatorTime [0..1]: 0..65.535, multiplicity set at pre-compile, post-build-variant-multiplicity=true, post-build-variant-value=true, set at pre-compile  # This parameter defines the maximum shutdown time of a connected and coordinated NM-Cluster. | Note:This includes nested connections.
        boolean NmPduRxIndicationEnabled: post-build-variant-value=true, set at pre-compile  # Pre-processor switch for enabling the PDU Rx Indication.
        boolean NmRemoteSleepIndEnabled: post-build-variant-value=true, set at pre-compile  # Pre-processor switch for enabling Remote Sleep Indication support. This feature is required for a Gateway or Nm Coordinator functionality. | Note that this feature should not be used if all NM channels have Passive Mode enabled.
        boolean NmStateChangeIndEnabled: post-build-variant-value=true, set at pre-compile  # Pre-processor switch for enabling the Network Management state change notification.
        boolean NmUserDataEnabled: post-build-variant-value=true, set at pre-compile  # Pre-processor switch for enabling User Data support.
        string NmHeaderFileInclusion [0..*]: multiplicity set at pre-compile, origin=AUTRON, set at pre-compile, regular-expression=[a-zA-Z]([a-zA-Z0-9\_])*\.h  # Name of the header file(s) to be included by the Nm module containing the used C-callout declarations.
      container NmGlobalProperties
        float NmCycletimeMainFunction [0..1]: 0..65.535, multiplicity set at pre-compile, set at pre-compile  # The period between successive calls to the Main Function of the NM Interface in seconds.
        boolean NmDevErrorDetect: set at pre-compile, default-value=false  # Switches the development error detection and notification on or off. | * true: detection and notification is enabled. * false: detection and notification is disabled.
        boolean NmVersionInfoApi: set at pre-compile, default-value=false  # Pre-processor switch for enabling Version Info API support.
