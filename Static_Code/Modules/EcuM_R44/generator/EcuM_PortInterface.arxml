AUTOSAR XML (schema 00047)
package /EcuM/ImplementationDataTypes
  11 x impl type, all with category=TYPE_REFERENCE:
    EcuM_BootTargetType: compu {0=ECUM_BOOT_TARGET_APP, 1=ECUM_BOOT_TARGET_OEM_BOOTLOADER, 2=ECUM_BOOT_TARGET_SYS_BOOTLOADER}, implementation-data-type=uint8
    EcuM_CallerType: implementation-data-type=uint16
    EcuM_ResetType: implementation-data-type=uint8
    EcuM_ShutdownCauseType: compu {0=ECUM_CAUSE_UNKNOWN, 1=ECUM_CAUSE_ECU_STATE, 2=ECUM_CAUSE_WDGM, 3=ECUM_CAUSE_DCM}, implementation-data-type=uint8
    EcuM_StateType: compu {16=ECUM_STATE_STARTUP, 17=ECUM_STATE_STARTUP_ONE, 18=ECUM_STATE_STARTUP_TWO, 19=ECUM_STATE_STARTUP_THREE, 20=ECUM_STATE_STARTUP_FOUR, 32=ECUM_STATE_WAKEUP, 33=ECUM_STATE_WAKEUP_ONE, 34=ECUM_STATE_WAKEUP_VALIDATION, 35=ECUM_STATE_WAKEUP_REACTION, 36=ECUM_STATE_WAKEUP_TWO, 37=ECUM_STATE_WAKEUP_WAKESLEEP, 38=ECUM_STATE_WAKEUP_TTII, 48=ECUM_STATE_RUN, 50=ECUM_STATE_APP_RUN, 51=ECUM_STATE_APP_POST_RUN, 64=ECUM_STATE_SHUTDOWN, 68=ECUM_STATE_PREP_SHUTDOWN, 73=ECUM_STATE_GO_SLEEP, 77=ECUM_STATE_GO_OFF_ONE, 78=ECUM_STATE_GO_OFF_TWO, 80=ECUM_STATE_SLEEP, 128=ECUM_STATE_OFF, 144=ECUM_STATE_RESET}, implementation-data-type=uint8
    EcuM_TimeType: implementation-data-type=uint32
    EcuM_UserType: implementation-data-type=uint8
    EcuM_WakeupSourceType: implementation-data-type=uint32
    EcuM_RequestType: compu {0=ECUM_REQUEST_RUN, 1=ECUM_REQUEST_SLEEP, 3=ECUM_REQUEST_RESET, 2=ECUM_REQUEST_OFF, 255=ECUM_REQUEST_INVALID}, implementation-data-type=uint8
    EcuM_ShutdownTargetType: compu {0=ECUM_SHUTDOWN_TARGET_SLEEP, 1=ECUM_SHUTDOWN_TARGET_RESET, 2=ECUM_SHUTDOWN_TARGET_OFF}, implementation-data-type=uint8
    EcuM_ShutdownModeType: implementation-data-type=uint16
package /EcuM/ModeDeclarationGroups
  mode declaration group BootTarget: category=EXPLICIT_ORDER, initial-mode=ECUM_BOOT_TARGET_APP, on-transition-value=3
    mode ECUM_BOOT_TARGET_APP: value=0
    mode ECUM_BOOT_TARGET_OEM_BOOTLOADER: value=1
    mode ECUM_BOOT_TARGET_SYS_BOOTLOADER: value=2
  mode declaration group EcuMode: category=EXPLICIT_ORDER, initial-mode=ECUM_STATE_STARTUP_ONE, on-transition-value=0
    11 x mode:
      ECUM_STATE_STARTUP_ONE: value=17
      ECUM_STATE_STARTUP_TWO: value=18
      ECUM_STATE_STARTUP_THREE: value=19
      ECUM_STATE_RUN: value=48
      ECUM_STATE_APP_RUN: value=50
      ECUM_STATE_APP_POST_RUN: value=51
      ECUM_STATE_SHUTDOWN: value=64
      ECUM_STATE_PREP_SHUTDOWN: value=68
      ECUM_STATE_SLEEP: value=80
      ECUM_STATE_OFF: value=128
      ECUM_STATE_RESET: value=144
package /EcuM/DataTypeMappingSets
  data type mapping set BootTargetMap: mode-request-type-map{implementation-data-type=EcuM_BootTargetType, mode-group=BootTarget}
  data type mapping set EcuModeMap: mode-request-type-map{implementation-data-type=EcuM_StateType, mode-group=EcuMode}
package /EcuM/ClientServerInterfaces
  6 x client server interface, all with is-service=true, service-kind=ECU-MANAGER:
    EcuM_ShutdownTarget
      6 x operation:
        GetLastShutdownTarget: possible-error=[EcuM_ShutdownTarget/E_OK, EcuM_ShutdownTarget/E_NOT_OK]
          arg shutdownTarget: type=EcuM_ShutdownTargetType, direction=OUT
          arg shutdownMode: type=EcuM_ShutdownModeType, direction=OUT
        GetShutdownCause: possible-error=[EcuM_ShutdownTarget/E_OK, EcuM_ShutdownTarget/E_NOT_OK]
          arg shutdownCause: type=EcuM_ShutdownCauseType, direction=OUT
        GetShutdownTarget: possible-error=EcuM_ShutdownTarget/E_OK
          arg shutdownTarget: type=EcuM_ShutdownTargetType, direction=OUT
          arg shutdownMode: type=EcuM_ShutdownModeType, direction=OUT
        GoDownHaltPoll: possible-error=[EcuM_ShutdownTarget/E_OK, EcuM_ShutdownTarget/E_NOT_OK]
          arg caller: type=EcuM_CallerType, direction=IN
        SelectShutdownCause: possible-error=[EcuM_ShutdownTarget/E_OK, EcuM_ShutdownTarget/E_NOT_OK]
          arg shutdownCause: type=EcuM_ShutdownCauseType, direction=IN
        SelectShutdownTarget: possible-error=[EcuM_ShutdownTarget/E_OK, EcuM_ShutdownTarget/E_NOT_OK]
          arg shutdownTarget: type=EcuM_ShutdownTargetType, direction=IN
          arg shutdownMode: type=EcuM_ShutdownModeType, direction=IN
      error E_OK: error-code=0
      error E_NOT_OK: error-code=1
    EcuM_BootTarget
      operation GetBootTarget: possible-error=EcuM_BootTarget/E_OK
        arg target: type=EcuM_BootTargetType, direction=OUT
      operation SelectBootTarget: possible-error=[EcuM_BootTarget/E_OK, EcuM_BootTarget/E_NOT_OK]
        arg target: type=EcuM_BootTargetType, direction=IN
      error E_OK: error-code=0
      error E_NOT_OK: error-code=1
    EcuM_AlarmClock
      4 x operation:
        AbortWakeupAlarm: possible-error=[EcuM_AlarmClock/E_OK, EcuM_AlarmClock/E_NOT_OK, ECUM_E_NOT_ACTIVE]
          arg user: type=EcuM_UserType, direction=IN
        SetAbsWakeupAlarm: possible-error=[EcuM_AlarmClock/E_OK, EcuM_AlarmClock/E_NOT_OK, ECUM_E_EARLIER_ACTIVE, ECUM_E_PAST]
          arg user: type=EcuM_UserType, direction=IN
          arg time: type=EcuM_TimeType, direction=IN
        SetClock: possible-error=[EcuM_AlarmClock/E_OK, EcuM_AlarmClock/E_NOT_OK]
          arg user: type=EcuM_UserType, direction=IN
          arg time: type=EcuM_TimeType, direction=IN
        SetRelWakeupAlarm: possible-error=[EcuM_AlarmClock/E_OK, EcuM_AlarmClock/E_NOT_OK, ECUM_E_EARLIER_ACTIVE]
          arg user: type=EcuM_UserType, direction=IN
          arg time: type=EcuM_TimeType, direction=IN
      5 x error:
        E_OK: error-code=1
        E_NOT_OK: error-code=2
        ECUM_E_EARLIER_ACTIVE: error-code=3
        ECUM_E_PAST: error-code=4
        ECUM_E_NOT_ACTIVE: error-code=5
    EcuM_WakeupSource
      operation DisableWakeupSources
        arg wakeupSource: type=EcuM_WakeupSourceType, direction=IN
      operation EnableWakeupSources
        arg wakeupSource: type=EcuM_WakeupSourceType, direction=IN
      operation ClearWakeupEvent
        arg wakeupSource: type=EcuM_WakeupSourceType, direction=IN
    EcuM_StateRequest
      7 x operation, all with possible-error=[EcuM_StateRequest/E_OK, EcuM_StateRequest/E_NOT_OK]:
        ReleasePOST_RUN
          arg user: type=EcuM_UserType, direction=IN
        ReleaseRUN
          arg user: type=EcuM_UserType, direction=IN
        RequestOff
          arg user: type=EcuM_UserType, direction=IN
        RequestPOST_RUN
          arg user: type=EcuM_UserType, direction=IN
        RequestRUN
          arg user: type=EcuM_UserType, direction=IN
        RequestReset
          arg user: type=EcuM_UserType, direction=IN
        RequestSleep
          arg user: type=EcuM_UserType, direction=IN
      error E_OK: error-code=0
      error E_NOT_OK: error-code=1
    EcuM_Time
      operation GetWakeupTime: possible-error=[EcuM_Time/E_OK, EcuM_Time/E_NOT_OK]
        arg time: type=EcuM_TimeType, direction=OUT
      operation GetCurrentTime: possible-error=[EcuM_Time/E_OK, EcuM_Time/E_NOT_OK]
        arg time: type=EcuM_TimeType, direction=OUT
      error E_OK: error-code=0
      error E_NOT_OK: error-code=1
package /EcuM/ModeSwitchInterfaces
  mode switch interface EcuM_CurrentMode: is-service=true
    mode group currentMode: type=EcuMode
