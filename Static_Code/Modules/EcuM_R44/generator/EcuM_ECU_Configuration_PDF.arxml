AUTOSAR XML (schema 00047)
# (C) 2021 HYUNDAI AUTOEVER Corp.
# Confidential Proprietary Information. Distribution Limited.
# Do Not Copy Without Prior Permission
package /AUTRON
  ecuc definition collection ParameterDefinition_EcuM: module=EcuM
  module definition EcuM [0..1]: category=VENDOR_SPECIFIC_MODULE_DEFINITION, post-build-variant-support=true, refined-module-def=EcuM, variants post-build/post-build-selectable/post-build-loadable  # Configuration of the EcuM (ECU State Manager) module.
    container EcuMConfiguration  # This container contains the configuration (parameters) of the ECU State Manager.
      container EcuMCommonConfiguration  # This container contains the common configuration (parameters) of the ECU State Manager.
        integer EcuMConfigConsistencyHash: 0..18446744073709551615, set at link  # In the pre-compile and link-time configuration phase a hash value is generated across all pre-compile and link-time parameters of all BSW modules. | In the post-build phase a hash value is generated across all pre-compile and link-time parameters, except for parameters located in EcucParamConfContainerDef instances or subContainers which have been introduced at post-build configuration time. This hash value is compared against each other and allows checking the consistency of the entire configuration.
        reference EcuMDefaultAppMode: post-build-variant-value=true, set at post-build, destination=OsAppMode  # The default application mode loaded when the ECU comes out of reset.
        reference EcuMOSResource [1..*]: multiplicity set at pre-compile, set at pre-compile, destination=OsResource  # This parameter is a reference to a OS resource which is used to bring the ECU into sleep mode. | In case of multi core each core shall have an own OsResource.
        reference EcuMOsTaskRef [0..*]: origin=AUTRON, set at pre-compile, destination=OsTask  # This parameter contains reference to container OsTask. This parameter is used for invoking for shutdown synchronization in multi core.
        reference EcuMOsSpinlockRef [0..1]: origin=AUTRON, set at post-build, destination=OsSpinlock  # This parameter is a reference to a OS spin lock which is used to protect a shared resource from Multi-Core.
        reference EcuMOsEventRef [0..*]: origin=AUTRON, set at pre-compile, destination=OsEvent
        container EcuMDefaultShutdownTarget  # This container describes the default shutdown target to be selected by EcuM. The actual shutdown target may be overridden by the EcuM_SelectShutdownTarget service.
          enumeration EcuMDefaultShutdownTarget: {EcuMShutdownTargetOff, EcuMShutdownTargetReset, EcuMShutdownTargetSleep}, post-build-variant-value=true, set at post-build  # This parameter describes the state part of the default shutdown target selected when the ECU comes out of reset. If EcuMShutdownTargetSleep is selected, the parameter EcuMDefaultSleepModeRef selects the specific sleep mode.
          reference EcuMDefaultResetModeRef [0..1]: multiplicity set at post-build, post-build-variant-multiplicity=true, post-build-variant-value=true, set at post-build, requires-symbolic-name-value=true, destination=EcuMResetMode  # If EcuMDefaultShutdownTarget is EcuMShutdownTargetReset, this parameter selects the default reset mode. Otherwise this parameter may be ignored.
          reference EcuMDefaultSleepModeRef [0..1]: multiplicity set at post-build, post-build-variant-multiplicity=true, post-build-variant-value=true, set at post-build, requires-symbolic-name-value=true, destination=EcuMSleepMode  # If EcuMDefaultShutdownTarget is EcuMShutdownTargetSleep, this parameter selects the default sleep mode. Otherwise this parameter may be ignored.
        container EcuMDriverInitListOne [0..1]  # Container for Init Block I. | This container holds a list of modules to be initialized. Each module in the list will be called for initialization in the list order. All modules in this list are initialized before the OS is started and so these modules require no OS support.
          container EcuMDriverInitItem [1..*]: requires-index=true  # These containers describe the entries in a driver init list.
            enumeration EcuMModuleParameter: {NULL_PTR, POSTBUILD_PTR, VOID}, set at pre-compile  # Definition of the function prototype and the parameter passed to the function.
            string EcuMModuleService [0..1]: multiplicity set at pre-compile, set at pre-compile  # The service to be called to initialize that module, e.g. Init, PreInit, Start etc. If nothing is defined "Init" is taken by default.
            integer EcuMDriverInitItemIndex: 0..65535, multiplicity set at pre-compile, origin=AUTRON, symbolic-name-value=true  # This index detemines the order of driver init list.
            string EcuMModulePostBuildPtr [0..1]: multiplicity set at pre-compile, origin=AUTRON, set at pre-compile  # The service to be called to initialize that module, e.g. Init, PreInit, Start etc. If nothing is defined "Init" is taken by default. / The configuration pointer set for Variant-post-build.
            boolean Used: origin=AUTRON, set at pre-compile  # Check if module is used in EcuM module
            foreign reference EcuMModuleRef [0..1]: set at pre-compile, destination-type=ECUC-MODULE-CONFIGURATION-VALUES  # Foreign reference to the configuration of a module instance which shall be initialized by EcuM
        container EcuMDriverInitListZero [0..1]  # Container for Init Block 0. | This container holds a list of modules to be initialized. Each module in the list will be called for initialization in the list order. All modules in this list are initialized before the post-build configuration has been loaded and the OS is initialized. Therefore, these modules may not use post-build configuration.
          container EcuMDriverInitItem [1..*]: requires-index=true  # These containers describe the entries in a driver init list.
            enumeration EcuMModuleParameter: {NULL_PTR, POSTBUILD_PTR, VOID}, set at pre-compile  # Definition of the function prototype and the parameter passed to the function.
            string EcuMModuleService [0..1]: multiplicity set at pre-compile, set at pre-compile  # The service to be called to initialize that module, e.g. Init, PreInit, Start etc. If nothing is defined "Init" is taken by default.
            integer EcuMDriverInitItemIndex: 0..65535, multiplicity set at pre-compile, origin=AUTRON, symbolic-name-value=true  # This index detemines the order of driver init list.
            string EcuMModulePostBuildPtr [0..1]: multiplicity set at pre-compile, origin=AUTRON, set at pre-compile  # The service to be called to initialize that module, e.g. Init, PreInit, Start etc. If nothing is defined "Init" is taken by default. / The configuration pointer set for Variant-post-build.
            boolean Used: origin=AUTRON, set at pre-compile  # Check if module is used in EcuM module
            foreign reference EcuMModuleRef: set at pre-compile, destination-type=ECUC-MODULE-CONFIGURATION-VALUES  # Foreign reference to the configuration of a module instance which shall be initialized by EcuM
        container EcuMDriverRestartList [0..1]  # List of modules to be initialized.
          container EcuMDriverInitItem [1..*]: requires-index=true  # These containers describe the entries in a driver init list.
            enumeration EcuMModuleParameter: {NULL_PTR, POSTBUILD_PTR, VOID}, set at pre-compile  # Definition of the function prototype and the parameter passed to the function.
            string EcuMModuleService [0..1]: multiplicity set at pre-compile, set at pre-compile  # The service to be called to initialize that module, e.g. Init, PreInit, Start etc. If nothing is defined "Init" is taken by default.
            integer EcuMDriverInitItemIndex: 0..65535, multiplicity set at pre-compile, origin=AUTRON, symbolic-name-value=true  # This index detemines the order of driver init list.
            string EcuMModulePostBuildPtr [0..1]: multiplicity set at pre-compile, origin=AUTRON, set at pre-compile  # The service to be called to initialize that module, e.g. Init, PreInit, Start etc. If nothing is defined "Init" is taken by default. / The configuration pointer set for Variant-post-build.
            boolean Used: origin=AUTRON, set at pre-compile  # Check if module is used in EcuM module
            foreign reference EcuMModuleRef: set at pre-compile, destination-type=ECUC-MODULE-CONFIGURATION-VALUES  # Foreign reference to the configuration of a module instance which shall be initialized by EcuM
        container EcuMSleepMode [1..256]  # These containers describe the configured sleep modes. | The names of these containers specify the symbolic names of the different sleep modes.
          integer EcuMSleepModeId: 0..255, scope=ECU, set at pre-compile, symbolic-name-value=true  # This ID identifies this sleep mode in services like EcuM_SelectShutdownTarget.
          boolean EcuMSleepModeSuspend: set at pre-compile  # Flag, which is set true, if the CPU is suspended, halted, or powered off in the sleep mode. If the CPU keeps running in this sleep mode, then this flag must be set to false.
          reference EcuMSleepModeMcuModeRef: set at pre-compile, requires-symbolic-name-value=true, destination=McuModeSettingConf  # This parameter is a reference to the corresponding MCU mode for this sleep mode.
          reference EcuMWakeupSourceMask [1..*]: multiplicity set at pre-compile, set at pre-compile, requires-symbolic-name-value=true, destination=EcuMWakeupSource  # These parameters are references to the wakeup sources that shall be enabled for this sleep mode.
        container EcuMWakeupSource [1..32]  # These containers describe the configured wakeup sources.
          float EcuMCheckWakeupTimeout [0..1]: 0..10, multiplicity set at pre-compile, set at pre-compile, default-value=0  # This Parameter is the initial Value for the Time of the EcuM to delay shut down of the ECU if the check of the Wakeup Source is done asynchronously (CheckWakeupTimer). | The unit is in seconds.
          float EcuMValidationTimeout [0..1]: 0..Inf, multiplicity set at pre-compile, set at pre-compile  # The validation timeout (period for which the ECU State Manager will wait for the validation of a wakeup event) can be defined for each wakeup source independently. The timeout is specified in seconds. | When the timeout is not instantiated, there is no validation routine and the ECU Manager shall not validate the wakeup source.
          integer EcuMWakeupSourceId: 0..31, scope=ECU, set at pre-compile, symbolic-name-value=true  # This parameter defines the identifier of this wakeup source.
          boolean EcuMWakeupSourcePolling: set at pre-compile  # This parameter describes if the wakeup source needs polling.
          reference EcuMComMChannelRef [0..1]: multiplicity set at pre-compile, set at pre-compile, requires-symbolic-name-value=true, destination=ComMChannel  # This parameter is a reference to a Network (channel) defined in the Communication Manager. No reference indicates that the wakeup source is not a communication channel.
          reference EcuMComMPNCRef [0..*]: multiplicity set at pre-compile, post-build-variant-multiplicity=true, set at pre-compile, requires-symbolic-name-value=true, destination=ComMPnc  # This is a reference to a one or more PNC's defined in the Communication Manager. | No reference indicates that the wakeup source is not assigned to a partial network.
          reference EcuMResetReasonRef [0..*]: multiplicity set at pre-compile, set at pre-compile, requires-symbolic-name-value=true, destination=McuResetReasonConf  # This parameter describes the mapping of reset reasons detected by the MCU driver into wakeup sources.
        container EcuMCalloutUserIncludeFiles [0..1]  # Header file name which shall be included by the EcuM Callout.
          string EcuMCalloutUserIncludeFile [0..*]: origin=AUTRON, set at pre-compile  # Header file name which shall be included by the EcuM Callout.
      container EcuMFlexConfiguration [0..1]  # This container contains the configuration (parameters) of the EcuMFlex. | Only applicable if EcuMFlex is implemented.
        reference EcuMNormalMcuModeRef: set at pre-compile, requires-symbolic-name-value=true, destination=McuModeSettingConf  # This parameter is a reference to the normal MCU mode to be restored after a sleep.
        reference EcuMPartitionRef [0..*]: multiplicity set at pre-compile, set at pre-compile, destination=EcucPartition  # Reference denotes the partition a EcuM shall run inside. | Please note that in case of a multicore ECU this reference is mandatory.
        reference EcuMNormalMcuClockRef [0..1]: set at pre-compile, destination=McuClockSettingConfig  # This parameter is a reference to the normal MCU clock to be initialized for Mcu_InitClock API.
        reference EcuMFlexGptConfigurationRef [0..1]: origin=AUTRON, set at pre-compile, destination=GptChannelConfiguration
        container EcuMAlarmClock [0..*]  # These containers describe the configured alarm clocks. | The name of these conatiners allows giving a symbolic name to one alarm clock.
          integer EcuMAlarmClockId: 0..255, set at pre-compile, symbolic-name-value=true  # This ID identifies this alarmclock.
          float EcuMAlarmClockTimeOut: 0..Inf, set at pre-compile  # This parameter allows to define a timeout for this alarm clock.
          reference EcuMAlarmClockUser: set at pre-compile, requires-symbolic-name-value=true, destination=EcuMFlexUserConfig  # This parameter allows an alarm to be assigned to a user.
        container EcuMDriverInitListBswM [0..*]  # This container holds a list of modules to be initialized by the BswM.
          container EcuMDriverInitItem [1..*]: requires-index=true  # These containers describe the entries in a driver init list.
            enumeration EcuMModuleParameter: {NULL_PTR, POSTBUILD_PTR, VOID}, set at pre-compile  # Definition of the function prototype and the parameter passed to the function.
            string EcuMModuleService [0..1]: multiplicity set at pre-compile, set at pre-compile  # The service to be called to initialize that module, e.g. Init, PreInit, Start etc. If nothing is defined "Init" is taken by default.
            integer EcuMDriverInitItemIndex: 0..65535, multiplicity set at pre-compile, origin=AUTRON, symbolic-name-value=true  # This index detemines the order of driver init list.
            string EcuMModulePostBuildPtr [0..1]: multiplicity set at pre-compile, origin=AUTRON, set at pre-compile  # The service to be called to initialize that module, e.g. Init, PreInit, Start etc. If nothing is defined "Init" is taken by default. / The configuration pointer set for Variant-post-build.
            boolean Used: origin=AUTRON, set at pre-compile  # Check if module is used in EcuM module
            foreign reference EcuMModuleRef [0..1]: set at pre-compile, destination-type=ECUC-MODULE-CONFIGURATION-VALUES  # Foreign reference to the configuration of a module instance which shall be initialized by EcuM
        container EcuMFlexUserConfig [1..256]  # These containers describe the identifiers that are needed to refer to a software component or another appropriate entity in the system which uses the EcuMFlex Interfaces.
          integer EcuMFlexUser: 0..255, set at pre-compile, symbolic-name-value=true  # Parameter used to identify one user.
          reference EcuMFlexEcucPartitionRef [0..1]: multiplicity set at pre-compile, set at pre-compile, destination=EcucPartition  # Denotes in which "EcucPartition" the user of the EcuM is executed.
        container EcuMGoDownAllowedUsers [0..1]  # This container describes the collection of allowed users which are allowed to call the EcuM_GoDownHaltPoll API (only applies in the case that the previously set shutdown target is TARGET_RESET or TARGET_OFF).
          reference EcuMGoDownAllowedUserRef [1..*]: multiplicity set at pre-compile, set at pre-compile, requires-symbolic-name-value=true, destination=EcuMFlexUserConfig  # This references an allowed user.
        container EcuMResetMode [1..256]  # These containers describe the configured reset modes. | The name of these containers allows one of the following symbolic names to be given to the different reset modes: - ECUM_RESET_MCU - ECUM_RESET_WDG - ECUM_RESET_IO.
          integer EcuMResetModeId: 0..255, set at pre-compile, symbolic-name-value=true  # This ID identifies this reset mode in services like EcuM_SelectShutdownTarget.
        container EcuMSetClockAllowedUsers [0..1]  # This container describes the collection of allowed users which are allowed to call the EcuM_SetClock API.
          reference EcuMSetClockAllowedUserRef [1..*]: multiplicity set at pre-compile, set at pre-compile, requires-symbolic-name-value=true, destination=EcuMFlexUserConfig  # These parameters describe the references to the users which are allowed to call the EcuM_SetClock API.
        container EcuMShutdownCause [1..256]  # These containers describe the configured shut down or reset causes. | The name of these containers allows to give one of the following symbolic names to the different shut down causes: - ECUM_CAUSE_ECU_STATE - ECU state machine entered a state for shutdown, - ECUM_CAUSE_WDGM - WdgM detected failure, - ECUM_CAUSE_DCM - Dcm requests shutdown (split into UDS services?), - and values from configuration.
          integer EcuMShutdownCauseId: 0..255, set at pre-compile, symbolic-name-value=true  # This ID identifies this shut down cause.
        container EcuMDriverListStartupOrShutdown [0..*]  # This container holds a list of modules to be initialized at Start Up phase
          container EcuMDriverListCollectionCoreWise [0..*]  # This container holds a list of modules to be initialized distinct by core-wise
            reference EcuMDriverListInitOrDeInitPartitionRef: multiplicity set at pre-compile, set at pre-compile, destination=EcucPartition  # Reference denotes the partition a EcuM shall run inside. | Please note that in case of a multicore ECU this reference is mandatory.
            container EcuMDriverListInitOrDeInitItem [1..*]: requires-index=true  # These containers describe the entries in a driver init list.
              enumeration EcuMModuleParameter: {NULL_PTR, POSTBUILD_PTR, VOID}, set at pre-compile  # Definition of the function prototype and the parameter passed to the function.
              string EcuMModuleService [0..1]: multiplicity set at pre-compile, set at pre-compile  # The service to be called to initialize that module, e.g. Init, PreInit, Start etc. If nothing is defined "Init" is taken by default.
              integer EcuMDriverInitItemIndex: 0..65535, multiplicity set at pre-compile, origin=AUTRON, symbolic-name-value=true  # This index detemines the order of driver init list.
              string EcuMModulePostBuildPtr [0..1]: multiplicity set at pre-compile, origin=AUTRON, set at pre-compile  # The service to be called to initialize that module, e.g. Init, PreInit, Start etc. If nothing is defined "Init" is taken by default. / The configuration pointer set for Variant-post-build.
              boolean Used: origin=AUTRON, set at pre-compile  # Check if module is used in EcuM module
              foreign reference EcuMModuleRef: set at pre-compile, destination-type=ECUC-MODULE-CONFIGURATION-VALUES  # Foreign reference to the configuration of a module instance which shall be initialized by EcuM
        container EcuMDriverinitListStartPreOs [0..1]  # Reference to Start PreOs to initialize a list driver belonging to.
          reference EcuMDriverInitListStartPreOsRef: scope=ECU, multiplicity set at pre-compile, origin=AUTRON, set at pre-compile, destination=EcuMDriverListStartupOrShutdown  # Reference denotes the partition a EcuM shall run inside. | Please note that in case of a multicore ECU this reference is mandatory.
        container EcuMDriverinitListStartPostOs [0..1]  # This container holds a list of modules to be initialized at Start Post Os phase
          reference EcuMDriverInitListStartPostOsRef: scope=ECU, multiplicity set at pre-compile, origin=AUTRON, set at pre-compile, destination=EcuMDriverListStartupOrShutdown  # Reference denotes the partition a EcuM shall run inside. | Please note that in case of a multicore ECU this reference is mandatory.
        container EcuMDriverDeInitListOffOs [0..1]  # This container holds a list of modules to be initialized at Start Post Os phase
          reference EcuMDriverDeInitListOffOsRef: scope=ECU, multiplicity set at pre-compile, origin=AUTRON, set at pre-compile, destination=EcuMDriverListStartupOrShutdown  # Reference denotes the partition a EcuM shall run inside. | Please note that in case of a multicore ECU this reference is mandatory.
        container EcuMDriverDeInitListPostOs [0..1]  # This container holds a list of modules to be initialized at Start Post Os phase
          reference EcuMDriverDeInitListPostOsRef: scope=ECU, multiplicity set at pre-compile, origin=AUTRON, set at pre-compile, destination=EcuMDriverListStartupOrShutdown  # Reference denotes the partition a EcuM shall run inside. | Please note that in case of a multicore ECU this reference is mandatory.
    container EcuMFlexGeneral [0..1]  # This container holds the general, pre-compile configuration parameters for the EcuMFlex. | Only applicable if EcuMFlex is implemented.
      boolean EcuMAlarmClockPresent: set at pre-compile  # This flag indicates whether the optional AlarmClock feature is present.
      boolean EcuMModeHandling [0..1]: multiplicity set at pre-compile, set at pre-compile  # If false, Run Request Protocol is not performed.
      boolean EcuMResetLoopDetection [0..1]: multiplicity set at pre-compile, set at pre-compile  # If false, no reset loop detection is performed. If this configuration parameter exists and is set to true, the callout "EcuM_LoopDetection" is called during startup of EcuM (during StartPreOS).
      boolean EcuMSetProgrammableInterrupts [0..1]: multiplicity set at pre-compile, set at pre-compile  # If this configuration parameter exists and is to true, the callout "EcuM_AL_SetProgrammableInterrupts" is called during startup of EcuM (during StartPreOS).
      boolean EcuMLpTransitionCalloutEnabled [0..1]: multiplicity set at pre-compile, origin=AUTRON, set at pre-compile  # This flag indicates whether the Lp transition callouts are used in low power mode or not. true: Lp callouts are used in low power mode. false: Lp callouts are not used in low power mode.
      reference EcuMAlarmWakeupSource [0..1]: multiplicity set at pre-compile, set at pre-compile, requires-symbolic-name-value=true, destination=EcuMWakeupSource  # This parameter describes the reference to the EcuMWakeupSource being used for the EcuM AlarmClock.
    container EcuMGeneral  # This container holds the general, pre-compile configuration parameters.
      boolean EcuMDevErrorDetect: set at pre-compile, default-value=false  # Switches the development error detection and notification on or off. | * true: detection and notification is enabled. * false: detection and notification is disabled.
      boolean EcuMIncludeDet: set at pre-compile  # If defined, the according BSW module will be initialized by the ECU State Manager
      float EcuMMainFunctionPeriod: 0..Inf, scope=ECU, set at pre-compile  # This parameter defines the schedule period of EcuM_MainFunction. | Unit: [s]
      boolean EcuMVersionInfoApi: set at pre-compile, default-value=false  # Switches the version info API on or off
      integer EcuMLoopCountMax [0..1]: 0..4294967295, origin=AUTRON, set at pre-compile, default-value=2000000  # The maximum number of iterations to prevent an infinite loop. ex) Failsafe for PLL Lock Loop.
