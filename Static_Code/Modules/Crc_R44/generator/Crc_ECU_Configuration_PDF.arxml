AUTOSAR XML (schema 00047)
package /AUTRON
  ecuc definition collection ParamterDefinition_Crc: module=Crc
  module definition Crc: category=STANDARDIZED_MODULE_DEFINITION, refined-module-def=Crc, variants pre-compile  # Configuration of the Crc (Crc routines) module.
    container CrcGeneral  # General configuration of CRC module
      enumeration Crc8Mode [0..1]: {CRC_8_TABLE, CRC_8_RUNTIME}, multiplicity set at pre-compile, set at pre-compile, default-value=CRC_8_TABLE  # Switch to select one of the available CRC 8-bit (SAE J1850) calculation methods
      enumeration Crc8H2FMode [0..1]: {CRC_8H2F_TABLE, CRC_8H2F_RUNTIME}, multiplicity set at pre-compile, set at pre-compile, default-value=CRC_8H2F_TABLE  # Switch to select one of the available CRC 8-bit (2Fh polynomial) calculation methods
      enumeration Crc16Mode [0..1]: {CRC_16_TABLE, CRC_16_RUNTIME}, multiplicity set at pre-compile, set at pre-compile, default-value=CRC_16_TABLE  # Switch to select one of the available CRC 16-bit (CCITT) calculation methods
      enumeration Crc16ARCMode [0..1]: {CRC_16_ARC_TABLE, CRC_16_ARC_RUNTIME}, multiplicity set at pre-compile, set at pre-compile, default-value=CRC_16_ARC_TABLE  # Switch to select one of the available CRC-16/ARC (polynomial 8005) calculation methods
      enumeration Crc32Mode [0..1]: {CRC_32_TABLE, CRC_32_RUNTIME}, multiplicity set at pre-compile, set at pre-compile, default-value=CRC_32_TABLE  # Switch to select one of the available CRC 32-bit (IEEE-802.3 CRC32 Ethernet Standard) calculation methods
      enumeration Crc32P4Mode [0..1]: {CRC_32P4_TABLE, CRC_32P4_RUNTIME}, multiplicity set at pre-compile, set at pre-compile, default-value=CRC_32P4_TABLE  # Switch to select one of the available CRC 32-bit E2E Profile 4 calculation methods.
      enumeration Crc64Mode [0..1]: {CRC_64_TABLE, CRC_64_RUNTIME}, multiplicity set at pre-compile, set at pre-compile, default-value=CRC_64_TABLE  # Switch to select one of the available CRC 64-bit calculation methods.
