AUTOSAR XML (schema 00047)
# (C) 2021 HYUNDAI AUTOEVER Co., Ltd.
# Confidential Proprietary Information. Distribution Limited.
# Do Not Copy Without Prior Permission
package /AUTRON
  module definition CanNm [0..1]: post-build-variant-support=true, refined-module-def=CanNm, variants pre-compile/post-build-selectable  # Configuration Parameters for the Can Nm module.
    container CanNmGlobalConfig  # This container contains the global configuration parameter of the CanNm. The parameters and the parameters of the sub containers shall be mapped to the C data type CanNm_ConfigType (for parameters where it is possible) which is passed to the CanNm_Init function.
      boolean CanNmBusLoadReductionEnabled: set at pre-compile  # Pre-processor switch for enabling busload reduction support.
      boolean CanNmBusSynchronizationEnabled: scope=ECU, set at pre-compile  # Pre-processor switch for enabling bus synchronization support. This feature is required for gateway nodes only.
      boolean CanNmComControlEnabled: scope=ECU, set at pre-compile  # Pre-processor switch for enabling the Communication Control support.
      boolean CanNmComUserDataSupport: scope=ECU, set at pre-compile  # Preprocessor switch for enabling the Tx path of Com User Data. | Use case: Setting of NMUserData via SWC.
      boolean CanNmCoordinatorSyncSupport: scope=ECU, set at pre-compile  # Enables/disables the coordinator synchronization support.
      boolean CanNmDevErrorDetect: set at pre-compile, default-value=false  # Switches the development error detection and notification on or off. | * true: detection and notification is enabled. * false: detection and notification is disabled.
      boolean CanNmGlobalPnSupport: set at pre-compile, default-value=false  # Pre-processor switch for enabling partial networking support globally.
      boolean CanNmImmediateRestartEnabled: set at pre-compile  # Pre-processor switch for enabling the immediate transmission of a NM PDU upon bus-communication request in Prepare-Bus-Sleep mode.
      boolean CanNmImmediateTxconfEnabled: scope=ECU, set at pre-compile  # Enable/disable the immediate tx confirmation.
      float CanNmMainFunctionPeriod: 0..Inf, set at link in variant link-time+post-build / pre-compile in variant pre-compile  # Call cycle in seconds of CanNm_MainFunction.
      boolean CanNmPassiveModeEnabled: scope=ECU, set at pre-compile  # Pre-processor switch for enabling support of the Passive Mode.
      boolean CanNmPduRxIndicationEnabled: scope=ECU, set at pre-compile  # Pre-processor switch for enabling the PDU Rx Indication.
      boolean CanNmPnEiraCalcEnabled [0..1]: multiplicity set at pre-compile, set at pre-compile, default-value=false  # Specifies if CanNm calculates the PN request information for internal an external requests. (EIRA) | true: PN request are calculated false: PN request are not calculated
      float CanNmPnResetTime [0..1]: 0.001..65.535, multiplicity set at link in variant link-time+post-build / pre-compile in variant pre-compile, set at link in variant link-time+post-build / pre-compile in variant pre-compile  # Specifies the runtime of the reset timer in seconds. This reset time is valid for the reset of PN requests in the EIRA and in the ERA. The value shall be the same for every channel. Thus it is a global config parameter.
      boolean CanNmRemoteSleepIndEnabled: set at pre-compile  # Pre-processor switch for enabling remote sleep indication support. This feature is required for gateway nodes only.
      boolean CanNmStateChangeIndEnabled: scope=ECU, set at pre-compile  # Pre-processor switch for enabling the CAN NM state change notification.
      boolean CanNmUserDataEnabled: scope=ECU, set at pre-compile  # Pre-processor switch for enabling user data support.
      boolean CanNmVersionInfoApi: scope=ECU, set at pre-compile, default-value=false  # Pre-processor switch for enabling version info API support.
      boolean CanNmPassiveNodeEnabled: set at pre-compile, origin=AUTOEVER, default-value=false  # Pre-processor switch for enabling support of the Passive Node.
      reference CanNmPnEiraRxNSduRef [0..1]: multiplicity set at link in variant link-time+post-build / pre-compile in variant pre-compile, set at link in variant link-time+post-build / pre-compile in variant pre-compile, destination=Pdu  # Reference to a Pdu in the COM-Stack. | Only one SduRef is required for CanNm because the EIRA is the aggregation over all Can Channels.
      container CanNmChannelConfig [1..*]: multiplicity set at pre-compile, post-build-variant-multiplicity=true  # This container contains the channel specific configuration parameter of the CanNm.
        boolean CanNmActiveWakeupBitEnabled [0..1]: multiplicity set at link in variant link-time+post-build / pre-compile in variant pre-compile, set at link in variant link-time+post-build / pre-compile in variant pre-compile, default-value=false  # Enables/Disables the handling of the Active Wakeup Bit in the CanNm module.
        boolean CanNmAllNmMessagesKeepAwake [0..1]: multiplicity set at link in variant link-time+post-build / pre-compile in variant pre-compile, set at link in variant link-time+post-build / pre-compile in variant pre-compile, default-value=false  # Specifies if CanNm drops irrelevant NM PDUs. | false: Only NM PDUs with a PNI bit = true and containing a PN request for this ECU triggers the standard RX indication handling true: Every NM PDU triggers the standard RX indication handling
        boolean CanNmBusLoadReductionActive: set at link in variant link-time+post-build / pre-compile in variant pre-compile  # This parameter defines if bus load reduction for the respective NM channel is active or not.
        integer CanNmCarWakeUpBitPosition [0..1]: 0..7, multiplicity set at link in variant link-time+post-build / pre-compile in variant pre-compile, set at link in variant link-time+post-build / pre-compile in variant pre-compile  # Specifies the Bit position of the CWU within the NM PDU.
        integer CanNmCarWakeUpBytePosition [0..1]: 0..7, multiplicity set at link in variant link-time+post-build / pre-compile in variant pre-compile, set at link in variant link-time+post-build / pre-compile in variant pre-compile  # Specifies the Byte position of the CWU within the NM PDU.
        boolean CanNmCarWakeUpFilterEnabled [0..1]: multiplicity set at link in variant link-time+post-build / pre-compile in variant pre-compile, set at link in variant link-time+post-build / pre-compile in variant pre-compile, default-value=false  # If CWU filtering is supported, only the CWU bit within the NM PDU with source node identifier CanNmCarWakeUpFilterNodeId is considered as CWU request. | FALSE - CWU filtering is not supported TRUE - CWU filtering is supported
        integer CanNmCarWakeUpFilterNodeId [0..1]: 0..255, multiplicity set at link in variant link-time+post-build / pre-compile in variant pre-compile, set at link in variant link-time+post-build / pre-compile in variant pre-compile  # Source node identifier for CWU filtering. If CWU filtering is supported, only the CWU bit within the NM PDU with source node identifier CanNmCarWakeUpFilterNodeId is considered as CWU request.
        boolean CanNmCarWakeUpRxEnabled: scope=ECU, set at link in variant link-time+post-build / pre-compile in variant pre-compile, default-value=false  # Enables or disables support of CarWakeUp bit evaluation in received NM PDUs. | FALSE - CarWakeUp not supported TRUE - CarWakeUp supported
        float CanNmImmediateNmCycleTime [0..1]: 0.001..65.535, multiplicity set at link in variant link-time+post-build / pre-compile in variant pre-compile, set at link in variant link-time+post-build / pre-compile in variant pre-compile  # Defines the immediate NM PDU cycle time in seconds which is used for CanNmImmediateNmTransmissions NM PDU transmissions.
        integer CanNmImmediateNmTransmissions: 0..255, set at link in variant link-time+post-build / pre-compile in variant pre-compile  # Defines the number of immediate NM PDUs which shall be transmitted. If the value is zero no immediate NM PDUs are transmitted. The cycle time of immeditate NM PDUs is defined by CanNmImmediateNmCycleTime.
        float CanNmMsgCycleOffset: 0..65.535, post-build-variant-value=true, set at link in variant link-time+post-build / pre-compile in variant pre-compile  # Time offset in the periodic transmission node. It determines the start delay of the transmission. Specified in seconds.
        float CanNmMsgCycleTime: 0.001..65.535, scope=ECU, set at link in variant link-time+post-build / pre-compile in variant pre-compile  # Period of a NM PDU in seconds. It determines the periodic rate in the "periodic transmission mode with bus load reduction" and is the basis for transmit scheduling in the "periodic transmission mode without bus load reduction".
        float CanNmMsgReducedTime: 0.001..65.535, post-build-variant-value=true, set at link in variant link-time+post-build / pre-compile in variant pre-compile  # Node specific bus cycle time in the periodic transmission mode with bus load reduction. Specified in seconds.
        float CanNmMsgTimeoutTime [0..1]: 0.001..65.535, multiplicity set at link in variant link-time+post-build / pre-compile in variant pre-compile, post-build-variant-multiplicity=true, post-build-variant-value=true, set at link in variant link-time+post-build / pre-compile in variant pre-compile  # When using Partial Network and this timeout is defined then CanNm monitors that a NM-PDU is transmitted successfully within this Transmission Timeout Time and provides an error notification otherwise.
        boolean CanNmNodeDetectionEnabled: scope=ECU, set at link in variant link-time+post-build / pre-compile in variant pre-compile  # Precompile time switch to enable the node detection feature.
        integer CanNmNodeId: 0..255, post-build-variant-value=true, set at link in variant link-time / post-build in variant post-build / pre-compile in variant pre-compile  # Node identifier of local node.
        boolean CanNmNodeIdEnabled: scope=ECU, set at link in variant link-time+post-build / pre-compile in variant pre-compile  # Pre-processor switch for enabling the source node identifier.
        enumeration CanNmPduCbvPosition: {CANNM_PDU_BYTE_0, CANNM_PDU_BYTE_1, CANNM_PDU_OFF}, scope=ECU, set at link in variant link-time+post-build / pre-compile in variant pre-compile  # Defines the position of the control bit vector within the NM PDU. | The value of the parameter represents the location of the Control Bit Vector in the NM PDU (CanNmPduByte0 means byte 0, CanNmPduByte1 means byte 1, CanNmPduOff means source node identifier is not part of the NM PDU) ImplementationType: CanNm_PduPositionType
        enumeration CanNmPduNidPosition: {CANNM_PDU_BYTE_0, CANNM_PDU_BYTE_1, CANNM_PDU_OFF}, scope=ECU, set at link in variant link-time+post-build / pre-compile in variant pre-compile  # Defines the position of the source node identifier within the NM PDU. | The value of the parameter represents the location of the source node identifier in the NM PDU (CANNM_PDU_BYTE_0 means byte 0, CANNM_PDU_BYTE_1 means byte 1, CANNM_PDU_OFF means source node identifier is not part of the NM PDU) ImplementationType: CanNm_PduPositionType
        boolean CanNmPnEnabled [0..1]: scope=ECU, multiplicity set at link in variant link-time / post-build in variant post-build / pre-compile in variant pre-compile, post-build-variant-multiplicity=true, post-build-variant-value=true, set at link in variant link-time / post-build in variant post-build / pre-compile in variant pre-compile, default-value=false  # Enables or disables support of partial networking. | false: Partial networking Range not supported true: Partial networking supported
        boolean CanNmPnEraCalcEnabled [0..1]: multiplicity set at link in variant link-time+post-build / pre-compile in variant pre-compile, set at link in variant link-time+post-build / pre-compile in variant pre-compile, default-value=false  # Specifies if CanNm calculates the PN request information for external requests. (ERA) | false: PN request are not calculated true: PN request are calculated
        boolean CanNmPnHandleMultipleNetworkRequests [0..1]: multiplicity set at link in variant link-time+post-build / pre-compile in variant pre-compile, set at link in variant link-time+post-build / pre-compile in variant pre-compile, default-value=false  # Specifies if CanNm performs an additional transition from Network Mode to Repeat Message State (true) or not (false).
        float CanNmRemoteSleepIndTime [0..1]: 0.001..65.535, set at link in variant link-time+post-build / pre-compile in variant pre-compile  # Timeout for Remote Sleep Indication. | It defines the time in seconds how long it shall take to recognize that all other nodes are ready to sleep.
        float CanNmRepeatMessageTime: 0..65.535, set at link in variant link-time+post-build / pre-compile in variant pre-compile  # Timeout for Repeat Message State. | It defines the time in seconds how long the NM shall stay in the Repeat Message State.
        boolean CanNmRepeatMsgIndEnabled: scope=ECU, set at link in variant link-time+post-build / pre-compile in variant pre-compile  # Enable/disable the notification that a RepeatMessageRequest bit has been received.
        float CanNmTimeoutTime: 0.002..65.535, set at link in variant link-time+post-build / pre-compile in variant pre-compile  # Network Timeout for NM PDUs. | It denotes the time in seconds how long the NM shall stay in the Ready Sleep State before transition into the Prepare Bus-Sleep Mode is initiated.
        float CanNmWaitBusSleepTime: 0.001..65.535, set at link in variant link-time+post-build / pre-compile in variant pre-compile  # Timeout for bus calm down phase. | It denotes the time in seconds how long the NM shall stay in the Prepare Bus-Sleep Mode before transition into Bus-Sleep Mode shall take place.
        boolean CanNmForcePnAvailabilityConfEnabled: origin=AUTOEVER, set at link in variant link-time+post-build / pre-compile in variant pre-compile  # This parameter enables or disables confirmation of PN availability without PN transceiver.
        enumeration CanNmPduNetworkRequestReasonPosition: {CANNM_PDU_BYTE_2, CANNM_PDU_OFF}, scope=ECU, set at link in variant link-time+post-build / pre-compile in variant pre-compile, origin=AUTOEVER, default-value=CANNM_PDU_BYTE_2  # Defines the position of the Network Request Reason within the NM PDU. | The value of the parameter represents the location of the Network Request Reason in the NM PDU (CANNM_PDU_BYTE_2 means 3rd byte of NM PDU, CANNM_PDU_OFF means Network Request Reason field is not part of the NM PDU) ImplementationType: CanNm_PduPositionType
        enumeration CanNmPduNmStatePosition: {CANNM_PDU_BYTE_3, CANNM_PDU_OFF}, scope=ECU, set at link in variant link-time+post-build / pre-compile in variant pre-compile, origin=AUTOEVER, default-value=CANNM_PDU_BYTE_3  # Defines the position of the NM State within the NM PDU. | The value of the parameter represents the location of the NM State in the NM PDU (CANNM_PDU_BYTE_3 means 4th byte of NM PDU, CANNM_PDU_OFF means NM State field is not part of the NM PDU) ImplementationType: CanNm_PduPositionType
        integer CanNmUserDataInitValue [0..1]: 0..255, set at link in variant link-time+post-build / pre-compile in variant pre-compile, origin=AUTOEVER, default-value=255  # Defines the user data that will be initialed for each byte of the CanNm Tx channel. NM applied ECU should set the user data to 0x00 when initializing. User data initialization value of NM ECU may affect other ECU in the following situations. 1) NM applied ECU and PN applied ECU are mixed in one channel 2) PN applied ECU should use the Selective Wakeup function
        reference CanNmComMNetworkHandleRef: set at link in variant link-time+post-build / pre-compile in variant pre-compile, requires-symbolic-name-value=true, destination=ComMChannel  # This reference points to the unique channel defined by the ComMChannel and provides access to the unique channel index value in ComMChannelId.
        reference CanNmPnEraRxNSduRef [0..1]: multiplicity set at link in variant link-time+post-build / pre-compile in variant pre-compile, set at link in variant link-time+post-build / pre-compile in variant pre-compile, destination=Pdu  # Reference to a Pdu in the COM-Stack. The SduRef is required for every CanNm Channel, because ERA is reported per channel.
        container CanNmRxPdu [1..*]  # This container is used to configure the Rx PDU properties that are used for the CanNm Channel.
          integer CanNmRxPduId: 0..65535, scope=ECU, post-build-variant-value=true, set at pre-compile, symbolic-name-value=true  # This parameter defines the Rx PDU ID of the CanIf L-PDU range that is associated with this CanNm channel.
          reference CanNmRxPduRef: post-build-variant-value=true, set at link in variant link-time / post-build in variant post-build / pre-compile in variant pre-compile, destination=Pdu  # Reference to the global PDU that is used by this CanNm channel.
        container CanNmTxPdu [0..1]  # This container contains the CanNmTxConfirmationPduId and the CanNmTxPduRef.
          integer CanNmTxConfirmationPduId: 0..65535, scope=ECU, post-build-variant-value=true, set at pre-compile, symbolic-name-value=true  # Handle Id to be used by the Lower Layer to confirm the transmission of the CanNmTxPdu to the LowerLayer.
          reference CanNmTxPduRef: post-build-variant-value=true, set at link in variant link-time / post-build in variant post-build / pre-compile in variant pre-compile, destination=Pdu  # The reference to the common PDU structure.
        container CanNmUserDataTxPdu [0..1]  # This optional container is used to configure the UserNm PDU. This container is only available if CanNmComUserDataSupport is enabled.
          integer CanNmTxUserDataPduId: 0..65535, scope=ECU, set at pre-compile, symbolic-name-value=true  # This parameter defines the Handle ID of the NM User Data I-PDU.
          reference CanNmTxUserDataPduRef: post-build-variant-value=true, set at link in variant link-time / post-build in variant post-build / pre-compile in variant pre-compile, destination=Pdu  # Reference to the NM User Data I-PDU in the global PDU collection.
      container CanNmPnInfo [0..1]  # PN information configuration
        integer CanNmPnInfoLength: 1..63, set at link in variant link-time+post-build / pre-compile in variant pre-compile, default-value=1  # Specifies the length of the PN request information in the NM PDU.
        integer CanNmPnInfoOffset: 1..63, set at link in variant link-time+post-build / pre-compile in variant pre-compile, default-value=1  # Specifies the offset of the PN request information in the NM PDU.
        container CanNmPnFilterMaskByte [0..63]  # PN information configuration
          integer CanNmPnFilterMaskByteIndex: 0..62, set at link in variant link-time+post-build / pre-compile in variant pre-compile  # Index of the filter mask byte. Specifies the position within the filter mask byte array.
          integer CanNmPnFilterMaskByteValue: 0..255, post-build-variant-value=true, set at link in variant link-time / post-build in variant post-build / pre-compile in variant pre-compile, default-value=0  # Parameter to configure the filter mask byte.
  ecuc definition collection ParameterDefinition_CanNm: module=CanNm
