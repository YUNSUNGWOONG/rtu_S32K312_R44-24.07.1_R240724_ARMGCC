AUTOSAR XML (schema 00047)
# (C) 2021 HYUNDAI AUTOEVER Corp.
# Confidential Proprietary Information. Distribution Limited.
# Do Not Copy Without Prior Permission
package /AUTRON
  module definition CanTp [0..1]: post-build-variant-support=true, variants pre-compile/post-build-selectable  # Configuration of the CanTp (CAN Transport Protocol) module.
    container CanTpConfig  # This container contains the configuration parameters and sub containers of the AUTOSAR CanTp module.
      float CanTpMainFunctionPeriod: 0..Inf, scope=ECU, set at pre-compile, default-value=0.005  # Allow to configure the time for the MainFunction (as float in seconds). The CanTpMainFunctionPeriod should be assigned a value which is optimal regarding all of the timers configured for CanTp in TX and RX data transfer i.e. the differences from the configured timing should be as small as possible. Please note: This period shall be the same as call cycle time of the periodic task were CanTp Main function is called.
      integer CanTpMaxChannelCnt [0..1]: 0..18446744073709551615, multiplicity set at pre-compile, set at pre-compile  # Maximum number of channels. This parameter is needed only in case of post-build loadable implementation using static memory allocation.
      container CanTpChannel [1..*]: multiplicity set at post-build in variant post-build / pre-compile in variant pre-compile, post-build-variant-multiplicity=true  # This container contains the configuration parameters of the CanTp channel.
        container CanTpRxNSdu [0..*]: multiplicity set at post-build in variant post-build / pre-compile in variant pre-compile, post-build-variant-multiplicity=true  # The following parameters needs to be configured for each CAN N-SDU that the CanTp module receives via the CanTpChannel. This N-SDU produces meta data items of type SOURCE_ADDRESS_16, TARGET_ADDRESS_16 and ADDRESS_EXTENSION_8.
          integer CanTpBs [0..1]: 0..255, multiplicity set at post-build in variant post-build / pre-compile in variant pre-compile, post-build-variant-multiplicity=true, post-build-variant-value=true, set at post-build in variant post-build / pre-compile in variant pre-compile, default-value=0  # Sets the number of N-PDUs the CanTp receiver allows the sender to send, before waiting for an authorization to continue transmission of the following N-PDUs.For further details on this parameter value see ISO 15765-2 specification.
          float CanTpNar [0..1]: 0..Inf, multiplicity set at post-build in variant post-build / pre-compile in variant pre-compile, post-build-variant-multiplicity=true, post-build-variant-value=true, set at post-build in variant post-build / pre-compile in variant pre-compile, default-value=1  # Value in seconds of the N_Ar timeout. N_Ar is the time for transmission of a CAN frame (any N_PDU) on the receiver side.
          float CanTpNbr [0..1]: 0..Inf, post-build-variant-value=true, set at post-build in variant post-build / pre-compile in variant pre-compile, default-value=0.005  # Value in seconds of the performance requirement for (N_Br + N_Ar). N_Br is the elapsed time between the receiving indication of a FF or CF or the transmit confirmation of a FC, until the transmit request of the next FC.
          float CanTpNcr [0..1]: 0..Inf, multiplicity set at post-build in variant post-build / pre-compile in variant pre-compile, post-build-variant-multiplicity=true, post-build-variant-value=true, set at post-build in variant post-build / pre-compile in variant pre-compile, default-value=1  # Value in seconds of the N_Cr timeout. N_Cr is the time until reception of the next Consecutive Frame N_PDU.
          enumeration CanTpRxAddressingFormat: {CANTP_EXTENDED, CANTP_MIXED, CANTP_MIXED29BIT, CANTP_NORMALFIXED, CANTP_STANDARD}, set at pre-compile, default-value=CANTP_STANDARD  # Declares which communication addressing mode is supported for this RxNSdu. Definition of Enumeration values: | CanTpStandard to use normal addressing format. CanTpExtended to use extended addressing format. CanTpMixed to use mixed 11 bit addressing format. CanTpNormalFixed to use normal fixed addressing format. CanTpMixed29Bit to use mixed 29 bit addressing format.
          integer CanTpRxNSduId: 0..65535, set at pre-compile, symbolic-name-value=true  # Unique identifier user by the upper layer to call CanTp_CancelReceive, CanTp_ChangeParameter and CanTp_ReadParameter.
          enumeration CanTpRxPaddingActivation: {CANTP_OFF, CANTP_ON}, post-build-variant-value=true, set at post-build in variant post-build / pre-compile in variant pre-compile, default-value=CANTP_ON  # Defines if the receive frame uses padding or not. This parameter is restricted to 8 byte N-PDUs. | Definition of enumeration values: CanTpOn: The N-PDU received uses padding for SF, FC and the last CF. (N-PDU length is always >= 8 bytes in case of CAN 2.0) CanTpOff: The N-PDU received does not use padding for SF, CF and the last CF. (N-PDU length is dynamic - any valid DLC value). Note: The mandatory mapping to the next higher valid DLC value for N-PDUs with a length > 8 bytes is not affected by this parameter.
          enumeration CanTpRxTaType: {CANTP_FUNCTIONAL, CANTP_PHYSICAL}, set at pre-compile  # Declares the communication type of this Rx N-SDU.
          integer CanTpRxWftMax [0..1]: 0..65535, multiplicity set at post-build in variant post-build / pre-compile in variant pre-compile, post-build-variant-multiplicity=true, post-build-variant-value=true, set at post-build in variant post-build / pre-compile in variant pre-compile, default-value=0  # This parameter indicates how many Flow Control wait N-PDUs can be consecutively transmitted by the receiver. It is local to the node and is not transmitted inside the FC protocol data unit. | CanTpRxWftMax is used to avoid sender nodes being potentially hooked-up in case of a temporarily reception inability on the part of the receiver nodes, whereby the sender could be waiting continuously.
          float CanTpSTmin [0..1]: 0..Inf, multiplicity set at post-build in variant post-build / pre-compile in variant pre-compile, post-build-variant-multiplicity=true, post-build-variant-value=true, set at post-build in variant post-build / pre-compile in variant pre-compile, default-value=0.005  # Sets the duration of the minimum time the CanTp sender shall wait between the transmissions of two CF N-PDUs. | For further details on this parameter value see ISO 15765-2 specification.
          reference CanTpRxNSduRef: post-build-variant-value=true, set at post-build in variant post-build / pre-compile in variant pre-compile, destination=Pdu  # Reference to a Pdu in the COM-Stack.
          container CanTpNAe [0..1]  # This container is required for each RxNSdu and TxNSdu with AddressingFormat CANTP_MIXED or CANTP_MIXED29BIT.
            integer CanTpNAe: 0..255, set at pre-compile  # This parameter contains the transport protocol address extension value.
          container CanTpNSa [0..1]  # This container is required for each RxNSdu and TxNSdu with RxTaType CANTP_PHYSICAL and CanTpAddressingFormat CANTP_EXTENDED. When DynIdSupport is enabled, this container is also required for each TxNSdu with AddressingFormat CANTP_NORMALFIXED or CANTP_MIXED29BIT. When DynIdSupport is enabled and GenericConnectionSupport is not enabled, this container is also required for each RxNSdu with AddressingFormat CANTP_NORMALFIXED or CANTP_MIXED29BIT.
            integer CanTpNSa: 0..255, set at pre-compile  # This parameter contains the transport protocol source address value.
          container CanTpNTa [0..1]  # This container is required for each RxNSdu and TxNSdu with AddressingFormat CANTP_EXTENDED. When DynIdSupport is enabled, this container is also required for each RxNSdu with AddressingFormat CANTP_NORMALFIXED or CANTP_MIXED29BIT. When DynIdSupport is enabled and GenericConnectionSupport is not enabled, this container is also required for each TxNSdu with AddressingFormat CANTP_NORMALFIXED or CANTP_MIXED29BIT.
            integer CanTpNTa: 0..255, set at pre-compile  # This parameter contains the transport protocol target address value.
          container CanTpRxNPdu  # Used for grouping of the ID of a PDU and the Reference to a PDU. This N-PDU consumes a meta data item of type CAN_ID_32.
            integer CanTpRxNPduId: 0..65535, set at pre-compile, symbolic-name-value=true  # The N-PDU identifier attached to the RxNsdu is identified by CanTpRxNSduId. | Each RxNsdu identifier is linked to only one SF/FF/CF N-PDU identifier. Nevertheless, in the case of extended or mixed addressing format, the same N-PDU identifier can be used for several N-SDU identifiers. The distinction is made by the N_TA or N_AE value (first data byte of SF or FF frames).
            reference CanTpRxNPduRef: post-build-variant-value=true, set at post-build in variant post-build / pre-compile in variant pre-compile, destination=Pdu  # Reference to a Pdu in the COM-Stack.
          container CanTpTxFcNPdu [0..1]  # Used for grouping of the ID of a PDU and the Reference to a PDU. This N-PDU produces a meta data item of type CAN_ID_32.
            integer CanTpTxFcNPduConfirmationPduId: 0..65535, set at pre-compile, symbolic-name-value=true  # Handle Id to be used by the CanIf to confirm the transmission of the CanTpTxFcNPdu to the CanIf module.
            reference CanTpTxFcNPduRef: post-build-variant-value=true, set at post-build in variant post-build / pre-compile in variant pre-compile, destination=Pdu  # Reference to a Pdu in the COM-Stack.
        container CanTpTxNSdu [0..*]: multiplicity set at post-build in variant post-build / pre-compile in variant pre-compile, post-build-variant-multiplicity=true  # The following parameters needs to be configured for each CAN N-SDU that the CanTp module transmits via the CanTpChannel. This N-SDU consumes meta data items of type SOURCE_ADDRESS_16, TARGET_ADDRESS_16 and ADDRESS_EXTENSION_8.
          float CanTpNas: 0..Inf, post-build-variant-value=true, set at post-build in variant post-build / pre-compile in variant pre-compile, default-value=1  # Value in second of the N_As timeout. N_As is the time for transmission of a CAN frame (any N_PDU) on the part of the sender.
          float CanTpNbs [0..1]: 0..Inf, multiplicity set at post-build in variant post-build / pre-compile in variant pre-compile, post-build-variant-multiplicity=true, post-build-variant-value=true, set at post-build in variant post-build / pre-compile in variant pre-compile, default-value=1  # Value in seconds of the N_Bs timeout. N_Bs is the time of transmission until reception of the next Flow Control N_PDU.
          float CanTpNcs [0..1]: 0..Inf, multiplicity set at post-build in variant post-build / pre-compile in variant pre-compile, post-build-variant-multiplicity=true, post-build-variant-value=true, set at post-build in variant post-build / pre-compile in variant pre-compile, default-value=0.005  # Value in seconds of the performance requirement of (N_Cs + N_As). N_Cs is the time in which CanTp is allowed to request the Tx data of a Consecutive Frame N_PDU.
          boolean CanTpTc: set at pre-compile, default-value=true  # Switch for enabling Transmit Cancellation.
          enumeration CanTpTxAddressingFormat: {CANTP_EXTENDED, CANTP_MIXED, CANTP_MIXED29BIT, CANTP_NORMALFIXED, CANTP_STANDARD}, set at pre-compile, default-value=CANTP_STANDARD  # Declares which communication addressing format is supported for this TxNSdu. Definition of Enumeration values: | CanTpStandard to use normal addressing format. CanTpExtended to use extended addressing format. CanTpMixed to use mixed 11 bit addressing format. CanTpNormalFixed to use normal fixed addressing format. CanTpMixed29Bit to use mixed 29 bit addressing format.
          integer CanTpTxNSduId: 0..65535, set at pre-compile, symbolic-name-value=true  # Unique identifier to a structure that contains all useful information to process the transmission of a TxNsdu.
          enumeration CanTpTxPaddingActivation: {CANTP_OFF, CANTP_ON}, post-build-variant-value=true, set at post-build in variant post-build / pre-compile in variant pre-compile, default-value=CANTP_ON  # Defines if the transmit frame use padding or not. This parameter is restricted to 8 byte N-PDUs. | Definition of Enumeration values: CanTpOn The transmit N-PDU uses padding for SF, FC and the last CF. (N-PDU length is always 8 bytes in case of CAN 2.0) CanTpOff The transmit N-PDU does not use padding for SF, CF and the last CF. (N-PDU length is dynamic - any valid DLC value). Note: The mandatory mapping to the next higher valid DLC value for N-PDUs with a length > 8 bytes is not affected by this parameter.
          enumeration CanTpTxTaType: {CANTP_FUNCTIONAL, CANTP_PHYSICAL}, set at pre-compile  # Declares the communication type of this TxNsdu. | Enumeration values: CanTpPhysical. Used for 1:1 communication. CanTpFunctional. Used for 1:n communication.
          reference CanTpTxNSduRef: post-build-variant-value=true, set at post-build in variant post-build / pre-compile in variant pre-compile, destination=Pdu  # Reference to a Pdu in the COM-Stack.
          container CanTpNAe [0..1]  # This container is required for each RxNSdu and TxNSdu with AddressingFormat CANTP_MIXED or CANTP_MIXED29BIT.
            integer CanTpNAe: 0..255, set at pre-compile  # This parameter contains the transport protocol address extension value.
          container CanTpNSa [0..1]  # This container is required for each RxNSdu and TxNSdu with RxTaType CANTP_PHYSICAL and CanTpAddressingFormat CANTP_EXTENDED. When DynIdSupport is enabled, this container is also required for each TxNSdu with AddressingFormat CANTP_NORMALFIXED or CANTP_MIXED29BIT. When DynIdSupport is enabled and GenericConnectionSupport is not enabled, this container is also required for each RxNSdu with AddressingFormat CANTP_NORMALFIXED or CANTP_MIXED29BIT.
            integer CanTpNSa: 0..255, set at pre-compile  # This parameter contains the transport protocol source address value.
          container CanTpNTa [0..1]  # This container is required for each RxNSdu and TxNSdu with AddressingFormat CANTP_EXTENDED. When DynIdSupport is enabled, this container is also required for each RxNSdu with AddressingFormat CANTP_NORMALFIXED or CANTP_MIXED29BIT. When DynIdSupport is enabled and GenericConnectionSupport is not enabled, this container is also required for each TxNSdu with AddressingFormat CANTP_NORMALFIXED or CANTP_MIXED29BIT.
            integer CanTpNTa: 0..255, set at pre-compile  # This parameter contains the transport protocol target address value.
          container CanTpRxFcNPdu [0..1]  # Used for grouping of the ID of a PDU and the Reference to a PDU. This N-PDU consumes a meta data item of type CAN_ID_32.
            integer CanTpRxFcNPduId: 0..65535, set at pre-compile, symbolic-name-value=true  # N-PDU identifier attached to the FC N-PDU of this TxNsdu identified by CanTpTxNSduId. | Each TxNsdu identifier is linked to one Rx FC N-PDU identifier only. However, in the case of extended addressing format, the same FC N-PDU identifier can be used for several N-SDU identifiers. The distinction is made by means of the N_TA value (first data byte of FC frames).
            reference CanTpRxFcNPduRef: post-build-variant-value=true, set at post-build in variant post-build / pre-compile in variant pre-compile, destination=Pdu  # Reference to a Pdu in the COM-Stack.
          container CanTpTxNPdu  # Used for grouping of the ID of a PDU and the Reference to a PDU. This N-PDU produces a meta data item of type CAN_ID_32.
            integer CanTpTxNPduConfirmationPduId: 0..65535, set at pre-compile, symbolic-name-value=true  # Handle Id to be used by the CanIf to confirm the transmission of the CanTpTxNPdu to the CanIf module.
            reference CanTpTxNPduRef: post-build-variant-value=true, set at post-build in variant post-build / pre-compile in variant pre-compile, destination=Pdu  # Reference to a Pdu in the COM-Stack.
    container CanTpGeneral  # This container contains the general configuration parameters of the CanTp module.
      boolean CanTpChangeParameterApi: set at pre-compile, default-value=true  # This parameter, if set to true, enables the CanTp_ChangeParameterRequest Api for this Module.
      boolean CanTpDevErrorDetect: set at pre-compile, default-value=true  # Switches the development error detection and notification on or off. | * true: detection and notification is enabled. * false: detection and notification is disabled.
      boolean CanTpDynIdSupport [0..1]: multiplicity set at pre-compile, set at pre-compile, default-value=false  # Enable support for dynamic ID handling via N-PDU MetaData.
      boolean CanTpFlexibleDataRateSupport [0..1]: set at pre-compile  # Enable support for CAN FD frames.
      boolean CanTpGenericConnectionSupport [0..1]: multiplicity set at pre-compile, set at pre-compile, default-value=false  # Enable support for the handling of generic connections using N-SDUs with MetaData. Requires CanTpDynIdSupport.
      integer CanTpPaddingByte: 0..255, set at pre-compile, default-value=170  # Used for the initialization of unused bytes with a certain value
      boolean CanTpReadParameterApi: set at pre-compile, default-value=false  # This parameter, if set to true, enables the CanTp_ReadParameterApi for this module.
      boolean CanTpVersionInfoApi: set at pre-compile, default-value=false  # The function CanTp_GetVersionInfo is configurable (On/Off) by this configuration parameter.
