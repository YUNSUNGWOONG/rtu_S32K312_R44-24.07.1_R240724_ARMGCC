AUTOSAR XML (schema 00047)
# (C) 2021 HYUNDAI AUTOEVER Corp.
# Confidential Proprietary Information. Distribution Limited.
# Do Not Copy Without Prior Permission
package /AUTRON
  ecuc definition collection ParameterDefinition_BswM: module=BswM
  module definition BswM [0..1]: category=VENDOR_SPECIFIC_MODULE_DEFINITION, post-build-variant-support=true, refined-module-def=BswM, variants link-time/post-build/pre-compile/post-build-selectable/post-build-loadable  # Configuration of the BswM (Basic SW Mode Manager) module.
    container BswMConfig [1..*]  # This container contains the configuration parameters and sub containers of the AUTOSAR BswM module. This container exists once per partition.
      reference BswMPartitionRef [0..1]: multiplicity set at pre-compile, set at pre-compile, destination=EcucPartition  # This references the partition the BswM shall run inside.
      reference BswMOsTaskRef: multiplicity set at pre-compile, set at pre-compile, destination=OsTask  # This references the Os Task that the BswM dequeue processing shall run inside.
      reference BswMOsEventRef: multiplicity set at pre-compile, set at pre-compile, destination=OsEvent  # This references the Os Event.
      container BswMArbitration  # This container includes all configuration sub-containers and parameters related to the mode arbitration functionality of the BswM.
        container BswMEventRequestPort [0..*]: multiplicity set at pre-compile  # Each instance of this container defines an event which can be sent to the BswM. Basic Software Modules may send these events to the BswM by calling the corresponding BswM C-API (for example: BswM_ComM_InitiateReset()).
          enumeration BswMEventRequestProcessing: {BSWM_DEFERRED, BSWM_IMMEDIATE}, set at link in variant link-time+post-build / pre-compile in variant pre-compile  # This parameter defines if the processing of the mode arbitration shall be done immediately when an event request is received or if it shall be deferred to the processing of the main function of BswM.
          choice container BswMEventRequestSource  # This choice container specifies the source of the event request. The sender of the event can be another BSW Module, such as ComM.
            container BswMComMInitiateReset [0..1]  # This is an indication from the ComM to signal a shutdown.
            container BswMDcmApplicationUpdatedIndication [0..1]  # This is a request to update application data from the DCM. This container does not contain any parameters since there are no further configuration needed for this type of request.
            container BswMModeSwitchErrorEvent [0..1]  # This is a notification that an error occurred because the partition containing mode users of the referenced PPort was restarted by the RTE. Because the Mode Machine Instance holding the current mode can reside on that terminated partition, the Mode Manager has to be informed about | the loss of this partition.
              reference BswMRteSwitchPortRef: set at link in variant link-time+post-build / pre-compile in variant pre-compile, destination=BswMSwitchPort  # This is a reference to the BswMSwitchPort.
            container BswMNmCarWakeUpIndication [0..1]  # This is an indication of a CarWakeup from the Nm.
              reference BswMNmChannelRef: set at link in variant link-time+post-build / pre-compile in variant pre-compile, requires-symbolic-name-value=true, destination=ComMChannel  # This is a reference to the channel handle that the indication corresponds to.
            container BswMPartitionRestarted [0..1]  # This is a notification that an error occured because the partition containing the BswM was restarted by the RTE. The Mode Users may lie in another (still running) partition. So the BswM has to be informed that the start of its partition is no normal startup but a restart of a single partition. This information can be used inside the Rules. This notification has to be used by the Restart Task of the particular partition.
            container BswMWdgMRequestPartitionReset [0..1]  # This is a Partition Reset request from from the WdgM. This port | corresponds to a call of the BswM_WdgM_RequestPartitionReset API.
              reference BswMWdgMRequestPartitionResetRef: set at link in variant link-time+post-build / pre-compile in variant pre-compile, destination=EcucPartition  # This is a reference to the partition that shall be reset.
        container BswMLogicalExpression [0..*]: multiplicity set at pre-compile  # This container describes the logical expressions that can be used for the mode arbitration. The logical expressions are built of a set of arguments and a logical operator. | Each argument can either be a mode condition or a sub-expression to allow definition of more complex logical expressions. There may be an unlimited number of arguments in each logical expression. Note that the order of evaluation of the expressions is not defined.
          enumeration BswMLogicalOperator [0..1]: {BSWM_AND, BSWM_NAND, BSWM_NOT, BSWM_OR, BSWM_XOR}, multiplicity set at link in variant link-time+post-build / pre-compile in variant pre-compile, set at link in variant link-time+post-build / pre-compile in variant pre-compile  # This parameter specifies the logical operator to be used in the logical expression. If the logical operator is set to something other than BSWM_NOT, and the expression only consists of a single condition, then this parameter will have no effect.
          choice reference BswMArgumentRef [1..*]: multiplicity set at link in variant link-time+post-build / pre-compile in variant pre-compile, set at link in variant link-time+post-build / pre-compile in variant pre-compile, destination=[BswMLogicalExpression, BswMModeCondition]  # This is a choice reference either to a mode condition or a sub-expression. | In case the BswMLogicalExpression.BswMLogicalOperator equals BSWM_NAND only two operands are supported. In case the BswMLogicalExpression.BswMLogicalOperator equals BSWM_NOT only one operand is supported.
        container BswMModeCondition [0..*]: multiplicity set at pre-compile  # This container describes the BswM mode conditions that can be used either by itself to form a rule or as a part of a logical expression.
          enumeration BswMConditionType: {BSWM_EQUALS, BSWM_EQUALS_NOT, BSWM_EVENT_IS_CLEARED, BSWM_EVENT_IS_SET}, set at link in variant link-time+post-build / pre-compile in variant pre-compile  # This parameter specifies what kind of comparison that is made for the evaluation of the mode condition. | For BSWM_EQUALS and BSWM_EQUALS_NOT, the BswMModeRequestPort port referenced by BswMConditionMode is compared with the value configured in BswMConditionValue for equality or not-equality. For BSWM_EVENT_IS_SET and BSWM_EVENT_IS_CLEARED, the BswMEventRequestPort port referenced by BswMConditionMode is checked for being set or cleared (not-set).
          choice reference BswMConditionMode: set at link in variant link-time+post-build / pre-compile in variant pre-compile, destination=[BswMEventRequestPort, BswMModeRequestPort]  # This parameter references either a mode request port or an event request port.
          choice container BswMConditionValue [0..1]  # This container holds the parameters and references necessary to identify the mode type and the value that the mode request is compared to.
            container BswMBswMode [0..1]  # This container defines the value and type of a mode in the BSW. The mode value is defined by configuring either BswMBswRequestedMode or BswMCompuScaleModeValue.
              string BswMBswRequestedMode [0..1]: multiplicity set at pre-compile, set at pre-compile  # This parameter contains the symbolic name (as a string) of a certain mode/state that can be requested/indicated by the BSW modules.
              container BswMCompuScaleModeValue [0..1]  # This container contains parameters used to define a mode value.
                string BswMCompuConstText: set at pre-compile  # The value of this parameter shall match the VT member of a CompuConst defined within the referenced CompuMethod (BswMCompuMethodRef). The interval value of the corresponding CompuScale shall be used as the mode request value.
                foreign reference BswMCompuMethodRef: set at pre-compile, destination-type=COMPU-METHOD  # This is a foreign reference to the CompuMethod used for mode requests.
            container BswMModeDeclaration [0..1]  # When the mode corresponds to a mode request or mode indication interface the mode is defined by a mode declaration. The mode declarations are defined in the SW-C Template and hence a foreign reference to the corresponding Mode Declaration is used.
              foreign reference BswMModeValueRef: set at link in variant link-time+post-build / pre-compile in variant pre-compile, destination-type=MODE-DECLARATION  # This is a foreign reference to the Mode Declaration used for the mode requests corresponding to this condition.
        container BswMModeRequestPort [0..*]: multiplicity set at pre-compile  # Each instance of this container defines a mode request interface that is used to requests or indicate modes from/to the BswM. These interfaces are implemented as ports or as ordinary C-functions based upon if the request is made by an SW-C or a BSW module. | There are different types of mode requests: 1. Mode requests from the SW-C:s 2. Mode Requests from other BSW modules such as the DCM. 3. State/mode indications from the RTE or other BSW modules such as the bus specific State Managers. Note that the BswM treats all request and indications in the exact same way.
          enumeration BswMRequestProcessing: {BSWM_DEFERRED, BSWM_IMMEDIATE}, set at link in variant link-time+post-build / pre-compile in variant pre-compile  # This parameter defines if the processing of the mode arbitration shall be done immediately when a mode request is received or if it shall be deferred to the processing of the main function of BswM.
          container BswMModeInitValue [0..1]  # This container defines the initial mode value that is used by BswM for the corresponding mode request after initialization. The initial mode value is defined by configuring either BswMBswModeInitValue or BswMCompuScaleModeValue. This container is optional.
            string BswMBswModeInitValue [0..1]: multiplicity set at pre-compile, set at pre-compile  # This parameter defines the initial mode value that is used by BswM for the corresponding mode request after initialization.
            container BswMCompuScaleModeValue [0..1]  # This container contains parameters used to define a mode value.
              string BswMCompuConstText: set at pre-compile  # The value of this parameter shall match the VT member of a CompuConst defined within the referenced CompuMethod (BswMCompuMethodRef). The interval value of the corresponding CompuScale shall be used as the mode request value.
              foreign reference BswMCompuMethodRef: set at pre-compile, destination-type=COMPU-METHOD  # This is a foreign reference to the CompuMethod used for mode requests.
          choice container BswMModeRequestSource  # This choice container specifies the source of the mode request or state/mode indication. The requester of a mode can be both SW-C:s and other BSW Modules, such as the bus specific State Managers.
            container BswMBswModeNotification [0..1]  # This is a mode request source emanating from another BSW Module.
              foreign reference BswMBswModeDeclarationGroupPrototypeRef: set at link in variant link-time+post-build / pre-compile in variant pre-compile, destination-type=MODE-DECLARATION-GROUP-PROTOTYPE  # This is a foreign reference to the Mode Declaration Group Prototype.
            container BswMCanSMIcomIndication [0..1]  # This is an indication from CanSM of the configuration Id of the Icom configuration
              enumeration BswMCanSMIcomIndicationSwitchError: {BSWM_ICOM_SWITCH_E_FAILED, BSWM_ICOM_SWITCH_E_OK}, set at link in variant link-time+post-build / pre-compile in variant pre-compile  # Identifies the type of indications (error or error-free) from the CanSM which this mode request corresponds to.
              reference BswMCanSMChannelRef: set at link in variant link-time+post-build / pre-compile in variant pre-compile, requires-symbolic-name-value=true, destination=ComMChannel  # This is a reference to the CAN channel handle that the mode request corresponds to.
            container BswMCanSMIndication [0..1]  # This is an indication of the current state of the CAN State Manager.
              reference BswMCanSMChannelRef: set at link in variant link-time+post-build / pre-compile in variant pre-compile, requires-symbolic-name-value=true, destination=ComMChannel  # This is a reference to the CAN channel handle that the mode request corresponds to.
            container BswMComMIndication [0..1]  # This is an indication of the current communication mode of a channel in the Communication Manager.
              reference BswMComMChannelRef: set at link in variant link-time+post-build / pre-compile in variant pre-compile, requires-symbolic-name-value=true, destination=ComMChannel  # This is a reference to the Communication Manager channel handle that the indication corresponds to.
            container BswMComMPncRequest [0..1]  # This is a request of the current communication mode of a Partial Network Cluster in the Communication Manager.
              reference BswMComMPncRef: set at link in variant link-time+post-build / pre-compile in variant pre-compile, requires-symbolic-name-value=true, destination=ComMPnc  # This is a reference to the Communication Manager PNC handle of the Partial Network Cluster that the request corresponds to.
            container BswMDcmComModeRequest [0..1]  # The source of the mode request is the Diagnostic Communication Manager.
              reference BswMDcmComMChannelRef: set at link in variant link-time+post-build / pre-compile in variant pre-compile, requires-symbolic-name-value=true, destination=ComMChannel  # This is a reference from DcmModeRequest to the ComM channel that the indication corresponds to.
            container BswMEcuMIndication [0..1]  # This is a notification of the current operation mode of the ECU State Manager. This container does not contain any parameters since there are no further configuration needed for this type of request.
            container BswMEcuMRUNRequestIndication [0..1]  # This is an indication of the current State of the RUN Request Protocol.
              enumeration BswMEcuMRUNRequestProtocolPort: {BSWM_ECUM_STATE_APP_POST_RUN, BSWM_ECUM_STATE_APP_RUN}, set at link in variant link-time+post-build / pre-compile in variant pre-compile  # Identifies the EcuM State which is related to the mode request.
            container BswMEcuMWakeupSource [0..1]  # This is a notification of the current state of an ECU State Manager wakeup source.
              reference BswMEcuMWakeupSrcRef: set at link in variant link-time+post-build / pre-compile in variant pre-compile, requires-symbolic-name-value=true, destination=EcuMWakeupSource  # This is a reference to the ECU State Manager Wakeup Source that the indication corresponds to.
            container BswMEthIfPortGroupLinkStateChg [0..1]  # This is an indication from the EthIf if the link state of a Ethernet interface switch port group has changed.
              reference BswMEthIfSwitchPortGroupRef: post-build-variant-value=true, set at link in variant link-time+post-build / pre-compile in variant pre-compile, requires-symbolic-name-value=true, destination=EthIfSwitchPortGroup  # This is a reference to the Ethernet Interface Switch Port Group that the indication corresponds to.
            container BswMEthSMIndication [0..1]  # This is an indication of the current state of the Ethernet State Manager.
              reference BswMEthSMChannelRef: set at link in variant link-time+post-build / pre-compile in variant pre-compile, requires-symbolic-name-value=true, destination=ComMChannel  # This is a reference to the Ethernet channel handle that the mode request corresponds to.
            container BswMFrSMIndication [0..1]  # This is an indication of the current state of the FlexRay State Manager.
              reference BswMFrSMChannelRef: set at link in variant link-time+post-build / pre-compile in variant pre-compile, requires-symbolic-name-value=true, destination=ComMChannel  # This is a reference to the FlexRay Cluster handle that the mode request corresponds to.
            container BswMGenericRequest [0..1]  # This mode request originates from a requester that is not among the list of standardized mode requesters (i.e. the different resource managers).
              integer BswMModeRequesterId: 0..65535, set at pre-compile, symbolic-name-value=true  # This parameters identifies the different users of the generic mode request interface.
            container BswMJ1939DcmBroadcastStatus [0..1]  # This is a notification of the desired broadcast status per network, triggered via DM13.
              reference BswMJ1939DcmChannelRef: set at link in variant link-time+post-build / pre-compile in variant pre-compile, requires-symbolic-name-value=true, destination=ComMChannel  # Reference to the communication channel which is affected by this mode request.
            container BswMJ1939NmIndication [0..1]  # This is an indication of the current state of the J1939 network management module.
              reference BswMJ1939NmChannelRef: set at link in variant link-time+post-build / pre-compile in variant pre-compile, requires-symbolic-name-value=true, destination=ComMChannel  # This is a reference to the J1939Nm channel handle that the mode request corresponds to.
              reference BswMJ1939NmNodeRef: set at link in variant link-time+post-build / pre-compile in variant pre-compile, requires-symbolic-name-value=true, destination=J1939NmNode  # This is a reference to the node that the mode request corresponds to.
            container BswMLinSMIndication [0..1]  # This is an indication of the current state of the LIN State Manager.
              reference BswMLinSMChannelRef: set at link in variant link-time+post-build / pre-compile in variant pre-compile, requires-symbolic-name-value=true, destination=ComMChannel  # This is a reference to the LIN channel handle that the mode request corresponds to.
            container BswMLinScheduleIndication [0..1]  # This is an indication of the currently active LIN Schedule Table for a specific LIN Interface.
              reference BswMLinScheduleRef: post-build-variant-value=true, set at link in variant link-time / post-build in variant post-build / pre-compile in variant pre-compile, requires-symbolic-name-value=true, destination=LinSMSchedule  # This is a reference to the LIN Schedule Table handle that the mode request corresponds to.
              reference BswMLinSMChannelRef: post-build-variant-value=true, set at link in variant link-time / post-build in variant post-build / pre-compile in variant pre-compile, requires-symbolic-name-value=true, destination=ComMChannel  # This is a reference to the LIN channel handle that the mode request corresponds to.
            container BswMLinTpModeRequest [0..1]  # This is a LinTp mode request from the LinIf. This port corresponds to a call of the BswM_LinTp_RequestMode API.
              reference BswMLinTpChannelRef: set at link in variant link-time+post-build / pre-compile in variant pre-compile, requires-symbolic-name-value=true, destination=ComMChannel  # This is a reference to the LIN Interface Channel that the mode | request corresponds to.
            container BswMNvMJobModeIndication [0..1]  # Indicates the current status of the multiblock job. The job is identified via BswMNvmService. Possible values for this indication are the possible values of NvM_RequestResultType.
              enumeration BswMNvmService: {NvmCancelWriteAll, NvmFirstInitAll, NvmReadAll, NvmValidateAll, NvmWriteAll}, set at link in variant link-time+post-build / pre-compile in variant pre-compile  # Identifies the Nvm job which is related to the mode request.
            container BswMNvMRequest [0..1]  # Via this Mode Request Source the NvM indicates the current status of the specified block. Possible Values are: | NvM_RequestResultType NVM_REQ_OK NVM_REQ_NOT_OK NVM_REQ_PENDING NVM_REQ_INTEGRITY_FAILED NVM_REQ_BLOCK_SKIPPED NVM_REQ_NV_INVALIDATED NVM_REQ_CANCELED NVM_REQ_REDUNDANCY_FAILED NVM_REQ_RESTORED_FROM_ROM
              reference BswMNvMBlockRef: set at link in variant link-time+post-build / pre-compile in variant pre-compile, requires-symbolic-name-value=true, destination=NvMBlockDescriptor  # This is a reference to the NvM Block Descriptor that the request corresponds to.
            container BswMSdClientServiceCurrentState [0..1]  # Used by Service Discovery module to indicate current state of the Client Service (available/down).
              reference BswMSdClientMethodsRef: set at link in variant link-time+post-build / pre-compile in variant pre-compile, requires-symbolic-name-value=true, destination=SdClientService  # This is a reference to a client service in the Sd module.
            container BswMSdConsumedEventGroupCurrentState [0..1]  # Used by Service Discovery to indicate current status of the EventHandler (requested/released).
              reference BswMSdConsumedEventGroupRef: set at link in variant link-time+post-build / pre-compile in variant pre-compile, requires-symbolic-name-value=true, destination=SdConsumedEventGroup  # This is a reference to an eventGroup that is defined within a client service in the Sd module.
            container BswMSdEventHandlerCurrentState [0..1]  # Used by Service Discovery to indicate current status of the EventHandler (requested/released).
              reference BswMSdEventHandlerRef: set at link in variant link-time+post-build / pre-compile in variant pre-compile, requires-symbolic-name-value=true, destination=SdEventHandler  # This is a reference to an event handler that is defined within a server service in the Sd module.
            container BswMSwcModeNotification [0..1]  # This is a mode switch notification associated with a RTE switch interface.
              foreign reference BswMSwcModeNotificationModeDeclarationGroupPrototypeRef: set at link in variant link-time+post-build / pre-compile in variant pre-compile, destination-type=MODE-DECLARATION-GROUP-PROTOTYPE  # This is a foreign reference to the ModeDeclarationGroupPrototype.
            container BswMSwcModeRequest [0..1]  # The source of the mode request is a SW Component.
              foreign reference BswMSwcModeRequestVariableDataPrototypeRef: post-build-variant-value=true, set at link in variant link-time / post-build in variant post-build / pre-compile in variant pre-compile, destination-type=VARIABLE-DATA-PROTOTYPE  # This is a reference to the VariableDataPrototype.
            container BswMTimer [0..1]  # This is a timer which can be used for time dependent rules. This mode request port can be in one of three modes (depending on the state of the timer): | * BSWM_TIMER_STOPPED (intial) (The timer has been stopped by an action) * BSWM_TIMER_STARTED (The timer has been started by an action) * BSWM_TIMER_EXPIRED (The timer has expired)
        container BswMRule [0..*]: multiplicity set at link in variant link-time / post-build in variant post-build / pre-compile in variant pre-compile, post-build-variant-multiplicity=true  # Each instance of this container describes a BswM arbitration rule. The rule either consists of a simple mode condition or a more complex logical expression. This container also references the action lists that shall be invoked when the rule is evaluated to True or False.
          boolean BswMNestedExecutionOnly: set at link in variant link-time+post-build / pre-compile in variant pre-compile, default-value=false  # This parameter defines for its related Rule if the Rule is an Independent rule or a Subordinate rule; | false: an Independent rule, i.e. to be evaluated each time applicable (both as standalone Rule driven by its own BswMModeRequestSource and when referenced by another Rule). true: a Subordinated rule, to be evaluated ONLY as a result of being referenced in one or more Action Lists.
          enumeration BswMRuleInitState: {BSWM_FALSE, BSWM_TRUE, BSWM_UNDEFINED}, set at link in variant link-time+post-build / pre-compile in variant pre-compile  # This parameter is a part of the reset/initialization behavior of BswM. | Action lists are executed when the result of a rule evaluation have changed since the last evaluation. This parameter defines the "previous evaluation result" of a rule to be used after initialization of the BswM. If this parameter is set to BSWM_UNDEFINED, the evaluation result is always treated as changed at the first evaluation of the rule after initialization. If this parameter is set to BSWM_TRUE, the evaluation result is treated as changed if the rule is evaluated to false. If this parameter is set to BSWM_FALSE, the evaluation result is treated as changed if the rule is evaluated to true.
          reference BswMRuleExpressionRef: set at link in variant link-time+post-build / pre-compile in variant pre-compile, destination=BswMLogicalExpression  # This is a reference to the logical expression that is evaluated for each rule.
          reference BswMRuleFalseActionList [0..1]: multiplicity set at link in variant link-time / post-build in variant post-build / pre-compile in variant pre-compile, post-build-variant-multiplicity=true, post-build-variant-value=true, set at link in variant link-time / post-build in variant post-build / pre-compile in variant pre-compile, destination=BswMActionList  # This is a reference to the action list that shall be executed when the rule is evaluated to False
          reference BswMRuleTrueActionList [0..1]: multiplicity set at link in variant link-time / post-build in variant post-build / pre-compile in variant pre-compile, post-build-variant-multiplicity=true, post-build-variant-value=true, set at link in variant link-time / post-build in variant post-build / pre-compile in variant pre-compile, destination=BswMActionList  # This is a reference to the action list that shall be executed when the rule is evaluated to True
      container BswMDataTypeMappingSets [0..1]  # Collection of references to DataTypeMappingSet.
        foreign reference BswMDataTypeMappingSetRef [1..*]: multiplicity set at link in variant link-time+post-build / pre-compile in variant pre-compile, set at link in variant link-time+post-build / pre-compile in variant pre-compile, destination-type=DATA-TYPE-MAPPING-SET  # Reference to DataTypeMappingSet.
      container BswMModeControl  # This container includes all configuration sub-containers and parameters related to the mode control functionality of the BswM.
        container BswMAction [0..*]: multiplicity set at pre-compile  # Each container of this type defines an action. These actions can be part of one or several action lists.
          choice container BswMAvailableActions  # Choice container including the available actions to be used in the action lists.
            container BswMClearEventRequest [0..1]  # This container contains a reference to a BswMEventRequestPort which will be cleared (i.e. set to CLEAR state) when this action is executed.
              reference BswMClearEventRequestPortRef: set at link in variant link-time+post-build / pre-compile in variant pre-compile, destination=BswMEventRequestPort  # This parameter references the BswMEventRequestPort which will be cleared.
            container BswMComMAllowCom [0..1]  # This container includes all parameters for the action to allow or to block communication for a ComM Channel. ComM_CommunicationAllowed is called when this action is configured.
              boolean BswMComAllowed: set at link in variant link-time+post-build / pre-compile in variant pre-compile  # The parameter BswMComMAllowChannelRef refers to a channel which will allow or block communication using the function ComM_CommunicationAllowed(). | This parameter corresponds to the parameter "Allowed" of the function ComM_CommunicationAllowed().
              reference BswMComMAllowChannelRef: set at link in variant link-time+post-build / pre-compile in variant pre-compile, requires-symbolic-name-value=true, destination=ComMChannel  # This is a reference to the ComM Channel for which communication shall be allowed or blocked. | This reference corresponds to the parameter "Channel" of the function ComM_CommunicationAllowed().
            container BswMComMModeLimitation [0..1]  # This container includes all parameters related to a limitation of communication mode for a ComM Channel. ComM_LimitChannelToNoComMode is called when this action is configured.
              boolean BswMComMLimitMode: set at link in variant link-time+post-build / pre-compile in variant pre-compile  # The function ComM_LimitChannelToNoComMode() takes in this boolean parameter to limit the channel's com mode to no-com mode. | This parameter corresponds to the parameter "Status" of the function ComM_LimitChannelToNoComMode.
              reference BswMComMLimitChannelRef: set at link in variant link-time+post-build / pre-compile in variant pre-compile, requires-symbolic-name-value=true, destination=ComMChannel  # This is a reference to the ComM channel for which the communication mode should be limited. | This reference corresponds to the parameter "Channel" of the function ComM_LimitChannelToNoComMode.
            container BswMComMModeSwitch [0..1]  # This container includes all parameters related to a switch of communication mode for a ComM User. ComM_RequestComMode is called when this action is configured.
              enumeration BswMComMRequestedMode: {BSWM_COMM_FULL_COMMUNICATION, BSWM_COMM_NO_COMMUNICATION}, set at link in variant link-time+post-build / pre-compile in variant pre-compile  # This parameter specifies if the requested communication mode. | This parameter corresponds to the parameter "ComMode" of the function ComM_RequestComMode.
              reference BswMComMUserRef: set at link in variant link-time+post-build / pre-compile in variant pre-compile, requires-symbolic-name-value=true, destination=ComMUser  # This is a reference to the ComM User that is associated to the Communication channel for which the communication mode should be requested. | This reference corresponds to the parameter "User" of the function ComM_RequestComMode.
            container BswMCoreHaltMode [0..1]  # This container includes all parameters related to a switch of the activation state of core Halt.
              string BswMCoreHaltActivationState: set at pre-compile  # Different possibilities are offered depending on the OS implementation and the CPU HW. The HALT modes addressed by this parameter are defined as names (strings) in the OS implementation. Different implementation may implement different HALT modes and subsequently different names.
              reference BswMTargetCoreRef: set at link in variant link-time+post-build / pre-compile in variant pre-compile, destination=EcucCoreDefinition  # This is a reference to the core on which the Core Halt process must be influenced.
            container BswMDeadlineMonitoringControl [0..1]  # This container includes all parameters related to enabling and disabling of deadline monitoring for one or several PDUs in COM.
              reference BswMDisabledDMPduGroupRef [0..*]: multiplicity set at link in variant link-time / post-build in variant post-build / pre-compile in variant pre-compile, post-build-variant-multiplicity=true, post-build-variant-value=true, set at link in variant link-time / post-build in variant post-build / pre-compile in variant pre-compile, requires-symbolic-name-value=true, destination=ComIPduGroup  # This is a reference to a PDU Group for which the Deadline Monitoring should be disabled. | This reference corresponds to the parameter "IpduGroupId" of the function Com_DisableReceptionDM.
              reference BswMEnabledDMPduGroupRef [0..*]: multiplicity set at link in variant link-time / post-build in variant post-build / pre-compile in variant pre-compile, post-build-variant-multiplicity=true, post-build-variant-value=true, set at link in variant link-time / post-build in variant post-build / pre-compile in variant pre-compile, requires-symbolic-name-value=true, destination=ComIPduGroup  # This is a reference to a PDU Group for which the Deadline Monitoring should be enabled. | This reference corresponds to the parameter "IpduGroupId" of the function Com_EnableReceptionDM.
            container BswMEcuMDriverInitListBswM [0..1]  # This container defines the action to trigger an EcuM driver initialization list.
              reference BswMEcuMDriverInitListBswMRef: set at link in variant link-time+post-build / pre-compile in variant pre-compile, destination=EcuMDriverInitListBswM  # This is a reference to the EcuM EcuMDriverInitListBswM container which represents the driver init list to be triggered.
            container BswMEcuMGoDownHaltPoll [0..1]  # This container defines the action to trigger the EcuM_GoDownHaltPoll from BswM.
              reference BswMEcuMUserIdRef: set at link in variant link-time+post-build / pre-compile in variant pre-compile, requires-symbolic-name-value=true, destination=EcuMFlexUserConfig  # This is a reference to a EcuM UserId.
            container BswMEcuMSelectShutdownTarget [0..1]  # This container defines the shutdown target.
              enumeration BswMEcuMShutdownTarget: {BSWM_ECUM_SHUTDOWN_TARGET_OFF, BSWM_ECUM_SHUTDOWN_TARGET_RESET, BSWM_ECUM_SHUTDOWN_TARGET_SLEEP}, set at link in variant link-time+post-build / pre-compile in variant pre-compile  # This parameter contains the shutdown target that the BswM selects at the EcuM.
              reference BswMEcuMResetModeRef [0..1]: multiplicity set at link in variant link-time+post-build / pre-compile in variant pre-compile, set at link in variant link-time+post-build / pre-compile in variant pre-compile, requires-symbolic-name-value=true, destination=EcuMResetMode  # This is a reference to a reset mode.
              reference BswMEcuMSleepModeRef [0..1]: multiplicity set at link in variant link-time+post-build / pre-compile in variant pre-compile, set at link in variant link-time+post-build / pre-compile in variant pre-compile, requires-symbolic-name-value=true, destination=EcuMSleepMode  # This is a reference to a sleep mode.
            container BswMEcuMStateSwitch [0..1]  # This container defines the action to switch a State of the ECU State Manager.
              enumeration BswMEcuMState: {BSWM_ECUM_STATE_APP_POST_RUN, BSWM_ECUM_STATE_APP_RUN, BSWM_ECUM_STATE_SHUTDOWN, BSWM_ECUM_STATE_SLEEP, BSWM_ECUM_STATE_STARTUP}, set at link in variant link-time+post-build / pre-compile in variant pre-compile  # This parameter corresponds to the parameter "State" of the function EcuM_ SetState ().
            container BswMEthIfSwitchPortGroupRequestMode [0..1]  # This container includes all parameters related to requesting a mode for the EthIfSwtPortGroup. | The EthIf_SwitchPortGroupRequestMode API is called when this action is executed.
              enumeration BswMEthTrcvMode: {BSWM_ETHTRCV_MODE_ACTIVE, BSWM_ETHTRCV_MODE_DOWN}, post-build-variant-value=true, set at link in variant link-time+post-build / pre-compile in variant pre-compile  # This parameter contains the mode which will be requested.
              reference BswMEthIfSwitchPortGroupRef: post-build-variant-value=true, set at link in variant link-time+post-build / pre-compile in variant pre-compile, requires-symbolic-name-value=true, destination=EthIfSwitchPortGroup  # This is a reference to the Ethernet Interface Switch Port Group which will receive the request.
            container BswMFrSMAllSlots [0..1]  # This container includes all parameter(s) for the action to request an exit from Flexray KeySlotOnlyMode. FrSM_AllSlots is called when this action is executed.
              reference BswMFrSMAllSlotsNetworkHandleRef: set at link in variant link-time+post-build / pre-compile in variant pre-compile, requires-symbolic-name-value=true, destination=ComMChannel  # This references the FlexRay cluster. The reference corresponds to the parameter "NetworkHandle" of the function FrSM_AllSlots.
            container BswMJ1939DcmStateSwitch [0..1]  # This container includes all parameters related to a switch of the J1939 Diagnostic Communication Managers network state for a J1939 node. J1939Dcm_SetState is called when this action is configured.
              enumeration BswMJ1939DcmRequestedState: {BSWM_J1939DCM_STATE_OFFLINE, BSWM_J1939DCM_STATE_ONLINE}, set at link in variant link-time+post-build / pre-compile in variant pre-compile  # This parameter describes the communication state of the J1939 Diagnostic Communication Manager and corresponds to the parameter "newState" of the function J1939Dcm_SetState.
              reference BswMJ1939DcmChannelRef: set at link in variant link-time+post-build / pre-compile in variant pre-compile, requires-symbolic-name-value=true, destination=ComMChannel  # This reference points to the unique channel defined by the ComMChannel and provides access to the unique channel index value in ComMChannelId. | This reference corresponds to the parameter "channel" of the function J1939Dcm_SetState.
              reference BswMJ1939DcmNodeRef: set at link in variant link-time+post-build / pre-compile in variant pre-compile, requires-symbolic-name-value=true, destination=J1939NmNode  # This reference points to a J1939NmNode and provides access to the unique J1939NmNodeId.This reference corresponds to the parameter "node" of the function J1939Dcm_SetState.
            container BswMJ1939RmStateSwitch [0..1]  # This container includes all parameters related to a switch of the J1939 Request Managers network state for a J1939 node. J1939Rm_SetState is called when this action is configured.
              enumeration BswMJ1939RmRequestedState: {BSWM_J1939RM_STATE_OFFLINE, BSWM_J1939RM_STATE_ONLINE}, set at link in variant link-time+post-build / pre-compile in variant pre-compile  # This parameter describes the communication state of the J1939 Request Manager and corresponds to the parameter "new state" of the function J1939Rm_SetState.
              reference BswMJ1939RmChannelRef: set at link in variant link-time+post-build / pre-compile in variant pre-compile, requires-symbolic-name-value=true, destination=ComMChannel  # This reference points to the unique channel defined by the ComMChannel and provides access to the unique channel index value in ComMChannelId. | This reference corresponds to the parameter "channel" of the function J1939Rm_SetState.
              reference BswMJ1939RmNodeRef: set at link in variant link-time+post-build / pre-compile in variant pre-compile, requires-symbolic-name-value=true, destination=J1939NmNode  # This reference points to a J1939NmNode and provides access to the unique J1939NmNodeId. | This reference corresponds to the parameter "node" of the function J1939Rm_SetState.
            container BswMLinScheduleSwitch [0..1]  # This container includes all parameters related to a switch of LIN schedule table. LinSM_ScheduleRequest is called when this action is configured. | The configuration for the "network" parameter can be accessed via the reference LinSMComMNetworkHandleRef contained in the parent container LinSMChannel of the container referenced by BswMLinScheduleRef.
              reference BswMLinScheduleRef: post-build-variant-value=true, set at link in variant link-time / post-build in variant post-build / pre-compile in variant pre-compile, requires-symbolic-name-value=true, destination=LinSMSchedule  # This is a reference to the LIN schedule table that the LIN SM shall change to. | This reference corresponds to the parameter "schedule" of the function LinSM_ScheduleRequest.
            container BswMNMControl [0..1]  # This container includes all parameters related to enabling and disabling of Network Management communication. Disabling of NM communication can be requested by DCM. | Nm_EnableCommunication or Nm_DisableCommunication is called when this action is configured.
              enumeration BswMNMAction: {BSWM_NM_DISABLE, BSWM_NM_ENABLE}, set at link in variant link-time+post-build / pre-compile in variant pre-compile  # This parameter specifies if the communication of the corresponding NM channel should be enabled or disabled.
              reference BswMComMNetworkHandleRef: set at link in variant link-time+post-build / pre-compile in variant pre-compile, requires-symbolic-name-value=true, destination=ComMChannel  # This reference points to the unique channel defined by the ComMChannel and provides access to the unique channel index value in ComMChannelId. | This reference corresponds to the parameter "NetworkHandle" of the function Nm_EnableCommunication and Nm_DisableCommunication.
            container BswMPduGroupSwitch [0..1]  # This container includes references to the PDU groups that shall be enabled and disabled.
              boolean BswMPduGroupSwitchReinit [0..1]: multiplicity set at link in variant link-time / post-build in variant post-build / pre-compile in variant pre-compile, post-build-variant-multiplicity=true, post-build-variant-value=true, set at link in variant link-time / post-build in variant post-build / pre-compile in variant pre-compile, default-value=false  # This parameter defines if the data of the I-PDU, the shadow buffers of included signal groups, etc. are reinitialized when a PDU Group is started. | This parameter corresponds to the parameter "initialize" of the function Com_IpduGroupStart.
              reference BswMDisabledPduGroupRef [0..*]: multiplicity set at link in variant link-time / post-build in variant post-build / pre-compile in variant pre-compile, post-build-variant-multiplicity=true, post-build-variant-value=true, set at link in variant link-time / post-build in variant post-build / pre-compile in variant pre-compile, requires-symbolic-name-value=true, destination=ComIPduGroup  # This is a reference to a PDU Group that should be disabled. | This reference corresponds to the parameter "IpduGroupId" of the function Com_IpduGroupStop.
              reference BswMEnabledPduGroupRef [0..*]: multiplicity set at link in variant link-time / post-build in variant post-build / pre-compile in variant pre-compile, post-build-variant-multiplicity=true, post-build-variant-value=true, set at link in variant link-time / post-build in variant post-build / pre-compile in variant pre-compile, requires-symbolic-name-value=true, destination=ComIPduGroup  # This is a reference to a PDU Group that should be enabled. | This reference corresponds to the parameter "IpduGroupId" of the function Com_IpduGroupStart.
            container BswMPduRouterControl [0..1]  # This container includes all parameters related to enabling and disabling of routing of Routing Path Groups in the PDU Router. PduR_EnableRouting or PduR_DisableRouting is called when this action is configured.
              enumeration BswMPduRouterAction: {BSWM_PDUR_DISABLE, BSWM_PDUR_ENABLE}, post-build-variant-value=true, set at link in variant link-time / post-build in variant post-build / pre-compile in variant pre-compile  # This parameter specifies if the routing of the corresponding PDU should be enabled or disabled.
              boolean BswMPduRouterDisableInitBuffer [0..1]: multiplicity set at link in variant link-time / post-build in variant post-build / pre-compile in variant pre-compile, post-build-variant-multiplicity=true, post-build-variant-value=true, set at link in variant link-time / post-build in variant post-build / pre-compile in variant pre-compile  # When BswPduRouterAction is set to BSWM_PDUR_DISABLE and this parameter is set to true, then the call to PduR_DisableRouting will be invoked with parameter "initialize" set to true, otherwise false.
              reference BswMPduRoutingPathGroupRef [1..*]: multiplicity set at link in variant link-time / post-build in variant post-build / pre-compile in variant pre-compile, post-build-variant-multiplicity=true, post-build-variant-value=true, set at link in variant link-time / post-build in variant post-build / pre-compile in variant pre-compile, requires-symbolic-name-value=true, destination=PduRRoutingPathGroup  # This is a reference to the PDU Routing Path Group for which the routing in the PDU Router should be enabled or disabled. | This reference corresponds to the parameter "id" of the function PduR_EnableRouting and PduR_DisableRouting.
            container BswMRteModeRequest [0..1]  # This container defines a mode request that the BswM may send to a SW-C which is acting as a mode-manager. RTE_Write is called when this action is configured.
              foreign reference BswMRequestedModeRef: set at link in variant link-time+post-build / pre-compile in variant pre-compile, destination-type=MODE-DECLARATION  # This is a foreign reference to the Mode Declaration used for the mode request
              reference BswMRteModeRequestPortRef: set at link in variant link-time+post-build / pre-compile in variant pre-compile, destination=BswMRteModeRequestPort  # This is a reference to a BswMRteModeRequestPort.
            container BswMRteStart [0..1]  # This container defines the action to start the Rte from BswM.
            container BswMRteStop [0..1]  # This container defines the action to stop the Rte from BswM
            container BswMRteSwitch [0..1]  # This container defines a mode switch indication that the BswM provides to the SW-C that need to be notified about the mode switch. RTE_Switch is called when this action is configured.
              reference BswMRteSwitchPortRef: set at link in variant link-time+post-build / pre-compile in variant pre-compile, destination=BswMSwitchPort  # This is a reference to the BswMSwitchPort.
              foreign reference BswMSwitchedMode: set at link in variant link-time+post-build / pre-compile in variant pre-compile, destination-type=MODE-DECLARATION  # This parameter contains the integer value that corresponds to a certain mode in a Mode Declaration Group.
            container BswMSchMSwitch [0..1]  # This container defines a mode switch indication that the BswM provides to the SW-C that need to be notified about the mode switch. SchM_Switch is called when this action is configured.
              foreign reference BswMSchMModeDeclarationGroupRef [0..1]: set at link in variant link-time+post-build / pre-compile in variant pre-compile, destination-type=MODE-DECLARATION-GROUP  # This is the reference to a ModeDeclarationGroup to define a ModeDeclarationGroupPrototype in the role BswModuleDescription.providedModeGroup.
              foreign reference BswMSchMSwitchedMode: set at link in variant link-time+post-build / pre-compile in variant pre-compile, destination-type=MODE-DECLARATION  # This parameter contains the integer value that corresponds to a certain mode in a Mode Declaration Group.
            container BswMSdClientServiceModeRequest [0..1]  # This container includes all parameters related to the selection of an client service of Sd. Sd_ClientServiceSetState is called when this action is configured.
              enumeration BswMSdClientServiceState: {BSWM_SD_CLIENT_SERVICE_RELEASED, BSWM_SD_CLIENT_SERVICE_REQUESTED}, set at link in variant link-time+post-build / pre-compile in variant pre-compile  # This parameter specifies if the corresponding client service shall be released or requested.
              reference BswMSdClientMethodsRef: set at link in variant link-time+post-build / pre-compile in variant pre-compile, requires-symbolic-name-value=true, destination=SdClientService  # This is a reference to a client service in the Sd module.
            container BswMSdConsumedEventGroupModeRequest [0..1]  # This container includes all parameters related to the selection of a consumed EventGroup of Sd. Sd_ConsumedEventGroupSetState is called when this action is configured.
              enumeration BswMSdConsumedEventGroupState: {BSWM_SD_CONSUMED_EVENTGROUP_RELEASED, BSWM_SD_CONSUMED_EVENTGROUP_REQUESTED}, set at link in variant link-time+post-build / pre-compile in variant pre-compile  # This parameter specifies if the corresponding consumed event group shall be released or requested.
              reference BswMSdConsumedEventGroupRef: set at link in variant link-time+post-build / pre-compile in variant pre-compile, requires-symbolic-name-value=true, destination=SdConsumedEventGroup  # This is a reference to an eventGroup that is defined within a client service in the Sd module.
            container BswMSdServerServiceModeRequest [0..1]  # This container includes all parameters related to the selection of a server service of Sd. Sd_ServerServiceSetState is called when this action is configured.
              enumeration BswMSdServerServiceState: {BSWM_SD_SERVER_SERVICE_AVAILABLE, BSWM_SD_SERVER_SERVICE_DOWN}, set at link in variant link-time+post-build / pre-compile in variant pre-compile  # This parameter specifies if the corresponding server service shall be down or available.
              reference BswMSdServerMethodsRef: set at link in variant link-time+post-build / pre-compile in variant pre-compile, requires-symbolic-name-value=true, destination=SdServerService  # This is a reference to a server service in the Sd module.
            container BswMSwitchIPduMode [0..1]  # This container includes all parameters related to the selection of the transmission mode an I-PDU to be sent by COM. Com_SwitchIpduTxMode is called when this action is configured.
              boolean BswMSwitchIPduModeValue: post-build-variant-value=true, set at link in variant link-time / post-build in variant post-build / pre-compile in variant pre-compile  # This parameter defines which transmission mode shall be selected during this call. | This parameter corresponds to the parameter "Mode" of the function Com_SwitchIpduTxMode.
              reference BswMSwitchIPduModeRef: post-build-variant-value=true, set at link in variant link-time / post-build in variant post-build / pre-compile in variant pre-compile, requires-symbolic-name-value=true, destination=ComIPdu  # This is a reference to an I-PDU for which the transmission mode shall be set. | This reference corresponds to the parameter "PduId" of the function Com_SwitchIpduTxMode.
            container BswMTimerControl [0..1]  # This container includes all parameters for the action to start or to stop a timer.
              enumeration BswMTimerAction: {BSWM_TIMER_START, BSWM_TIMER_STOP}, set at link in variant link-time+post-build / pre-compile in variant pre-compile, default-value=BSWM_TIMER_START  # Specify the action for the timer. The timer can be started or stopped.
              float BswMTimerValue: 0..Inf, set at link in variant link-time+post-build / pre-compile in variant pre-compile  # Specify the timer value (in seconds) that is used when the timer is started.
              reference BswMTimerRef: set at link in variant link-time+post-build / pre-compile in variant pre-compile, destination=BswMTimer  # Specify the Timer for which the timer action shall be executed.
            container BswMTriggerIPduSend [0..1]  # This container includes all parameters related to the triggering of an I-PDU to be sent by COM. Com_TriggerIPDUSend is called when this action is configured.
              reference BswMTriggeredIPduRef [1..*]: multiplicity set at link in variant link-time / post-build in variant post-build / pre-compile in variant pre-compile, post-build-variant-multiplicity=true, post-build-variant-value=true, set at link in variant link-time / post-build in variant post-build / pre-compile in variant pre-compile, requires-symbolic-name-value=true, destination=ComIPdu  # This is a reference to an I-PDU that should be triggered for transmission. | This reference corresponds to the parameter "PduId" of the function Com_TriggerIPDUSend.
            container BswMUserCallout [0..1]  # This container includes all details needed for a user defined function call.
              string BswMUserCalloutFunction: set at pre-compile  # This parameter specifies the complete function call including all parameters. The parameters are specified during configuration time, and cannot be changed during run time. Any return values passed by the callout will be ignored. | Example usage can be: Actions to initialize other BSW modules Action to call NvM_ReadAll() Action to call NvM_WriteAll()
        container BswMActionList [0..*]: multiplicity set at link in variant link-time / post-build in variant post-build / pre-compile in variant pre-compile, post-build-variant-multiplicity=true  # Each instance of this container defines an action list that is invoked based on the BswM Rules. An action list contains a list of numbered action items to be processed. An action list can also include other action lists.
          enumeration BswMActionListExecution: {BSWM_CONDITION, BSWM_TRIGGER}, set at link in variant link-time+post-build / pre-compile in variant pre-compile  # This parameter controls if the corresponding action list shall be executed every time the rule is evaluated or only when the result of the evaluation changes. This parameter does not have an effect when this action list is executed within another action list.
          container BswMActionListItem [1..*]: multiplicity set at link in variant link-time / post-build in variant post-build / pre-compile in variant pre-compile, post-build-variant-multiplicity=true  # This container defines an item in an action list.
            boolean BswMAbortOnFail: post-build-variant-value=true, set at link in variant link-time / post-build in variant post-build / pre-compile in variant pre-compile, default-value=false  # This parameter defines if the execution of the action list shall be aborted if this specific action returns E_NOT_OK. Note that this is only applicable for actions that have E_NOT_OK as a possible return value.
            integer BswMActionListItemIndex: 0..255, post-build-variant-value=true, set at link in variant link-time / post-build in variant post-build / pre-compile in variant pre-compile  # This parameter defines the index of the action in the action list. It is used define in which order the actions shall be performed.
            integer BswMReportFailRuntimeErrorId [0..1]: 128..255, multiplicity set at link in variant link-time / post-build in variant post-build / pre-compile in variant pre-compile, post-build-variant-multiplicity=true, post-build-variant-value=true, set at link in variant link-time / post-build in variant post-build / pre-compile in variant pre-compile, default-value=128  # If this parameter is configured, and this specific action returns E_NOT_OK, the BswM will report a Det Runtime Error. The ErrorId reported in the Runtime Error is given by the value configured in this parameter.
            choice reference BswMActionListItemRef: post-build-variant-value=true, set at link in variant link-time / post-build in variant post-build / pre-compile in variant pre-compile, destination=[BswMAction, BswMActionList, BswMRule]  # The action item can either be an atomic action or a reference to another action list or rule.
        container BswMRteModeRequestPort [0..*]: multiplicity set at pre-compile  # This container defines a mode request port which the BswM may utilize to send a mode request to a SW-C which is acting as a mode-manager. If this container is referenced by a BswMRteModeRequest, the BswM shall create a corresponding PPort in its service description.
          instance reference BswMRteModeRequestPortInterfaceRef [0..1]: set at pre-compile, destination-context=SW-COMPONENT-PROTOTYPE*PORT-PROTOTYPE, destination-type=VARIABLE-DATA-PROTOTYPE  # This is an instance reference to the variable data prototype used for the mode request.
          foreign reference BswMRteModeRequestVariableDataPrototypeSRRef [0..1]: set at pre-compile, destination-type=VARIABLE-DATA-PROTOTYPE  # This is a foreign reference to a VariableDataPrototype used for the mode request.
        container BswMSwitchPort [0..*]: multiplicity set at pre-compile  # This container includes a reference to mode switch interface which the BswM must instantiate for the creation of a PPortPrototype in its SWCD.
          foreign reference BswMModeSwitchInterfaceRef: set at link in variant link-time+post-build / pre-compile in variant pre-compile, destination-type=MODE-SWITCH-INTERFACE  # Reference to the ModeSwitchInterface of this BswMModeSwitchPort.
    container BswMGeneral  # General configuration parameters of the Basic SW Mode Manager.
      boolean BswMCanSMEnabled: set at pre-compile, default-value=false  # enable/disable CanSM module related BswM API: | true: Enabled false: Disabled
      boolean BswMCanSMIcomEnabled: set at pre-compile, default-value=false  # enable/disable CanSM Icom related BswM API: | true: Enabled false: Disabled
      boolean BswMComMEnabled: set at pre-compile, default-value=false  # enable/disable ComM module related BswM API: | true: Enabled false: Disabled
      boolean BswMDcmEnabled: set at pre-compile, default-value=false  # enable/disable Dcm module related BswM API: | true: Enabled false: Disabled
      boolean BswMDevErrorDetect: set at pre-compile, default-value=false  # Switches the development error detection and notification on or off. | * true: detection and notification is enabled. * false: detection and notification is disabled.
      boolean BswMEcuMEnabled: set at pre-compile, default-value=false  # enable/disable EcuM module related BswM API: | true: Enabled false: Disabled
      boolean BswMEthIfEnabled: set at pre-compile, default-value=false  # enable/disable EthIf module related BswM API: | true: Enabled false: Disabled
      boolean BswMEthSMEnabled: set at pre-compile, default-value=false  # enable/disable EthSM module related BswM API: | true: Enabled false: Disabled
      boolean BswMFrSMEnabled: set at pre-compile, default-value=false  # enable/disable FrSM module related BswM API: | true: Enabled false: Disabled
      boolean BswMGenericRequestEnabled: set at pre-compile, default-value=false  # enable/disable Generic Request related BswM API: | true: Enabled false: Disabled
      boolean BswMJ1939DcmEnabled: set at pre-compile, default-value=false  # Enable/disable J1939Dcm module related BswM API: | true: Enabled false: Disabled
      boolean BswMJ1939NmEnabled: set at pre-compile, default-value=false  # Enable/disable J1939Nm module related BswM API. | true: Enabled false: Disabled
      boolean BswMLinSMEnabled: set at pre-compile, default-value=false  # enable/disable LinSM module related BswM API: | true: Enabled false: Disabled
      boolean BswMLinTPEnabled: set at pre-compile, default-value=false  # enable/disable LinTP module related BswM API: | true: Enabled false: Disabled
      float BswMMainFunctionPeriod [0..1]: 0..Inf, multiplicity set at link in variant link-time+post-build / pre-compile in variant pre-compile, set at link in variant link-time+post-build / pre-compile in variant pre-compile  # The cycle time of the periodic main function of BswM. Defined in seconds .
      boolean BswMNmEnabled: set at pre-compile, default-value=false  # enable/disable Nm module related BswM API: | true: Enabled false: Disabled
      boolean BswMNvMEnabled: set at pre-compile, default-value=false  # enable/disable NvM module related BswM API: | true: Enabled false: Disabled
      boolean BswMSchMEnabled: set at pre-compile, default-value=false  # enable/disable SchM module related BswM API: | true: Enabled false: Disabled
      boolean BswMSdEnabled: set at pre-compile, default-value=false  # enable/disable Sd module related BswM API. | true: Enabled false: Disabled
      boolean BswMVersionInfoApi: set at pre-compile, default-value=false  # Switches the possibility to read the version information with the service BswM_GetVersionInfo(). | true: Enabled false: Disabled
      boolean BswMWdgMEnabled: set at pre-compile, default-value=false  # enable/disable WdgM module related BswM API: | true: Enabled false: Disabled
      reference BswMOsSpinLockRef [0..1]: multiplicity set at pre-compile, origin=AUTRON, set at pre-compile, requires-symbolic-name-value=true, destination=OsSpinlock  # This parameter is a reference to a OS spin lock which is used to protect a shared resource from Multi-Partition.
      container BswMUserIncludeFiles [0..1]  # Collection of header file names which shall be included by the BswM.
        string BswMUserIncludeFile [1..*]: multiplicity set at pre-compile, set at pre-compile  # Header file name which shall be included by the BswM. | The value of this parameter shall be used as h-char-sequence or q-char-sequence according to ISO C90 section 6.10.2 "source file inclusion". The parameter value MUST NOT represent a path, since ISO C90 does not specify how such a path is treated (i.e., this is implementation defined (and additionally depends on the operating system and the underlying file system)).
  alias name set NameSet_BswMModeCondition
    alias-names:
      short-label=BswMModeCondition_BswMModeCondition, label=l-4=[BswMConditionMode:removePrefix(MRP), BswMConditionType:replace(BSWM_EQUALS=EQ | BSWM_EQUALS_NOT=EN)], identifiable=BswMModeCondition
      short-label=BswMModeCondition_BswMModeDeclaration, label=l-4=sub=BswMModeValueRef, identifiable=BswMModeDeclaration
      {short-label=BswMModeCondition_BswMBswMode, label=[{sup=BswMCanSMIndication, sub=BswMBswRequestedMode:replace(CANSM_BSWM_NO_COMMUNICATION = NO_COM), sub=BswMBswRequestedMode:replace(CANSM_BSWM_SILENT_COMMUNICATION = SILENT_COM), sub=BswMBswRequestedMode:replace(CANSM_BSWM_FULL_COMMUNICATION = FULL_COM), sub=BswMBswRequestedMode:replace(CANSM_BSWM_BUS_OFF = BUS_OFF), sub=BswMBswRequestedMode:replace(CANSM_BSWM_CHANGE_BAUDRATE = CHANGE_BAUDRATE)}, {sup=BswMComMIndication, sub=BswMBswRequestedMode:replace(COMM_NO_COMMUNICATION=NO_COM), sub=BswMBswRequestedMode:replace(COMM_SILENT_COMMUNICATION=SILENT_COM), sub=BswMBswRequestedMode:replace(COMM_FULL_COMMUNICATION=FULL_COM)}, {sup=BswMComMPncRequest, sub=BswMBswRequestedMode:replace(PNC_READY_SLEEP=READY_SLEEP), sub=BswMBswRequestedMode:replace(PNC_PREPARE_SLEEP=PREPARE_SLEEP), sub=BswMBswRequestedMode:replace(PNC_NO_COMMUNICATION=NO_COM), sub=BswMBswRequestedMode:replace(PNC_FULL_COMMUNICATION=FULL_COM)}, {sup=BswMDcmApplicationUpdatedIndication, sub=BswMBswRequestedMode:replace(DCM_DISABLE_RX_ENABLE_TX_NM=DISABLE_RX_ENABLE_TX_NM), sub=BswMBswRequestedMode:replace(DCM_DISABLE_RX_ENABLE_TX_NORM=DISABLE_RX_ENABLE_TX_NORM), sub=BswMBswRequestedMode:replace(DCM_DISABLE_RX_ENABLE_TX_NORM_NM=DISABLE_RX_ENABLE_TX_NORM_NM), sub=BswMBswRequestedMode:replace(DCM_DISABLE_RX_TX_NM=DISABLE_RX_TX_NM), sub=BswMBswRequestedMode:replace(DCM_DISABLE_RX_TX_NORM=DISABLE_RX_TX_NORM), sub=BswMBswRequestedMode:replace(DCM_DISABLE_RX_TX_NORM_NM=DISABLE_RX_TX_NORM_NM), sub=BswMBswRequestedMode:replace(DCM_ENABLE_RX_DISABLE_TX_NM=ENABLE_RX_DISABLE_TX_NM), sub=BswMBswRequestedMode:replace(DCM_ENABLE_RX_DISABLE_TX_NORM=ENABLE_RX_DISABLE_TX_NORM), sub=BswMBswRequestedMode:replace(DCM_ENABLE_RX_DISABLE_TX_NORM_NM=ENABLE_RX_DISABLE_TX_NORM_NM), sub=BswMBswRequestedMode:replace(DCM_ENABLE_RX_TX_NM=ENABLE_RX_TX_NM), sub=BswMBswRequestedMode:replace(DCM_ENABLE_RX_TX_NORM=ENABLE_RX_TX_NORM), sub=BswMBswRequestedMode:replace(DCM_ENABLE_RX_TX_NORM_NM=ENABLE_RX_TX_NORM_NM)}, {sup=BswMDcmComModeRequest, sub=BswMBswRequestedMode=replace(DCM_DISABLE_RX_ENABLE_TX_NM=DISABLE_RX_ENABLE_TX_NM), sub=BswMBswRequestedMode=replace(DCM_DISABLE_RX_ENABLE_TX_NORM=DISABLE_RX_ENABLE_TX_NORM), sub=BswMBswRequestedMode=replace(DCM_DISABLE_RX_ENABLE_TX_NORM_NM=DISABLE_RX_ENABLE_TX_NORM_NM), sub=BswMBswRequestedMode=replace(DCM_DISABLE_RX_TX_NM=DISABLE_RX_TX_NM), sub=BswMBswRequestedMode=replace(DCM_DISABLE_RX_TX_NORM=DISABLE_RX_TX_NORM), sub=BswMBswRequestedMode=replace(DCM_DISABLE_RX_TX_NORM_NM=DISABLE_RX_TX_NORM_NM), sub=BswMBswRequestedMode=replace(DCM_ENABLE_RX_DISABLE_TX_NM=ENABLE_RX_DISABLE_TX_NM), sub=BswMBswRequestedMode=replace(DCM_ENABLE_RX_DISABLE_TX_NORM=ENABLE_RX_DISABLE_TX_NORM), sub=BswMBswRequestedMode=replace(DCM_ENABLE_RX_DISABLE_TX_NORM_NM=ENABLE_RX_DISABLE_TX_NORM_NM), sub=BswMBswRequestedMode=replace(DCM_ENABLE_RX_TX_NM=ENABLE_RX_TX_NM), sub=BswMBswRequestedMode=replace(DCM_ENABLE_RX_TX_NORM=ENABLE_RX_TX_NORM), sub=BswMBswRequestedMode=replace(DCM_ENABLE_RX_TX_NORM_NM=ENABLE_RX_TX_NORM_NM)}, {sup=BswMEcuMIndication, sub=BswMBswRequestedMode:replace(ECUM_STATE_STARTUP_ONE=STARTUP_ONE), sub=BswMBswRequestedMode:replace(ECUM_STATE_STARTUP_TWO=STARTUP_TWO), sub=BswMBswRequestedMode:replace(ECUM_STATE_WAKEUP_VALIDATION=WAKEUP_VALIDATION), sub=BswMBswRequestedMode:replace(ECUM_STATE_GO_SLEEP=GO_SLEEP), sub=BswMBswRequestedMode:replace(ECUM_STATE_GO_OFF_ONE=GO_OFF_ONE)}, {sup=BswMEcuMWakeupSource, sub=BswMBswRequestedMode:replace(ECUM_WKSTATUS_DISABLED=DISABLED), sub=BswMBswRequestedMode:replace(ECUM_WKSTATUS_EXPIRED=EXPIRED), sub=BswMBswRequestedMode:replace(ECUM_WKSTATUS_VALIDATED=VALIDATED), sub=BswMBswRequestedMode:replace(ECUM_WKSTATUS_PENDING=PENDING), sub=BswMBswRequestedMode:replace(ECUM_WKSTATUS_NONE=NONE)}, {sup=BswMEthSMIndication, sub=BswMBswRequestedMode:replace(ETHSM_STATE_OFFLINE=OFFLINE), sub=BswMBswRequestedMode:replace(ETHSM_STATE_WAIT_TRCVLINK=WAIT_TRCVLINK), sub=BswMBswRequestedMode:replace(ETHSM_STATE_WAIT_ONLINE=WAIT_ONLINE), sub=BswMBswRequestedMode:replace(ETHSM_STATE_ONLINE=ONLINE), sub=BswMBswRequestedMode:replace(ETHSM_STATE_ONHOLD=ONHOLD), sub=BswMBswRequestedMode:replace(ETHSM_STATE_WAIT_OFFLINE=WAIT_OFFLINE)}, {sup=BswMFrSMIndication, sub=BswMBswRequestedMode:replace(FRSM_BSWM_READY=READY), sub=BswMBswRequestedMode:replace(FRSM_BSWM_READY_ECU_PASSIVE=READY_ECU_PASSIVE), sub=BswMBswRequestedMode:replace(FRSM_BSWM_STARTUP=STARTUP), sub=BswMBswRequestedMode:replace(FRSM_BSWM_STARTUP_ECU_PASSIVE=STARTUP_ECU_PASSIVE), sub=BswMBswRequestedMode:replace(FRSM_BSWM_WAKEUP=WAKEUP), sub=BswMBswRequestedMode:replace(FRSM_BSWM_WAKEUP_ECU_PASSIVE=WAKEUP_ECU_PASSIVE), sub=BswMBswRequestedMode:replace(FRSM_BSWM_HALT_REQ=HALT_REQ), sub=BswMBswRequestedMode:replace(FRSM_BSWM_HALT_REQ_ECU_PASSIVE=HALT_REQ_ECU_PASSIVE), sub=BswMBswRequestedMode:replace(FRSM_BSWM_KEYSLOT_ONLY=KEYSLOT_ONLY), sub=BswMBswRequestedMode:replace(FRSM_BSWM_KEYSLOT_ONLY_ECU_PASSIVE=KEYSLOT_ONLY_ECU_PASSIVE), sub=BswMBswRequestedMode:replace(FRSM_BSWM_ONLINE=ONLINE), sub=BswMBswRequestedMode:replace(FRSM_BSWM_ONLINE_ECU_PASSIVE=ONLINE_ECU_PASSIVE), sub=BswMBswRequestedMode:replace(FRSM_BSWM_ONLINE_PASSIVE=ONLINE_PASSIVE), sub=BswMBswRequestedMode:replace(FRSM_BSWM_ONLINE_PASSIVE_ECU_PASSIVE=ONLINE_PASSIVE_ECU_PASSIVE), sub=BswMBswRequestedMode:replace(FRSM_LOW_NUMBER_OF_COLDSTARTERS=LOW_NUMBER_OF_COLDSTARTERS), sub=BswMBswRequestedMode:replace(FRSM_LOW_NUMBER_OF_COLDSTARTERS_ECU_PASSIVE=LOW_NUMBER_OF_COLDSTARTERS_ECU_PASSIVE)}, {sup=BswMGenericRequest, sub=BswMBswRequestedMode}, {sup=BswMLinSMIndication, sub=BswMBswRequestedMode:replace(LINSM_NO_COM=NO_COM), sub=BswMBswRequestedMode:replace(LINSM_FULL_COM=FULL_COM)}, {sup=BswMLinScheduleIndication, sub=BswMBswRequestedMode}, {sup=BswMLinTpModeRequest, sub=BswMBswRequestedMode:replace(LINTP_APPLICATIVE_SCHEDULE=APPLICATIVE_SCHEDULE), sub=BswMBswRequestedMode:replace(LINTP_DIAG_REQUEST=DIAG_REQUEST), sub=BswMBswRequestedMode:replace(LINTP_DIAG_RESPONSE=DIAG_RESPONSE)}, {sup=BswMNvMJobModeIndication, sub=BswMBswRequestedMode=replace(NVM_REQ_OK=OK), sub=BswMBswRequestedMode=replace(NVM_REQ_NOT_OK=NOT_OK), sub=BswMBswRequestedMode=replace(NVM_REQ_PENDING=PENDING), sub=BswMBswRequestedMode=replace(NVM_REQ_INTEGRITY_FAILED=INTEGRITY_FAILED), sub=BswMBswRequestedMode=replace(NVM_REQ_BLOCK_SKIPPED=BLOCK_SKIPPED), sub=BswMBswRequestedMode=replace(NVM_REQ_NV_INVALIDATED=NV_INVALIDATED), sub=BswMBswRequestedMode=replace(NVM_REQ_CANCELED=CANCELED), sub=BswMBswRequestedMode=replace(NVM_REQ_REDUNDANCY_FAILED=REDUNDANCY_FAILED), sub=BswMBswRequestedMode=replace(NVM_REQ_RESTORED_FROM_ROM=RESTORED_FROM_ROM), sub=BswMBswRequestedMode=replace(NVM_MAXVALUE=MAXVALUE)}, {sup=BswMNvMRequest, sub=BswMBswRequestedMode:replace(NVM_REQ_OK=OK), sub=BswMBswRequestedMode:replace(NVM_REQ_NOT_OK=NOT_OK), sub=BswMBswRequestedMode:replace(NVM_REQ_PENDING=PENDING), sub=BswMBswRequestedMode:replace(NVM_REQ_INTEGRITY_FAILED=INTEGRITY_FAILED), sub=BswMBswRequestedMode:replace(NVM_REQ_BLOCK_SKIPPED=BLOCK_SKIPPED), sub=BswMBswRequestedMode:replace(NVM_REQ_NV_INVALIDATED=NV_INVALIDATED), sub=BswMBswRequestedMode:replace(NVM_REQ_CANCELED=CANCELED), sub=BswMBswRequestedMode:replace(NVM_REQ_REDUNDANCY_FAILED=REDUNDANCY_FAILED), sub=BswMBswRequestedMode:replace(NVM_REQ_RESTORED_FROM_ROM=RESTORED_FROM_ROM), sub=BswMBswRequestedMode:replace(NVM_MAXVALUE=MAXVALUE)}, {sup=BswMWdgMRequestPartitionReset, sub=BswMBswRequestedMode}, {sup=BswMSwcModeRequest, sub=BswMBswRequestedMode}, {sup=BswMJ1939DcmBroadcastStatus, sub=BswMBswRequestedMode}, {sup=BswMJ1939NmIndication, sub=BswMBswRequestedMode=replace(NM_STATE_UNINIT=UNINIT), sub=BswMBswRequestedMode=replace(NM_STATE_BUS_SLEEP=BUS_SLEEP), sub=BswMBswRequestedMode=replace(NM_STATE_PREPARE_BUS_SLEEP=PREPARE_BUS_SLEEP), sub=BswMBswRequestedMode=replace(NM_STATE_READY_SLEEP=READY_SLEEP), sub=BswMBswRequestedMode=replace(NM_STATE_NORMAL_OPERATION=NORMAL_OPERATION), sub=BswMBswRequestedMode=replace(NM_STATE_REPEAT_MESSAGE=REPEAT_MESSAGE), sub=BswMBswRequestedMode=replace(NM_STATE_SYNCHRONIZE=SYNCHRONIZE), sub=BswMBswRequestedMode=replace(NM_STATE_OFFLINE=OFFLINE)}], identifiable=BswMBswMode}
  keyword set KeywordSet_BswM
    6 x keyword, all with classifications=Prefix:
      BswMModeRequestPort: abbr-name=MRP
      BswMModeCondition: abbr-name=MC
      BswMAction: abbr-name=AC
      BswMLogicalExpression: abbr-name=LE
      BswMRule: abbr-name=Rule
      BswMActionList: abbr-name=AL
  alias name set NameSet_BswMAction
    alias-names:
      short-label=BswMAction_BswMComMAllowCom, label=l-4=[BswMComMAllowChannelRef:removePrefix(ComMChannel), BswMComAllowed:replace(1=TRUE | 0=FALSE)], identifiable=BswMComMAllowCom
      short-label=BswMAction_BswMComMModeLimitation, label=l-4=[BswMComMLimitChannelRef:removePrefix(ComMChannel), BswMComMLimitMode:replace(1=TRUE | 0=FALSE)], identifiable=BswMComMModeLimitation
      short-label=BswMAction_BswMComMModeSwitch, label=l-4=[BswMComMUserRef:removePrefix(ComMUser), BswMComMRequestedMode:removePrefix(BSWM)], identifiable=BswMComMModeSwitch
      short-label=BswMAction_BswMDeadlineMonitoringControl, label=l-4=[BswMDisabledDMPduGroupRef:removePrefix(ComIPduGroup), BswMEnabledDMPduGroupRef:removePrefix(ComIPduGroup)], identifiable=BswMDeadlineMonitoringControl
      short-label=BswMAction_BswMEcuMGoDownHaltPoll, label=l-4=sub=BswMEcuMUserIdRef:removePrefix(EcuMFlexUserConfig | EcuMUser | ECUM_USER), identifiable=BswMEcuMGoDownHaltPoll
      short-label=BswMAction_BswMEcuMSelectShutdownTarget, label=l-4=[BswMEcuMShutdownTarget:removePrefix(ECUM_STATE), BswMEcuMSleepModeRef:removePrefix(EcuMSleepMode |ECUM_SLEEP | ECUM_MCU), BswMEcuMResetModeRef:removePrefix(EcuMResetMode | ECUM_RESET)], identifiable=BswMEcuMSelectShutdownTarget
      short-label=BswMAction_BswMLinScheduleSwitch, label=l-4=sub=BswMLinScheduleRef, identifiable=BswMLinScheduleSwitch
      short-label=BswMAction_BswMNMControl, label=l-4=[BswMComMNetworkHandleRef:removePrefix(ComMChannel), BswMNMAction:removePrefix(BSWM_NM)], identifiable=BswMNMControl
      short-label=BswMAction_BswMPduGroupSwitch, label=l-4=[BswMDisabledPduGroupRef:removePrefix(ComIPduGroup),addPostfix(DISABLE), BswMEnabledPduGroupRef:removePrefix(ComIPduGroup),addPostfix(ENABLE), BswMPduGroupSwitchReinit: replace(1=REINIT | 0=NOREINIT)], identifiable=BswMPduGroupSwitch
      short-label=BswMAction_BswMPduRouterControl, label=l-4=[BswMPduRoutingPathGroupRef:removePrefix(PduRRoutingPathGroup), BswMPduRouterAction:removePrefix(BSWM_PDUR)], identifiable=BswMPduRouterControl
      short-label=BswMAction_BswMSwitchIPduMode, label=l-4=[BswMSwitchIPduModeRef:removePrefix(ComIpdu), BswMSwitchIPduModeValue:replace(1=TRUE | 0=FALSE)], identifiable=BswMSwitchIPduMode
      short-label=BswMAction_BswMTriggerIPduSend, label=l-4=sub=BswMTriggeredIPduRef:removePrefix(ComIPdu), identifiable=BswMTriggerIPduSend
      short-label=BswMAction_BswMRteSwitch, label=l-4=[BswMRteSwitchPortRef, BswMSwitchedMode], identifiable=BswMRteSwitch
      short-label=BswMAction_BswMSchMSwitch, label=l-4=[BswMSchMModeDeclarationGroupRef, BswMSchMSwitchedMode], identifiable=BswMSchMSwitch
      short-label=BswMAction_BswMJ1939DcmStateSwitch, label=l-4=[BswMJ1939DcmChannelRef:removePrefix(ComMChannel), BswMJ1939DcmNodeRef:removePrefix(J1939NmNode), BswMJ1939DcmRequestedState:removePrefix(J1939DCM_STATE)], identifiable=BswMJ1939DcmStateSwitch
      short-label=BswMAction_BswMJ1939RmStateSwitch, label=l-4=[BswMJ1939RmChannelRef:removePrefix(ComMChannel), BswMJ1939RmNodeRef:removePrefix(J1939NmNode), BswMJ1939RmRequestedState:removePrefix(J1939RM_STATE)], identifiable=BswMJ1939RmStateSwitch
  keyword set ConfigInfoSet_BswM
    11 x keyword:
      removePrefix: classifications=NameSet_Function  # removePrefix(str1 | str2)
      addPrefix: classifications=NameSet_Function  # addPrefix(str)
      removePostfix: classifications=NameSet_Function  # removePostfix(str1 | str2)
      addPostfix: classifications=NameSet_Function  # addPostfix(str)
      replace: classifications=NameSet_Function  # replace(1=REINIT | 0=NOREINIT)
      replaceAll: classifications=NameSet_Function  # replace(1=REINIT | 0=NOREINIT)
      replaceFirst: classifications=NameSet_Function  # replaceFirst(1=REINIT | 0=NOREINIT)
      replaceAt: classifications=NameSet_Function  # replaceAt[2](1=REINIT | 0=NOREINIT)
      ExclusiveConfig: classifications=[SDG_GID_PARAMETER_DEF, SDG_GID_REFERENCE_DEF]
      OptionalConfig: classifications=[SDG_GID_PARAMETER_DEF, SDG_GID_REFERENCE_DEF]
      RequiredConfig: classifications=[SDG_GID_REFERENCE_VALUE, SDG_GID_PARAMETER_VALUE]
  alias name set NameSet_BswMModeRequestPort
    alias-names:
      short-label=BswMModeRequestPort_BswMModeRequestPort, label=l-4=sub=BswMRequestProcessing:replace(BSWM_DEFERRED=DEF|BSWM_IMMEDIATE=IMM), identifiable=BswMModeRequestPort
      short-label=BswMModeRequestPort_BswMCanSMIndication, label=l-4=sub=BswMCanSMChannelRef:removePrefix(ComMChannel), identifiable=BswMCanSMIndication
      short-label=BswMModeRequestPort_BswMComMIndication, label=l-4=sub=BswMComMChannelRef:removePrefix(ComMChannel), identifiable=BswMComMIndication
      short-label=BswMModeRequestPort_BswMComMPncRequest, label=l-4=sub=BswMComMPncRef:removePrefix(ComMPnc), identifiable=BswMComMPncRequest
      short-label=BswMModeRequestPort_BswMDcmComModeRequest, label=l-4=sub=BswMDcmComMChannelRef:removePrefix(ComMChannel), identifiable=BswMDcmComModeRequest
      short-label=BswMModeRequestPort_BswMEcuMWakeupSource, label=l-4=sub=BswMEcuMWakeupSrcRef:removePrefix(ECUM_WKSOURCE |EcuMWakeupSource), identifiable=BswMEcuMWakeupSource
      short-label=BswMModeRequestPort_BswMEthSMIndication, label=l-4=sub=BswMEthSMChannelRef:removePrefix(ComMChannel), identifiable=BswMEthSMIndication
      short-label=BswMModeRequestPort_BswMFrSMIndication, label=l-4=sub=BswMFrSMChannelRef:removePrefix(ComMChannel), identifiable=BswMFrSMIndication
      short-label=BswMModeRequestPort_BswMLinSMIndication, label=l-4=sub=BswMLinSMChannelRef:removePrefix(ComMChannel), identifiable=BswMLinSMIndication
      short-label=BswMModeRequestPort_BswMLinScheduleIndication, label=l-4=sub=BswMLinScheduleRef, identifiable=BswMLinScheduleIndication
      short-label=BswMModeRequestPort_BswMNvMJobModeIndication, label=l-4=sub=BswMNvmService:removePrefix(Nvm), identifiable=BswMNvMJobModeIndication
      short-label=BswMModeRequestPort_BswMLinTpModeRequest, label=l-4=sub=BswMLinTpChannelRef:removePrefix(LinIfChannel), identifiable=BswMLinTpModeRequest
      short-label=BswMModeRequestPort_BswMNvMRequest, label=l-4=sub=BswMNvMBlockRef:removePrefix(NvMBlockDescriptor| NvMBlock), identifiable=BswMNvMRequest
      short-label=BswMModeRequestPort_BswMSwcModeRequest, label=l-4=sub=BswMSwcModeRequestVariableDataPrototypeRef, identifiable=BswMSwcModeRequest
      short-label=BswMModeRequestPort_BswMJ1939DcmBroadcastStatus, label=l-4=sub=BswMJ1939DcmChannelRef:removePrefix(ComMChannel), identifiable=BswMJ1939DcmBroadcastStatus
      short-label=BswMModeRequestPort_BswMJ1939NmIndication, label=l-4=[BswMJ1939NmChannelRef:removePrefix(ComMChannel), BswMJ1939NmNodeRef:removePrefix(J1939NmNode)], identifiable=BswMJ1939NmIndication
      short-label=BswMModeRequestPort_BswMBswModeNotification, label=l-4=sub=BswMBswModeDeclarationGroupPrototypeRef, identifiable=BswMBswModeNotification
      short-label=BswMModeRequestPort_BswMSwcModeNotification, label=l-4=sub=BswMSwcModeNotificationModeDeclarationGroupPrototypeRef, identifiable=BswMSwcModeNotification
