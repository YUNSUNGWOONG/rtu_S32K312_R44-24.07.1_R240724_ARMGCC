AUTOSAR XML (schema 00047)
# (C) 2021 HYUNDAI AUTOEVER Corp.
package /AUTRON
  module definition CryIf [0..1]: category=STANDARDIZED_MODULE_DEFINITION, refined-module-def=CryIf, variants pre-compile  # Configuration of the Crypto Interface.
    container CryIfChannel [0..*]  # Container for incorporation of CryIfChannel.
      integer CryIfChannelId: 0..4294967295, symbolic-name-value=true  # Identifier of the crypto channel. | Specifies to which crypto channel the CSM queue is connected to.
      reference CryIfDriverObjectRef: requires-symbolic-name-value=true, destination=CryptoDriverObject  # This parameter refers to a Crypto Driver Object. | Specifies to which Crypto Driver Object the crypto channel is connected to
    container CryIfGeneral  # Container for incorporation of CryIfGeneral.
      boolean CryIfDevErrorDetect: default-value=false  # Switches the development error detection and notification on or off. | true: detection and notification is enabled. false: detection and notification is disabled.
      boolean CryIfVersionInfoApi: default-value=false  # Pre-processor switch to enable and disable availability of the API CryIf_GetVersionInfo(). | True: API CryIf_GetVersionInfo() is available False: API CryIf_GetVersionInfo() is not available.
    container CryIfKey [0..*]  # Container for incorporation of CryIfKey.
      integer CryIfKeyId: 0..4294967295, symbolic-name-value=true  # Identifier of the CryIf key. | Specifies to which CryIf key the CSM key is mapped to.
      reference CryIfKeyRef: requires-symbolic-name-value=true, destination=CryptoKey  # This parameter refers to the crypto driver key. | Specifies to which crypto driver key the CryIf key is mapped to.
