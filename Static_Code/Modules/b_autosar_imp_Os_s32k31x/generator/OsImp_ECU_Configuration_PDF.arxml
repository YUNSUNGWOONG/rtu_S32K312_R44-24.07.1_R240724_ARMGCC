AUTOSAR XML (schema 4-2-1)
# (C) 2018 HYUNDAI AUTRON Co., Ltd.
# Confidential Proprietary Information. Distribution Limited.
# Do Not Copy Without Prior Permission
package /AUTRON
  module definition OsImp  # Configuration of the OsImp (OS Improvement Code) module.
    container OsImpGeneral
      boolean OsImpCpuLoad: set at pre-compile, origin=AUTRON  # This parameter is used to select whether the CPU/Interrupt load measurement is used or not. True : used False : not used
    container OsImpConfiguration
      container OsImpRamSector [0..*]  # This container contains the configuration (parameters) for the RAM Sector setting. RAM Sector configurations are used for RAM initializing before main() execution.
        integer OsImpRamDefaultValue: 0..4294967295, set at pre-compile, origin=AUTRON, default-value=0  # This parameter shall represent the Data pre-setting to be initialized
        integer OsImpRamSectionBaseAddress [0..1]: 0..4294967295, set at pre-compile, origin=AUTRON, default-value=0  # This parameter represents the RAM section base address. The address must be aligned to 64 bytes. If OsImpRamInitProperty is Stack, then the address must be aligned to 16 bytes.
        integer OsImpRamSectionSize [0..1]: 0..393216, set at pre-compile, origin=AUTRON, default-value=1024  # This parameter represents the RAM section size in bytes. The size must be multiple of 64. If OsImpRamInitProperty is not Stack, then the size must be multiple of 16. If OsImpRamSectionSizeLinkerSym is not empty, then this parameter is not used.
        string OsImpRamSectionBaseAddrLinkerSym [0..1]: set at pre-compile, origin=AUTRON  # This parameter represents the RAM section base address which is defined in linker script. The address must be aligned to 64 bytes. If OsImpRamInitProperty is Stack, then the address must be aligned to 16 bytes. If this parameter is empty, then the integer values from OsImpRamSectionBaseAddress will be used.
        string OsImpRamSectionSizeLinkerSym [0..1]: set at pre-compile, origin=AUTRON  # This parameter represents the RAM section size in bytes which is defined in linker script. The size must be multiple of 64. If OsImpRamInitProperty is Stack, then the size must be multiple of 16. If this parameter is empty, then the integer values from OsImpRamSectionSize will be used.
        enumeration OsImpRamInitProperty: {PowerOnReset, WakeUp, Stack}, set at pre-compile, origin=AUTRON, default-value=PowerOnReset  # This parameter selects when RAM needs to be initialized. PowerOnReset: Initialize RAM when power on reset WakeUp: Initialize RAM when wake-up from Low Power Mode Stack: Fill pattern to stack area in RAM when every reset. This is valid when OsImpDebugStackdepth is true.
  ecuc definition collection AUTOSARParameterDefinition: module=OsImp
