AUTOSAR XML (schema 00047)
# (C) 2023 HYUNDAI AUTOEVER Corp.
package /AUTRON
  ecuc definition collection AUTOSARParameterDefinition: module=Rte
  module definition Rte [0..1]: post-build-variant-support=true, refined-module-def=Rte, variants post-build/pre-compile  # Configuration of the Rte (Runtime Environment) module.
    container RteBswGeneral  # General configuration parameters of the Bsw Scheduler section.
      boolean RteSchMVersionInfoApi: set at pre-compile, default-value=false  # Enables the generation of the SchM_GetVersionInfo() API.
    container RteBswModuleInstance [0..65535]  # Represents one instance of a Bsw-Module configured on one ECU.
      foreign reference RteBswImplementationRef: set at pre-compile, destination-type=BSW-IMPLEMENTATION  # Reference to the BswImplementation for which the Rte /SchM is configured.
      foreign reference RteBswModuleConfigurationRef [0..1]: multiplicity set at pre-compile, set at pre-compile, destination-type=ECUC-MODULE-CONFIGURATION-VALUES  # Reference to the ECU Configuration Values provided for this BswImplementation.
      container RteBswEventToTaskMapping [0..65535]  # Maps a BswModuleEntity onto an OsTask based on the activating BswEvent. A BswModuleEntity can be activated by more than one BswEvent and thus be mapped to more than one OsTask. In the case of a BswSchedulableEntity executed via a direct function call this RteBswEventToTaskMapping is still specified but no RteBswMappedToTaskRef element is included. The RteBswPositionInTask parameter is necessary to provide an ordering of events invoked by the same RTE API.
        float RteBswActivationOffset [0..1]: 0..Inf, multiplicity set at pre-compile, set at pre-compile  # Activation offset in seconds.
        boolean RteBswImmediateRestart: category=NOT_SUPPORTED, set at pre-compile, default-value=false  # When RteBswImmediateRestart is set to true the BswSchedulableEntitiy shall be immediately re-started after termination if it was activated by this BswEvent while it was already started. | This parameter shall not be set to true when the mapped BswEvent refers to a BswSchedulableEntitiy which minimumStartInterval attribute is > 0.
        integer RteBswPositionInTask [0..1]: 0..65535, multiplicity set at pre-compile, set at pre-compile  # Each BswSchedulableEntity activation mapped to an OsTask has a specific position within the task execution. | For periodic activation this is the order of execution. For event driver activation this is the order of evaluation which actual BswSchedulableEntity has to be executed. In case of direct function calls this parameter is necessary to provide an ordering of events when several ExecutableEntities are invoked by the same RTE API.
        integer RteBswServerQueueLength [0..1]: 0..65535, multiplicity set at pre-compile, origin=AUTOEVER, set at pre-compile  # Specifies the length of the queue for the server call serialization.
        enumeration RteOsSchedulePoint [0..1]: {CONDITIONAL, NONE, UNCONDITIONAL}, multiplicity set at pre-compile, set at pre-compile  # Introduce a schedule point by explicitly calling Os Schedule service after the execution of the ExecutableEntity. The Rte generator is allowed to optimize several consecutive calls to Os schedule into one single call if the ExecutableEntity executions in between have been skipped. | The absence of this parameter is interpreted as "NONE". It shall be considered an invalid configuration if the task is preemptable and the value of this parameter is not set to "NONE" or the parameter is absent.
        reference RteBswEventPredecessorSyncPointRef [0..1]: category=NOT_SUPPORTED, multiplicity set at pre-compile, set at pre-compile, destination=RteSyncPoint  # The RteBswEventPredecessorSyncPointRef is necessary to provide a cross core synchronization in case of BswEvents triggered by the same event source but mapped to tasks belonging to different partitions on different cores. | The synchronization point must be reached by all referencing BswEvents before the execution in all related tasks is continued. In case of RteBswEventPredecessorSyncPointRef the BswModuleEntity activated by the mapped BswEvent is executed after the synchronization point is passed.
        foreign reference RteBswEventRef: set at pre-compile, destination-type=BSW-EVENT  # Reference to the BswEvent.
        reference RteBswEventSuccessorSyncPointRef [0..1]: category=NOT_SUPPORTED, multiplicity set at pre-compile, set at pre-compile, destination=RteSyncPoint  # The RteBswEventSuccessorSyncPointRef is necessary to provide a cross core synchronization in case of BswEvents triggered by the same event source but mapped to tasks belonging to different partitions on different cores. | The synchronization point must be reached by all referencing BswEvents before the execution in all related tasks is continued. In case of RteBswEventSuccessorSyncPointRef the BswModuleEntity activated by the mapped BswEvent is executed before the synchronization point is entered.
        reference RteBswMappedToTaskRef [0..1]: multiplicity set at pre-compile, set at pre-compile, destination=OsTask  # Reference to the OsTask the BswSchedulableEntity activated by the RteBswEventRef is mapped to. | If no reference to the OsTask is specified the BswSchedulableEntity activated by this BswEvent is executed in the context of the caller.
        reference RteBswUsedOsAlarmRef [0..1]: multiplicity set at pre-compile, set at pre-compile, destination=OsAlarm  # If an OsAlarm is used to activate the OsTask this BswEvent is mapped to it shall be referenced here.
        reference RteBswUsedWaitPointTOutOsAlarmRef [0..1]: multiplicity set at pre-compile, origin=AUTOEVER, set at pre-compile, destination=OsAlarm  # If the RunnableEntity activated by this RteEvent is mapped to a WaitPoint then the OsAlarm used for timeout monitoring of the WaitPoint shall be referenced here.
        reference RteBswUsedOsEventRef [0..1]: multiplicity set at pre-compile, set at pre-compile, destination=OsEvent  # If an OsEvent is used to activate the OsTask this BswEvent is mapped to it shall be referenced here.
        reference RteBswUsedWaitPointOsEventRef [0..1]: multiplicity set at pre-compile, origin=AUTOEVER, set at pre-compile, destination=OsEvent  # If an OsEvent is used to activate the OsTask for indicating setting of a waitpoint mapped to the runnable activated by this RteEvent, it shall be referenced here.
        reference RteBswUsedOsSchTblExpiryPointRef [0..1]: multiplicity set at pre-compile, set at pre-compile, destination=OsScheduleTableExpiryPoint  # If an OsScheduleTableExpiryPoint is used to activate the OsTask this BswEvent is mapped to it shall be referenced here.
      container RteBswExclusiveAreaImpl [0..65535]  # Represents one ExclusiveArea of one BswImplementation. Used to specify the implementation means of this ExclusiveArea.
        enumeration RteBswExclusiveAreaImplKind [0..1]: {RTE_MACRO, RTE_FUNCTION}, origin=AUTOEVER, set at pre-compile, default-value=RTE_MACRO  # Enumeration Parameter which provides an option to RTE generator to generate SchM Exclusive Area APIs as a macro or a function.
        enumeration RteExclusiveAreaImplMechanism: {ALL_INTERRUPT_BLOCKING, NONE, OS_INTERRUPT_BLOCKING, OS_RESOURCE, OS_SPINLOCK}, set at pre-compile  # To be used implementation mechanism for the specified ExclusiveArea.
        reference RteBswExclusiveAreaOsResourceRef [0..1]: multiplicity set at pre-compile, set at pre-compile, destination=OsResource  # Optional reference to an OsResource in case RteExclusiveAreaImplMechanism is configured to OS_RESOURCE for this ExclusiveArea.
        reference RteBswExclusiveAreaOsSpinlockRef [0..1]: multiplicity set at pre-compile, set at pre-compile, destination=OsSpinlock  # Optional reference to an OsSpinlock in case RteExclusiveAreaImplMechanism is configured to OS_SPINLOCK for this ExclusiveArea.
        foreign reference RteBswExclusiveAreaRef: set at pre-compile, destination-type=EXCLUSIVE-AREA  # Reference to the ExclusiveArea for which the implementation mechanism shall be specified.
      container RteBswExternalTriggerConfig [0..65535]  # Defines the configuration of Inter Basic Software Module Entity Triggering
        integer RteBswTriggerSourceQueueLength: 0..4294967295, set at pre-compile, default-value=0  # Length of trigger queue on the trigger source side. | The queue is implemented by the RTE. A value greater or equal to 1 requests an queued behavior. Setting the value of RteTriggerSourceQueueLength to 0 requests an none queued implementation of the trigger communication. If there is no RteBswTriggerSourceQueueLength configured for a Trigger Emitter the default value of 0 applies as well.
        foreign reference RteBswTriggerSourceRef: set at pre-compile, destination-type=TRIGGER  # Reference to a Trigger instance in the role releasedTrigger of the related BSW Module instance. | The referenced Trigger has to belong to the same BSW Module instance as the RteBswModuleInstance owning this parameter configures.
      container RteBswInternalTriggerConfig [0..65535]  # Defines the configuration of internal Basic Software Module Entity Triggering
        integer RteBswTriggerSourceQueueLength: 0..4294967295, set at pre-compile, default-value=0  # Length of trigger queue on the trigger source side. | The queue is implemented by the RTE. A value greater or equal to 1 requests an queued behavior. Setting the value of RteTriggerSourceQueueLength to 0 requests an none queued implementation of the trigger communication. If there is no RteBswTriggerSourceQueueLength configured for a Trigger Emitter the default value of 0 applies as well.
        foreign reference RteBswTriggerSourceRef: set at pre-compile, destination-type=BSW-INTERNAL-TRIGGERING-POINT  # Reference to a BswInternalTriggeringPoint of the related BSW Module instance. | The referenced BswInternalTriggeringPoint has to belong to the same BSW Module instance as the RteBswModuleInstance owning this parameter configures.
      container RteBswRequiredClientServerConnection [0..65535]  # Defines the connection between one requiredClientServerEntry and one providedClientServerEntry of a BswModuleDescription. This container shall be provided on the client side of the connection.
        reference RteBswProvidedClientServerEntryModInstRef: set at pre-compile, destination=RteBswModuleInstance  # Reference to the RteBswModuleInstance configuration container which identifies the instance of the BSW Module. | Used with the RteBswProvidedClientServerEntryRef to unambiguously identify the BswModuleClientServerEntry instance.
        foreign reference RteBswProvidedClientServerEntryRef: set at pre-compile, destination-type=BSW-MODULE-CLIENT-SERVER-ENTRY  # Reference the providedClientServerEntry for this connection.
        foreign reference RteBswRequiredClientServerEntryRef: set at pre-compile, destination-type=BSW-MODULE-CLIENT-SERVER-ENTRY  # Reference the requiredClientServerEntry for this connection.
      container RteBswRequiredModeGroupConnection [0..65535]  # Defines the connection between one requiredModeGroup of this BSW Module instance and one providedModeGroup instance.
        foreign reference RteBswProvidedModeGroupRef: set at pre-compile, destination-type=MODE-DECLARATION-GROUP-PROTOTYPE  # References the providedModeGroupPrototype to which this requiredModeGroup shall be connected.
        reference RteBswProvidedModeGrpModInstRef: set at pre-compile, destination=RteBswModuleInstance  # Reference to the RteBswModuleInstance configuration container which identifies the instance of the BSW Module. | Used with the RteBswProvidedModeGroupRef to unambiguously identify the ModeDeclarationGroupPrototype instance.
        foreign reference RteBswRequiredModeGroupRef: set at pre-compile, destination-type=MODE-DECLARATION-GROUP-PROTOTYPE  # References requiredModeGroupPrototype which shall be connected to the providedModeGroupPrototype.
        foreign reference RteModeDeclarationMappingSetRef [0..1]: category=NOT_SUPPORTED, multiplicity set at pre-compile, set at pre-compile, destination-type=MODE-DECLARATION-MAPPING-SET  # This defines the effective ModeDeclarationMappingSet in the case that the provided ModeDeclarationGroupPrototype and the required ModeDeclarationGroupPrototype are not compatible.
      container RteBswRequiredSenderReceiverConnection [0..65535]  # Defines the connection between one requiredData and one providedData of a BswModuleDescription. This container shall be provided on the receiver side of the connection.
        reference RteBswProvidedDataModInstRef: set at pre-compile, destination=RteBswModuleInstance  # Reference to the RteBswModuleInstance configuration container which identifies the instance of the BSW Module. | Used with the RteBswProvidedVariableDataPrototypeRef to unambiguously identify the VariableDataPrototype instance.
        foreign reference RteBswProvidedVariableDataPrototypeRef: set at pre-compile, destination-type=VARIABLE-DATA-PROTOTYPE  # Reference the providedData for this connection.
        foreign reference RteBswRequiredVariableDataPrototypeRef: set at pre-compile, destination-type=VARIABLE-DATA-PROTOTYPE  # Reference the requiredData for this connection.
      container RteBswRequiredTriggerConnection [0..65535]  # Defines the connection between one requiredTrigger of this BSW Module instance and one releasedTrigger instance.
        reference RteBswReleasedTriggerModInstRef: set at pre-compile, destination=RteBswModuleInstance  # Reference to the RteBswModuleInstance configuration container which identifies the instance of the BSW Module. | Used with the RteBswReleasedTriggerRef to unambiguously identify the Trigger instance.
        foreign reference RteBswReleasedTriggerRef: set at pre-compile, destination-type=TRIGGER  # References the releasedTrigger to which this requiredTrigger shall be connected.
        foreign reference RteBswRequiredTriggerRef: set at pre-compile, destination-type=TRIGGER  # References one requiredTrigger which shall be connected to the releasedTrigger.
    container RteGeneration  # This container holds the parameters for the configuration of the RTE Generation.
      enumeration RteBypassSupport: {COMPONENT_WRAPPER, EXTENDED_BUFFER_ACCESS, NONE}, category=NOT_SUPPORTED, set at pre-compile, default-value=NONE  # General switch to enable and select the bypass support method.
      enumeration RteCalibrationSupport: {DOUBLE_POINTERED, INITIALIZED_RAM, NONE, SINGLE_POINTERED}, set at pre-compile, default-value=NONE  # The RTE generator shall have the option to switch off support for calibration for generated RTE code. This option shall influence complete RTE code at once.
      integer RteCodeVendorId: 0..65535, category=FIXED, set at pre-compile, default-value=76  # Holds the vendor ID of the generated Rte code.
      boolean RteDevErrorDetect: set at pre-compile, default-value=false  # Switches the development error detection and notification on or off. | * true: detection and notification is enabled. * false: detection and notification is disabled.
      boolean RteOsErrorDetect: origin=AUTOEVER, set at pre-compile, default-value=true  # Switches the return value validation of OS APIs on and off. | * true: Return value is validated. * false: Return value is not validated.
      boolean RteDevErrorDetectUninit: set at pre-compile, default-value=false  # The Rte shall detect if it is started when its APIs are called, and the BSW Scheduler shall check if it is initialized when its APIs are called.
      enumeration RteGenerationMode: {COMPATIBILITY_MODE, VENDOR_MODE}, category=NOT_SUPPORTED, set at pre-compile, default-value=COMPATIBILITY_MODE  # Switch between the two available generation modes of the RTE generator.
      boolean RteInExclusiveAreaCheckEnabled: set at pre-compile, default-value=true  # Enables the check for RTE_E_IN_EXCLUSIVE_AREA (for blocking APIs).
      boolean RteMeasurementSupport: set at pre-compile, default-value=false  # The RTE generator shall have the option to switch off support for measurement for generated RTE code. This option shall influence complete RTE code at once.
      enumeration RteOptimizationMode: {MEMORY, RUNTIME}, category=NOT_SUPPORTED, set at pre-compile, default-value=RUNTIME  # Switch between the two available optimization modes of the RTE generator.
      boolean RteRxAPIComDecoupling: origin=AUTOEVER, set at pre-compile, default-value=false  # If set to true, RTE generator shall generate Com Receiver APIs in RTE COM Callbacks.
      integer RteToolChainSignificantCharacters [0..1]: 0..65535, category=NOT_SUPPORTED, multiplicity set at pre-compile, set at pre-compile, default-value=31  # If present, the RTE generator shall provide the list of C RTE identifiers whose name is not unique when only the first RteToolChainSignificantCharacters characters are considered.
      boolean RteValueRangeCheckEnabled: set at pre-compile, default-value=false  # If set to true the RTE generator shall enable the value range checking for the specified VariableDataPrototypes.
      linker symbol RteVfbTraceClientPrefix [0..65535]: multiplicity set at pre-compile, set at pre-compile  # Defines an additional prefix for all VFB trace functions to be generated. With this approach it is possible to have debugging and DLT trace functions at the same time.
      boolean RteVfbTraceEnabled: set at pre-compile, default-value=false  # The RTE generator shall globally enable VFB tracing when RteVfbTrace is set to "true".
      function name RteVfbTraceFunction [0..65535]: multiplicity set at pre-compile, set at pre-compile  # The RTE generator shall enable VFB tracing for a given hook function when there is a #define in the RTE configuration header file for the hook function name and tracing is globally enabled. | Example: #define Rte_WriteHook_i1_p1_a_Start This also applies to VFB trace functions with a RteVfbTraceClientPrefix, e.g. Rte_Dbg_WriteHook_I1_P1_a_Start.
      float RteCrossCoreServiceTOut [0..1]: ..1.0, origin=AUTOEVER, set at pre-compile  # Expected Timeout in seconds till which an RTE API will wait for a cross core request to finish.
    container RteImplicitCommunication [0..65535]  # Configuration of the Implicit Communication behavior to be generated.
      boolean RteCoherentAccess: category=FIXED, set at pre-compile, default-value=true  # If set to true the referenced VariableAccess'es of this RteImplicitCommunication container are in one CoherencyGroup. | Data values for Coherent Implicit Read Access'es are read before the first reading RunnbaleEntity starts and are stable during the execution of all the reading RunnableEntitys; except Coherent Implicit Write Access'es belongs to the same Coherency Group. Data values written by Coherent Implicit Write Access'es are available for readers not belonging to the Coherency Group after the last writing RunnableEntity has terminated. Please note that a Coherent Implicit Data Access can be defined for VariableAccess'es to same and different data element. Nevertheless all Coherent Implicit Data Access'es of one Coherency Group have to be executed in the same task.
      boolean RteImmediateBufferUpdate: category=NOT_SUPPORTED, set at pre-compile, default-value=false  # If set to true the RTE will perform preemption area specific buffer update immediately before (for VariableAccess in the role dataReadAccess) resp. after (for VariableAccess in the role dataWriteAccess) Runnable execution.
      instance reference RteSoftwareComponentInstanceRef [1..65535]: multiplicity set at pre-compile, set at pre-compile, destination-context=ROOT-SW-COMPOSITION-PROTOTYPE, destination-type=SW-COMPONENT-PROTOTYPE  # Reference to a SwComponentPrototype. | This denotes the instances of the VariableAccess belonging to the RteImplicitCommunication.
      foreign reference RteVariableReadAccessRef [0..65535]: multiplicity set at pre-compile, set at pre-compile, destination-type=VARIABLE-ACCESS  # Reference to the VariableAccess in the dataReadAccess role.
      foreign reference RteVariableWriteAccessRef [0..65535]: multiplicity set at pre-compile, set at pre-compile, destination-type=VARIABLE-ACCESS  # Reference to the VariableAccess in the dataWriteAccess role.
    container RteInitializationBehavior [1..65535]  # Specifies the initialization strategy for variables allocated by RTE with the purpose to implement VariableDataPrototypes. | The container defines a set of RteSectionInitializationPolicys and one RteInitializationStrategy which is applicable for this set.
      enumeration RteInitializationStrategy: {RTE_INITIALIZATION_STRATEGY_AT_DATA_DECLARATION, RTE_INITIALIZATION_STRATEGY_AT_DATA_DECLARATION_AND_PARTITION_RESTART, RTE_INITIALIZATION_STRATEGY_AT_RTE_START_AND_PARTITION_RESTART, RTE_INITIALIZATION_STRATEGY_NONE}, category=FIXED, set at pre-compile, default-value=RTE_INITIALIZATION_STRATEGY_AT_DATA_DECLARATION  # Definition of the initialization strategy applicable for the SectionInitializationPolicys selected by RteSectionInitializationPolicy.
      string RteSectionInitializationPolicy [1..65535]: category=NOT_SUPPORTED, multiplicity set at pre-compile, set at pre-compile  # This parameter describes the SectionInitializationPolicys for which a particular RTE initialization strategy applies. | The SectionInitializationPolicy describes the intended initialization of MemorySections. The following values are standardized in AUTOSAR Methodology: * '''NO-INIT''': No initialization and no clearing is performed. Such data elements must not be read before one has written a value into it. * '''INIT''': To be used for data that are initialized by every reset to the specified value (initValue). * '''POWER-ON-INIT''': To be used for data that are initialized by "Power On" to the specified value (initValue). Note: there might be several resets between power on resets. * '''CLEARED''': To be used for data that are initialized by every reset to zero. * '''POWER-ON-CLEARED''': To be used for data that are initialized by "Power On" to zero. Note: there might be several resets between power on resets.
    container RteInitializationRunnableBatch [0..65535]  # This container corresponds to an Rte_Init_<shortName of this container> function invoking the mapped RunnableEntities.
    container RteOsInteraction [1..65535]  # Interaction of the Rte with the Os.
      container RteModeToScheduleTableMapping [0..65535]  # Provides configuration input in which Modes of a ModeDeclarionGroupPrototype of a Mode Manager a OsScheudleTable shall be active. | The Mode Manager is either specified as a SwComponentPrototype (RteModeSchtblMapSwc) or as a BSW-Module (RteModeSchtblMapBsw).
        reference RteModeScheduleTableRef: set at pre-compile, destination=OsScheduleTable  # Reference to the OsScheduleTable which shall be active in the specified RteModeSchblMapModeDeclarationRefs.
        foreign reference RteModeSchtblMapModeDeclarationRef [1..65535]: multiplicity set at pre-compile, set at pre-compile, destination-type=MODE-DECLARATION  # Reference to the ModeDeclarations.
        container RteModeSchtblMapBsw [0..1]  # Specifies an instance of a ModeDeclarationGroupPrototype of a Bsw-Module.
          reference RteModeSchtblMapBswInstanceRef: set at pre-compile, destination=RteBswModuleInstance  # Reference to an instance specification of a Bsw-Module.
          foreign reference RteModeSchtblMapBswProvidedModeGroupRef: set at pre-compile, destination-type=MODE-DECLARATION-GROUP-PROTOTYPE  # Reference to an instance of a ModeDeclarationGroupPrototype of a Bsw-Module.
        container RteModeSchtblMapSwc [0..1]  # Specifies an instance of a ModeDeclarationGroupPrototype of a SwComponentPrototype.
          reference RteModeSchtblMapSwcInstanceRef: set at pre-compile, destination=RteSwComponentInstance  # Reference to an instance specification of a SwComponentPrototype.
          foreign reference RteModeSchtblMapSwcPortRef: set at pre-compile, destination-type=ABSTRACT-PROVIDED-PORT-PROTOTYPE  # Reference to the PPortPrototype of a SwComponentPrototype.
      container RteSyncPoint [0..65535]  # The RteSyncPoint is necessary to provide an cross core synchronization in case of RteEvents triggered by the same event source but mapped to tasks belonging to different partitions on different cores. | The synchronization point must be reached by all referencing RteEvents before the execution in all related tasks is continued. In case of Rte(Bsw)EventSuccessorSyncPointRef the ExecutableEntity activated by the mapped event is executed before the synchronization point is entered. In case of Rte(Bsw)EventPredecessorSyncPointRef the ExecutableEntity activated by the mapped event is executed after the synchronization point is passed.
      container RteUsedOsActivation [0..65535]  # Attributes used in the activation of OsTasks and Runnable Entities.
        float RteExpectedActivationOffset: 0..Inf, set at pre-compile  # Activation offset in seconds. | Important: This is a requirement from the Rte towards the Os/Mcu setup. The Rte Generator shall assume this activation offset to be fulfilled.
        float RteExpectedTickDuration: 0..Inf, set at pre-compile  # The expected tick duration in seconds which shall be configured to drive the OsScheduleTables or OsAlarm. | Important: This is a requirement from the Rte towards the Os/Mcu setup. The Rte Generator shall assume this tick duration to be fulfilled.
        enumeration RteActivationType [0..1]: {ABSOLUTE, RELATIVE, SYNCHRON}, origin=AUTOEVER, set at pre-compile, default-value=RELATIVE  # Enumeration Parameter which gives an option to RTE generator to generate specific ScheduleTable or Alarm function calls.
        reference RteActivationOsAlarmRef [0..1]: multiplicity set at pre-compile, set at pre-compile, destination=OsAlarm  # Reference to an OsAlarm.
        reference RteActivationOsSchTblRef [0..1]: multiplicity set at pre-compile, set at pre-compile, destination=OsScheduleTable  # Reference to an OsScheduleTable.
        reference RteActivationOsTaskRef [0..1]: multiplicity set at pre-compile, set at pre-compile, destination=OsTask  # Reference to an OsTask.
    container RtePostBuildVariantConfiguration [0..1]  # Specifies the PostbuildVariantSets for each of the PostBuild configurations of the RTE.
      foreign reference RtePostBuildUsedPredefinedVariant [1..65535]: multiplicity set at post-build in variant post-build / pre-compile in variant pre-compile, post-build-variant-multiplicity=true, post-build-variant-value=true, set at post-build in variant post-build / pre-compile in variant pre-compile, destination-type=PREDEFINED-VARIANT  # Reference to the PredefinedVariant element which defines the values for PostBuildVariationCriterion elements. | The shortName of the referenced PredefinedVariant defines the name of the RtePostBuildVariant.
    container RteSwComponentInstance [0..65535]  # Representation of one SwComponentPrototype located on the to be configured ECU. All subcontainer configuration aspects are in relation to this SwComponentPrototype. | The RteSwComponentInstance can be associated with either a AtomicSwComponentType or ParameterSwComponentType.
      foreign reference RteSoftwareComponentInstanceRef [0..1]: multiplicity set at pre-compile, set at pre-compile, destination-type=SW-COMPONENT-PROTOTYPE  # Reference to a SwComponentPrototype.
      container RteEventToTaskMapping [0..65535]  # Maps an instance of a RunnableEntity onto one OsTask based on the activating RTEEvent. | In the case of a RunnableEntity executed via a direct function call this RteEventToTaskMapping is still specified but no RteMappedToTask element is included. The RtePositionInTask parameter is necessary to provide an ordering of events invoked by the same RTE API.
        float RteActivationOffset [0..1]: 0..Inf, multiplicity set at pre-compile, set at pre-compile  # Activation offset in seconds.
        boolean RteImmediateRestart: category=NOT_SUPPORTED, set at pre-compile, default-value=false  # When RteImmediateRestart is set to true the RunnableEntitiy shall be immediately re-started after termination if it was activated by this RTEEvent while it was already started. | This parameter shall not be set to true when the mapped RTEEvent refers to a RunnableEntity which minimumStartInterval attribute is > 0.
        enumeration RteOsSchedulePoint [0..1]: {CONDITIONAL, NONE, UNCONDITIONAL}, multiplicity set at pre-compile, set at pre-compile  # Introduce a schedule point by explicitly calling Os Schedule service after the execution of the ExecutableEntity. The Rte generator is allowed to optimize several consecutive calls to Os schedule into one single call if the ExecutableEntity executions in between have been skipped. | The absence of this parameter is interpreted as "NONE". It shall be considered an invalid configuration if the task is preemptable and the value of this parameter is not set to "NONE" or the parameter is absent.
        integer RtePositionInTask [0..1]: 0..65535, multiplicity set at pre-compile, set at pre-compile  # Each RunnableEntity mapped to an OsTask has a specific position within the task execution. | For periodic activation this is the order of execution. For event driver activation this is the order of evaluation which actual RunnableEntity has to be executed. In case of direct function calls this parameter is necessary to provide an ordering of events when several ExecutableEntities are invoked by the same RTE API.
        reference RteEventPredecessorSyncPointRef [0..1]: category=NOT_SUPPORTED, multiplicity set at pre-compile, set at pre-compile, destination=RteSyncPoint  # The RteEventPredecessorSyncPointRef is necessary to provide a cross core synchronization in case of RteEvents triggered by the same event source but mapped to tasks belonging to different partitions on different cores. | The synchronization point must be reached by all referencing RteEvents before the execution in all related tasks is continued. In case of RteEventPredecessorSyncPointRef the RunnableEntity activated by the mapped RteEvent is executed after the synchronization point is passed.
        foreign reference RteEventRef: set at pre-compile, destination-type=RTE-EVENT  # Reference to the description of the RTEEvent which is pointing to the RunnableEntity being mapped. This allows a fine grained mapping of RunnableEntites based on the activating RTEEvent.
        reference RteEventSuccessorSyncPointRef [0..1]: category=NOT_SUPPORTED, multiplicity set at pre-compile, set at pre-compile, destination=RteSyncPoint  # The RteEventSuccessorSyncPointRef is necessary to provide a cross core synchronization in case of RteEvents triggered by the same event source but mapped to tasks belonging to different partitions on different cores. | The synchronization point must be reached by all referencing RteEvents before the execution in all related tasks is continued. In case of RteEventSuccessorSyncPointRef the RunnableEntity activated by the mapped RteEvent is executed before the synchronization point is entered.
        reference RteMappedToTaskRef [0..1]: multiplicity set at pre-compile, set at pre-compile, destination=OsTask  # Reference to the OsTask the RunnableEntity activated by the RteEventRef is mapped to. | If no reference to the OsTask is specified the RunnableEntity shall be executed via a direct function call. The fact that no reference to an OsTask is specified for a RunnableEntity does not necessarily imply that every RTE generator has to support the implementation of this RunnableEntity as a direct function call. The standard set of use cases for direct function calls that has to be supported by every RTE generator is explicitly stated as requirements in this document. For further optimization RTE vendors are free to support additional scenarios of direct function call implementations that are not explicitly required in this document.
        reference RteUsedInitFnc [0..1]: multiplicity set at pre-compile, set at pre-compile, destination=RteInitializationRunnableBatch  # The RunnableEntity is executed during initialization in the context of the Rte_Init_<InitContainer> function.
        reference RteUsedOsAlarmRef [0..1]: multiplicity set at pre-compile, set at pre-compile, destination=OsAlarm  # If an OsAlarm is used to activate the OsTask this RteEvent is mapped to it shall be referenced here.
        reference RteUsedWaitPointTOutOsAlarmRef [0..1]: multiplicity set at pre-compile, origin=AUTOEVER, set at pre-compile, destination=OsAlarm  # If the RunnableEntity activated by this RteEvent is mapped to a WaitPoint then the OsAlarm used for timeout monitoring of the WaitPoint shall be referenced here.
        reference RteUsedOsEventRef [0..1]: multiplicity set at pre-compile, set at pre-compile, destination=OsEvent  # If an OsEvent is used to activate the OsTask this RteEvent is mapped to it shall be referenced here.
        reference RteUsedWaitPointOsEventRef [0..1]: multiplicity set at pre-compile, origin=AUTOEVER, set at pre-compile, destination=OsEvent  # If an OsEvent is used to activate the OsTask for indicating setting of a waitpoint mapped to the runnable activated by this RteEvent, it shall be referenced here.
        reference RteUsedOsSchTblExpiryPointRef [0..1]: multiplicity set at pre-compile, set at pre-compile, destination=OsScheduleTableExpiryPoint  # If an OsScheduleTableExpiryPoint is used to activate the OsTask this RteEvent is mapped to it shall be referenced here.
        reference RteVirtuallyMappedToTaskRef [0..1]: category=NOT_SUPPORTED, multiplicity set at pre-compile, set at pre-compile, destination=OsTask  # Optional reference to an OsTask where the activation of this RteEvent shall be evaluated. The actual execution of the Runnable Entity shall happen in the OsTask referenced by RteMappedToTaskRef.
      container RteExclusiveAreaImplementation [0..65535]  # Specifies the implementation to be used for the data consistency of this ExclusiveArea.
        enumeration RteExclusiveAreaImplKind [0..1]: {RTE_MACRO, RTE_FUNCTION}, origin=AUTOEVER, set at pre-compile, default-value=RTE_MACRO  # Enumeration Parameter which provides an option to RTE generator to generate RTE Exclusive Area APIs as a macro or a function.
        enumeration RteExclusiveAreaImplMechanism: {ALL_INTERRUPT_BLOCKING, NONE, OS_INTERRUPT_BLOCKING, OS_RESOURCE}, set at pre-compile  # To be used implementation mechanism for the specified ExclusiveArea.
        reference RteExclusiveAreaOsResourceRef [0..1]: multiplicity set at pre-compile, set at pre-compile, destination=OsResource  # Optional reference to an OsResource in case RteExclusiveAreaImplMechanism is configured to OS_RESOURCE for this ExclusiveArea.
        foreign reference RteExclusiveAreaRef: set at pre-compile, destination-type=EXCLUSIVE-AREA  # Reference to the ExclusiveArea.
      container RteExternalTriggerConfig [0..65535]  # Defines the configuration of External Trigger Event Communication for Software Components
        integer RteTriggerSourceQueueLength: 0..4294967295, set at pre-compile, default-value=0  # Length of trigger queue on the trigger source side. | The queue is implemented by the RTE. A value greater or equal to 1 requests an queued behavior. Setting the value of RteTriggerSourceQueueLength to 0 requests an none queued implementation of the trigger communication. If there is no RteTriggerSourceQueueLength configured for a Trigger Emitter the default value of 0 applies as well.
        instance reference RteSwcTriggerSourceRef: set at pre-compile, destination-context=ABSTRACT-PROVIDED-PORT-PROTOTYPE, destination-type=TRIGGER  # Reference to a Trigger instance in the pPortPrototype of the related component instance. | The referenced Trigger instance has to belong to the same software component instance as the RteSwComponentInstance owning this parameter configures.
      container RteInternalTriggerConfig [0..65535]  # Defines the configuration of Inter Runnable Triggering for Software Components
        integer RteTriggerSourceQueueLength: 0..4294967295, set at pre-compile, default-value=0  # Length of trigger queue on the trigger source side. | The queue is implemented by the RTE. A value greater or equal to 1 requests an queued behavior. Setting the value of RteTriggerSourceQueueLength to 0 requests an none queued implementation of the trigger communication. If there is no RteTriggerSourceQueueLength configured for a Trigger Emitter the default value of 0 applies as well.
        foreign reference RteSwcTriggerSourceRef: set at pre-compile, destination-type=INTERNAL-TRIGGERING-POINT  # Reference to an InternalTriggeringPoint of the related component instance. | The referenced InternalTriggeringPoint has to belong to the same software component instance as the RteSwComponentInstance owning this parameter configures.
      container RteNvRamAllocation [0..65535]  # Specifies the relationship between the AtomicSwComponentType's NVRAMMapping / NVRAM needs and the NvM module configuration.
        linker symbol RteNvmRamBlockLocationSymbol [0..1]: multiplicity set at pre-compile, set at pre-compile  # This is the name of the linker object name where the NVRam Block will be mirrored by the Nvm. | This symbol will be resolved into the parameter "NvmRamBlockDataAddress" from the "NvmBlockDescriptor".
        linker symbol RteNvmRomBlockLocationSymbol [0..1]: multiplicity set at pre-compile, set at pre-compile  # This is the name of the linker object name where the NVRom Block will be accessed by the Nvm. | This symbol will be resolved into the parameter "NvmRomBlockDataAddress" from the "NvmBlockDescriptor".
        symbolic name reference RteNvmBlockRef: set at pre-compile, destination=NvMBlockDescriptor  # Reference to the used NvM block for storage of the NVRAMMapping information.
        foreign reference RteSwNvBlockDescriptorRef [0..1]: multiplicity set at pre-compile, set at pre-compile, destination-type=NV-BLOCK-DESCRIPTOR  # Reference to the NvBlockDescriptor in case the RTE needs to call the NvM directly (e.g. for the supportDirtyFlag feature, storeCyclic feature, server invocation for NV data management or mode switch based invocation NvM services).
        foreign reference RteSwNvRamMappingRef [0..1]: multiplicity set at pre-compile, set at pre-compile, destination-type=SWC-SERVICE-DEPENDENCY  # Reference to the SwSeriveDependency which is used to specify the NvBlockNeeds. | XOR
    container RteSwComponentType [0..65535]  # Representation of one SwComponentType for the base of all configuration parameter which are affecting the whole type and not a specific instance.
      boolean RteBypassSupportEnabled [0..1]: category=NOT_SUPPORTED, multiplicity set at pre-compile, set at pre-compile, default-value=false  # Individual switch to enable the bypass support for this software component type.
      foreign reference RteComponentTypeRef: set at pre-compile, destination-type=SW-COMPONENT-TYPE  # Reference to either AtomicSwComponentType or ParameterSwComponentType.
      foreign reference RteImplementationRef [0..1]: multiplicity set at pre-compile, set at pre-compile, destination-type=SWC-IMPLEMENTATION  # The Implementation which shall be assigned to the SwComponentType.
      container RteComponentTypeCalibration [0..1]  # Specifies for each ParameterSwComponentType or AtomicSwComponentType whether calibration is enabled. | If references to SwAddrMethod are provided in RteCalibrationSwAddrMethodRef only ParameterDataPrototypes with the referenced SwAddrMethod shall have software calibration support enabled.
        boolean RteCalibrationSupportEnabled: set at pre-compile  # Enables calibration support for the specified ParameterSwComponentType or AtomicSwComponentType.
        foreign reference RteCalibrationSwAddrMethodRef [0..65535]: category=NOT_SUPPORTED, multiplicity set at pre-compile, set at pre-compile, destination-type=SW-ADDR-METHOD  # Reference to the SwAddrMethod for which software calibration support shall be enabled.
    container CommonPublishedInformation
      string ArReleaseVersion: category=FIXED, set at published-information, default-value=4.4.0, regular-expression=4\.[0-9]\.[0-9]  # Version of the AUTOSAR Release on which this implementation is based. The numbering contains three levels (major, minor, revision) which are defined by AUTOSAR.
      string SwVersion: category=FIXED, set at published-information, default-value=1.8.0  # Software version of this implementation. The numbering contains three levels (like major, minor, patch), its values are vendor specific.
      string VendorApiInfix: category=NOT_SUPPORTED, set at published-information  # In driver modules which can be instantiated several times on a single ECU, BSW00347 requires that the name of APIs is extended by the VendorId and a vendor specific name. This parameter is used to specify the vendor specific name. In total, the implementation specific name is generated as follows: <ModuleName>_<VendorId>_<VendorApiInfix><Api name from SWS>. E.g. assuming that the VendorId of the implementer is 123 and the implementer chose a VendorApiInfix of "v11r456" a api name Can_Write defined in the SWS will translate to Can_123_v11r456Write. This parameter is mandatory for all modules with upper multiplicity > 1. It shall not be used for modules with upper multiplicity =1.
