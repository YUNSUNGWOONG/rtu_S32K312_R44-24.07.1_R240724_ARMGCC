AUTOSAR XML (schema 00047)
package /AUTRON
  module definition Fota [0..*]: variants pre-compile  # Configuration of the FOTA handler module. | Its multiplicity describes the actual number of FOTA drivers. There will be one container for each Mem driver.
    container FotaGeneral  # Container for general configuration parameters of the FOTA driver. These parameters are always pre-compile.
      boolean FotaDevErrorDetect: set at pre-compile  # Switches the development error detection and notification on or off.
      boolean FotaLargeSector [0..1]: set at pre-compile  # Is Fota implement with large sector?.
      boolean FotaDownGradeProtection: set at pre-compile  # Enable downgrade protection.
      boolean FotaARMArchitectureEcu [0..1]: set at pre-compile  # Is Ecu a ARM architecture.
      boolean FotaVersionInfoAPI: set at pre-compile  # Fota use API of version info.
      boolean FotaBootManagerEnable: set at pre-compile  # Fota use boot manager feature.
      boolean FotaSoftwareVersionCheckEnable: set at pre-compile  # Fota use software version check feature.
      string FotaUserIncludeFiles [0..255]: origin=AUTRON  # User include files
      float FotaMainfunctionPeriod: 0..Inf, origin=AUTRON
      enumeration FotaMcuMemoryAccessType: {FOTA_MMU_TYPE, FOTA_NON_MMU_TYPE, FOTA_SINGLE_TYPE}, default-value=FOTA_MMU_TYPE  # Memory Access Type of Fota | FOTA_SINGLE_TYPE: Single type. FOTA_NON_MMU_TYPE: Dual NonMMU type. FOTA_MMU_TYPE: Dual MMU type.
      enumeration FotaStandardSupport: {FOTA_OTA_ES98765_01, FOTA_OTA_ES98765_02}, default-value=FOTA_OTA_ES98765_01  # Standard of Fota
      enumeration FotaMode: {FBL_MODE, APP_MODE, UPDATER_MODE}, default-value=FBL_MODE  # Operation mode of Fota module
      integer FotaVersionLengthMaximum
      integer FotaCommonRAMAddress
      integer FotaStartUpCommandAddress
      integer FotaStartUpCommandValue
      integer FotaCpdKeyValue
      integer FotaTpBlockLength
      integer FotaPartitionFlagSecurityValue
    container FotaSwUnit [1..255]: multiplicity set at pre-compile  # This container includes the FOTA driver instance specific configuration parameters. | Its multiplicity describes the number of FOTA driver instances of this FOTA driver. There will be one container for each FOTA driver instance.
      enumeration FotaSoftwareType: {FOTA_FBL_TYPE, FOTA_UPDATER_TYPE, FOTA_NEW_FBL_TYPE, FOTA_RTSW_TYPE, FOTA_RTSW_PARTA_TYPE, FOTA_RTSW_PARTB_TYPE, FOTA_DATA_TYPE, FOTA_USER_TYPE}
      integer FotaSwUnitIndex: 0..255, set at pre-compile, default-value=0  # This value specifies the unique numeric identifier which is used to reference a Mem driver instance in case multiple devices of the same type shall be addressed by one Mem driver. This value will be assigned to the symbolic name derived of the MemInstance container short name. Tags: atp.Status=draft
      integer FotaEcuSwUnit: 0..65535, set at pre-compile, default-value=0  # The parameter specifies the ECU software Unit according to ES95486-02E Tags: atp.Status=draft
      function name FotaPreRoutineControlCallout [0..1]
      integer FotaSwFuncPtrTable [0..1]: 0..4294967295, set at pre-compile, default-value=1  # Number of contiguous sectors with identical values for MemSectorSize and MemPageSize. Tags: atp.Status=draft | If this parameter is configured to be greater than 1, the sectors are grouped in a sector batch.
      function name FotaPostRoutineControlCallout [0..1]
      choice reference FotaMemDriverRef [0..1]: destination=MemInstance
      choice reference FotaNvmBlockRef [0..1]: destination=NvMBlockDescriptor
      choice reference FotaProtectedBlock [0..255]: destination=FotaBlock
      choice reference FotaHeaderTrailerRef [0..1]: destination=HeaderTrailerInfo
      container FotaBlockInfo: multiplicity set at pre-compile  # Specific configurations for the firmware instance to be installed/updated. | It is recommended to group as many identical sectors as possible together.
        integer ModuleInfoAddress
        container FotaBlock [1..255]
          enumeration BlockType: {METADATA, FIRMWARE, SIGNATURE, PARTITION_FLAG, CRC}  # Each firmware block handling is different based on block type
          integer BlockIndex
          integer BlockStartAddress
          integer BlockEndAddress
          container VerificationInfo [0..1]
            choice reference CsmAlgorithm [0..1]: destination=CsmJob
            reference TargetBlock [0..255]: destination=FotaBlock
            integer VerifySizeOfOneCycle: 0..8192, default-value=8  # Lengh of verify in one cycle.
            boolean VerifyBufferUsed: default-value=false  # Is Verify buffer used or not.
          container PartitionFlagInfo [0..1]
            function name WriteParitionFlagUserCallOut
          container MetaDataInfo [0..1]
            integer MdBlockHeaderLength: 0..255, default-value=8  # Length of the metadata sector header in BYTES.
            integer MdBlockMetadataLength: 0..255, default-value=48  # Length of the actual metadata used for hashing in metadata sector in BYTES.
            integer MdBlockDecKeyMACLength: 0..255, default-value=16  # Length of the firmware decryption key's MAC value in metadata sector in BYTES.
            boolean MetadataWriteToFlash: default-value=false  # Specify whether the metadata block shall be written into code flash. In case TRUE, an appropriate address in code flash for this metadata sector must be provided.
            choice reference CsmMetadataHashJob: destination=CsmJob  # CsmJob for hashing of firmware metadata.
            choice reference CsmKeyForKeyDerivationPassword: destination=CsmKey  # CsmKey to be used for storing the OEM specific Pre-shared Key and performing the derivation of firmware decryption key & CMAC verification key.
            choice reference CsmKeyForKeyDerivationResult: destination=CsmKey  # CsmKey to be used for storing the derivation result of firmware decryption key & CMAC verification key.
            choice reference CsmDecryptKey: destination=CsmKey  # CsmKey to be used for storing the firmware decryption key.
            choice reference CsmDecryptKeyVerifyJob: destination=CsmJob  # CsmJob to be used for performing the CMAC verification of firmware decryption key.
          container BlockProcessing [0..1]
            boolean IsEncrypted: set at pre-compile
            choice reference CsmDecryptionAlgo [0..1]: destination=CsmJob  # CsmJob to be used for performing decryption of firmware data block.
            container PreBlockUserCallOutInfo [0..255]
              function name PreProcessingBlockUserCallOut [0..1]
              choice reference CsmAlgorithm [0..1]: destination=CsmJob
            container PostBlockUserCallOutInfo [0..255]
              function name PostProcessingBlockUserCallOut [0..1]
              choice reference CsmAlgorithm [0..1]: destination=CsmJob
    container HeaderTrailerInfo [0..255]  # Container for information of header and trailer.
      integer BlockHeader
      integer BlockTrailer
  ecuc definition collection ParameterDefinition_Fota: module=Fota
