AUTOSAR XML (schema 4-2-1)
# (C) 2021 HYUNDAI AUTOEVER Corp.
package /AUTRON
  ecuc definition collection ParameterDefinition_OsProfiler: module=OsProfiler
  module definition OsProfiler: refined-module-def=Cdd, variants pre-compile  # Configuration of the OsProfiler module.
    container OsProfilerGlobalConfig
      boolean EnableOsProfiler: set at , default-value=false  # Enable OsProfiler
      boolean EnableProfileIsr: set at , default-value=false  # Enable OsProfiler
      integer NumberOfCores: 1..6, set at pre-compile, origin=AUTRON, default-value=1  # OsProfiler Number of cores (2 or 3 can be only applicable to TC2xx and 2 ~ 6 can be only applicable to TC3xx)
      integer ProfileEventCount: 0..32767, set at pre-compile, origin=AUTRON, default-value=20  # Profiled Event Count
      boolean EnableTimeIndex: set at , default-value=false  # Enable Time Index
      boolean UpwardDirectionCount: category=FIXED, origin=AUTRON  # Direction of System Timer Clock for OsProfiler True: Upward Direction Increasing of System Timer Clock False: Downward Direction Increasing of System Timer Clock
      float TimeIndexPeriod: 0.001..1, set at pre-compile, origin=AUTRON  # Period of Time Index in seconds .
      enumeration TargetOperatingSystem: {FREESCALE_MPC560xB, RENESAS_RH850, AUTRON_COMMON}, category=FIXED, set at pre-compile, origin=AUTRON, default-value=NONE  # Target Operating System
    container OsProfilerSpecificTargetConfig
      integer XOSC [0..1]: 0..4294967295, set at pre-compile, origin=AUTRON  # XOSC clock (Applicable to FREESCALE_MPC560XB, RENESAS_RH850)
    container OsProfilerCommonTargetConfig
      integer StmAddress [0..1]: 0..4294967295, category=FIXED, set at pre-compile, origin=AUTRON  # Address of System Timer Clock for OsProfiler (Applicable to AUTRON_COMMON)
      integer StmMaxTick [0..1]: 0..4294967295, category=FIXED, set at pre-compile, origin=AUTRON  # Max Tick of System Timer Clock for OsProfiler (Applicable to AUTRON_COMMON)
      float StmFrequency [0..1]: 0..4294967295, category=FIXED, set at pre-compile, origin=AUTRON  # Frequency of System Timer Clock for OsProfiler (in MHz) (Applicable to AUTRON_COMMON)
    container OsProfilerPeriodTaskConfig [1..255]
      float TaskPeriod [0..1]: 0.000001..100, category=NOT_SUPPORTED, set at pre-compile, origin=AUTRON  # Period of Task in seconds
      reference PeriodTaskRef: destination=OsTask
