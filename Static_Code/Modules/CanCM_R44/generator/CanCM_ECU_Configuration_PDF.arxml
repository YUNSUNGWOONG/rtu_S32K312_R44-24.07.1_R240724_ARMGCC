AUTOSAR XML (schema 00047)
# (C) 2021 HYUNDAI AUTOEVER Corp.
# Confidential Proprietary Information. Distribution Limited.
# Do Not Copy Without Prior Permission
package /AUTRON
  ecuc definition collection ParameterDefinition_CanCM: module=CanCM
  module definition CanCM: category=STANDARDIZED_MODULE_DEFINITION, api-service-prefix=CanCM, post-build-variant-support=true, refined-module-def=Cdd, variants pre-compile/post-build/post-build-selectable  # Configuration Parameters for the CanCM module.
    container CanCMGlobalConfig: post-build-variant-multiplicity=true, multiple-configuration-container=true  # This container contains the global configuration parameter of the CanCM.
      boolean CanCMVersionInfoApi: set at pre-compile, default-value=true  # Enabling Version Info API
      boolean CanCMDevErrorDetect: set at pre-compile, default-value=true  # Pre-processor switch for enabling development error detection support.
      float CanCMMainFunctionPeriod: 0.001..1, set at pre-compile, default-value=0.005  # Period of invoking CanCM_MainFunction in seconds .
      boolean CanCMDemStatusReport: set at pre-compile, default-value=true  # Precompile option for voltage status reporting to Dem
      boolean CanCMDisableDMOnAbnormalVoltage: default-value=true  # Precompile option to disable deadline monitoring on abnormal voltage in order to prevent recording DTC by signal timeout
      boolean CanCMWakeupSupport: default-value=true  # Precompile option for wake-up support to check port pin assigned as wake-up source
      boolean CanCMHysteresisSupport: default-value=true  # Precompile option for hysteresis support to decide recovery from voltage error
      integer CanCMFilteringConstant: 0..255, default-value=128  # Link-time option for filtering Adc value for battery voltage
    container CanCMChannelConfig [1..*]: post-build-variant-multiplicity=true, multiple-configuration-container=true  # This container contains the global configuration parameter of the CanCM.
      integer CanCMChannelId: 0..255, set at pre-compile  # Channel Identifier.
      float CanCMNetworkActivationTime: 0.001..60, set at pre-compile  # Time interval between Network Start-up and Network Activation specified in seconds.
      float CanCMVoltageErrorDelayTime: 0.001..60, set at pre-compile  # Time which the CanCM shall wait before voltage mode transition from voltage critical to voltage non-critical specified in seconds.
      float CanCMTimeoutMonitoringStartTime: 0.001..60, set at pre-compile  # Time(in seconds) which the CanCM shall wait before starting Reception DM of the Com module
      float CanCMVoltageAbnormalUpper: 0..4096, set at pre-compile  # upper limit of abnormal voltage range
      float CanCMVoltageAbnormalLower: 0..4096, set at pre-compile  # lower limit of abnormal voltage range
      float CanCMVoltageCriticalUpper: 0..4096, set at pre-compile  # upper limit of critical voltage range
      float CanCMVoltageCriticalLower: 0..4096, set at pre-compile  # lower limit of critical voltage range
      float CanCMVoltageHysteresis: 0..4096, default-value=0  # Hysteresis value
      reference CanCMComMChannelId: set at pre-compile, destination=ComMChannel  # Reference to the ComM channel that is mapped to this CanCMChannel instance.
      container CanCMDemEventParameterRefs [0..1]: scope=ECU
        reference CANCM_E_BAT_FAIL: destination=DemEventParameter
      container CanCMWakeupParameterRefs [0..1]
        reference CanCMEcuMWakeupSourceRef: destination=EcuMWakeupSource
        reference CanCMIoHwAbWakeupPinNameRef: destination=IoHwAbDigitalDirectLogical
    container CanCMBatMonConfig [0..10]: post-build-variant-multiplicity=true, multiple-configuration-container=true
      integer CanCMAdcDefault: 0..65535, default-value=500  # Initial value for ADC buffer saving battery voltage
      reference CanCMBatAnalogInputRef: set at pre-compile, destination=IoHwAbAnalogInputDirectLogical  # Reference to AdcGroup container that is used for battery voltage acquisition
