AUTOSAR XML (schema 00047)
# (C) 2019-2020 HYUNDAI AUTRON Co., Ltd.
# Confidential Proprietary Information. Distribution Limited.
# Do Not Copy Without Prior Permission
package /Bsw_WdgM
  bsw implementation BswImplementation_WdgM: programming-language=C, sw-version=1.0.0, swc-bsw-mapping=SwcBswMapping_WdgM, vendor-id=76, ar-release-version=4.4.0, behavior=BswInternalBehavior_WdgM, vendor-specific-module-def=WdgM
  bsw module description WdgM: module-id=13
    required-mode-groups:
      mode declaration group prototype modeNotificationPort_EcuMode: type=EcuMode
    bsw internal behavior BswInternalBehavior_WdgM: data-type-mapping=EcuModeMap, bsw-mode-receiver-policy{enhanced-mode-api=true, required-mode-group=modeNotificationPort_EcuMode, supports-asynchronous-mode-switch=true}
      exclusive area FIRSTEXPIREDSEID_MULTICORE_PROTECTION
      exclusive area GLOBALSUPVSNSTATUS_PROTECTION
      10 x bsw called entity:
        BswCE_WdgM_CheckpointReached: implemented-entry=WdgM_CheckpointReached
        BswCE_WdgM_DeInit: implemented-entry=WdgM_DeInit
        BswCE_WdgM_GetFirstExpiredSEID: implemented-entry=WdgM_GetFirstExpiredSEID
        BswCE_WdgM_GetGlobalStatus: implemented-entry=WdgM_GetGlobalStatus
        BswCE_WdgM_GetLocalStatus: implemented-entry=WdgM_GetLocalStatus
        BswCE_WdgM_GetMode: implemented-entry=WdgM_GetMode
        BswCE_WdgM_GetVersionInfo: implemented-entry=WdgM_GetVersionInfo
        BswCE_WdgM_Init: implemented-entry=WdgM_Init
        BswCE_WdgM_PerformReset: implemented-entry=WdgM_PerformReset
        BswCE_WdgM_SetMode: implemented-entry=WdgM_SetMode
      bsw schedulable entity BswSE_WdgM_MainFunction: can-enter-exclusive-area=[FIRSTEXPIREDSEID_MULTICORE_PROTECTION, GLOBALSUPVSNSTATUS_PROTECTION], accessed-mode-groups=modeNotificationPort_EcuMode, implemented-entry=WdgM_MainFunction
      bsw timing event BswTE_WdgM_MainFunction: context-limitation=BswDistinguishedPartition_WdgM, disabled-in-mode=modeNotificationPort_EcuMode.ECUM_STATE_SHUTDOWN, starts-on-event=BswSE_WdgM_MainFunction, period=0.01
      bsw distinguished partition BswDistinguishedPartition_WdgM
  11 x bsw module entry, all with is-synchronous=true, bsw-entry-kind=CONCRETE:
    WdgM_CheckpointReached: service-id=0x0e, is-reentrant=true, call-type=REGULAR, execution-context=UNSPECIFIED, sw-service-impl-policy=STANDARD  # Indicates to the Watchdog Manager that a Checkpoint within a Supervised Entity has been reached.
      return type Std_ReturnType: implementation-data-type=Std_ReturnType
      sw service arg SEID: direction=IN, implementation-data-type=WdgM_SupervisedEntityIdType  # Identifier of the Supervised Entity that reports a Checkpoint.
      sw service arg CheckpointID: direction=IN, implementation-data-type=WdgM_CheckpointIdType  # Identifier of the Checkpoint within a Supervised Entity that has been reached.
    WdgM_DeInit: service-id=0x01, is-reentrant=false, call-type=REGULAR, execution-context=UNSPECIFIED, sw-service-impl-policy=STANDARD  # De-initializes the Watchdog Manager.
    WdgM_GetFirstExpiredSEID: service-id=0x10, is-reentrant=true, call-type=REGULAR, execution-context=UNSPECIFIED, sw-service-impl-policy=STANDARD  # Returns SEID that first reached the state WDGM_LOCAL_STATUS_EXPIRED.
      return type Std_ReturnType: implementation-data-type=Std_ReturnType
      sw service arg SEID: direction=OUT, sw-pointer-target-props=WdgM_SupervisedEntityIdType  # Identifier of the supervised entity that first reached the state WDGM_LOCAL_STATUS_EXPIRED.
    WdgM_GetGlobalStatus: service-id=0x0d, is-reentrant=true, call-type=REGULAR, execution-context=UNSPECIFIED, sw-service-impl-policy=STANDARD  # Returns the global supervision status of the Watchdog Manager.
      return type Std_ReturnType: implementation-data-type=Std_ReturnType
      sw service arg Status: direction=OUT, sw-pointer-target-props=WdgM_GlobalStatusType  # Global supervision status of the Watchdog Manager.
    WdgM_GetLocalStatus: service-id=0x0c, is-reentrant=true, call-type=REGULAR, execution-context=UNSPECIFIED, sw-service-impl-policy=STANDARD  # Returns the supervision status of an individual Supervised Entity.
      return type Std_ReturnType: implementation-data-type=Std_ReturnType
      sw service arg SEID: direction=IN, implementation-data-type=WdgM_SupervisedEntityIdType  # Identifier of the supervised entity whose supervision status shall be returned.
      sw service arg Status: direction=OUT, sw-pointer-target-props=WdgM_LocalStatusType  # Supervision status of the given supervised entity.
    WdgM_GetMode: service-id=0x0b, is-reentrant=true, call-type=REGULAR, execution-context=UNSPECIFIED, sw-service-impl-policy=STANDARD  # Returns the current mode of the Watchdog Manager.
      return type Std_ReturnType: implementation-data-type=Std_ReturnType
      sw service arg Mode: direction=OUT, sw-pointer-target-props=WdgM_ModeType  # Current mode of the Watchdog Manager.
    WdgM_GetVersionInfo: service-id=0x02, is-reentrant=true, call-type=REGULAR, execution-context=UNSPECIFIED, sw-service-impl-policy=STANDARD  # Returns the version information of this module.
      sw service arg VersionInfo: direction=OUT, sw-pointer-target-props=Std_VersionInfoType  # Pointer to where to store the version information of the module WdgM.
    WdgM_Init: service-id=0x00, is-reentrant=false, call-type=REGULAR, execution-context=UNSPECIFIED, sw-service-impl-policy=STANDARD  # Initializes the Watchdog Manager.
      sw service arg ConfigPtr: direction=IN, sw-pointer-target-props={implementation-data-type=WdgM_ConfigType, sw-impl-policy=CONST}  # Pointer to post-build configuration data
    WdgM_MainFunction: service-id=0x08, is-reentrant=false, call-type=SCHEDULED, execution-context=TASK, sw-service-impl-policy=INLINE-CONDITIONAL  # Performs the processing of the cyclic Watchdog Manager jobs.
    WdgM_PerformReset: service-id=0x0f, is-reentrant=false, call-type=REGULAR, execution-context=UNSPECIFIED, sw-service-impl-policy=STANDARD  # Instructs the Watchdog Manager to cause a watchdog reset.
    WdgM_SetMode: service-id=0x03, is-reentrant=false, call-type=REGULAR, execution-context=UNSPECIFIED, sw-service-impl-policy=STANDARD  # Sets the current mode of Watchdog Manager.
      return type Std_ReturnType: implementation-data-type=Std_ReturnType
      sw service arg Mode: direction=IN, implementation-data-type=WdgM_ModeType  # One of the configured Watchdog Manager modes.
