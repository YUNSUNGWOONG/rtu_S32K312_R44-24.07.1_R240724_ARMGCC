AUTOSAR XML (schema 00047)
# (C) 2021 HYUNDAI AUTOEVER Corp.
package /Bsw_Os
  bsw implementation BswImplementation_Os: programming-language=C, sw-version=1.3.0, vendor-id=76, ar-release-version=4.4.0, behavior=BswInternalBehavior_Os
    code-descriptors:
      code Code_OS_ARCH
        artifact-descriptors:
          short-label=Os_Arch_Context, category=SWHDR
          short-label=Os_Arch_PowerManagement, category=SWHDR
          short-label=Os_Arch_Ram, category=SWHDR
          short-label=Os_Arch_Ram, category=SWSRC
          short-label=Os_Arch_Regs, category=SWHDR
          short-label=Os_Arch_Timer, category=SWHDR
          short-label=Os_Arch_Trap, category=SWSRC
          short-label=Os_Config, category=SWSRC
          short-label=Os_Debug, category=SWHDR
          short-label=Os_PortTypes, category=SWHDR
          short-label=Os_Arch_Context, category=SWSRC
          short-label=Os_Arch_Counter, category=SWSRC
          short-label=Os_Arch_Exceptions, category=SWSRC
          short-label=Os_Arch_Init, category=SWSRC
          short-label=Os_Arch_Init, category=SWHDR
          short-label=Os_Arch_Interrupt, category=SWSRC
          short-label=Os_Arch_Interrupt, category=SWHDR
          short-label=Os_Arch_MemPro, category=SWSRC
          short-label=Os_Arch_MemPro, category=SWHDR
          short-label=Os_Arch_Multicore, category=SWSRC
          short-label=Os_Arch_Multicore, category=SWHDR
          short-label=Os_Arch_PowerManagement, category=SWSRC
          short-label=Os_Arch_Timer, category=SWSRC
          short-label=Os_Arch_TimingProtection, category=SWSRC
          short-label=Os_Arch_TimingProtection, category=SWHDR
          short-label=Os_Debug, category=SWSRC
          short-label=Os_ISR2, category=SWSRC
      code Code_OS_Common
        artifact-descriptors:
          short-label=Os, category=SWHDR
          short-label=Os_definition, category=SWHDR
          short-label=Os_ErrorExternal, category=SWHDR
          short-label=Os_Gen, category=SWHDR
          short-label=Os_InternalTypes, category=SWHDR
          short-label=Os_Interrupt, category=SWHDR
          short-label=Os_IocInternalTypes, category=SWHDR
          short-label=Os_Multicore, category=SWHDR
          short-label=Os_Ram, category=SWSRC
          short-label=Os_Ram, category=SWHDR
          short-label=Os_Task, category=SWHDR
          short-label=Os_Types, category=SWHDR
          short-label=Os, category=SWHDR
          short-label=Os_Alarm, category=SWHDR
          short-label=Os_Alarm, category=SWSRC
          short-label=Os_Application, category=SWHDR
          short-label=Os_Application, category=SWSRC
          short-label=Os_Counter, category=SWHDR
          short-label=Os_Counter, category=SWSRC
          short-label=Os_Error, category=SWHDR
          short-label=Os_Error, category=SWSRC
          short-label=Os_Event, category=SWHDR
          short-label=Os_Event, category=SWSRC
          short-label=Os_Interrupt, category=SWHDR
          short-label=Os_Ioc, category=SWHDR
          short-label=Os_Ioc, category=SWSRC
          short-label=Os_Kernel, category=SWHDR
          short-label=Os_Kernel, category=SWSRC
          short-label=Os_Multicore, category=SWSRC
          short-label=Os_MulticoreMessage, category=SWHDR
          short-label=Os_MulticoreMessage, category=SWSRC
          short-label=Os_MulticoreReceive, category=SWSRC
          short-label=Os_MulticoreSend, category=SWSRC
          short-label=Os_Panic, category=SWHDR
          short-label=Os_Panic, category=SWSRC
          short-label=Os_Peripheral, category=SWHDR
          short-label=Os_Peripheral, category=SWSRC
          short-label=Os_Resource, category=SWHDR
          short-label=Os_Resource, category=SWSRC
          short-label=Os_SchedTable, category=SWHDR
          short-label=Os_SchedTable, category=SWSRC
          short-label=Os_Shutdown, category=SWHDR
          short-label=Os_Shutdown, category=SWSRC
          short-label=Os_SpinLock, category=SWHDR
          short-label=Os_SpinLock, category=SWSRC
          short-label=Os_Stack, category=SWHDR
          short-label=Os_Stack, category=SWSRC
          short-label=Os_SystemCallTable, category=SWHDR
          short-label=Os_SystemCallTable, category=SWSRC
          short-label=Os_Task, category=SWSRC
          short-label=Os_TimingProtection, category=SWHDR
          short-label=Os_TimingProtection, category=SWSRC
    resource consumption ResourceConsumption
  bsw module description Os: module-id=1
    bsw internal behavior BswInternalBehavior_Os
      bsw distinguished partition BswDistinguishedPartition_Os
