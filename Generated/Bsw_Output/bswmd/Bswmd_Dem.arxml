AUTOSAR XML (schema 00047)
package /Bsw_Dem
  bsw implementation BswImplementation_Dem: programming-language=C, sw-version=1.0.0, swc-bsw-mapping=SwcBswMapping, vendor-id=76, ar-release-version=4.4.0, behavior=BswInternalBehavior_Dem
  bsw module description Dem: category=BSW_MODULE, module-id=54
    implemented-entrys:
      Dem_SetEventFailureCycleCounterThreshold
      Dem_DcmGetInfoTypeValue08
      Dem_GetNextExtendedDataRecord
      Dem_J1939DcmSetFreezeFrameFilter
      Dem_DcmReadDataOfPID4D
      Dem_SetDataOfPID4D
      Dem_J1939DcmSetRatioFilter
      Dem_SetEventDisabled
      Dem_GetMonitorStatus
      Dem_J1939DcmFirstDTCwithLampStatus
      Dem_GetDTCSelectionResultForClearDTC
      Dem_DcmReadDataOfPID41
      Dem_J1939DcmGetNextFilteredRatio
      Dem_ClearDTC
      Dem_SetWIRStatus
      Dem_GetIUMPRDenCondition
      Dem_J1939DcmGetNextFreezeFrame
      Dem_GetNextFreezeFrameData
      Dem_GetSizeOfExtendedDataRecordSelection
      Dem_GetEventMemoryOverflow
      Dem_SetComponentAvailable
      Dem_GetNumberOfEventMemoryEntries
      Dem_GetEventUdsStatus
      Dem_SetPtoStatus
      Dem_DcmReadDataOfPID31
      Dem_GetDTCByOccurrenceTime
      Dem_SetDTR
      Dem_DcmReadDataOfOBDFreezeFrame
      Dem_GetSeverityOfDTC
      Dem_DisableDTCRecordUpdate
      Dem_GetNumberOfFreezeFrameRecords
      Dem_GetDTCOfEvent
      Dem_RestartOperationCycle
      Dem_SetEnableCondition
      Dem_DcmReadDataOfPID01
      Dem_ResetEventDebounceStatus
      Dem_SetStorageCondition
      Dem_DcmReadDataOfPID30
      Dem_GetSizeOfFreezeFrameSelection
      Dem_SetEventAvailable
      Dem_SetDataOfPID21
      Dem_DisableDTCSetting
      Dem_GetDTCStatusAvailabilityMask
      Dem_DcmReadDataOfPID21
      Dem_PreInit
      Dem_SetDataOfPID31
      Dem_SelectExtendedDataRecord
      Dem_Init
      Dem_SetEventStatusWithMonitorData
      Dem_GetNextFilteredRecord
      Dem_SelectFreezeFrameData
      Dem_SetDataOfPID4E
      Dem_GetNumberOfFilteredDTC
      Dem_PrestoreFreezeFrame
      Dem_GetNextFilteredDTCAndFDC
      Dem_GetFunctionalUnitOfDTC
      Dem_J1939DcmGetNextFilteredDTC
      Dem_SetFreezeFrameRecordFilter
      Dem_GetIndicatorStatus
      Dem_RepIUMPRFaultDetect
      Dem_SetDTCSuppression
      Dem_GetComponentFailed
      Dem_GetDTCSelectionResult
      Dem_GetEventExtendedDataRecordEx
      Dem_SetEventStatus
      Dem_GetTranslationType
      Dem_DcmReadDataOfPID4E
      Dem_J1939DcmClearDTC
      Dem_J1939DcmGetNextDTCwithLampStatus
      Dem_GetDTCSuppression
      Dem_GetNextFilteredDTC
      Dem_GetDataOfPID21
      Dem_GetVersionInfo
      Dem_DcmGetDTRData
      Dem_GetDTCSeverityAvailabilityMask
      Dem_GetEventFreezeFrameDataEx
      Dem_GetFaultDetectionCounter
      Dem_Shutdown
      Dem_GetDebouncingOfEvent
      Dem_DcmGetDTCOfOBDFreezeFrame
      Dem_EnableDTCSetting
      Dem_RepIUMPRDenRelease
      Dem_ResetEventStatus
      Dem_SetCycleQualified
      Dem_ClearPrestoredFreezeFrame
      Dem_DcmGetAvailableOBDMIDs
      Dem_SetDTCFilter
      Dem_DcmGetInfoTypeValue0B
      Dem_SetIUMPRDenCondition
      Dem_J1939DcmReadDiagnosticReadiness2
      Dem_J1939DcmSetDTCFilter
      Dem_J1939DcmGetNumberOfFilteredDTC
      Dem_GetStatusOfDTC
      Dem_MainFunction
      Dem_DcmReadDataOfPID91
      Dem_GetB1Counter
      Dem_EnableDTCRecordUpdate
      Dem_SelectDTC
      Dem_J1939DcmGetNextSPNInFreezeFrame
      Dem_GetCycleQualified
      Dem_DcmGetNumTIDsOfOBDMID
      Dem_J1939DcmReadDiagnosticReadiness3
      Dem_GetNextFilteredDTCAndSeverity
      Dem_DcmReadDataOfPID1C
      Dem_ReadDataOfPID01
      Dem_J1939DcmReadDiagnosticReadiness1
    5 x bsw module dependency:
      BswModuleDependency_DCM: target-module-id=53
      BswModuleDependency_EcuM: target-module-id=10
      BswModuleDependency_FiM: target-module-id=11
      BswModuleDependency_J1939Dcm: target-module-id=58
      BswModuleDependency_NvM: target-module-id=20
    bsw internal behavior BswInternalBehavior_Dem
      9 x exclusive area:
        CAPTURE_OBD_DATA
        REQUEST_BUFFER_PROTECTION
        REQUEST_DATA_PROTECTION
        REQUEST_DEBOUNCETIMEBASED
        REQUEST_NVDATA_PROTECTION
        REQUEST_OCCTIME_PROTECTION
        REQUEST_OCC_PROTECTION
        REQUEST_RECORD_PROTECTION
        REQUEST_STATUS_PROTECTION
      104 x bsw called entity:
        BswCE_Dem_ClearDTC: implemented-entry=Dem_ClearDTC
        BswCE_Dem_ClearPrestoredFreezeFrame: implemented-entry=Dem_ClearPrestoredFreezeFrame
        BswCE_Dem_DcmGetAvailableOBDMIDs: implemented-entry=Dem_DcmGetAvailableOBDMIDs
        BswCE_Dem_DcmGetDTCOfOBDFreezeFrame: implemented-entry=Dem_DcmGetDTCOfOBDFreezeFrame
        BswCE_Dem_DcmGetDTRData: implemented-entry=Dem_DcmGetDTRData
        BswCE_Dem_DcmGetInfoTypeValue08: implemented-entry=Dem_DcmGetInfoTypeValue08
        BswCE_Dem_DcmGetInfoTypeValue0B: implemented-entry=Dem_DcmGetInfoTypeValue0B
        BswCE_Dem_DcmGetNumTIDsOfOBDMID: implemented-entry=Dem_DcmGetNumTIDsOfOBDMID
        BswCE_Dem_DcmReadDataOfOBDFreezeFrame: implemented-entry=Dem_DcmReadDataOfOBDFreezeFrame
        BswCE_Dem_DcmReadDataOfPID01: implemented-entry=Dem_DcmReadDataOfPID01
        BswCE_Dem_DcmReadDataOfPID1C: implemented-entry=Dem_DcmReadDataOfPID1C
        BswCE_Dem_DcmReadDataOfPID21: implemented-entry=Dem_DcmReadDataOfPID21
        BswCE_Dem_DcmReadDataOfPID30: implemented-entry=Dem_DcmReadDataOfPID30
        BswCE_Dem_DcmReadDataOfPID31: implemented-entry=Dem_DcmReadDataOfPID31
        BswCE_Dem_DcmReadDataOfPID41: implemented-entry=Dem_DcmReadDataOfPID41
        BswCE_Dem_DcmReadDataOfPID4D: implemented-entry=Dem_DcmReadDataOfPID4D
        BswCE_Dem_DcmReadDataOfPID4E: implemented-entry=Dem_DcmReadDataOfPID4E
        BswCE_Dem_DcmReadDataOfPID91: implemented-entry=Dem_DcmReadDataOfPID91
        BswCE_Dem_DisableDTCRecordUpdate: implemented-entry=Dem_DisableDTCRecordUpdate
        BswCE_Dem_DisableDTCSetting: implemented-entry=Dem_DisableDTCSetting
        BswCE_Dem_EnableDTCRecordUpdate: implemented-entry=Dem_EnableDTCRecordUpdate
        BswCE_Dem_EnableDTCSetting: implemented-entry=Dem_EnableDTCSetting
        BswCE_Dem_GetB1Counter: implemented-entry=Dem_GetB1Counter
        BswCE_Dem_GetComponentFailed: implemented-entry=Dem_GetComponentFailed
        BswCE_Dem_GetCycleQualified: implemented-entry=Dem_GetCycleQualified
        BswCE_Dem_GetDTCByOccurrenceTime: implemented-entry=Dem_GetDTCByOccurrenceTime
        BswCE_Dem_GetDTCOfEvent: implemented-entry=Dem_GetDTCOfEvent
        BswCE_Dem_GetDTCSelectionResult: implemented-entry=Dem_GetDTCSelectionResult
        BswCE_Dem_GetDTCSelectionResultForClearDTC: implemented-entry=Dem_GetDTCSelectionResultForClearDTC
        BswCE_Dem_GetDTCSeverityAvailabilityMask: implemented-entry=Dem_GetDTCSeverityAvailabilityMask
        BswCE_Dem_GetDTCStatusAvailabilityMask: implemented-entry=Dem_GetDTCStatusAvailabilityMask
        BswCE_Dem_GetDTCSuppression: implemented-entry=Dem_GetDTCSuppression
        BswCE_Dem_GetDataOfPID21: implemented-entry=Dem_GetDataOfPID21
        BswCE_Dem_GetDebouncingOfEvent: implemented-entry=Dem_GetDebouncingOfEvent
        BswCE_Dem_GetEventExtendedDataRecordEx: implemented-entry=Dem_GetEventExtendedDataRecordEx
        BswCE_Dem_GetEventFreezeFrameDataEx: implemented-entry=Dem_GetEventFreezeFrameDataEx
        BswCE_Dem_GetEventMemoryOverflow: implemented-entry=Dem_GetEventMemoryOverflow
        BswCE_Dem_GetEventUdsStatus: implemented-entry=Dem_GetEventUdsStatus
        BswCE_Dem_GetFaultDetectionCounter: implemented-entry=Dem_GetFaultDetectionCounter
        BswCE_Dem_GetFunctionalUnitOfDTC: implemented-entry=Dem_GetFunctionalUnitOfDTC
        BswCE_Dem_GetIUMPRDenCondition: implemented-entry=Dem_GetIUMPRDenCondition
        BswCE_Dem_GetIndicatorStatus: implemented-entry=Dem_GetIndicatorStatus
        BswCE_Dem_GetMonitorStatus: implemented-entry=Dem_GetMonitorStatus
        BswCE_Dem_GetNextExtendedDataRecord: implemented-entry=Dem_GetNextExtendedDataRecord
        BswCE_Dem_GetNextFilteredDTC: implemented-entry=Dem_GetNextFilteredDTC
        BswCE_Dem_GetNextFilteredDTCAndFDC: implemented-entry=Dem_GetNextFilteredDTCAndFDC
        BswCE_Dem_GetNextFilteredDTCAndSeverity: implemented-entry=Dem_GetNextFilteredDTCAndSeverity
        BswCE_Dem_GetNextFilteredRecord: implemented-entry=Dem_GetNextFilteredRecord
        BswCE_Dem_GetNextFreezeFrameData: implemented-entry=Dem_GetNextFreezeFrameData
        BswCE_Dem_GetNumberOfEventMemoryEntries: implemented-entry=Dem_GetNumberOfEventMemoryEntries
        BswCE_Dem_GetNumberOfFilteredDTC: implemented-entry=Dem_GetNumberOfFilteredDTC
        BswCE_Dem_GetNumberOfFreezeFrameRecords: implemented-entry=Dem_GetNumberOfFreezeFrameRecords
        BswCE_Dem_GetSeverityOfDTC: implemented-entry=Dem_GetSeverityOfDTC
        BswCE_Dem_GetSizeOfExtendedDataRecordSelection: implemented-entry=Dem_GetSizeOfExtendedDataRecordSelection
        BswCE_Dem_GetSizeOfFreezeFrameSelection: implemented-entry=Dem_GetSizeOfFreezeFrameSelection
        BswCE_Dem_GetStatusOfDTC: implemented-entry=Dem_GetStatusOfDTC
        BswCE_Dem_GetTranslationType: implemented-entry=Dem_GetTranslationType
        BswCE_Dem_Init: implemented-entry=Dem_Init
        BswCE_Dem_J1939DcmClearDTC: implemented-entry=Dem_J1939DcmClearDTC
        BswCE_Dem_J1939DcmFirstDTCwithLampStatus: implemented-entry=Dem_J1939DcmFirstDTCwithLampStatus
        BswCE_Dem_J1939DcmGetNextDTCwithLampStatus: implemented-entry=Dem_J1939DcmGetNextDTCwithLampStatus
        BswCE_Dem_J1939DcmGetNextFilteredDTC: implemented-entry=Dem_J1939DcmGetNextFilteredDTC
        BswCE_Dem_J1939DcmGetNextFilteredRatio: implemented-entry=Dem_J1939DcmGetNextFilteredRatio
        BswCE_Dem_J1939DcmGetNextFreezeFrame: implemented-entry=Dem_J1939DcmGetNextFreezeFrame
        BswCE_Dem_J1939DcmGetNextSPNInFreezeFrame: implemented-entry=Dem_J1939DcmGetNextSPNInFreezeFrame
        BswCE_Dem_J1939DcmGetNumberOfFilteredDTC: implemented-entry=Dem_J1939DcmGetNumberOfFilteredDTC
        BswCE_Dem_J1939DcmReadDiagnosticReadiness{1..3}: implemented-entry=Dem_J1939DcmReadDiagnosticReadiness{1..3}
        BswCE_Dem_J1939DcmSetDTCFilter: implemented-entry=Dem_J1939DcmSetDTCFilter
        BswCE_Dem_J1939DcmSetFreezeFrameFilter: implemented-entry=Dem_J1939DcmSetFreezeFrameFilter
        BswCE_Dem_J1939DcmSetRatioFilter: implemented-entry=Dem_J1939DcmSetRatioFilter
        BswCE_Dem_PreInit: implemented-entry=Dem_PreInit
        BswCE_Dem_PrestoreFreezeFrame: implemented-entry=Dem_PrestoreFreezeFrame
        BswCE_Dem_ReadDataOfPID01: implemented-entry=Dem_ReadDataOfPID01
        BswCE_Dem_RepIUMPRDenRelease: implemented-entry=Dem_RepIUMPRDenRelease
        BswCE_Dem_RepIUMPRFaultDetect: implemented-entry=Dem_RepIUMPRFaultDetect
        BswCE_Dem_ResetEventDebounceStatus: implemented-entry=Dem_ResetEventDebounceStatus
        BswCE_Dem_ResetEventStatus: implemented-entry=Dem_ResetEventStatus
        BswCE_Dem_RestartOperationCycle: implemented-entry=Dem_RestartOperationCycle
        BswCE_Dem_SelectDTC: implemented-entry=Dem_SelectDTC
        BswCE_Dem_SelectExtendedDataRecord: implemented-entry=Dem_SelectExtendedDataRecord
        BswCE_Dem_SelectFreezeFrameData: implemented-entry=Dem_SelectFreezeFrameData
        BswCE_Dem_SetComponentAvailable: implemented-entry=Dem_SetComponentAvailable
        BswCE_Dem_SetCycleQualified: implemented-entry=Dem_SetCycleQualified
        BswCE_Dem_SetDTCFilter: implemented-entry=Dem_SetDTCFilter
        BswCE_Dem_SetDTCSuppression: implemented-entry=Dem_SetDTCSuppression
        BswCE_Dem_SetDTR: implemented-entry=Dem_SetDTR
        BswCE_Dem_SetDataOfPID21: implemented-entry=Dem_SetDataOfPID21
        BswCE_Dem_SetDataOfPID31: implemented-entry=Dem_SetDataOfPID31
        BswCE_Dem_SetDataOfPID4D: implemented-entry=Dem_SetDataOfPID4D
        BswCE_Dem_SetDataOfPID4E: implemented-entry=Dem_SetDataOfPID4E
        BswCE_Dem_SetEnableCondition: implemented-entry=Dem_SetEnableCondition
        BswCE_Dem_SetEventAvailable: implemented-entry=Dem_SetEventAvailable
        BswCE_Dem_SetEventDisabled: implemented-entry=Dem_SetEventDisabled
        BswCE_Dem_SetEventFailureCycleCounterThreshold: implemented-entry=Dem_SetEventFailureCycleCounterThreshold
        BswCE_Dem_SetEventStatus: implemented-entry=Dem_SetEventStatus
        BswCE_Dem_SetEventStatusWithMonitorData: implemented-entry=Dem_SetEventStatusWithMonitorData
        BswCE_Dem_SetFreezeFrameRecordFilter: implemented-entry=Dem_SetFreezeFrameRecordFilter
        BswCE_Dem_SetIUMPRDenCondition: implemented-entry=Dem_SetIUMPRDenCondition
        BswCE_Dem_SetPtoStatus: implemented-entry=Dem_SetPtoStatus
        BswCE_Dem_SetStorageCondition: implemented-entry=Dem_SetStorageCondition
        BswCE_Dem_SetWIRStatus: implemented-entry=Dem_SetWIRStatus
        BswCE_Dem_Shutdown: implemented-entry=Dem_Shutdown
      bsw schedulable entity BswSE_Dem_MainFunction: can-enter-exclusive-area=[CAPTURE_OBD_DATA, REQUEST_BUFFER_PROTECTION, REQUEST_DATA_PROTECTION, REQUEST_DEBOUNCETIMEBASED, REQUEST_NVDATA_PROTECTION, REQUEST_OCCTIME_PROTECTION, REQUEST_OCC_PROTECTION, REQUEST_RECORD_PROTECTION, REQUEST_STATUS_PROTECTION], implemented-entry=Dem_MainFunction
      bsw timing event BswTE_Dem_MainFunction: starts-on-event=BswSE_Dem_MainFunction, period=0.01
      bsw distinguished partition BswDistinguishedPartition_Dem
  106 x bsw module entry, all with bsw-entry-kind=CONCRETE:
    Dem_ClearDTC: service-id=35, is-reentrant=false, is-synchronous=false, call-type=REGULAR  # Clears single DTCs, as well as groups of DTCs.
      return type Std_ReturnType: implementation-data-type=Std_ReturnType
      sw service arg ClientId: direction=IN, implementation-data-type=uint8  # Unique client id, assigned to the instance of the calling module.
    Dem_ClearPrestoredFreezeFrame: service-id=7, is-reentrant=false, is-synchronous=true, call-type=REGULAR  # Clears a prestored freeze frame of a specific event. This API can only be used through the RTE and therefore no declaration is exported via Dem.h.
      return type Std_ReturnType: implementation-data-type=Std_ReturnType
      sw service arg EventId: direction=IN, implementation-data-type=Dem_EventIdType  # Identification of an event by assigned EventId.
    Dem_DcmGetAvailableOBDMIDs: service-id=163, is-reentrant=true, is-synchronous=true, call-type=REGULAR  # Reports the value of a requested "availability-OBDMID" to the DCM upon a Service $06 request. Derived from that the tester displays the supported tests a mechanic can select from. API is needed in OBD-relevant ECUs only.
      return type Std_ReturnType: implementation-data-type=Std_ReturnType
      sw service arg Obdmid: direction=IN, implementation-data-type=uint8  # Availablity OBDMID ($00,$20, $40...)
      sw service arg Obdmidvalue: category=DATA_REFERENCE, direction=OUT, sw-pointer-target-props=uint32  # Bit coded information on the support of OBDMIDs.
    Dem_DcmGetDTCOfOBDFreezeFrame: service-id=83, is-reentrant=false, is-synchronous=true, call-type=REGULAR  # Gets DTC by freeze frame record number. API is needed in OBD-relevant ECUs only.
      return type Std_ReturnType: implementation-data-type=Std_ReturnType
      sw service arg FrameNumber: direction=IN, implementation-data-type=uint8  # Unique identifier for a freeze frame record as defined in ISO 15031-5. The value 0x00 indicates the complete OBD freeze frame. Other values are reserved for future functionality.
      sw service arg DTC: category=DATA_REFERENCE, direction=OUT, sw-pointer-target-props=uint32  # Diagnostic Trouble Code in ODB format. If the return value of the function is other than E_OK this parameter does not contain valid data.
      sw service arg DTCFormat: direction=IN, implementation-data-type=Dem_DTCFormatType  # Output format of the DTC value.
    Dem_DcmGetDTRData: service-id=165, is-reentrant=true, is-synchronous=true, call-type=REGULAR  # Reports a DTR data along with TID-value, UaSID, test result with lower and upper limit. API is needed in OBD-relevant ECUs only.
      return type Std_ReturnType: implementation-data-type=Std_ReturnType
      7 x sw service arg:
        Obdmid: direction=IN, implementation-data-type=uint8  # Identification of a DTR element by assigned DTRId.
        TIDindex: direction=IN, implementation-data-type=uint8  # Index of the TID within the DEM. Runs from 0 to "numberOfTIDs" obtained in the call to Dem_DcmGetNumTIDsOfOBDMID()
        TIDvalue: category=DATA_REFERENCE, direction=OUT, sw-pointer-target-props=uint8  # TID to be put on the tester reponse
        UaSID: category=DATA_REFERENCE, direction=OUT, sw-pointer-target-props=uint8  # UaSID to be put on the tester reponse
        Testvalue: category=DATA_REFERENCE, direction=OUT, sw-pointer-target-props=uint16  # Latest test result
        Lowlimvalue: category=DATA_REFERENCE, direction=OUT, sw-pointer-target-props=uint16  # Lower limit value associated to the latest test result
        Upplimvalue: category=DATA_REFERENCE, direction=OUT, sw-pointer-target-props=uint16  # Upper limit value associated to the latest test result
    Dem_DcmGetInfoTypeValue08: service-id=107, is-reentrant=false, is-synchronous=true, call-type=REGULAR  # Service is used for requesting IUMPR data according to InfoType $08. This interface is derived from the prototype <Module>_GetInfotypeValueData() defined by the Dcm. Therefore Dcm_OpStatusType and Std_ReturnType are contained. API is needed in OBD-relevant ECUs only.
      return type Std_ReturnType: implementation-data-type=Std_ReturnType
      sw service arg OpStatus: direction=IN, implementation-data-type=Dcm_OpStatusType  # Only DCM_INITIAL will appear, because this API behaves synchronous.
      sw service arg Iumprdata08: category=DATA_REFERENCE, direction=OUT, sw-pointer-target-props=uint8  # Buffer containing the number of data elements (as defined in ISO-15031-5) and contents of InfoType $08. The buffer is provided by the Dcm.
      sw service arg Iumprdata08BufferSize: category=DATA_REFERENCE, direction=INOUT, sw-pointer-target-props=uint8  # The maximum number of data bytes that can be written to the Iumprdata08 Buffer.
    Dem_DcmGetInfoTypeValue0B: service-id=108, is-reentrant=false, is-synchronous=true, call-type=REGULAR  # Service is used for requesting IUMPR data according to InfoType $0B. This interface is derived from the prototype <Module>_GetInfotypeValueData() defined by the Dcm. Therefore Dcm_OpStatusType and Std_ReturnType are contained. API is needed in OBD-relevant ECUs only.
      return type Std_ReturnType: implementation-data-type=Std_ReturnType
      sw service arg OpStatus: direction=IN, implementation-data-type=Dcm_OpStatusType  # Only DCM_INITIAL will appear, because this API behaves synchronous.
      sw service arg Iumprdata0B: category=DATA_REFERENCE, direction=OUT, sw-pointer-target-props=uint8  # Buffer containing the number of data elements (as defined in ISO-15031-5) and contents of InfoType $0B. The buffer is provided by the Dcm.
      sw service arg Iumprdata0BBufferSize: category=DATA_REFERENCE, direction=INOUT, sw-pointer-target-props=uint8  # The maximum number of data bytes that can be written to the Iumprdata0B Buffer.
    Dem_DcmGetNumTIDsOfOBDMID: service-id=164, is-reentrant=true, is-synchronous=true, call-type=REGULAR  # Gets the number of TIDs per (functional) OBDMID. This can be used by the DCM to iteratively request for OBD/TID result data within a loop from 0....numberOfTIDs-1 API is needed in OBD-relevant ECUs only.
      return type Std_ReturnType: implementation-data-type=Std_ReturnType
      sw service arg Obdmid: direction=IN, implementation-data-type=uint8  # OBDMID subject of the request to identify the number of assigned TIDs
      sw service arg numberOfTIDs: category=DATA_REFERENCE, direction=OUT, sw-pointer-target-props=uint8  # Number of assigned TIDs for the requested OBDMID. Used as loop value for the DCM to retrieve all OBD/TID result data.
    Dem_DcmReadDataOfOBDFreezeFrame: service-id=82, is-reentrant=false, is-synchronous=true, call-type=REGULAR  # Gets data element per PID and index of the most important freeze frame being selected for the output of service $02. The function stores the data in the provided DestBuffer. API is needed in OBD-relevant ECUs only.
      return type Std_ReturnType: implementation-data-type=Std_ReturnType
      4 x sw service arg:
        PID: direction=IN, implementation-data-type=uint8  # This parameter is an identifier for a PID as defined in ISO15031-5.
        DataElementIndexOfPID: direction=IN, implementation-data-type=uint8  # Data element index of this PID according to the Dcm configuration of service $02. It is zero-based and consecutive, and ordered by the data element positions (configured in Dcm, refer to SWS_Dem_00597).
        DestBuffer: category=DATA_REFERENCE, direction=INOUT, sw-pointer-target-props=uint8  # This parameter contains a byte pointer that points to the buffer, to which the data element of the PID shall be written to. The format is raw hexadecimal values and contains no header-information.
        BufSize: category=DATA_REFERENCE, direction=INOUT, sw-pointer-target-props=uint16  # When the function is called this parameter contains the maximum number of data bytes that can be written to the buffer. The function returns the actual number of written data bytes in this parameter.
    Dem_DcmReadDataOfPID01: service-id=97, is-reentrant=false, is-synchronous=true, call-type=REGULAR  # Service to report the value of PID $01 computed by the Dem. API is needed in OBD-relevant ECUs only.
      return type Std_ReturnType: implementation-data-type=Std_ReturnType
      sw service arg PID01value: category=DATA_REFERENCE, direction=OUT, sw-pointer-target-props=uint8  # Buffer containing the contents of PID $01 computed by the Dem. The buffer is provided by the Dcm with the appropriate size, i.e. during configuration, the Dcm identifies the required size from the largest PID in order to configure a PIDBuffer.
    Dem_DcmReadDataOfPID1C: service-id=99, is-reentrant=false, is-synchronous=true, call-type=REGULAR  # Service to report the value of PID $1C computed by the Dem. API is needed in OBD-relevant ECUs only.
      return type Std_ReturnType: implementation-data-type=Std_ReturnType
      sw service arg PID1Cvalue: category=DATA_REFERENCE, direction=OUT, sw-pointer-target-props=uint8  # Buffer containing the contents of PID $1C computed by the Dem. The value of PID$1C is configuration within DemOBDCompliancy. The buffer is provided by the Dcm with the appropriate size, i.e. during configuration, the Dcm identifies the required size from the largest PID in order to configure a PIDBuffer.
    Dem_DcmReadDataOfPID21: service-id=100, is-reentrant=false, is-synchronous=true, call-type=REGULAR  # Service to report the value of PID $21 computed by the Dem. API is needed in OBD-relevant ECUs only.
      return type Std_ReturnType: implementation-data-type=Std_ReturnType
      sw service arg PID21value: category=DATA_REFERENCE, direction=OUT, sw-pointer-target-props=uint8  # Buffer containing the contents of PID $21 computed by the Dem. The buffer is provided by the Dcm with the appropriate size, i.e. during configuration, the Dcm identifies the required size from the largest PID in order to configure a PIDBuffer.
    Dem_DcmReadDataOfPID30: service-id=101, is-reentrant=false, is-synchronous=true, call-type=REGULAR  # Service to report the value of PID $30 computed by the Dem. API is needed in OBD-relevant ECUs only.
      return type Std_ReturnType: implementation-data-type=Std_ReturnType
      sw service arg PID30value: category=DATA_REFERENCE, direction=OUT, sw-pointer-target-props=uint8  # Buffer containing the contents of PID $30 computed by the Dem. The buffer is provided by the Dcm with the appropriate size, i.e. during configuration, the Dcm identifies the required size from the largest PID in order to configure a PIDBuffer.
    Dem_DcmReadDataOfPID31: service-id=102, is-reentrant=false, is-synchronous=true, call-type=REGULAR  # Service to report the value of PID $31 computed by the Dem. API is needed in OBD-relevant ECUs only.
      return type Std_ReturnType: implementation-data-type=Std_ReturnType
      sw service arg PID31value: category=DATA_REFERENCE, direction=OUT, sw-pointer-target-props=uint8  # Buffer containing the contents of PID $31 computed by the Dem. The buffer is provided by the Dcm with the appropriate size, i.e. during configuration, the Dcm identifies the required size from the largest PID in order to configure a PIDBuffer.
    Dem_DcmReadDataOfPID41: service-id=103, is-reentrant=false, is-synchronous=true, call-type=REGULAR  # Service to report the value of PID $41 computed by the Dem. API is needed in OBD-relevant ECUs only.
      return type Std_ReturnType: implementation-data-type=Std_ReturnType
      sw service arg PID41value: category=DATA_REFERENCE, direction=OUT, sw-pointer-target-props=uint8  # Buffer containing the contents of PID $41 computed by the Dem. The buffer is provided by the Dcm with the appropriate size, i.e. during configuration, the Dcm identifies the required size from the largest PID in order to configure a PIDBuffer.
    Dem_DcmReadDataOfPID4D: service-id=104, is-reentrant=false, is-synchronous=true, call-type=REGULAR  # Service to report the value of PID $4D computed by the Dem. API is needed in OBD-relevant ECUs only.
      return type Std_ReturnType: implementation-data-type=Std_ReturnType
      sw service arg PID4Dvalue: category=DATA_REFERENCE, direction=OUT, sw-pointer-target-props=uint8  # Buffer containing the contents of PID $4D computed by the Dem. The buffer is provided by the Dcm with the appropriate size, i.e. during configuration, the Dcm identifies the required size from the largest PID in order to configure a PIDBuffer.
    Dem_DcmReadDataOfPID4E: service-id=105, is-reentrant=false, is-synchronous=true, call-type=REGULAR  # Service to report the value of PID $4E computed by the Dem. API is needed in OBD-relevant ECUs only.
      return type Std_ReturnType: implementation-data-type=Std_ReturnType
      sw service arg PID4Evalue: category=DATA_REFERENCE, direction=OUT, sw-pointer-target-props=uint8  # Buffer containing the contents of PID $4E computed by the Dem. The buffer is provided by the Dcm with the appropriate size, i.e. during configuration, the Dcm identifies the required size from the largest PID in order to configure a PIDBuffer.
    Dem_DcmReadDataOfPID91: service-id=106, is-reentrant=false, is-synchronous=true, call-type=REGULAR  # Service to report the value of PID $91 computed by the Dem. API is needed in OBD-relevant ECUs only.
      return type Std_ReturnType: implementation-data-type=Std_ReturnType
      sw service arg PID91value: category=DATA_REFERENCE, direction=OUT, sw-pointer-target-props=uint8  # Buffer containing the contents of PID $91 computed by the Dem. The buffer is provided by the Dcm with the appropriate size, i.e. during configuration, the Dcm identifies the required size from the largest PID in order to configure a PIDBuffer.
    Dem_DisableDTCRecordUpdate: service-id=26, is-reentrant=false, is-synchronous=false, call-type=REGULAR  # Disables the event memory update of a specific DTC (only one at one time).
      return type Std_ReturnType: implementation-data-type=Std_ReturnType
      sw service arg ClientId: direction=IN, implementation-data-type=uint8  # Unique client id, assigned to the instance of the calling module.
    Dem_DisableDTCSetting: service-id=36, is-reentrant=false, is-synchronous=false, call-type=REGULAR  # Disables the DTC setting for all DTCs assigned to the DemEventMemorySet of the addressed client.
      return type Std_ReturnType: implementation-data-type=Std_ReturnType
      sw service arg ClientId: direction=IN, implementation-data-type=uint8  # Unique client id, assigned to the instance of the calling module.
    Dem_EnableDTCRecordUpdate: service-id=27, is-reentrant=false, is-synchronous=false, call-type=REGULAR  # Enables the event memory update of the DTC disabled by Dem_DisableDTCRecordUpdate() before.
      return type Std_ReturnType: implementation-data-type=Std_ReturnType
      sw service arg ClientId: direction=IN, implementation-data-type=uint8  # Unique client id, assigned to the instance of the calling module.
    Dem_EnableDTCSetting: service-id=37, is-reentrant=false, is-synchronous=false, call-type=REGULAR  # (Re)-Enables the DTC setting for all DTCs assigned to the DemEventMemorySet of the addressed client.
      return type Std_ReturnType: implementation-data-type=Std_ReturnType
      sw service arg ClientId: direction=IN, implementation-data-type=uint8  # Unique client id, assigned to the instance of the calling module.
    Dem_GetB1Counter: service-id=180, is-reentrant=false, is-synchronous=true, call-type=REGULAR  # Service to report the value of the B1 counter computed by the Dem. API is needed in WWH-OBD relevant ECUs only
      return type Std_ReturnType: implementation-data-type=Std_ReturnType
      sw service arg B1Counter: category=DATA_REFERENCE, direction=OUT, sw-pointer-target-props=uint16  # Buffer containing the B1 counter. The buffer is provided by the application with the size of 2 bytes.
    Dem_GetComponentFailed: service-id=42, is-reentrant=true, is-synchronous=true, call-type=REGULAR  # Gets the failed status of a DemComponent.
      return type Std_ReturnType: implementation-data-type=Std_ReturnType
      sw service arg ComponentId: direction=IN, implementation-data-type=Dem_ComponentIdType  # Identification of a DemComponent
      sw service arg ComponentFailed: category=DATA_REFERENCE, direction=OUT, sw-pointer-target-props=boolean  # TRUE: failed FALSE: not failed
    Dem_GetCycleQualified: service-id=171, is-reentrant=false, is-synchronous=true, call-type=REGULAR  # Returns the qualification state of the dependent operation cycle.
      return type Std_ReturnType: implementation-data-type=Std_ReturnType
      sw service arg OperationCycleId: direction=IN, implementation-data-type=uint8  # Identification of a configured DemOperationCycle.
      sw service arg isQualified: category=DATA_REFERENCE, direction=OUT, sw-pointer-target-props=boolean  # TRUE: The dependent operation cylcle is qualified. FALSE: The qualification conditions of the dependent operation cylcle have not been met.
    Dem_GetDTCByOccurrenceTime: service-id=25, is-reentrant=false, is-synchronous=true, call-type=REGULAR  # Gets the DTC by occurrence time. There is no explicit parameter for the DTC-origin as the origin always is DEM_DTC_ORIGIN_PRIMARY_MEMORY.
      return type Std_ReturnType: implementation-data-type=Std_ReturnType
      sw service arg ClientId: direction=IN, implementation-data-type=uint8  # Unique client id, assigned to the instance of the calling module.
      sw service arg DTCRequest: direction=IN, implementation-data-type=Dem_DTCRequestType  # This parameter defines the request type of the DTC.
      sw service arg DTC: category=DATA_REFERENCE, direction=OUT, sw-pointer-target-props=uint32  # Receives the DTC value in UDS format returned by the function. If the return value of the function is other than DEM_OCCURR_OK this parameter does not contain valid data.
    Dem_GetDTCOfEvent: service-id=13, is-reentrant=true, is-synchronous=true, call-type=REGULAR  # Gets the DTC of an event.
      return type Std_ReturnType: implementation-data-type=Std_ReturnType
      sw service arg EventId: direction=IN, implementation-data-type=Dem_EventIdType  # Identification of an event by assigned EventId.
      sw service arg DTCFormat: direction=IN, implementation-data-type=Dem_DTCFormatType  # Defines the output-format of the requested DTC value.
      sw service arg DTCOfEvent: category=DATA_REFERENCE, direction=OUT, sw-pointer-target-props=uint32  # Receives the DTC value in respective format returned by this function. If the return value of the function is other than E_OK this parameter does not contain valid data.
    Dem_GetDTCSelectionResult: service-id=184, is-reentrant=false, is-synchronous=false, call-type=REGULAR  # Provides information if the last call to Dem_SelectDTC has selected a valid DTC or group of DTCs.
      return type Std_ReturnType: implementation-data-type=Std_ReturnType
      sw service arg ClientId: direction=IN, implementation-data-type=uint8  # Unique client id, assigned to the instance of the calling module.
    Dem_GetDTCSelectionResultForClearDTC: service-id=187, is-reentrant=false, is-synchronous=false, call-type=REGULAR  # Provides information if the last call to Dem_SelectDTC has selected a valid DTC or group of DTCs, respecting the settings if the Dem shall clear only all DTCs.
      return type Std_ReturnType: implementation-data-type=Std_ReturnType
      sw service arg ClientId: direction=IN, implementation-data-type=uint8  # Unique client id, assigned to the instance of the calling module.
    Dem_GetDTCSeverityAvailabilityMask: service-id=178, is-reentrant=false, is-synchronous=true, call-type=REGULAR  # Gets the DTC Severity availability mask.
      return type Std_ReturnType: implementation-data-type=Std_ReturnType
      sw service arg ClientId: direction=IN, implementation-data-type=uint8  # Unique client id, assigned to the instance of the calling module.
      sw service arg DTCSeverityMask: category=DATA_REFERENCE, direction=OUT, sw-pointer-target-props=Dem_DTCSeverityType  # DTCSeverityMask The value DTCSeverityMask indicates the supported DTC severity bits from the Dem. All supported information is indicated by setting the corresponding status bit to 1. See ISO14229-1.
    Dem_GetDTCStatusAvailabilityMask: service-id=22, is-reentrant=false, is-synchronous=true, call-type=REGULAR  # Gets the DTC Status availability mask.
      return type Std_ReturnType: implementation-data-type=Std_ReturnType
      sw service arg ClientId: direction=IN, implementation-data-type=uint8  # Unique client id, assigned to the instance of the calling module.
      sw service arg DTCStatusMask: category=DATA_REFERENCE, direction=OUT, sw-pointer-target-props=Dem_UdsStatusByteType  # DTCStatusMask The value DTCStatusMask indicates the supported DTC status bits from the Dem. All supported information is indicated by setting the corresponding status bit to 1. See ISO14229-1.
    Dem_GetDTCSuppression: service-id=188, is-reentrant=true, is-synchronous=false, call-type=REGULAR  # Returns the suppression status of a specific DTC. API Availability: This API will be available only if ({ecuc(Dem/DemGeneral.DemSuppressionSupport)} == DEM_DTC_SUPPRESSION)
      return type Std_ReturnType: implementation-data-type=Std_ReturnType
      sw service arg ClientId: direction=IN, implementation-data-type=uint8  # Unique client id, assigned to the instance of the calling module
      sw service arg SuppressionStatus: category=DATA_REFERENCE, direction=OUT, sw-pointer-target-props=boolean  # Defines whether the respective DTC is suppressed (TRUE) or enabled (FALSE).
    Dem_GetDataOfPID21: service-id=177, is-reentrant=false, is-synchronous=true, call-type=REGULAR  # Service to get the value of PID $21 from the Dem by a software component. API is needed in OBD-relevant ECUs only.
      return type Std_ReturnType: implementation-data-type=Std_ReturnType
      sw service arg PID21value: category=DATA_REFERENCE, direction=OUT, sw-pointer-target-props=uint8  # Content of PID $21 as raw hex value.
    Dem_GetDebouncingOfEvent: service-id=159, is-reentrant=true, is-synchronous=true, call-type=REGULAR  # Gets the debouncing status of an event. This function shall not be used for EventId with native debouncing within their functions. It is rather for EventIds using debouncing within the Dem.
      return type Std_ReturnType: implementation-data-type=Std_ReturnType
      sw service arg EventId: direction=IN, implementation-data-type=Dem_EventIdType  # Identification of an event by assigned EventId.
      sw service arg DebouncingState: category=DATA_REFERENCE, direction=OUT, sw-pointer-target-props=Dem_DebouncingStateType  # Bit 0 Temporarily Defective (corresponds to 0 < FDC < 127) Bit 1 finally Defective (corresponds to FDC = 127) Bit 2 temporarily healed (corresponds to -128 < FDC < 0) Bit 3 Test complete (corresponds to FDC = -128 or FDC = 127) Bit 4 DTR Update (= Test complete && Debouncing complete && enable conditions / storage conditions fulfilled)
    Dem_GetEventExtendedDataRecordEx: service-id=109, is-reentrant=true, is-synchronous=true, call-type=REGULAR  # Gets the data of an extended data record by event.
      return type Std_ReturnType: implementation-data-type=Std_ReturnType
      4 x sw service arg:
        EventId: direction=IN, implementation-data-type=Dem_EventIdType  # Identification of an event by assigned EventId.
        RecordNumber: direction=IN, implementation-data-type=uint8  # Identification of requested Extended data record. Valid values are between 0x01 and 0xEF as defined in ISO14229-1.
        DestBuffer: category=DATA_REFERENCE, direction=OUT, sw-pointer-target-props=uint8  # This parameter contains a byte pointer that points to the buffer, to which the extended data shall be written to. The format is raw hexadecimal values and contains no header-information.
        BufSize: category=DATA_REFERENCE, direction=INOUT, sw-pointer-target-props=uint16  # When the function is called this parameter contains the maximum number of data bytes that can be written to the buffer. The function returns the actual number of written data bytes in this parameter.
    Dem_GetEventFreezeFrameDataEx: service-id=110, is-reentrant=true, is-synchronous=true, call-type=REGULAR  # Gets the data of a freeze frame by event.
      return type Std_ReturnType: implementation-data-type=Std_ReturnType
      5 x sw service arg:
        EventId: direction=IN, implementation-data-type=Dem_EventIdType  # Identification of an event by assigned EventId.
        RecordNumber: direction=IN, implementation-data-type=uint8  # This parameter is a unique identifier for a freeze frame record as defined in ISO14229-1. '''0xFF means most recent freeze frame record is returned.''' 0x00 is only supported if the Dem module supports WWH-OBD (refer to DemOBDSupport)
        DataId: direction=IN, implementation-data-type=uint16  # This parameter specifies the DID (ISO14229-1) that shall be copied to the destination buffer.
        DestBuffer: category=DATA_REFERENCE, direction=OUT, sw-pointer-target-props=uint8  # This parameter contains a byte pointer that points to the buffer, to which the freeze frame data record shall be written to. The format is raw hexadecimal values and contains no header-information.
        BufSize: category=DATA_REFERENCE, direction=INOUT, sw-pointer-target-props=uint16  # When the function is called this parameter contains the maximum number of data bytes that can be written to the buffer. The function returns the actual number of written data bytes in this parameter.
    Dem_GetEventMemoryOverflow: service-id=50, is-reentrant=false, is-synchronous=true, call-type=REGULAR  # Gets the event memory overflow indication status.
      return type Std_ReturnType: implementation-data-type=Std_ReturnType
      sw service arg ClientId: direction=IN, implementation-data-type=uint8  # DemClientID identifying the DemEventMemorySet indicating in which event memory the overflow has occurred.
      sw service arg DTCOrigin: direction=IN, implementation-data-type=Dem_DTCOriginType  # If the Dem supports more than one event memory this parameter is used to select the source memory the overflow indication shall be read from.
      sw service arg OverflowIndication: category=DATA_REFERENCE, direction=OUT, sw-pointer-target-props=boolean  # This parameter returns TRUE if the according event memory was overflowed, otherwise it returns FALSE.
    Dem_GetEventUdsStatus: service-id=182, is-reentrant=true, is-synchronous=true, call-type=REGULAR  # Gets the current UDS status byte assigned to the DTC for the event
      return type Std_ReturnType: implementation-data-type=Std_ReturnType
      sw service arg EventId: direction=IN, implementation-data-type=Dem_EventIdType  # Identification of an event by assigned EventId.
      sw service arg UDSStatusByte: category=DATA_REFERENCE, direction=OUT, sw-pointer-target-props=Dem_UdsStatusByteType  # UDS DTC status byte of the requested event (refer to chapter "Status bit support"). If the return value of the function call is E_NOT_OK, this parameter does not contain valid data.
    Dem_GetFaultDetectionCounter: service-id=62, is-reentrant=false, is-synchronous=true, call-type=REGULAR  # Gets the fault detection counter of an event. This API can only be used through the RTE, and therefore no declaration is exported via Dem.h.
      return type Std_ReturnType: implementation-data-type=Std_ReturnType
      sw service arg EventId: direction=IN, implementation-data-type=Dem_EventIdType  # Identification of an event by assigned EventId.
      sw service arg FaultDetectionCounter: category=DATA_REFERENCE, direction=OUT, sw-pointer-target-props=sint8  # This parameter receives the Fault Detection Counter information of the requested EventId. If the return value of the function call is other than E_OK this parameter does not contain valid data. -128dec...127dec PASSED... FAILED according to ISO 14229-1
    Dem_GetFunctionalUnitOfDTC: service-id=52, is-reentrant=false, is-synchronous=false, call-type=REGULAR  # Gets the functional unit of the requested DTC.
      return type Std_ReturnType: implementation-data-type=Std_ReturnType
      sw service arg ClientId: direction=IN, implementation-data-type=uint8  # Unique client id, assigned to the instance of the calling module.
      sw service arg DTCFunctionalUnit: category=DATA_REFERENCE, direction=OUT, sw-pointer-target-props=uint8  # Functional unit value of this DTC
    Dem_GetIUMPRDenCondition: service-id=175, is-reentrant=true, is-synchronous=true, call-type=REGULAR  # In order to communicate the status of the (additional) denominator conditions among the OBD relevant ECUs, the API is used to retrieve the condition status from the Dem of the ECU where the conditions are computed. API is needed in OBD-relevant ECUs only.
      return type Std_ReturnType: implementation-data-type=Std_ReturnType
      sw service arg ConditionId: direction=IN, implementation-data-type=Dem_IumprDenomCondIdType  # Identification of a IUMPR denominator condition ID (General Denominator, Cold start, EVAP, 500mi).
      sw service arg ConditionStatus: category=DATA_REFERENCE, direction=OUT, sw-pointer-target-props=Dem_IumprDenomCondStatusType  # Status of the IUMPR denominator condition (Not-reached, reached, not reachable / inhibited)
    Dem_GetIndicatorStatus: service-id=41, is-reentrant=false, is-synchronous=true, call-type=REGULAR  # Gets the indicator status derived from the UDS status.
      return type Std_ReturnType: implementation-data-type=Std_ReturnType
      sw service arg IndicatorId: direction=IN, implementation-data-type=uint8  # Number of indicator
      sw service arg IndicatorStatus: category=DATA_REFERENCE, direction=OUT, sw-pointer-target-props=Dem_IndicatorStatusType  # Status of the indicator, like off, on, or blinking.
    Dem_GetMonitorStatus: service-id=181, is-reentrant=true, is-synchronous=true, call-type=REGULAR  # Gets the current monitor status for an event.
      return type Std_ReturnType: implementation-data-type=Std_ReturnType
      sw service arg EventID: direction=IN, implementation-data-type=Dem_EventIdType  # Identification of an event by assigned EventId.
      sw service arg MonitorStatus: category=DATA_REFERENCE, direction=OUT, sw-pointer-target-props=Dem_MonitorStatusType  # Monitor status byte of the requested event. If the return value of the function call is E_NOT_OK, this parameter does not contain valid data.
    Dem_GetNextExtendedDataRecord: service-id=32, is-reentrant=false, is-synchronous=false, call-type=REGULAR  # Gets extended data record for the DTC selected by Dem_SelectExtendedDataRecord. The function stores the data in the provided DestBuffer.
      return type Std_ReturnType: implementation-data-type=Std_ReturnType
      sw service arg ClientId: direction=IN, implementation-data-type=uint8  # Unique client id, assigned to the instance of the calling module.
      sw service arg DestBuffer: category=DATA_REFERENCE, direction=OUT, sw-pointer-target-props=uint8  # This parameter contains a byte pointer that points to the buffer, to which the extended data record shall be written to. The format is: {ExtendedDataRecordNumber, data[0], data[1], ..., data[n]}
      sw service arg BufSize: category=DATA_REFERENCE, direction=INOUT, sw-pointer-target-props=uint16  # When the function is called this parameter contains the maximum number of data bytes that can be written to the buffer. The function returns the actual number of written data bytes in this parameter.
    Dem_GetNextFilteredDTC: service-id=24, is-reentrant=false, is-synchronous=false, call-type=REGULAR  # Gets the next filtered DTC matching the filter criteria. For UDS services, the interface has an asynchronous behavior, because a large number of DTCs has to be processed.
      return type Std_ReturnType: implementation-data-type=Std_ReturnType
      sw service arg ClientId: direction=IN, implementation-data-type=uint8  # Unique client id, assigned to the instance of the calling module.
      sw service arg DTC: category=DATA_REFERENCE, direction=OUT, sw-pointer-target-props=uint32  # Receives the DTC value in respective format of the filter returned by this function. If the return value of the function is other than DEM_FILTERED_OK this parameter does not contain valid data.
      sw service arg DTCStatus: category=DATA_REFERENCE, direction=OUT, sw-pointer-target-props=uint8  # This parameter receives the status information of the requested DTC. It follows the format as defined in ISO14229-1 If the return value of the function call is other than DEM_FILTERED_OK this parameter does not contain valid data.
    Dem_GetNextFilteredDTCAndFDC: service-id=59, is-reentrant=false, is-synchronous=false, call-type=REGULAR  # Gets the next filtered DTC and its associated Fault Detection Counter (FDC) matching the filter criteria. The interface has an asynchronous behavior, because a large number of DTCs has to be processed and the FDC might be received asynchronously from a SW-C, too.
      return type Std_ReturnType: implementation-data-type=Std_ReturnType
      sw service arg ClientId: direction=IN, implementation-data-type=uint8  # Unique client id, assigned to the instance of the calling module.
      sw service arg DTC: category=DATA_REFERENCE, direction=OUT, sw-pointer-target-props=uint32  # Receives the DTC value in respective format of the filter returned by this function. If the return value of the function is other than DEM_FILTERED_OK this parameter does not contain valid data.
      sw service arg DTCFaultDetectionCounter: category=DATA_REFERENCE, direction=OUT, sw-pointer-target-props=sint8  # This parameter receives the Fault Detection Counter information of the requested DTC. If the return value of the function call is other than DEM_FILTERED_OK this parameter does not contain valid data. -128dec...127dec PASSED...FAILED according to ISO 14229-1
    Dem_GetNextFilteredDTCAndSeverity: service-id=61, is-reentrant=false, is-synchronous=false, call-type=REGULAR  # Gets the next filtered DTC and its associated Severity matching the filter criteria. The interface has an asynchronous behavior, because a large number of DTCs has to be processed.
      return type Std_ReturnType: implementation-data-type=Std_ReturnType
      5 x sw service arg:
        ClientId: direction=IN, implementation-data-type=uint8  # Unique client id, assigned to the instance of the calling module.
        DTC: category=DATA_REFERENCE, direction=OUT, sw-pointer-target-props=uint32  # Receives the DTC value in respective format of the filter returned by this function. If the return value of the function is other than DEM_FILTERED_OK this parameter does not contain valid data.
        DTCStatus: category=DATA_REFERENCE, direction=OUT, sw-pointer-target-props=uint8  # This parameter receives the status information of the requested DTC. It follows the format as defined in ISO14229-1 If the return value of the function call is other than DEM_FILTERED_OK this parameter does not contain valid data.
        DTCSeverity: category=DATA_REFERENCE, direction=OUT, sw-pointer-target-props=Dem_DTCSeverityType  # Receives the severity value returned by the function. If the return value of the function is other than DEM_FILTERED_OK this parameter does not contain valid data.
        DTCFunctionalUnit: category=DATA_REFERENCE, direction=OUT, sw-pointer-target-props=uint8  # Receives the functional unit value returned by the function. If the return value of the function is other than DEM_FILTERED_OK this parameter does not contain valid data.
    Dem_GetNextFilteredRecord: service-id=58, is-reentrant=false, is-synchronous=false, call-type=REGULAR  # Gets the next freeze frame record number and its associated DTC stored in the event memory. The interface has an asynchronous behavior, because NvRAM access might be required.
      return type Std_ReturnType: implementation-data-type=Std_ReturnType
      sw service arg ClientId: direction=IN, implementation-data-type=uint8  # Unique client id, assigned to the instance of the calling module.
      sw service arg DTC: category=DATA_REFERENCE, direction=OUT, sw-pointer-target-props=uint32  # DTC Receives the DTC value in respective format of the filter returned by this function. If the return value of the function is other than E_OK this parameter does not contain valid data.
      sw service arg RecordNumber: category=DATA_REFERENCE, direction=OUT, sw-pointer-target-props=uint8  # Freeze frame record number of the reported DTC (relative addressing). If the return value of the function is other than E_OK this parameter does not contain valid data.
    Dem_GetNextFreezeFrameData: service-id=29, is-reentrant=false, is-synchronous=false, call-type=REGULAR  # Gets freeze frame data by the DTC selected by Dem_SelectFreezeFrameData. The function stores the data in the provided DestBuffer.
      return type Std_ReturnType: implementation-data-type=Std_ReturnType
      sw service arg ClientId: direction=IN, implementation-data-type=uint8  # Unique client id, assigned to the instance of the calling module.
      sw service arg DestBuffer: category=DATA_REFERENCE, direction=OUT, sw-pointer-target-props=uint8  # This parameter contains a byte pointer that points to the buffer, to which the freeze frame data record shall be written to. The format is: {RecordNumber, NumOfDIDs, DID[1], data[1], ..., DID[N], data[N]}
      sw service arg BufSize: category=DATA_REFERENCE, direction=INOUT, sw-pointer-target-props=uint16  # When the function is called this parameter contains the maximum number of data bytes that can be written to the buffer. The function returns the actual number of written data bytes in this parameter.
    Dem_GetNumberOfEventMemoryEntries: service-id=53, is-reentrant=false, is-synchronous=true, call-type=REGULAR  # Returns the number of entries currently stored in the requested event memory.
      return type Std_ReturnType: implementation-data-type=Std_ReturnType
      sw service arg ClientId: direction=IN, implementation-data-type=uint8  # DemClientID identifying the DemEventMemorySet to which the requested event memory belongs to.
      sw service arg DTCOrigin: direction=IN, implementation-data-type=Dem_DTCOriginType  # If the Dem supports more than one event memory this parameter is used to select the source memory the number of entries shall be read from.
      sw service arg NumberOfEventMemoryEntries: category=DATA_REFERENCE, direction=OUT, sw-pointer-target-props=uint8  # Number of entries currently stored in the requested event memory.
    Dem_GetNumberOfFilteredDTC: service-id=23, is-reentrant=false, is-synchronous=false, call-type=REGULAR  # Gets the number of a filtered DTC.
      return type Std_ReturnType: implementation-data-type=Std_ReturnType
      sw service arg ClientId: direction=IN, implementation-data-type=uint8  # Unique client id, assigned to the instance of the calling module.
      sw service arg NumberOfFilteredDTC: category=DATA_REFERENCE, direction=OUT, sw-pointer-target-props=uint16  # The number of DTCs matching the defined status mask.
    Dem_GetNumberOfFreezeFrameRecords: service-id=90, is-reentrant=false, is-synchronous=false, call-type=REGULAR  # This function returns the number of all freeze frame records currently stored in the primary event memory
      return type Std_ReturnType: implementation-data-type=Std_ReturnType
      sw service arg ClientId: direction=IN, implementation-data-type=uint8  # Unique client id, assigned to the instance of the calling module.
      sw service arg NumberOfFilteredRecords: category=DATA_REFERENCE, direction=OUT, sw-pointer-target-props=uint16  # Number of all freeze frame records currently stored in the primary event memory.
    Dem_GetSeverityOfDTC: service-id=14, is-reentrant=false, is-synchronous=false, call-type=REGULAR  # Gets the severity of the requested DTC. For large configurations and DTC-calibration, the interface behavior can be asynchronous (splitting the DTC-search into segments).
      return type Std_ReturnType: implementation-data-type=Std_ReturnType
      sw service arg ClientId: direction=IN, implementation-data-type=uint8  # Unique client id, assigned to the instance of the calling module.
      sw service arg DTCSeverity: category=DATA_REFERENCE, direction=OUT, sw-pointer-target-props=Dem_DTCSeverityType  # This parameter contains the DTCSeverity according to ISO 14229-1.
    Dem_GetSizeOfExtendedDataRecordSelection: service-id=33, is-reentrant=false, is-synchronous=false, call-type=REGULAR  # Gets the size of Extended Data Record by DTC selected by the call of Dem_SelectExtendedDataRecord.
      return type Std_ReturnType: implementation-data-type=Std_ReturnType
      sw service arg ClientId: direction=IN, implementation-data-type=uint8  # Unique client id, assigned to the instance of the calling module.
      sw service arg SizeOfExtendedDataRecord: category=DATA_REFERENCE, direction=OUT, sw-pointer-target-props=uint16  # Size of the requested extended data record(s) including record number. The format for a single ExtendedDataRecord is: {RecordNumber, data[1], ..., data[N]}
    Dem_GetSizeOfFreezeFrameSelection: service-id=31, is-reentrant=false, is-synchronous=false, call-type=REGULAR  # Gets the size of freeze frame data by DTC selected by the call of Dem_SelectFreezeFrameData.
      return type Std_ReturnType: implementation-data-type=Std_ReturnType
      sw service arg ClientId: direction=IN, implementation-data-type=uint8  # Unique client id, assigned to the instance of the calling module.
      sw service arg SizeOfFreezeFrame: category=DATA_REFERENCE, direction=OUT, sw-pointer-target-props=uint16  # Number of bytes in the requested freeze frame record.
    Dem_GetStatusOfDTC: service-id=21, is-reentrant=false, is-synchronous=false, call-type=REGULAR  # Gets the status of a DTC. For large configurations and DTC-calibration, the interface behavior can be asynchronous (splitting the DTC-search into segments). The DTCs of OBD Events Suppression shall be reported as Dem_WRONG_DTC.
      return type Std_ReturnType: implementation-data-type=Std_ReturnType
      sw service arg ClientId: direction=IN, implementation-data-type=uint8  # Unique client id, assigned to the instance of the calling module.
      sw service arg DTCStatus: category=DATA_REFERENCE, direction=OUT, sw-pointer-target-props=uint8  # This parameter receives the status information of the requested DTC. It follows the format as defined in ISO14229-1 If the return value of the function call is other than DEM_FILTERED_OK this parameter does not contain valid data.
    Dem_GetTranslationType: service-id=60, is-reentrant=false, is-synchronous=true, call-type=REGULAR  # Gets the supported DTC formats of the ECU.The supported formats are configured via DemTypeOfDTCSupported.
      return type Dem_DTCTranslationFormatType: implementation-data-type=Dem_DTCTranslationFormatType
      sw service arg ClientId: direction=IN, implementation-data-type=uint8  # Unique client id, assigned to the instance of the calling module.
    Dem_GetVersionInfo: service-id=0, is-reentrant=true, is-synchronous=true, call-type=REGULAR  # Returns the version information of this module.
      sw service arg versioninfo: category=DATA_REFERENCE, direction=OUT, sw-pointer-target-props=Std_VersionInfoType  # Pointer to where to store the version information of this module.
    Dem_Init: service-id=2, is-reentrant=false, is-synchronous=true, call-type=REGULAR  # Initializes or reinitializes this module.
      sw service arg ConfigPtr: category=DATA_REFERENCE, direction=IN, sw-pointer-target-props={implementation-data-type=Dem_ConfigType, sw-impl-policy=CONST}  # Pointer to the configuration set in VARIANT-POST-BUILD.
    Dem_J1939DcmClearDTC: service-id=149, is-reentrant=false, is-synchronous=false, call-type=REGULAR  # Clears the status of all event(s) related to the specified DTC(s), as well as all associated event memory entries for these event(s).
      return type Std_ReturnType: implementation-data-type=Std_ReturnType
      sw service arg DTCTypeFilter: direction=IN, implementation-data-type=Dem_J1939DcmSetClearFilterType  # Defines the type of DTCs to be cleared.
      sw service arg DTCOrigin: direction=IN, implementation-data-type=Dem_DTCOriginType  # This parameter is used to select the source memory the DTCs shall be read/cleared from.
      sw service arg ClientId: direction=IN, implementation-data-type=uint8  # ClientId to address the J1939 event memory
    Dem_J1939DcmFirstDTCwithLampStatus: service-id=147, is-reentrant=false, is-synchronous=true, call-type=REGULAR  # The function sets the filter to the first applicable DTC for the DM31 response for a specific node.
      sw service arg ClientId: direction=IN, implementation-data-type=uint8  # ClientId to address the J1939 event memory
    Dem_J1939DcmGetNextDTCwithLampStatus: service-id=148, is-reentrant=false, is-synchronous=true, call-type=REGULAR  # Gets the next filtered J1939 DTC for DM31 including current LampStatus.
      return type Std_ReturnType: implementation-data-type=Std_ReturnType
      4 x sw service arg:
        LampStatus: category=DATA_REFERENCE, direction=OUT, sw-pointer-target-props=Dem_J1939DcmLampStatusType  # Receives the lamp status returned by this function. If the return value of the function is other than DEM_FILTERED_OK this parameter does not contain valid data.
        J1939DTC: category=DATA_REFERENCE, direction=OUT, sw-pointer-target-props=uint32  # Receives the J1939DTC value. If the return value of the function is other than DEM_FILTERED_OK this parameter does not contain valid data.
        OccurenceCounter: category=DATA_REFERENCE, direction=OUT, sw-pointer-target-props=uint8  # This parameter receives the corresponding occurrence counter. If the return value of the function call is other than DEM_FILTERED_OK this parameter does not contain valid data.
        ClientId: direction=IN, implementation-data-type=uint8  # ClientId to address the J1939 event memory
    Dem_J1939DcmGetNextFilteredDTC: service-id=146, is-reentrant=false, is-synchronous=false, call-type=REGULAR  # Gets the next filtered J1939 DTC.
      return type Std_ReturnType: implementation-data-type=Std_ReturnType
      sw service arg J1939DTC: category=DATA_REFERENCE, direction=OUT, sw-pointer-target-props=uint32  # Receives the J1939DTC value. If the return value of the function is other than DEM_FILTERED_OK this parameter does not contain valid data.
      sw service arg OccurenceCounter: category=DATA_REFERENCE, direction=OUT, sw-pointer-target-props=uint8  # This parameter receives the corresponding occurrence counter. If the return value of the function call is other than DEM_FILTERED_OK this parameter does not contain valid data.
      sw service arg ClientId: direction=IN, implementation-data-type=uint8  # ClientId to address the J1939 event memory
    Dem_J1939DcmGetNextFilteredRatio: service-id=154, is-reentrant=false, is-synchronous=true, call-type=REGULAR  # Gets the next filtered Ratio.
      return type Std_ReturnType: implementation-data-type=Std_ReturnType
      4 x sw service arg:
        SPN: category=DATA_REFERENCE, direction=OUT, sw-pointer-target-props=uint32  # Receives the SPN of the applicaple system monitor. If the return value of the function is other than DEM_FILTERED_OK this parameter does not contain valid data.
        Numerator: category=DATA_REFERENCE, direction=OUT, sw-pointer-target-props=uint16  # Receives the Numerator of the applicable system monitor. If the return value of the function is other than DEM_FILTERED_OK this parameter does not contain valid data.
        Denominator: category=DATA_REFERENCE, direction=OUT, sw-pointer-target-props=uint16  # Receives the Denominator of the applicable system monitor. If the return value of the function is other than DEM_FILTERED_OK this parameter does not contain valid data.
        ClientId: direction=IN, implementation-data-type=uint8  # ClientId to address the J1939 event memory
    Dem_J1939DcmGetNextFreezeFrame: service-id=151, is-reentrant=false, is-synchronous=false, call-type=REGULAR  # Gets next freeze frame data. The function stores the data in the provided DestBuffer.
      return type Std_ReturnType: implementation-data-type=Std_ReturnType
      5 x sw service arg:
        J1939DTC: category=DATA_REFERENCE, direction=OUT, sw-pointer-target-props=uint32  # Receives the J1939DTC value. If the return value of the function is other than DEM_FILTERED_OK this parameter does not contain valid data.
        OccurenceCounter: category=DATA_REFERENCE, direction=OUT, sw-pointer-target-props=uint8  # This parameter receives the corresponding occurrence counter. If the return value of the function call is other than DEM_FILTERED_OK this parameter does not contain valid data.
        DestBuffer: category=DATA_REFERENCE, direction=INOUT, sw-pointer-target-props=uint8  # This parameter contains a byte pointer that points to the buffer, to which the freeze frame data record shall be written to.
        BufSize: category=DATA_REFERENCE, direction=INOUT, sw-pointer-target-props=uint16  # When the function is called this parameter contains the maximum number of data bytes that can be written to the buffer. The function returns the actual number of written data bytes in DestBuffer
        ClientId: direction=IN, implementation-data-type=uint8  # ClientId to address the J1939 event memory
    Dem_J1939DcmGetNextSPNInFreezeFrame: service-id=152, is-reentrant=false, is-synchronous=false, call-type=REGULAR  # Gets next SPN.
      return type Std_ReturnType: implementation-data-type=Std_ReturnType
      sw service arg SPNSupported: category=DATA_REFERENCE, direction=OUT, sw-pointer-target-props=uint32  # This parameter contains the next SPN in the ExpandedFreezeFrame
      sw service arg SPNDataLength: category=DATA_REFERENCE, direction=OUT, sw-pointer-target-props=uint8  # This parameter contains the corresponding dataLength of the SPN
      sw service arg ClientId: direction=IN, implementation-data-type=uint8  # ClientId to address the J1939 event memory
    Dem_J1939DcmGetNumberOfFilteredDTC: service-id=145, is-reentrant=false, is-synchronous=false, call-type=REGULAR  # Gets the number of currently filtered DTCs set by the function Dem_J1939DcmSetDTCFilter.
      return type Std_ReturnType: implementation-data-type=Std_ReturnType
      sw service arg NumberOfFilteredDTC: category=DATA_REFERENCE, direction=OUT, sw-pointer-target-props=uint16  # The number of DTCs matching the defined status mask.
      sw service arg ClientId: direction=IN, implementation-data-type=uint8  # ClientId to address the J1939 event memory
    Dem_J1939DcmReadDiagnosticReadiness1: service-id=155, is-reentrant=false, is-synchronous=true, call-type=REGULAR  # Service to report the value of Diagnostic Readiness 1 (DM05) computed by the Dem.
      return type Std_ReturnType: implementation-data-type=Std_ReturnType
      sw service arg DataValue: category=DATA_REFERENCE, direction=OUT, sw-pointer-target-props=Dem_J1939DcmDiagnosticReadiness1Type  # Buffer of 8 bytes containing the contents of Diagnostic Readiness 1 (DM05) computed by the Dem.
      sw service arg ClientId: direction=IN, implementation-data-type=uint8  # ClientId to address the J1939 event memory
    Dem_J1939DcmReadDiagnosticReadiness2: service-id=156, is-reentrant=false, is-synchronous=true, call-type=REGULAR  # Service to report the value of Diagnostic Readiness 2 (DM21) computed by the Dem.
      return type Std_ReturnType: implementation-data-type=Std_ReturnType
      sw service arg DataValue: category=DATA_REFERENCE, direction=OUT, sw-pointer-target-props=Dem_J1939DcmDiagnosticReadiness2Type  # Buffer of 8 bytes containing the contents of Diagnostic Readiness 2 (DM21) computed by the Dem.
      sw service arg ClientId: direction=IN, implementation-data-type=uint8  # ClientId to address the J1939 event memory
    Dem_J1939DcmReadDiagnosticReadiness3: service-id=157, is-reentrant=false, is-synchronous=true, call-type=REGULAR  # Service to report the value of Diagnostic Readiness 3 (DM26) computed by the Dem.
      return type Std_ReturnType: implementation-data-type=Std_ReturnType
      sw service arg DataValue: category=DATA_REFERENCE, direction=OUT, sw-pointer-target-props=Dem_J1939DcmDiagnosticReadiness3Type  # Buffer of 8 bytes containing the contents of Diagnostic Readiness 3 (DM26) computed by the Dem.
      sw service arg ClientId: direction=IN, implementation-data-type=uint8  # ClientId to address the J1939 event memory
    Dem_J1939DcmSetDTCFilter: service-id=144, is-reentrant=false, is-synchronous=true, call-type=REGULAR  # The function sets the DTC filter for a specific node and returns the composite lamp status of the filtered DTCs.
      return type Std_ReturnType: implementation-data-type=Std_ReturnType
      5 x sw service arg:
        DTCStatusFilter: direction=IN, implementation-data-type=Dem_J1939DcmDTCStatusFilterType  # The following types are available: DEM_J1939DTC_ACTIVE DEM_J1939DTC_PREVIOUSLY_ACTIVE DEM_J1939DTC_PENDING DEM_J1939DTC_PERMANENT DEM_J1939DTC_CURRENTLY_ACTIVE
        DTCKind: direction=IN, implementation-data-type=Dem_DTCKindType  # Defines the functional group of DTCs to be reported (e.g. all DTC, OBD-relevant DTC)
        DTCOrigin: direction=IN, implementation-data-type=Dem_DTCOriginType  # This parameter is used to select the source memory the DTCs shall be read/cleared from.
        ClientId: direction=IN, implementation-data-type=uint8  # ClientId to address the J1939 event memory
        LampStatus: category=DATA_REFERENCE, direction=OUT, sw-pointer-target-props=Dem_J1939DcmLampStatusType  # E_OK: Operation successful DEM_NO_SUCH_ELEMENT: The requested element is not available DEM_PENDING: Operation successful and result pending. DEM_BUFFER_TOO_SMALL: The provided buffer is too small
    Dem_J1939DcmSetFreezeFrameFilter: service-id=150, is-reentrant=false, is-synchronous=true, call-type=REGULAR  # The function sets the FreezeFrame filter for a specific node.
      return type Std_ReturnType: implementation-data-type=Std_ReturnType
      sw service arg FreezeFrameKind: direction=IN, implementation-data-type=Dem_J1939DcmSetFreezeFrameFilterType  # The following types are available: DEM_J1939DCM_FREEZEFRAME DEM_J1939DCM_EXPANDED_FREEZEFRAME DEM_J1939DCM_SPNS_IN_EXPANDED_FREEZEFRAME
      sw service arg ClientId: direction=IN, implementation-data-type=uint8  # ClientId to address the J1939 event memory
    Dem_J1939DcmSetRatioFilter: service-id=153, is-reentrant=false, is-synchronous=true, call-type=REGULAR  # The function sets the Ratio filter for a specific node and returns the corresponding Ignition Cycle Counter and General Denominator.
      return type Std_ReturnType: implementation-data-type=Std_ReturnType
      sw service arg IgnitionCycleCounter: category=DATA_REFERENCE, direction=OUT, sw-pointer-target-props=uint16  # Ignition Cycle Counter
      sw service arg OBDMonitoringConditionsEncountered: category=DATA_REFERENCE, direction=OUT, sw-pointer-target-props=uint16  # OBD Monitoring Conditions Encountered
      sw service arg ClientId: direction=IN, implementation-data-type=uint8  # ClientId to address the J1939 event memory
    Dem_MainFunction: service-id=85, call-type=SCHEDULED  # Processes all not event based Dem internal functions.
    Dem_PreInit: service-id=1, is-reentrant=false, is-synchronous=true, call-type=REGULAR  # Initializes the internal states necessary to process events reported by BSW-modules.
    Dem_PrestoreFreezeFrame: service-id=6, is-reentrant=false, is-synchronous=true, call-type=REGULAR  # Captures the freeze frame data for a specific event. This API can only be used through the RTE and therefore no declaration is exported via Dem.h.
      return type Std_ReturnType: implementation-data-type=Std_ReturnType
      sw service arg EventId: direction=IN, implementation-data-type=Dem_EventIdType  # Identification of an event by assigned EventId.
    Dem_ReadDataOfPID01: service-id=179, is-reentrant=false, is-synchronous=true, call-type=REGULAR  # Service to report the value of PID $01 computed by the Dem. API is needed in OBD relevant ECUs only
      return type Std_ReturnType: implementation-data-type=Std_ReturnType
      sw service arg PID01value: category=DATA_REFERENCE, direction=OUT, sw-pointer-target-props=uint8  # Buffer containing the contents of PID $01 computed by the Dem. The buffer is provided by the application with the size of 4 bytes.
    Dem_RepIUMPRDenRelease: service-id=114, is-reentrant=true, is-synchronous=true, call-type=REGULAR  # Service is used to release a denominator of a specific monitor. API is needed in OBD-relevant ECUs only
      return type Std_ReturnType: implementation-data-type=Std_ReturnType
      sw service arg RatioID: direction=IN, implementation-data-type=Dem_RatioIdType  # Ratio Identifier reporting that specific denominator is released (for physical reasons - e.g. temperature conditions or minimum activity)
    Dem_RepIUMPRFaultDetect: service-id=115, is-reentrant=false, is-synchronous=true, call-type=REGULAR  # Service for reporting that faults are possibly found because all conditions are fullfilled. API is needed in OBD-relevant ECUs only
      return type Std_ReturnType: implementation-data-type=Std_ReturnType
      sw service arg RatioID: direction=IN, implementation-data-type=Dem_RatioIdType  # Ratio Identifier reporting that a respective monitor could have found a fault - only used when interface option "API" is selected
    Dem_ResetEventDebounceStatus: service-id=9, is-reentrant=false, is-synchronous=true, call-type=REGULAR  # Control the internal debounce counter/timer by BSW modules and SW-Cs. The event qualification will not be affected by these debounce state changes. This API is available for BSW modules as soon as Dem_PreInit has been completed (refer to SWS_Dem_00438 and SWS_Dem_00167).
      return type Std_ReturnType: implementation-data-type=Std_ReturnType
      sw service arg EventId: direction=IN, implementation-data-type=Dem_EventIdType  # Identification of an event by assigned EventId.
      sw service arg DebounceResetStatus: direction=IN, implementation-data-type=Dem_DebounceResetStatusType  # Freeze or reset the internal debounce counter/timer of the specified event.
    Dem_ResetEventStatus: service-id=5, is-reentrant=false, is-synchronous=false, call-type=REGULAR  # Resets the event failed status. This API can only be used through the RTE and therefore no declaration is exported via Dem.h.
      return type Std_ReturnType: implementation-data-type=Std_ReturnType
      sw service arg EventId: direction=IN, implementation-data-type=Dem_EventIdType  # Identification of an event by assigned EventId.
    Dem_RestartOperationCycle: service-id=8, is-reentrant=true, is-synchronous=false, call-type=REGULAR  # Sets an operation cycle state. This API can only be used through the RTE and therefore no declaration is exported via Dem.h. The interface has an asynchronous behavior to avoid exceeding of typical timing requirements on APIs if a large number of events has to be processed and during the re-initializations of the related monitors. The asynchronous acknowledgements are the related InitMonitorForEvent callbacks.
      return type Std_ReturnType: implementation-data-type=Std_ReturnType
      sw service arg OperationCycleId: direction=IN, implementation-data-type=uint8  # Identification of operation cycle, like power cycle, driving cycle.
    Dem_SelectDTC: service-id=183, is-reentrant=false, is-synchronous=true, call-type=REGULAR  # Selects a DTC or DTC group as target for further operations.
      return type Std_ReturnType: implementation-data-type=Std_ReturnType
      4 x sw service arg, all with direction=IN:
        ClientId: implementation-data-type=uint8  # Unique client id, assigned to the instance of the calling module.
        DTC: implementation-data-type=uint32  # Defines the DTC in respective format that is selected. If the DTC fits to a DTC group number, the DTC group is selected.
        DTCFormat: implementation-data-type=Dem_DTCFormatType  # Defines the input-format of the provided DTC value.
        DTCOrigin: implementation-data-type=Dem_DTCOriginType  # The event memory of the requested DTC or group of DTC.
    Dem_SelectExtendedDataRecord: service-id=186, is-reentrant=false, is-synchronous=true, call-type=REGULAR  # Sets the filter to be used by Dem_GetNextExtendedDataRecord and Dem_GetSizeOfExtendedDataRecordSelection.
      return type Std_ReturnType: implementation-data-type=Std_ReturnType
      sw service arg ClientId: direction=IN, implementation-data-type=uint8  # Unique client id, assigned to the instance of the calling module.
      sw service arg ExtendedDataNumber: direction=IN, implementation-data-type=uint8  # Identification/Number of requested extended data record. Additionally the values 0xFE and 0xFF are explicitly allowed to request the overall size of all OBD records / all records.
    Dem_SelectFreezeFrameData: service-id=185, is-reentrant=false, is-synchronous=true, call-type=REGULAR  # Sets the filter to be used by Dem_GetNextFreezeFrameData and Dem_GetSizeOfFreezeFrameSelection.
      return type Std_ReturnType: implementation-data-type=Std_ReturnType
      sw service arg ClientId: direction=IN, implementation-data-type=uint8  # Unique client id, assigned to the instance of the calling module.
      sw service arg RecordNumber: direction=IN, implementation-data-type=uint8  # Unique identifier for a snapshot record as defined in ISO 14229-1. The value 0xFF is a placeholder referencing all snapshot records of the addressed DTC. The value 0x00 indicates the DTC-specific WWH-OBD snapshot record.
    Dem_SetComponentAvailable: service-id=43, is-reentrant=false, is-synchronous=true, call-type=REGULAR  # Set the availability of a specific DemComponent.
      return type Std_ReturnType: implementation-data-type=Std_ReturnType
      sw service arg ComponentId: direction=IN, implementation-data-type=Dem_ComponentIdType  # Identification of a DemComponent.
      sw service arg AvailableStatus: direction=IN, implementation-data-type=boolean  # This parameter specifies whether the respective Component shall be available (TRUE) or not (FALSE).
    Dem_SetCycleQualified: service-id=86, is-reentrant=true, is-synchronous=true, call-type=REGULAR  # Sets a dependent operation cycle as qualified, so it may be processed along with its leading cycle.
      return type Std_ReturnType: implementation-data-type=Std_ReturnType
      sw service arg OperationCycleId: direction=IN, implementation-data-type=uint8  # Identification of a configured DemOperationCycle
    Dem_SetDTCFilter: service-id=19, is-reentrant=false, is-synchronous=true, call-type=REGULAR  # Sets the DTC Filter.
      return type Std_ReturnType: implementation-data-type=Std_ReturnType
      7 x sw service arg, all with direction=IN:
        ClientId: implementation-data-type=uint8  # Unique client id, assigned to the instance of the calling module.
        DTCStatusMask: implementation-data-type=uint8  # Status-byte mask for DTC status-byte filtering Values: 0x00: Autosar-specific value to deactivate the status-byte filtering (different meaning than in ISO 14229-1) to report all supported DTCs (used for service 0x19 subfunctions 0x0A/0x15) 0x01..0xFF: Status-byte mask according to ISO 14229-1 DTCStatusMask (handed over by Dcm from service request directly) to filter for DTCs with at least one status bit set matching this status-byte mask
        DTCFormat: implementation-data-type=Dem_DTCFormatType  # Defines the output-format of the requested DTC values for the sub-sequent API calls. If passed value does not fit to Configuration, the DET error DEM_E_WRONG_CONFIGURATION shall be reported, e.g. if DTCFormat "DEM_DTC_FORMAT_OBD" is passed, but OBD is not supported per configuration.
        DTCOrigin: implementation-data-type=Dem_DTCOriginType  # If the Dem supports more than one event memory this parameter is used to select the source memory the DTCs shall be read from. If passed value does not fit to Configuration, the DET error DEM_E_WRONG_CONFIGURATION shall be reported, e.g. if DTCOrigin "DEM_DTC_ORIGIN_MIRROR_MEMORY" is passed, but no mirror memory is configured.
        FilterWithSeverity: implementation-data-type=boolean  # This flag defines whether severity information (ref. to parameter below) shall be used for filtering. This is to allow for coexistence of DTCs with and without severity information.
        DTCSeverityMask: implementation-data-type=Dem_DTCSeverityType  # Contains the DTCSeverityMask according to ISO14229-1.
        FilterForFaultDetectionCounter: implementation-data-type=boolean  # This flag defines whether the fault detection counter information shall be used for filtering. This is to allow for coexistence of DTCs with and without fault detection counter information. If fault detection counter information is filter criteria, only those DTCs with a fault detection counter value between 1 and 0x7E shall be reported. Remark: If the event does not use the debouncing inside Dem, then the Dem must request this information via GetFaultDetectionCounter.
    Dem_SetDTCSuppression: service-id=51, is-reentrant=false, is-synchronous=true, call-type=REGULAR  # Set the suppression status of a specific DTC.
      return type Std_ReturnType: implementation-data-type=Std_ReturnType
      sw service arg ClientId: direction=IN, implementation-data-type=uint8  # Unique client id, assigned to the instance of the calling module.
      sw service arg SuppressionStatus: direction=IN, implementation-data-type=boolean  # This parameter specifies whether the respective DTC shall be disabled (TRUE) or enabled (FALSE).
    Dem_SetDTR: service-id=162, is-reentrant=false, is-synchronous=true, call-type=REGULAR  # Reports a DTR result with lower and upper limit. The internal eventstatus serves as master whether the DTR values are forwarded or ignored, also taking the DTRUpdateKind into account. The EventId that is related to the DTR is assigned per configuration (and derived from ServiceNeeds). Processing takes enable/storage conditions into account. API is needed in OBD-relevant ECUs only.
      return type Std_ReturnType: implementation-data-type=Std_ReturnType
      5 x sw service arg, all with direction=IN:
        DTRId: implementation-data-type=uint16  # Identification of a DTR element by assigned DTRId.
        TestResult: implementation-data-type=sint32  # Test result of DTR
        LowerLimit: implementation-data-type=sint32  # Lower limit of DTR
        UpperLimit: implementation-data-type=sint32  # Upper limit of DTR
        Ctrlval: implementation-data-type=Dem_DTRControlType  # Control value of the DTR to support its interpretation Dem-internally.
    Dem_SetDataOfPID21: service-id=166, is-reentrant=false, is-synchronous=true, call-type=REGULAR  # Service to set the value of PID $21 in the Dem by a software component. API is needed in OBD-relevant ECUs only.
      return type Std_ReturnType: implementation-data-type=Std_ReturnType
      sw service arg PID21value: category=DATA_REFERENCE, direction=IN, sw-pointer-target-props={implementation-data-type=uint8, sw-impl-policy=CONST}  # Buffer containing the contents of PID $21. The buffer is provided by the Dcm with the appropriate size, i.e. during configuration, the Dcm identifies the required size from the largest PID in order to configure a PIDBuffer.
    Dem_SetDataOfPID31: service-id=167, is-reentrant=false, is-synchronous=true, call-type=REGULAR  # Service to set the value of PID $31 in the Dem by a software component. API is needed in OBD-relevant ECUs only.
      return type Std_ReturnType: implementation-data-type=Std_ReturnType
      sw service arg PID31value: category=DATA_REFERENCE, direction=IN, sw-pointer-target-props={implementation-data-type=uint8, sw-impl-policy=CONST}  # Buffer containing the contents of PID $31. The buffer is provided by the Dcm with the appropriate size, i.e. during configuration, the Dcm identifies the required size from the largest PID in order to configure a PIDBuffer.
    Dem_SetDataOfPID4D: service-id=168, is-reentrant=false, is-synchronous=true, call-type=REGULAR  # Service to set the value of PID $4D in the Dem by a software component. API is needed in OBD-relevant ECUs only.
      return type Std_ReturnType: implementation-data-type=Std_ReturnType
      sw service arg PID4Dvalue: category=DATA_REFERENCE, direction=IN, sw-pointer-target-props={implementation-data-type=uint8, sw-impl-policy=CONST}  # Buffer containing the contents of PID $4D. The buffer is provided by the Dcm with the appropriate size, i.e. during configuration, the Dcm identifies the required size from the largest PID in order to configure a PIDBuffer.
    Dem_SetDataOfPID4E: service-id=169, is-reentrant=false, is-synchronous=false, call-type=REGULAR  # Service to set the value of PID $4E in the Dem by a software component. API is needed in OBD-relevant ECUs only.
      return type Std_ReturnType: implementation-data-type=Std_ReturnType
      sw service arg PID4Evalue: category=DATA_REFERENCE, direction=IN, sw-pointer-target-props={implementation-data-type=uint8, sw-impl-policy=CONST}  # Buffer containing the contents of PID $4E. The buffer is provided by the Dcm with the appropriate size, i.e. during configuration, the Dcm identifies the required size from the largest PID in order to configure a PIDBuffer.
    Dem_SetEnableCondition: service-id=57, is-reentrant=true, is-synchronous=false, call-type=REGULAR  # Sets an enable condition.
      return type Std_ReturnType: implementation-data-type=Std_ReturnType
      sw service arg EnableConditionID: direction=IN, implementation-data-type=uint8  # This parameter identifies the enable condition.
      sw service arg ConditionFulfilled: direction=IN, implementation-data-type=boolean  # This parameter specifies whether the enable condition assigned to the EnableConditionID is fulfilled (TRUE) or not fulfilled (FALSE).
    Dem_SetEventAvailable: service-id=55, is-reentrant=false, is-synchronous=false, call-type=REGULAR  # Set the available status of a specific Event.
      return type Std_ReturnType: implementation-data-type=Std_ReturnType
      sw service arg EventId: direction=IN, implementation-data-type=Dem_EventIdType  # Identification of an event by assigned EventId.
      sw service arg AvailableStatus: direction=IN, implementation-data-type=boolean  # This parameter specifies whether the respective Event shall be available (TRUE) or not (FALSE).
    Dem_SetEventDisabled: service-id=81, is-reentrant=false, is-synchronous=true, call-type=REGULAR  # Service for reporting the event as disabled to the Dem for the PID $41 computation. API is needed in OBD-relevant ECUs only.
      return type Std_ReturnType: implementation-data-type=Std_ReturnType
      sw service arg EventId: direction=IN, implementation-data-type=Dem_EventIdType  # Identification of an event by assigned EventId.
    Dem_SetEventFailureCycleCounterThreshold: service-id=87, is-reentrant=false, is-synchronous=false, call-type=REGULAR  # Set the failure confirmation threshold of an event.
      return type Std_ReturnType: implementation-data-type=Std_ReturnType
      sw service arg EventId: direction=IN, implementation-data-type=Dem_EventIdType  # Identification of an event by assigned EventId.
      sw service arg FailureCycleCounterThreshold: direction=IN, implementation-data-type=uint8  # Failure cycle counter threshold of event to be set.
    Dem_SetEventStatus: service-id=4, is-reentrant=false, is-synchronous=false, call-type=REGULAR  # Called by SW-Cs or BSW modules to report monitor status information to the Dem. BSW modules calling Dem_SetEventStatus can safely ignore the return value.
      return type Std_ReturnType: implementation-data-type=Std_ReturnType
      sw service arg EventId: direction=IN, implementation-data-type=Dem_EventIdType  # Identification of an event by assigned EventId.
      sw service arg EventStatus: direction=IN, implementation-data-type=Dem_EventStatusType  # Monitor test result
    Dem_SetEventStatusWithMonitorData: service-id=189, is-reentrant=false, is-synchronous=false, call-type=REGULAR
      return type Std_ReturnType: implementation-data-type=Std_ReturnType
      4 x sw service arg, all with direction=IN:
        EventId: implementation-data-type=Dem_EventIdType  # Identification of an event by assigned EventId.
        EventStatus: implementation-data-type=Dem_EventStatusType  # Monitor test result
        monitorData0: implementation-data-type=Dem_MonitorDataType
        monitorData1: implementation-data-type=Dem_MonitorDataType
    Dem_SetFreezeFrameRecordFilter: service-id=63, is-reentrant=false, is-synchronous=true, call-type=REGULAR  # Sets a freeze frame record filter.
      return type Std_ReturnType: implementation-data-type=Std_ReturnType
      sw service arg ClientId: direction=IN, implementation-data-type=uint8  # Unique client id, assigned to the instance of the calling module.
      sw service arg DTCFormat: direction=IN, implementation-data-type=Dem_DTCFormatType  # Defines the output-format of the requested DTC values
    Dem_SetIUMPRDenCondition: service-id=174, is-reentrant=true, is-synchronous=false, call-type=REGULAR  # In order to communicate the status of the (additional) denominator conditions among the OBD relevant ECUs, the API is used to forward the condition status to a Dem of a particular ECU. API is needed in OBD-relevant ECUs only.
      return type Std_ReturnType: implementation-data-type=Std_ReturnType
      sw service arg ConditionId: direction=IN, implementation-data-type=Dem_IumprDenomCondIdType  # Identification of a IUMPR denominator condition ID (General Denominator, Cold start, EVAP, 500mi).
      sw service arg ConditionStatus: direction=IN, implementation-data-type=Dem_IumprDenomCondStatusType  # Status of the IUMPR denominator condition (Not-reached, reached, not reachable / inhibited)
    Dem_SetPtoStatus: service-id=121, is-reentrant=false, is-synchronous=true, call-type=REGULAR  # API is needed in OBD-relevant ECUs only
      return type Std_ReturnType: implementation-data-type=Std_ReturnType
      sw service arg PtoStatus: direction=IN, implementation-data-type=boolean  # sets the status of the PTO (TRUE==active; FALSE==inactive)
    Dem_SetStorageCondition: service-id=56, is-reentrant=true, is-synchronous=true, call-type=REGULAR  # Sets a storage condition.
      return type Std_ReturnType: implementation-data-type=Std_ReturnType
      sw service arg StorageConditionID: direction=IN, implementation-data-type=uint8  # This parameter identifies the storage condition.
      sw service arg ConditionFulfilled: direction=IN, implementation-data-type=boolean  # This parameter specifies whether the storage condition assigned to the StorageConditionID is fulfilled (TRUE) or not fulfilled (FALSE).
    Dem_SetWIRStatus: service-id=122, is-reentrant=false, is-synchronous=false, call-type=REGULAR  # Sets the WIR status bit via failsafe SW-Cs. This API can only be used through the RTE and therefore no declaration is exported via Dem.h.
      return type Std_ReturnType: implementation-data-type=Std_ReturnType
      sw service arg EventId: direction=IN, implementation-data-type=Dem_EventIdType  # Identification of an event by assigned EventId. The Event Number is configured in the DEM. Min.: 1 (0: Indication of no Event or Failure) Max.:Result of configuration of Event Numbers in DEM (Max is either 255 or 65535)
      sw service arg WIRStatus: direction=IN, implementation-data-type=boolean  # Requested status of event related WIR-bit (regarding to the current status of function inhibition) WIRStatus = TRUE -> WIR-bit shall be set to "1" WIRStatus = FALSE -> WIR-bit shall be set to "0"
    Dem_Shutdown: service-id=3, is-reentrant=false, is-synchronous=true, call-type=REGULAR  # Shuts down this module.
  swc bsw mapping SwcBswMapping: bsw-behavior=BswInternalBehavior_Dem, swc-bsw-runnable-mapping{bsw-entity=BswSE_Dem_MainFunction, swc-runnable=MainFunction}, swc-behavior=InternalBehavior
