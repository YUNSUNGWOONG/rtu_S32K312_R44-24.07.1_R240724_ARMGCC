AUTOSAR XML (schema 00047)
package /Bsw_CanNm
  bsw implementation BswImplementation_CanNm: programming-language=C, sw-version=1.2.0, vendor-id=76, ar-release-version=4.4.0, behavior=BswInternalBehavior_CanNm
    code-descriptors:
      code Code_CanNm
        artifact-descriptors:
          short-label=CanNm, category=SWSRC
          short-label=CanNm, category=SWHDR
          short-label=CanNm_Globals, category=SWSRC
          short-label=CanNm_Globals, category=SWHDR
          short-label=CanNm_IntFunc, category=SWSRC
          short-label=CanNm_IntFunc, category=SWHDR
          short-label=CanNm_IntTypes, category=SWHDR
          short-label=CanNm_Version, category=SWSRC
          short-label=CanNm_Version, category=SWHDR
  bsw module description CanNm: category=BSW_MODULE, module-id=31
    implemented-entrys:
      CanNm_Init
      CanNm_DeInit
      CanNm_PassiveStartUp
      CanNm_NetworkRequest
      CanNm_NetworkRelease
      CanNm_DisableCommunication
      CanNm_DisableCommunication_TimerisNotStopped
      CanNm_EnableCommunication
      CanNm_EnableCommunication_TimerisNotStarted
      CanNm_SetUserData
      CanNm_GetUserData
      CanNm_Transmit
      CanNm_GetNodeIdentifier
      CanNm_GetLocalNodeIdentifier
      CanNm_RepeatMessageRequest
      CanNm_GetPduData
      CanNm_GetState
      CanNm_GetVersionInfo
      CanNm_TxConfirmation
      CanNm_RxIndication
      CanNm_ConfirmPnAvailability
      CanNm_TriggerTransmit
      CanNm_MainFunction
    5 x bsw module dependency:
      BswModuleDependency_CanIf: target-module-id=60
      BswModuleDependency_CanSM: target-module-id=140
      BswModuleDependency_Det: target-module-id=15
      BswModuleDependency_Nm: target-module-id=29
      BswModuleDependency_PduR: target-module-id=51
    bsw internal behavior BswInternalBehavior_CanNm: bsw-exclusive-area-policy{api-principle=COMMON, exclusive-area=INTERNAL_STATUS}
      exclusive area INTERNAL_STATUS
      22 x bsw called entity:
        BswCE_CanNm_ConfirmPnAvailability: can-enter-exclusive-area=INTERNAL_STATUS, reentrancy-level=NON-REENTRANT, implemented-entry=CanNm_ConfirmPnAvailability
        BswCE_CanNm_DeInit: reentrancy-level=NON-REENTRANT, implemented-entry=CanNm_DeInit
        BswCE_CanNm_DisableCommunication: can-enter-exclusive-area=INTERNAL_STATUS, reentrancy-level=SINGLE-CORE-REENTRANT, implemented-entry=CanNm_DisableCommunication
        BswCE_CanNm_DisableCommunication_TimerisNotStopped: can-enter-exclusive-area=INTERNAL_STATUS, reentrancy-level=SINGLE-CORE-REENTRANT, implemented-entry=CanNm_DisableCommunication_TimerisNotStopped
        BswCE_CanNm_EnableCommunication: can-enter-exclusive-area=INTERNAL_STATUS, reentrancy-level=SINGLE-CORE-REENTRANT, implemented-entry=CanNm_EnableCommunication
        BswCE_CanNm_EnableCommunication_TimerisNotStarted: can-enter-exclusive-area=INTERNAL_STATUS, reentrancy-level=SINGLE-CORE-REENTRANT, implemented-entry=CanNm_EnableCommunication_TimerisNotStarted
        BswCE_CanNm_GetLocalNodeIdentifier: reentrancy-level=NON-REENTRANT, implemented-entry=CanNm_GetLocalNodeIdentifier
        BswCE_CanNm_GetNodeIdentifier: reentrancy-level=NON-REENTRANT, implemented-entry=CanNm_GetNodeIdentifier
        BswCE_CanNm_GetPduData: can-enter-exclusive-area=INTERNAL_STATUS, reentrancy-level=SINGLE-CORE-REENTRANT, implemented-entry=CanNm_GetPduData
        BswCE_CanNm_GetState: can-enter-exclusive-area=INTERNAL_STATUS, reentrancy-level=SINGLE-CORE-REENTRANT, implemented-entry=CanNm_GetState
        BswCE_CanNm_GetUserData: can-enter-exclusive-area=INTERNAL_STATUS, reentrancy-level=NON-REENTRANT, implemented-entry=CanNm_GetUserData
        BswCE_CanNm_GetVersionInfo: reentrancy-level=SINGLE-CORE-REENTRANT, implemented-entry=CanNm_GetVersionInfo
        BswCE_CanNm_Init: reentrancy-level=NON-REENTRANT, implemented-entry=CanNm_Init
        BswCE_CanNm_NetworkRelease: can-enter-exclusive-area=INTERNAL_STATUS, reentrancy-level=MULTICORE-REENTRANT, implemented-entry=CanNm_NetworkRelease
        BswCE_CanNm_NetworkRequest: can-enter-exclusive-area=INTERNAL_STATUS, reentrancy-level=SINGLE-CORE-REENTRANT, implemented-entry=CanNm_NetworkRequest
        BswCE_CanNm_PassiveStartUp: can-enter-exclusive-area=INTERNAL_STATUS, reentrancy-level=SINGLE-CORE-REENTRANT, implemented-entry=CanNm_PassiveStartUp
        BswCE_CanNm_RepeatMessageRequest: can-enter-exclusive-area=INTERNAL_STATUS, reentrancy-level=SINGLE-CORE-REENTRANT, implemented-entry=CanNm_RepeatMessageRequest
        BswCE_CanNm_RxIndication: can-enter-exclusive-area=INTERNAL_STATUS, reentrancy-level=SINGLE-CORE-REENTRANT, implemented-entry=CanNm_RxIndication
        BswCE_CanNm_SetUserData: can-enter-exclusive-area=INTERNAL_STATUS, reentrancy-level=NON-REENTRANT, implemented-entry=CanNm_SetUserData
        BswCE_CanNm_Transmit: can-enter-exclusive-area=INTERNAL_STATUS, reentrancy-level=SINGLE-CORE-REENTRANT, implemented-entry=CanNm_Transmit
        BswCE_CanNm_TriggerTransmit: reentrancy-level=SINGLE-CORE-REENTRANT, implemented-entry=CanNm_TriggerTransmit
        BswCE_CanNm_TxConfirmation: can-enter-exclusive-area=INTERNAL_STATUS, reentrancy-level=SINGLE-CORE-REENTRANT, implemented-entry=CanNm_TxConfirmation
      bsw schedulable entity BswSE_CanNm_MainFunction: can-enter-exclusive-area=INTERNAL_STATUS, minimum-start-interval=10.0, reentrancy-level=NON-REENTRANT, implemented-entry=CanNm_MainFunction
      bsw timing event BswSE_CanNm_MainFunction: starts-on-event=BswSE_CanNm_MainFunction, period=0.005
      bsw distinguished partition BswDistinguishedPartition_CanNm
package /Bsw_CanNm/BswModuleEntries
  25 x bsw module entry, all with category=TYPE_REFERENCE, sw-service-impl-policy=STANDARD, bsw-entry-kind=CONCRETE:
    CanNm_ConfirmPnAvailability: service-id=22, is-reentrant=true, is-synchronous=true, call-type=REGULAR, execution-context=UNSPECIFIED
      sw service arg nmChannelHandle: direction=IN, base-type=void, implementation-data-type=boolean
    CanNm_DeInit: service-id=16, is-reentrant=false, is-synchronous=true, call-type=REGULAR, execution-context=UNSPECIFIED
    CanNm_DisableCommunication: service-id=12, is-reentrant=true, is-synchronous=false, call-type=REGULAR, execution-context=UNSPECIFIED
      return type Std_ReturnType: direction=OUT, base-type=void, implementation-data-type=boolean
      sw service arg nmChannelHandle: direction=IN, base-type=void, implementation-data-type=boolean
    CanNm_DisableCommunication_TimerisNotStopped: is-reentrant=true, is-synchronous=false, call-type=REGULAR, execution-context=UNSPECIFIED
      return type Std_ReturnType: direction=OUT, base-type=void, implementation-data-type=boolean
      sw service arg nmChannelHandle: direction=IN, base-type=void, implementation-data-type=boolean
    CanNm_EnableCommunication: service-id=13, is-reentrant=true, is-synchronous=false, call-type=REGULAR, execution-context=UNSPECIFIED
      return type Std_ReturnType: direction=OUT, base-type=void, implementation-data-type=boolean
      sw service arg nmChannelHandle: direction=IN, base-type=void, implementation-data-type=boolean
    CanNm_EnableCommunication_TimerisNotStarted: is-reentrant=true, is-synchronous=false, call-type=REGULAR, execution-context=UNSPECIFIED
      return type Std_ReturnType: direction=OUT, base-type=void, implementation-data-type=boolean
      sw service arg nmChannelHandle: direction=IN, base-type=void, implementation-data-type=boolean
    CanNm_GetLocalNodeIdentifier: service-id=7, is-reentrant=true, is-synchronous=true, call-type=REGULAR, execution-context=UNSPECIFIED
      return type Std_ReturnType: direction=OUT, implementation-data-type=Std_ReturnType
      sw service arg nmChannelHandle: direction=IN, implementation-data-type=NetworkHandleType
      sw service arg nmNodeIdPtr: direction=IN, implementation-data-type=uint8
    CanNm_GetNetworkRequestReason: is-reentrant=false, is-synchronous=true, call-type=REGULAR, execution-context=UNSPECIFIED
      return type Std_ReturnType: direction=OUT, implementation-data-type=Std_ReturnType
      sw service arg nmChannelHandle: direction=IN, implementation-data-type=NetworkHandleType
      sw service arg nmNetworkRequestReason: direction=OUT, implementation-data-type=uint8
    CanNm_GetNodeIdentifier: service-id=6, is-reentrant=true, is-synchronous=true, call-type=REGULAR, execution-context=UNSPECIFIED
      return type Std_ReturnType: direction=OUT, base-type=void, implementation-data-type=boolean
      sw service arg nmChannelHandle: direction=IN, base-type=void, implementation-data-type=boolean
      sw service arg nmNodeIdPtr: direction=IN, base-type=void, implementation-data-type=boolean
    CanNm_GetPduData: service-id=10, is-reentrant=true, is-synchronous=true, call-type=REGULAR, execution-context=UNSPECIFIED
      return type Std_ReturnType: direction=OUT, base-type=void, implementation-data-type=boolean
      sw service arg nmChannelHandle: direction=IN, base-type=void, implementation-data-type=boolean
      sw service arg nmPduDataPtr: direction=INOUT, base-type=void, implementation-data-type=boolean
    CanNm_GetState: service-id=10, is-reentrant=true, is-synchronous=true, call-type=REGULAR, execution-context=UNSPECIFIED
      return type Std_ReturnType: direction=OUT, base-type=void, implementation-data-type=boolean
      sw service arg nmChannelHandle: direction=IN, base-type=void, implementation-data-type=boolean
      sw service arg nmStatePtr: direction=INOUT, base-type=void, implementation-data-type=boolean
      sw service arg nmModePtr: direction=INOUT, base-type=void, implementation-data-type=boolean
    CanNm_GetUserData: service-id=5, is-reentrant=true, is-synchronous=true, call-type=REGULAR, execution-context=UNSPECIFIED
      return type Std_ReturnType: direction=OUT, base-type=void, implementation-data-type=boolean
      sw service arg nmChannelHandle: direction=IN, base-type=void, implementation-data-type=boolean
      sw service arg nmUserDataPtr: direction=INOUT, base-type=void, implementation-data-type=boolean
    CanNm_GetVersionInfo: service-id=241, is-reentrant=true, is-synchronous=true, call-type=REGULAR, execution-context=UNSPECIFIED
      sw service arg versioninfo: direction=INOUT, base-type=void, implementation-data-type=boolean
    CanNm_Init: service-id=0, is-reentrant=false, is-synchronous=true, call-type=REGULAR, execution-context=UNSPECIFIED
      sw service arg cannmConfigPtr: direction=IN, base-type=void, implementation-data-type=boolean
    CanNm_MainFunction: service-id=19, call-type=SCHEDULED, execution-context=TASK
    CanNm_NetworkRelease: service-id=3, is-reentrant=true, is-synchronous=false, call-type=REGULAR, execution-context=UNSPECIFIED
      return type Std_ReturnType: direction=OUT, base-type=void, implementation-data-type=boolean
      sw service arg nmChannelHandle: direction=IN, base-type=void, implementation-data-type=boolean
    CanNm_NetworkRequest: service-id=2, is-reentrant=true, is-synchronous=false, call-type=REGULAR, execution-context=UNSPECIFIED
      return type Std_ReturnType: direction=OUT, base-type=void, implementation-data-type=boolean
      sw service arg nmChannelHandle: direction=IN, base-type=void, implementation-data-type=boolean
    CanNm_PassiveStartUp: service-id=1, is-reentrant=false, is-synchronous=true, call-type=REGULAR, execution-context=UNSPECIFIED
      return type Std_ReturnType: direction=OUT, base-type=void, implementation-data-type=boolean
      sw service arg nmChannelHandle: direction=IN, base-type=void, implementation-data-type=boolean
    CanNm_RepeatMessageRequest: service-id=8, is-reentrant=true, is-synchronous=false, call-type=REGULAR, execution-context=UNSPECIFIED
      return type Std_ReturnType: direction=OUT, implementation-data-type=Std_ReturnType
      sw service arg nmChannelHandle: direction=IN, implementation-data-type=NetworkHandleType
    CanNm_RxIndication: service-id=66, is-reentrant=true, is-synchronous=true, call-type=REGULAR, execution-context=UNSPECIFIED
      sw service arg RxPduId: direction=IN, base-type=void, implementation-data-type=boolean
      sw service arg PduInfoPtr: direction=IN, base-type=void, implementation-data-type=boolean
    CanNm_SetNetworkRequestReason: is-reentrant=false, is-synchronous=true, call-type=REGULAR, execution-context=UNSPECIFIED
      return type Std_ReturnType: direction=OUT, implementation-data-type=Std_ReturnType
      sw service arg nmChannelHandle: direction=IN, implementation-data-type=NetworkHandleType
      sw service arg nmNetworkRequestReason: direction=IN, implementation-data-type=uint8
    CanNm_SetUserData: service-id=4, is-reentrant=true, is-synchronous=true, call-type=REGULAR, execution-context=UNSPECIFIED
      return type Std_ReturnType: direction=OUT, base-type=void, implementation-data-type=boolean
      sw service arg nmChannelHandle: direction=IN, base-type=void, implementation-data-type=boolean
      sw service arg nmUserDataPtr: direction=IN, base-type=void, implementation-data-type=boolean
    CanNm_Transmit: service-id=73, is-reentrant=true, is-synchronous=true, call-type=REGULAR, execution-context=UNSPECIFIED
      return type Std_ReturnType: direction=OUT, base-type=void, implementation-data-type=boolean
      sw service arg TxPduId: direction=IN, base-type=void, implementation-data-type=boolean
      sw service arg PduInfoPtr: direction=IN, base-type=void, implementation-data-type=boolean
    CanNm_TriggerTransmit: service-id=65, is-reentrant=true, is-synchronous=true, call-type=REGULAR, execution-context=UNSPECIFIED
      sw service arg TxPduId: direction=IN, base-type=void, implementation-data-type=boolean
      sw service arg PduInfoPtr: direction=IN, base-type=void, implementation-data-type=boolean
    CanNm_TxConfirmation: service-id=64, is-reentrant=true, is-synchronous=true, call-type=REGULAR, execution-context=UNSPECIFIED
      sw service arg TxPduId: direction=IN, base-type=void, implementation-data-type=boolean
      sw service arg result: direction=IN, base-type=void, implementation-data-type=boolean
