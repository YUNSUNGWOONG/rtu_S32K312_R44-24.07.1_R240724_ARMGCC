AUTOSAR XML (schema 00047)
# (C) 2021 HYUNDAI AUTOEVER Corp.
package /Bsw_KeyM
  bsw implementation BswImplementation_KeyM: programming-language=C, sw-version=1.0.9, swc-bsw-mapping=SwcBswMapping_KeyM, vendor-id=76, ar-release-version=4.4.0, behavior=BswInternalBehavior_KeyM, vendor-specific-module-def=KeyM
  bsw module description KeyM: module-id=109
    required-mode-groups:
      mode declaration group prototype modeNotificationPort_KeyMEcuShutdown: type=EcuMode
    bsw internal behavior BswInternalBehavior_KeyM: data-type-mapping=EcuModeMap, bsw-exclusive-area-policy{api-principle=COMMON, exclusive-area=GLOBALVAR_PROTECTION}, bsw-mode-receiver-policy{enhanced-mode-api=true, required-mode-group=modeNotificationPort_KeyMEcuShutdown, supports-asynchronous-mode-switch=true}
      exclusive area GLOBALVAR_PROTECTION
      23 x bsw called entity:
        BswCE_KeyM_CertElementGet: implemented-entry=KeyM_CertElementGet
        BswCE_KeyM_CertGetStatus: implemented-entry=KeyM_CertGetStatus
        BswCE_KeyM_CertificateElementGetByIndex: implemented-entry=KeyM_CertificateElementGetByIndex
        BswCE_KeyM_CertificateElementGetCount: implemented-entry=KeyM_CertificateElementGetCount
        BswCE_KeyM_CertificateVerifyCallbackNotification: implemented-entry=KeyM_CertificateVerifyCallbackNotification
        BswCE_KeyM_CryptoKeyFinalizeCallbackNotification: implemented-entry=KeyM_CryptoKeyFinalizeCallbackNotification
        BswCE_KeyM_CryptoKeyUpdateCallbackNotification: implemented-entry=KeyM_CryptoKeyUpdateCallbackNotification
        BswCE_KeyM_CryptoKeyVerifyCallbackNotification: implemented-entry=KeyM_CryptoKeyVerifyCallbackNotification
        BswCE_KeyM_Deinit: implemented-entry=KeyM_Deinit
        BswCE_KeyM_Finalize: implemented-entry=KeyM_Finalize
        BswCE_KeyM_GetCertificate: implemented-entry=KeyM_GetCertificate
        BswCE_KeyM_GetVersionInfo: implemented-entry=KeyM_GetVersionInfo
        BswCE_KeyM_Init: implemented-entry=KeyM_Init
        BswCE_KeyM_Prepare: implemented-entry=KeyM_Prepare
        BswCE_KeyM_ServiceCertificate: implemented-entry=KeyM_ServiceCertificate
        BswCE_KeyM_ServiceCertificateCallbackNotification: implemented-entry=KeyM_ServiceCertificateCallbackNotification
        BswCE_KeyM_SetCertificate: implemented-entry=KeyM_SetCertificate
        BswCE_KeyM_Start: implemented-entry=KeyM_Start
        BswCE_KeyM_Update: implemented-entry=KeyM_Update
        BswCE_KeyM_Verify: implemented-entry=KeyM_Verify
        BswCE_KeyM_VerifyCertificate: implemented-entry=KeyM_VerifyCertificate
        BswCE_KeyM_VerifyCertificateChain: implemented-entry=KeyM_VerifyCertificateChain
        BswCE_KeyM_VerifyCertificates: implemented-entry=KeyM_VerifyCertificates
      bsw schedulable entity BswSE_KeyM_MainBackgroundFunction: can-enter-exclusive-area=GLOBALVAR_PROTECTION, accessed-mode-groups=modeNotificationPort_KeyMEcuShutdown, implemented-entry=KeyM_MainBackgroundFunction
      bsw schedulable entity BswSE_KeyM_MainFunction: can-enter-exclusive-area=GLOBALVAR_PROTECTION, accessed-mode-groups=modeNotificationPort_KeyMEcuShutdown, implemented-entry=KeyM_MainFunction
      bsw timing event BswTE_KeyM_MainBackgroundFunction: context-limitation=BswDistinguishedPartition_KeyM, disabled-in-mode=modeNotificationPort_KeyMEcuShutdown.ECUM_STATE_SHUTDOWN, starts-on-event=BswSE_KeyM_MainBackgroundFunction, period=0.1
      bsw timing event BswTE_KeyM_MainFunction: context-limitation=BswDistinguishedPartition_KeyM, disabled-in-mode=modeNotificationPort_KeyMEcuShutdown.ECUM_STATE_SHUTDOWN, starts-on-event=BswSE_KeyM_MainFunction, period=0.01
      bsw distinguished partition BswDistinguishedPartition_KeyM
  25 x bsw module entry, all with sw-service-impl-policy=STANDARD:
    KeyM_CertElementGet: service-id=0x0f, is-reentrant=false, is-synchronous=true, call-type=REGULAR, execution-context=UNSPECIFIED, bsw-entry-kind=CONCRETE  # Provides the content of a specific certificate element. The certificate configuration defines how the certificate submodule can find the element, e.g. by providing the object identifier (OID). This function is used to retrieve this information if only one element is assigned to the respective OID.
      return type Std_ReturnType: implementation-data-type=Std_ReturnType
      4 x sw service arg:
        CertId: direction=IN, implementation-data-type=KeyM_CertificateIdType  # Holds the identifier of the certificate.
        CertElementId: direction=IN, implementation-data-type=KeyM_CertElementIdType  # Specifies the ElementId where the data shall be read from.
        CertElementData: direction=OUT, sw-pointer-target-props=uint8  # Pointer to a data buffer allocated by the caller of this function. If available, the function returns E_OK and copies the data into this buffer.
        CertElementDataLength: direction=INOUT, sw-pointer-target-props=uint32  # In: Pointer to a value that contains the maximum data length of the CertElementData buffer. Out: The data length will be overwritten with the actual length of data placed to the buffer if the function returns E_OK. Otherwise, the it will be overwritten with the value zero.
    KeyM_CertGetStatus: service-id=0x12, is-reentrant=false, is-synchronous=true, call-type=REGULAR, execution-context=UNSPECIFIED, bsw-entry-kind=CONCRETE  # This function provides the status of a certificate.
      return type Std_ReturnType: implementation-data-type=Std_ReturnType
      sw service arg CertId: direction=IN, implementation-data-type=KeyM_CertificateIdType  # Holds the identifier of the certificate
      sw service arg Status: direction=OUT, sw-pointer-target-props=KeyM_CertificateStatusType  # Provides the status of the certificate.
    KeyM_CertificateElementGetByIndex: service-id=0x13, is-reentrant=false, is-synchronous=true, call-type=REGULAR, execution-context=UNSPECIFIED, bsw-entry-kind=CONCRETE  # This function provides the element data of a certificate. The function is used if an element type can have more than one parameter. The index specifies which element shall be read. The function works similar to the KeyM_CertElementGetFirst/KeyM_CertElementGetNext, but instead of the iteration, the individual elements can be accessed by index (like the operation in the service interface).
      return type Std_ReturnType: implementation-data-type=Std_ReturnType
      5 x sw service arg:
        CertId: direction=IN, implementation-data-type=KeyM_CertificateIdType  # Holds the identifier of the certificate.
        CertElementId: direction=IN, implementation-data-type=KeyM_CertElementIdType  # Specifies the CertElementId where the data shall be read from.
        Index: direction=INOUT, sw-pointer-target-props=uint32  # Specifies the index to the element that shall be read (0..N).
        CertElementDataPtr: direction=OUT, sw-pointer-target-props=uint8  # Pointer to a data buffer allocated by the caller of this function. If available, the function returns E_OK and copies the data into this buffer.
        CertElementDataLengthPtr: direction=INOUT, sw-pointer-target-props=uint32  # In: Pointer to a value that contains the maximum data length of the CertElementData buffer. Out: The data length will be overwritten with the actual length of data placed to the buffer if the function returns E_OK.
    KeyM_CertificateElementGetCount: service-id=0x14, is-reentrant=false, is-synchronous=true, call-type=REGULAR, execution-context=UNSPECIFIED, bsw-entry-kind=CONCRETE  # This function provides the total number of data elements that are available for the specified certificate element. Typically, only one data element is available. But in some cases, several data elements can be assigned to one certificate element in a row. This function retrieves the total number of elements. The individual data elements can then accessed with KeyM_CertificateElementGetByIndex().
      return type Std_ReturnType: implementation-data-type=Std_ReturnType
      sw service arg CertId: direction=IN, implementation-data-type=KeyM_CertificateIdType  # Holds the identifier of the certificate.
      sw service arg CertElementId: direction=IN, implementation-data-type=KeyM_CertElementIdType  # Specifies the CertElementId where the data shall be read from.
      sw service arg CountPtr: direction=OUT, sw-pointer-target-props=uint16  # Pointer to the buffer where the number of available data elements for this certificate element shall be copied to.
    KeyM_CertificateVerifyCallbackNotification: is-reentrant=true, is-synchronous=true, call-type=CALLBACK, execution-context=TASK, bsw-entry-kind=ABSTRACT  # Notifies the application that a certificate verification has been finished. The function name is configurable by KeyMCertificateVerifyCallbackNotificationFunc.
      return type Std_ReturnType: implementation-data-type=Std_ReturnType
      sw service arg CertId: direction=IN, implementation-data-type=KeyM_CertificateIdType  # The certificate identifier that has been verified.
      sw service arg Result: direction=IN, implementation-data-type=KeyM_CertificateStatusType  # Contains information about the result of the operation.
    KeyM_CryptoKeyFinalizeCallbackNotification: is-reentrant=true, is-synchronous=true, call-type=CALLBACK, execution-context=TASK, bsw-entry-kind=ABSTRACT  # Notifies the application that a crypto key finalize operation has been finished. The callback function is only called and needed if KeyMCryptoKeyStartFinalizeFunctionEnabled is set to TRUE.
      sw service arg Result: direction=IN, implementation-data-type=KeyM_ResultType  # Contains information about the result of the operation.
      sw service arg ResultDataLength: direction=IN, implementation-data-type=uint16  # ontains the length of the resulting data of this operation.
      sw service arg ResultDataPtr: direction=IN, sw-pointer-target-props={implementation-data-type=uint8, sw-impl-policy=CONST}  # Pointer to the data of the result (the data buffer that has been provided with the service function).
    KeyM_CryptoKeyUpdateCallbackNotification: is-reentrant=true, is-synchronous=true, call-type=CALLBACK, execution-context=TASK, bsw-entry-kind=ABSTRACT  # Notifies the application that a crypto key update operation has been finished. This function is used by the key manager.
      sw service arg Result: direction=IN, implementation-data-type=KeyM_ResultType  # Contains information about the result of the operation.
      sw service arg ResultDataLength: direction=IN, implementation-data-type=uint16  # Contains the length of the resulting data of this operation if any.
      sw service arg ResultDataPtr: direction=IN, sw-pointer-target-props={implementation-data-type=uint8, sw-impl-policy=CONST}  # Pointer to the data of the result.
    KeyM_CryptoKeyVerifyCallbackNotification: is-reentrant=true, is-synchronous=true, call-type=CALLBACK, execution-context=TASK, bsw-entry-kind=ABSTRACT  # Notifies the application that a crypto key verify operation has been finished. This function is used by the key manager.
      4 x sw service arg, all with direction=IN:
        Result: implementation-data-type=KeyM_ResultType  # Contains information about the result of the operation.
        KeyId: implementation-data-type=uint32  # The key identifier where this verification was started for.
        ResultDataLength: implementation-data-type=uint16  # Contains the length of the resulting data of this operation if any.
        ResultDataPtr: sw-pointer-target-props={implementation-data-type=uint8, sw-impl-policy=CONST}  # Pointer to the data of the result.
    KeyM_Deinit: service-id=0x02, is-reentrant=false, is-synchronous=true, call-type=REGULAR, execution-context=TASK, bsw-entry-kind=CONCRETE  # This function resets the key management module to the uninitialized state.
    KeyM_Finalize: service-id=0x07, is-reentrant=false, is-synchronous=false, call-type=REGULAR, execution-context=UNSPECIFIED, bsw-entry-kind=CONCRETE  # The function is used to finalize key update operations. It is typically used in conjunction with the KeyM_Start operation and returns the key operation into the idle mode. Further key prepare or update operations are not accepted until a new KeyM_Start operation has been initialized. This function is only available if KeyMCryptoKeyStartFinalizeFunctionEnabled is set to TRUE. In addition, updated key material will be persisted and set into valid state (calling Csm_KeySetValid).
      return type Std_ReturnType: implementation-data-type=Std_ReturnType
      4 x sw service arg:
        RequestDataPtr: direction=IN, sw-pointer-target-props={implementation-data-type=uint8, sw-impl-policy=CONST}  # Information that comes along with the request
        RequestDataLength: direction=IN, implementation-data-type=uint16  # Length of data in the RequestData array
        ResponseDataPtr: direction=OUT, sw-pointer-target-props=uint8  # Data returned by the function.
        ResponseMaxDataLength: direction=IN, implementation-data-type=uint16  # Length of data in the RespondData array
    KeyM_GetCertificate: service-id=0x0b, is-reentrant=false, is-synchronous=true, call-type=REGULAR, execution-context=UNSPECIFIED, bsw-entry-kind=CONCRETE  # This function provides the certificate data
      return type Std_ReturnType: implementation-data-type=Std_ReturnType
      sw service arg CertId: direction=IN, implementation-data-type=KeyM_CertificateIdType  # Holds the identifier of the certificate
      sw service arg CertificateDataPtr: direction=INOUT, sw-pointer-target-props=KeyM_CertDataType  # Provides a pointer to a certificate data structure. The buffer located by the pointer in the structure shall be provided by the caller of this function. The length information indicates the maximum length of the buffer when the function is called. If E_OK is returned, the length information indicates the actual length of the certificate data in the buffer.
    KeyM_GetVersionInfo: service-id=0x03, is-reentrant=false, is-synchronous=true, call-type=REGULAR, execution-context=UNSPECIFIED, bsw-entry-kind=CONCRETE  # Provides the version information of this module.
      sw service arg VersionInfo: direction=OUT, sw-pointer-target-props=Std_VersionInfoType  # Pointer to the version information of this module.
    KeyM_Init: service-id=0x01, is-reentrant=false, is-synchronous=true, call-type=REGULAR, execution-context=TASK, bsw-entry-kind=CONCRETE  # This function initializes the key management module.
      sw service arg ConfigPtr: direction=IN, sw-pointer-target-props=sw-impl-policy=CONST  # Pointer to the configuration set in VARIANT-POST-BUILD.
    KeyM_MainBackgroundFunction: service-id=0x1a, is-reentrant=false, is-synchronous=true, call-type=SCHEDULED, execution-context=TASK, bsw-entry-kind=CONCRETE  # Function is called from a pre-emptive operating system when no other task operation is needed. Can be used for calling time consuming synchronous functions such as KeyM_KH_Update().
    KeyM_MainFunction: service-id=0x19, is-reentrant=false, is-synchronous=true, call-type=SCHEDULED, execution-context=TASK, bsw-entry-kind=CONCRETE  # Function is called periodically according the specified time interval.
    KeyM_Prepare: service-id=0x05, is-reentrant=false, is-synchronous=true, call-type=REGULAR, execution-context=UNSPECIFIED, bsw-entry-kind=CONCRETE  # This function is used to prepare a key update operation. The main intent is to provide information for the key operation to the key server. Other operations may start the negotiation for a common secret that is used further to derive key material. This function is only available if KeyMCryptoKeyPrepareFunctionEnabled is set to TRUE.
      return type Std_ReturnType: implementation-data-type=Std_ReturnType
      4 x sw service arg:
        RequestData: direction=IN, sw-pointer-target-props={implementation-data-type=uint8, sw-impl-policy=CONST}  # Information that comes along with the request
        RequestDataLength: direction=IN, implementation-data-type=uint16  # Length of data in the RequestData array
        ResponseData: direction=OUT, sw-pointer-target-props=uint8  # Data returned by the function.
        ResponseDataLength: direction=INOUT, sw-pointer-target-props=uint16  # In: Max number of bytes available in ResponseData Out: Actual number of bytes
    KeyM_ServiceCertificate: service-id=0x09, is-reentrant=false, is-synchronous=false, call-type=REGULAR, execution-context=UNSPECIFIED, bsw-entry-kind=CONCRETE  # The key server requests an operation from the key client. The type of operation is specified in the first parameter KeyM_ServiceCertificateType. Certificate operation requests are operated through this function. This function is only available if the configuration parameter KeyMServiceCertificateFunctionEnabled is set to TRUE.
      return type Std_ReturnType: implementation-data-type=Std_ReturnType
      7 x sw service arg:
        Service: direction=IN, implementation-data-type=KeyM_ServiceCertificateType  # Provides the type of service the key manager has to perform.
        CertNamePtr: direction=IN, sw-pointer-target-props={implementation-data-type=uint8, sw-impl-policy=CONST}  # Points to an array that defines the name of the certificate to be updated
        CertNameLength: direction=IN, implementation-data-type=uint16  # Specifies the number of bytes in CertNamePtr. The value 0 indicates that no CertNamePtr is provided within this function.
        RequestData: direction=IN, sw-pointer-target-props={implementation-data-type=uint8, sw-impl-policy=CONST}  # Information that comes along with the request
        RequestDataLength: direction=IN, implementation-data-type=uint16  # Length of data in the RequestData array
        ResponseData: direction=OUT, sw-pointer-target-props=uint8  # Data returned by the function.
        ResponseDataLength: direction=IN, implementation-data-type=uint16  # Max number of bytes available in ResponseDataPtr.
    KeyM_ServiceCertificateCallbackNotification: is-reentrant=true, is-synchronous=true, call-type=CALLBACK, execution-context=TASK, bsw-entry-kind=ABSTRACT  # Notifies the application that the certificate service operation has been finished. This function is used by the certificate submodule. This callback is only provided if KeyMServiceCertificateFunctionEnabled is set to TRUE. The function name is configurable by KeyMServiceCertificateCallbackNotificationFunc.
      4 x sw service arg, all with direction=IN:
        CertId: implementation-data-type=KeyM_CertificateIdType  # The certificate identifier where this service was started for.
        Result: implementation-data-type=KeyM_ResultType  # Contains information about the result of the operation.
        ResultDataLength: implementation-data-type=uint16  # Contains the length of the resulting data of this operation if any.
        ResultDataPtr: sw-pointer-target-props={implementation-data-type=uint8, sw-impl-policy=CONST}  # Pointer to the data of the result.
    KeyM_SetCertificate: service-id=0x0a, is-reentrant=false, is-synchronous=true, call-type=REGULAR, execution-context=UNSPECIFIED, bsw-entry-kind=CONCRETE  # This function provides the certificate data to the key management module to temporarily store the certificate.
      return type Std_ReturnType: implementation-data-type=Std_ReturnType
      sw service arg CertId: direction=IN, implementation-data-type=KeyM_CertificateIdType  # Holds the identifier of the certificate
      sw service arg CertificateDataPtr: direction=IN, sw-pointer-target-props={implementation-data-type=KeyM_CertDataType, sw-impl-policy=CONST}  # Pointer to a structure that provides the certificate data.
    KeyM_Start: service-id=0x04, is-reentrant=false, is-synchronous=true, call-type=REGULAR, execution-context=UNSPECIFIED, bsw-entry-kind=CONCRETE  # This function is optional and only used if the configuration item KeyMCryptoKeyStartFinalizeFunctionEnabled is set to true. It intents to allow key update operation.
      return type Std_ReturnType: implementation-data-type=Std_ReturnType
      5 x sw service arg:
        StartType: direction=IN, implementation-data-type=KeyM_StartType  # Defines in which mode the key operation shall be executed.
        RequestData: direction=IN, sw-pointer-target-props={implementation-data-type=uint8, sw-impl-policy=CONST}  # Information that comes along with the request, e.g. signature
        RequestDataLength: direction=IN, implementation-data-type=uint16  # Length of data in the RequestData array
        ResponseData: direction=OUT, sw-pointer-target-props=uint8  # Data returned by the function.
        ResponseDataLength: direction=INOUT, sw-pointer-target-props=uint16  # In: Max number of bytes available in ResponseData Out: Actual number
    KeyM_Update: service-id=0x06, is-reentrant=false, is-synchronous=false, call-type=REGULAR, execution-context=UNSPECIFIED, bsw-entry-kind=CONCRETE  # This function is used to initiate the key generation or update process.
      return type Std_ReturnType: implementation-data-type=Std_ReturnType
      6 x sw service arg:
        KeyNamePtr: direction=IN, sw-pointer-target-props={implementation-data-type=uint8, sw-impl-policy=CONST}  # Pointer to an array that defines the name of the key to be updated
        KeyNameLength: direction=IN, implementation-data-type=uint16  # Specifies the number of bytes in keyName. The value 0 indicates that no keyName is provided within this function.
        RequestDataPtr: direction=IN, sw-pointer-target-props={implementation-data-type=uint8, sw-impl-policy=CONST}  # Information that comes along with the request
        RequestDataLength: direction=IN, implementation-data-type=uint16  # Length of data in the RequestData array
        ResultDataPtr: direction=OUT, sw-pointer-target-props=uint8  # Pointer to a data buffer used by the function to store results.
        ResultDataMaxLength: direction=IN, implementation-data-type=uint16  # Max number of bytes available in ResultDataPtr.
    KeyM_Verify: service-id=0x08, is-reentrant=false, is-synchronous=false, call-type=REGULAR, execution-context=UNSPECIFIED, bsw-entry-kind=CONCRETE  # The key server requests to verify the provided keys. The key manager performs operation on the assigned job and returns the result to the key server who verifies if the results was provided with this key as expected. This function is only available if KeyMCryptoKeyVerifyFunctionEnabled is set to TRUE.
      return type Std_ReturnType: implementation-data-type=Std_ReturnType
      6 x sw service arg:
        KeyNamePtr: direction=IN, sw-pointer-target-props={implementation-data-type=uint8, sw-impl-policy=CONST}  # Points to an array that defines the name of the key to be updated
        KeyNameLength: direction=IN, implementation-data-type=uint16  # Specifies the number of bytes in KeyNamePtr. The value 0 indicates that no KeyNamePtr is provided within this function.
        RequestData: direction=IN, sw-pointer-target-props={implementation-data-type=uint8, sw-impl-policy=CONST}  # Information that comes along with the request
        RequestDataLength: direction=IN, implementation-data-type=uint16  # Length of data in the RequestData array
        ResponseData: direction=OUT, sw-pointer-target-props=uint8  # Data returned by the function.
        ResponseDataLength: direction=INOUT, sw-pointer-target-props=uint16  # In: Max number of bytes available in ResponseData Out: Actual number of bytes in ResponseData or left untouched if service runs in asynchronous mode and function returns KEYM_E_PENDING
    KeyM_VerifyCertificate: service-id=0x0d, is-reentrant=false, is-synchronous=false, call-type=REGULAR, execution-context=UNSPECIFIED, bsw-entry-kind=CONCRETE  # This function verifies a certificate that was previously provided with KeyM_SetCertificate() against already stored and provided certificates stored with other certificate IDs.
      return type Std_ReturnType: implementation-data-type=Std_ReturnType
      sw service arg CertId: direction=IN, implementation-data-type=KeyM_CertificateIdType  # Holds the identifier of the certificate
    KeyM_VerifyCertificateChain: service-id=0x0e, is-reentrant=false, is-synchronous=false, call-type=REGULAR, execution-context=UNSPECIFIED, bsw-entry-kind=CONCRETE  # This function performs a certificate verification against a list of certificates. It is a pre-requisite that the certificate that shall be checked has already been written with KeyM_SetCertificate() and that the root certificate is either in the list or is already assigned to one of the other certificates.
      return type Std_ReturnType: implementation-data-type=Std_ReturnType
      sw service arg CertId: direction=IN, implementation-data-type=KeyM_CertificateIdType  # Holds the identifier of the certificate.
      sw service arg certChainData: direction=IN, implementation-data-type=KeyM_CertDataType, sw-impl-policy=CONST  # This is a pointer to an array of certificates sorted according to the order in the PKI.
      sw service arg NumberOfCertificates: direction=IN, implementation-data-type=uint8  # Defines the number of certificates stored in the CertChainData array.
    KeyM_VerifyCertificates: service-id=0x0c, is-reentrant=false, is-synchronous=false, call-type=REGULAR, execution-context=UNSPECIFIED, bsw-entry-kind=CONCRETE  # This function verifies two certificates that are stored and parsed internally against each other. The certificate referenced with CertId was signed by the certificate referenced with certUpperId. Only these two certificates are validated against each other.
      return type Std_ReturnType: implementation-data-type=Std_ReturnType
      sw service arg CertId: direction=IN, implementation-data-type=KeyM_CertificateIdType  # Holds the identifier of the lower certificate in the chain
      sw service arg CertUpperId: direction=IN, implementation-data-type=KeyM_CertificateIdType  # Holds the identifier of the upper certificate in the chain
