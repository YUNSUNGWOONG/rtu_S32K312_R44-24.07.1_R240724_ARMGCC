AUTOSAR XML (schema 00047)
# (C) 2021 HYUNDAI AUTOEVER Corp.
package /BSW_CryIf
  bsw implementation BswImplementation_CryIf: programming-language=C, sw-version=1.0.5, vendor-id=76, ar-release-version=4.4.0, behavior=BswInternalBehavior_CryIf, vendor-specific-module-def=CryIf
  bsw module description CryIf: category=BSW_MODULE, module-id=112
    implemented-entrys:
      CryIf_Init
      CryIf_GetVersionInfo
      CryIf_ProcessJob
      CryIf_CancelJob
      CryIf_KeyElementSet
      CryIf_KeySetValid
      CryIf_KeyElementGet
      CryIf_KeyElementCopy
      CryIf_KeyElementCopyPartial
      CryIf_KeyCopy
      CryIf_RandomSeed
      CryIf_KeyGenerate
      CryIf_KeyDerive
      CryIf_KeyExchangeCalcPubVal
      CryIf_KeyExchangeCalcSecret
      CryIf_CallbackNotification
    bsw internal behavior BswInternalBehavior_CryIf
      bsw called entity BswCE_CryIf_GetVersionInfo: implemented-entry=CryIf_GetVersionInfo
      bsw called entity BswCE_CryIf_Init: implemented-entry=CryIf_Init
      bsw distinguished partition BswDistinguishedPartition_CryIf
  16 x bsw module entry, all with call-type=REGULAR, execution-context=UNSPECIFIED, sw-service-impl-policy=STANDARD, bsw-entry-kind=CONCRETE:
    CryIf_CallbackNotification: service-id=0x0d, is-reentrant=false, is-synchronous=true  # Notifies the CRYIF about the completion of the request with the result of the cryptographic operation.
      sw service arg job: direction=IN, implementation-data-type=Crypto_JobType  # Points to the completed job's information structure. It contains a callbackID to identify which job is finished.
      sw service arg result: direction=IN, implementation-data-type=Std_ReturnType  # Contains the result of the cryptographic operation.
    CryIf_CancelJob: service-id=0x0e, is-reentrant=true, is-synchronous=true  # This interface dispatches the job cancellation function to the configured crypto driver object.
      return type Std_ReturnType: implementation-data-type=Std_ReturnType
      sw service arg channelId: direction=IN, implementation-data-type=uint32  # Holds the identifier of the crypto channel.
      sw service arg job: direction=INOUT, implementation-data-type=Crypto_JobType  # Pointer to the configuration of the job. Contains structures with user and primitive relevant information.
    CryIf_GetVersionInfo: service-id=0x01, is-reentrant=true, is-synchronous=true  # Returns the version information of this module.
      sw service arg versioninfo: direction=IN, implementation-data-type=Std_VersionInfoType  # Pointer to where to store the version information of this module.
    CryIf_Init: service-id=0x00, is-reentrant=true, is-synchronous=true  # Initializes the CRYIF module.
      sw service arg configPtr: direction=IN, implementation-data-type=CryIf_ConfigType  # Pointer to a selected configuration structure
    CryIf_KeyCopy: service-id=0x10, is-reentrant=false, is-synchronous=true  # This function shall copy all key elements from the source key to a target key.
      return type Std_ReturnType: implementation-data-type=Std_ReturnType
      sw service arg cryIfKeyId: direction=IN, implementation-data-type=uint32  # Holds the identifier of the key whose key element shall be the source element.
      sw service arg targetCryIfKeyId: direction=IN, implementation-data-type=uint32  # Holds the identifier of the key whose key element shall be the destination element.
    CryIf_KeyDerive: service-id=0x09, is-reentrant=true, is-synchronous=true  # This function shall dispatch the key derive function to the configured crypto driver object.
      return type Std_ReturnType: implementation-data-type=Std_ReturnType
      sw service arg cryIfKeyId: direction=IN, implementation-data-type=uint32  # Holds the identifier of the key which is used for key derivation.
      sw service arg targetCryIfKeyId: direction=IN, implementation-data-type=uint32  # Holds the identifier of the key which is used to store the derived key.
    CryIf_KeyElementCopy: service-id=0x0f, is-reentrant=false, is-synchronous=true  # This function shall copy a key elements from one key to a target key.
      return type Std_ReturnType: implementation-data-type=Std_ReturnType
      4 x sw service arg, all with direction=IN, implementation-data-type=uint32:
        cryIfKeyId  # Holds the identifier of the key whose key element shall be the source element.
        keyElementId  # Holds the identifier of the key element which shall be the source for the copy operation.
        targetCryIfKeyId  # Holds the identifier of the key whose key element shall be the destination element.
        targetKeyElementId  # Holds the identifier of the key element which shall be the destination for the copy operation.
    CryIf_KeyElementCopyPartial: service-id=0x12, is-reentrant=false, is-synchronous=true  # Copies a key element to another key element. The keyElementOffsets and keyElementCopyLength allows to copy just parts of the source key element into the destination key element.
      return type Std_ReturnType: implementation-data-type=Std_ReturnType
      7 x sw service arg, all with direction=IN, implementation-data-type=uint32:
        cryIfKeyId  # Holds the identifier of the key whose key element shall be the source element.
        keyElementId  # Holds the identifier of the key element which shall be the source for the copy operation.
        keyElementSourceOffset  # This is the offset of the source key element indicating the start index of the copy operation.
        keyElementTargetOffset  # This is the offset of the target key element indicating the start index of the copy operation.
        keyElementCopyLength  # Specifies the number of bytes that shall be copied.
        targetCryIfKeyId  # Holds the identifier of the key whose key element shall be the destination element.
        targetKeyElementId  # Holds the identifier of the key element which shall be the destination for the copy operation.
    CryIf_KeyElementGet: service-id=0x06, is-reentrant=true, is-synchronous=true  # This function shall dispatch the get key element function to the configured crypto driver object.
      return type Std_ReturnType: implementation-data-type=Std_ReturnType
      4 x sw service arg:
        cryIfKeyId: direction=IN, implementation-data-type=uint32  # Holds the identifier of the key whose key element shall be returned.
        keyElementId: direction=IN, implementation-data-type=uint32  # Holds the identifier of the key element which shall be returned.
        resultPtr: direction=OUT, implementation-data-type=uint8  # Holds the pointer of the buffer for the returned key element
        resultLengthPtr: direction=INOUT, implementation-data-type=uint32  # Holds a pointer to a memory location in which the length information is stored. On calling this function this parameter shall contain the size of the buffer provided by resultPtr. If the key element is configured to allow partial access, this parameter contains the amount of data which should be read from the key element. The size may not be equal to the size of the provided buffer anymore. When the request has finished, the amount of data that has been stored shall be stored.
    CryIf_KeyElementSet: service-id=0x04, is-reentrant=false, is-synchronous=true  # This function shall dispatch the set key element function to the configured crypto driver object.
      return type Std_ReturnType: implementation-data-type=Std_ReturnType
      4 x sw service arg, all with direction=IN:
        cryIfKeyId: implementation-data-type=uint32  # Holds the identifier of the key whose key element shall be set.
        keyElementId: implementation-data-type=uint32  # Holds the identifier of the key element which shall be set.
        keyPtr: implementation-data-type=uint8  # Holds the pointer to the key data which shall be set as key element.
        keyLength: implementation-data-type=uint32  # Contains the length of the key element in bytes.
    CryIf_KeyExchangeCalcPubVal: service-id=0x0a, is-reentrant=true, is-synchronous=true  # This function shall dispatch the key exchange public value calculation function to the configured crypto driver object.
      return type Std_ReturnType: implementation-data-type=Std_ReturnType
      sw service arg cryIfKeyId: direction=IN, implementation-data-type=uint32  # Holds the identifier of the key which shall be used for the key exchange protocol.
      sw service arg publicValuePtr: direction=OUT, implementation-data-type=uint8  # Contains the pointer to the data where the public value shall be stored.
      sw service arg publicValueLengthPtr: direction=INOUT, implementation-data-type=uint32  # Holds a pointer to the memory location in which the public value length information is stored. On calling this function, this parameter shall contain the size of the buffer provided by publicValuePtr. When the request has finished, the actual length of the returned value shall be stored.
    CryIf_KeyExchangeCalcSecret: service-id=0x0b, is-reentrant=true, is-synchronous=true  # This function shall dispatch the key exchange common shared secret calculation function to the configured crypto driver object.
      return type Std_ReturnType: implementation-data-type=Std_ReturnType
      sw service arg cryIfKeyId: direction=IN, implementation-data-type=uint32  # Holds the identifier of the key which shall be used for the key exchange protocol.
      sw service arg partnerPublicValuePtr: direction=IN, implementation-data-type=uint8  # Holds the pointer to the memory location which contains the partner's public value.
      sw service arg partnerPublicValueLength: direction=IN, implementation-data-type=uint32  # Contains the length of the partner's public value in bytes.
    CryIf_KeyGenerate: service-id=0x08, is-reentrant=true, is-synchronous=false  # This function shall dispatch the key generate function to the configured crypto driver object.
      return type Std_ReturnType: implementation-data-type=Std_ReturnType
      sw service arg cryIfKeyId: direction=IN, implementation-data-type=uint32  # Holds the identifier of the key which is to be updated with the generated value.
    CryIf_KeySetValid: service-id=0x05, is-reentrant=false, is-synchronous=true  # This function shall dispatch the set key valid function to the configured crypto driver object.
      return type Std_ReturnType: implementation-data-type=Std_ReturnType
      sw service arg cryIfKeyId: direction=IN, implementation-data-type=uint32  # Holds the identifier of the key whose key elements shall be set to valid.
    CryIf_ProcessJob: service-id=0x03, is-reentrant=true, is-synchronous=false  # This interface dispatches the received jobs to the configured crypto driver object.
      return type Std_ReturnType: implementation-data-type=Std_ReturnType
      sw service arg channelId: direction=IN, implementation-data-type=uint32  # Holds the identifier of the crypto channel.
      sw service arg job: direction=INOUT, implementation-data-type=Crypto_JobType  # Pointer to the configuration of the job. Contains structures with user and primitive relevant information.
    CryIf_RandomSeed: service-id=0x07, is-reentrant=true, is-synchronous=false  # This function shall dispatch the random seed function to the configured crypto driver object.
      return type Std_ReturnType: implementation-data-type=Std_ReturnType
      sw service arg cryIfKeyId: direction=IN, implementation-data-type=uint32  # Holds the identifier of the key for which a new seed shall be generated.
      sw service arg seedPtr: direction=IN, implementation-data-type=uint8  # Holds a pointer to the memory location which contains the data to feed the seed.
      sw service arg seedLength: direction=IN, implementation-data-type=uint32  # Contains the length of the seed in bytes.
