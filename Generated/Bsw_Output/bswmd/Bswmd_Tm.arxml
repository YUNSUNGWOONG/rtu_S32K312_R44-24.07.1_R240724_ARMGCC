AUTOSAR XML (schema 00047)
package /Bsw_Tm
  bsw implementation BswImplementation_Tm: programming-language=C, sw-version=1.0.4, vendor-id=76, ar-release-version=4.4.0, behavior=BswInternalBehavior_Tm
  bsw module description Tm: module-id=14
    bsw module dependency BswModuleDependency_Det: target-module-id=15
    bsw module dependency BswModuleDependency_Gpt: target-module-id=100
    bsw internal behavior BswInternalBehavior_Tm
      19 x bsw called entity:
        BswCE_Tm_BusyWait1us16bit: implemented-entry=Tm_BusyWait1us16bit
        BswCE_Tm_BusyWait1us24bit: implemented-entry=Tm_BusyWait1us24bit
        BswCE_Tm_BusyWait1us32bit: implemented-entry=Tm_BusyWait1us32bit
        BswCE_Tm_GetTimeSpan100us32bit: implemented-entry=Tm_GetTimeSpan100us32bit
        BswCE_Tm_GetTimeSpan1us16bit: implemented-entry=Tm_GetTimeSpan1us16bit
        BswCE_Tm_GetTimeSpan1us24bit: implemented-entry=Tm_GetTimeSpan1us24bit
        BswCE_Tm_GetTimeSpan1us32bit: implemented-entry=Tm_GetTimeSpan1us32bit
        BswCE_Tm_ResetTimer100us32bit: implemented-entry=Tm_ResetTimer100us32bit
        BswCE_Tm_ResetTimer1us16bit: implemented-entry=Tm_ResetTimer1us16bit
        BswCE_Tm_ResetTimer1us24bit: implemented-entry=Tm_ResetTimer1us24bit
        BswCE_Tm_ResetTimer1us32bit: implemented-entry=Tm_ResetTimer1us32bit
        BswCE_Tm_ShiftTimer100us32bit: implemented-entry=Tm_ShiftTimer100us32bit
        BswCE_Tm_ShiftTimer1us16bit: implemented-entry=Tm_ShiftTimer1us16bit
        BswCE_Tm_ShiftTimer1us24bit: implemented-entry=Tm_ShiftTimer1us24bit
        BswCE_Tm_ShiftTimer1us32bit: implemented-entry=Tm_ShiftTimer1us32bit
        BswCE_Tm_SyncTimer100us32bit: implemented-entry=Tm_SyncTimer100us32bit
        BswCE_Tm_SyncTimer1us16bit: implemented-entry=Tm_SyncTimer1us16bit
        BswCE_Tm_SyncTimer1us24bit: implemented-entry=Tm_SyncTimer1us24bit
        BswCE_Tm_SyncTimer1us32bit: implemented-entry=Tm_SyncTimer1us32bit
      bsw distinguished partition BswDistinguishedPartition_Tm
package /Bsw_Tm/ExpectedEntries
  bsw module entry Det_ReportError: service-id=1, is-reentrant=true, is-synchronous=true, call-type=REGULAR, execution-context=TASK, sw-service-impl-policy=STANDARD
    return type Std_ReturnType: direction=OUT
    4 x sw service arg, all with direction=IN:
      ModuleId: category=TYPE_REFERENCE
      InstanceId
      ApiId
      ErrorId
  bsw module entry Det_ReportRuntimeError: service-id=4, is-reentrant=true, is-synchronous=true, call-type=REGULAR, execution-context=TASK, sw-service-impl-policy=STANDARD
    return type Std_ReturnType: direction=OUT
    4 x sw service arg, all with direction=IN:
      ModuleId: category=TYPE_REFERENCE
      InstanceId
      ApiId
      ErrorId
  bsw module entry Gpt_GetPredefTimerValue: service-id=13, is-reentrant=true, is-synchronous=true, call-type=REGULAR, execution-context=TASK, sw-service-impl-policy=STANDARD
    return type Std_ReturnType: direction=OUT
    sw service arg PredefTimer: category=TYPE_REFERENCE, direction=IN
    sw service arg TimeValuePtr: direction=OUT
package /Bsw_Tm/ImplementedEntries
  20 x bsw module entry, all with is-reentrant=true, is-synchronous=true, call-type=REGULAR, execution-context=TASK, sw-service-impl-policy=STANDARD:
    Tm_BusyWait1us16bit: service-id=6
      return type Std_ReturnType: direction=OUT
      sw service arg WaitingTimeMin: direction=IN
    Tm_BusyWait1us24bit: service-id=11
      return type Std_ReturnType: direction=OUT
      sw service arg WaitingTimeMin: direction=IN
    Tm_BusyWait1us32bit: service-id=16
      return type Std_ReturnType: direction=OUT
      sw service arg WaitingTimeMin: direction=IN
    Tm_GetTimeSpan100us32bit: service-id=18
      return type Std_ReturnType: direction=OUT
      sw service arg TimerPtr: category=TYPE_REFERENCE, direction=IN
      sw service arg TimeSpanPtr: category=DATA_REFERENCE, direction=OUT
    Tm_GetTimeSpan1us16bit: service-id=3
      return type Std_ReturnType: direction=OUT
      sw service arg TimerPtr: category=TYPE_REFERENCE, direction=IN
      sw service arg TimeSpanPtr: category=DATA_REFERENCE, direction=OUT
    Tm_GetTimeSpan1us24bit: service-id=8
      return type Std_ReturnType0: direction=OUT
      sw service arg TimerPtr: category=TYPE_REFERENCE, direction=IN
      sw service arg TimeSpanPtr: category=DATA_REFERENCE, direction=OUT
    Tm_GetTimeSpan1us32bit: service-id=13
      return type Std_ReturnType: direction=OUT
      sw service arg TimerPtr: category=TYPE_REFERENCE, direction=IN
      sw service arg TimeSpanPtr: category=DATA_REFERENCE, direction=OUT
    Tm_GetVersionInfo: service-id=1
      sw service arg VersionInfoPtr: category=TYPE_REFERENCE, direction=OUT
    Tm_ResetTimer100us32bit: service-id=17
      return type Std_ReturnType: direction=OUT
      sw service arg TimerPtr: category=TYPE_REFERENCE, direction=OUT
    Tm_ResetTimer1us16bit: service-id=2
      return type Std_ReturnType: direction=OUT
      sw service arg TimerPtr: category=TYPE_REFERENCE, direction=OUT
    Tm_ResetTimer1us24bit: service-id=7
      return type Std_ReturnType0: direction=OUT
      sw service arg TimerPtr: category=TYPE_REFERENCE, direction=OUT
    Tm_ResetTimer1us32bit: service-id=12
      return type Std_ReturnType0: direction=OUT
      sw service arg TimerPtr: category=TYPE_REFERENCE, direction=OUT
    Tm_ShiftTimer100us32bit: service-id=19
      sw service arg TimerPtr: category=TYPE_REFERENCE, direction=INOUT
      sw service arg TimeValue: direction=IN
    Tm_ShiftTimer1us16bit: service-id=4
      sw service arg TimerPtr: category=TYPE_REFERENCE, direction=INOUT
      sw service arg TimeValue: direction=IN
    Tm_ShiftTimer1us24bit: service-id=9
      sw service arg TimerPtr: category=TYPE_REFERENCE, direction=INOUT
      sw service arg TimeValue: direction=IN
    Tm_ShiftTimer1us32bit: service-id=14
      sw service arg TimerPtr: category=TYPE_REFERENCE, direction=INOUT
      sw service arg TimeValue: direction=IN
    Tm_SyncTimer100us32bit: service-id=20
      sw service arg TimerSrcPtr: category=TYPE_REFERENCE, direction=IN
      sw service arg TimerDstPtr: category=TYPE_REFERENCE, direction=OUT
    Tm_SyncTimer1us16bit: service-id=5
      sw service arg TimerDstPtr: category=TYPE_REFERENCE, direction=OUT
      sw service arg TimerSrcPtr: category=TYPE_REFERENCE, direction=IN
    Tm_SyncTimer1us24bit: service-id=10
      sw service arg TimerSrcPtr: category=TYPE_REFERENCE, direction=IN
      sw service arg TimerDstPtr: category=TYPE_REFERENCE, direction=OUT
    Tm_SyncTimer1us32bit: service-id=15
      sw service arg TimerSrcPtr: category=TYPE_REFERENCE, direction=IN
      sw service arg TimerDstPtr: category=TYPE_REFERENCE, direction=OUT
