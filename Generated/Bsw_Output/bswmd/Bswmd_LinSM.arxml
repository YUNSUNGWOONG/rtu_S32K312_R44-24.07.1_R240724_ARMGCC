AUTOSAR XML (schema 00047)
package /Bsw_LinSM
  bsw implementation BswImplementation_LinSM: programming-language=C, sw-version=1.0.9, vendor-id=76, ar-release-version=4.4.0, behavior=BswInternalBehavior_LinSM
    code-descriptors:
      code Code_LinSM
        artifact-descriptors:
          short-label=LinSM_Cbk.c, category=SWSRC
          short-label=LinSM_Dbg.h, category=SWHDR
          short-label=LinSM_InternalFunc.c, category=SWSRC
          short-label=LinSM_InternalFunc.h, category=SWHDR
          short-label=LinSM_PCTypes.h, category=SWHDR
          short-label=LinSM_Ram.c, category=SWDRC
          short-label=LinSM_Ram.h, category=SWHDR
          short-label=LinSM_Version.c, category=SWSRC
          short-label=LinSM_Version.h, category=SWHDR
          short-label=LinSM.c, category=SWSRC
          short-label=LinSM.h, category=SWHDR
          short-label=LinSM_Cfg.h, category=SWHDR
          short-label=LinSM_Cfg.c, category=SWSRC
  bsw module description LinSM: module-id=141
    implemented-entrys:
      LinSM_Init
      LinSM_ScheduleRequest
      LinSM_GetVersionInfo
      LinSM_GetCurrentComMode
      LinSM_RequestComMode
      LinSM_MainFunction
      LinSM_ScheduleRequestConfirmation
      LinSM_GotoSleepConfirmation
      LinSM_WakeupConfirmation
    5 x bsw module dependency:
      BswModuleDependency_BswM: target-module-id=42, target-module=BswM
      BswModuleDependency_ComM: target-module-id=12, target-module=ComM
      BswModuleDependency_Dem: target-module-id=54, target-module=Dem
      BswModuleDependency_Det: target-module-id=15, target-module=Det
      BswModuleDependency_LinIf: target-module-id=62, target-module=LinIf
    bsw internal behavior BswInternalBehavior_LinSM
      exclusive area CHANNEL_STATUS_PROTECTION_0
      exclusive area CHANNEL_STATUS_PROTECTION_1
      8 x bsw called entity:
        BswCE_LinSM_GetCurrentComMode: reentrancy-level=NON-REENTRANT, implemented-entry=LinSM_GetCurrentComMode
        BswCE_LinSM_GetVersionInfo: reentrancy-level=NON-REENTRANT, implemented-entry=LinSM_GetVersionInfo
        BswCE_LinSM_GotoSleepConfirmation: reentrancy-level=SINGLE-CORE-REENTRANT, implemented-entry=LinSM_GotoSleepConfirmation
        BswCE_LinSM_Init: reentrancy-level=NON-REENTRANT, implemented-entry=LinSM_Init
        BswCE_LinSM_RequestComMode: reentrancy-level=NON-REENTRANT, implemented-entry=LinSM_RequestComMode
        BswCE_LinSM_ScheduleRequest: reentrancy-level=SINGLE-CORE-REENTRANT, implemented-entry=LinSM_ScheduleRequest
        BswCE_LinSM_ScheduleRequestConfirmation: reentrancy-level=SINGLE-CORE-REENTRANT, implemented-entry=LinSM_ScheduleRequestConfirmation
        BswCE_LinSM_WakeupConfirmation: reentrancy-level=SINGLE-CORE-REENTRANT, implemented-entry=LinSM_WakeupConfirmation
      bsw schedulable entity BswSE_LinSM_MainFunction: can-enter-exclusive-area=[CHANNEL_STATUS_PROTECTION_0, CHANNEL_STATUS_PROTECTION_1], reentrancy-level=MULTICORE-REENTRANT, implemented-entry=LinSM_MainFunction
      bsw timing event BswTE_LinSM_MainFunction: context-limitation=BswDistinguishedPartition_LinSM, starts-on-event=BswSE_LinSM_MainFunction, period=0.01
      bsw distinguished partition BswDistinguishedPartition_LinSM
  9 x bsw module entry, all with sw-service-impl-policy=STANDARD, bsw-entry-kind=CONCRETE:
    LinSM_GetCurrentComMode: service-id=17, is-reentrant=true, is-synchronous=true, call-type=REGULAR, execution-context=UNSPECIFIED
      return type Std_ReturnType: implementation-data-type=Std_ReturnType
      sw service arg network: direction=IN, implementation-data-type=NetworkHandleType
      sw service arg mode: category=DATA_REFERENCE, direction=OUT, implementation-data-type=ComM_ModeType, sw-pointer-target-props={implementation-data-type=ComM_ModeType, sw-impl-policy=CONST}
    LinSM_GetVersionInfo: service-id=2, is-reentrant=true, is-synchronous=true, call-type=REGULAR, execution-context=UNSPECIFIED
      sw service arg versioninfo: category=DATA_REFERENCE, direction=OUT, sw-pointer-target-props={target-category=TYPE_REFERENCE, implementation-data-type=Std_VersionInfoType}
    LinSM_GotoSleepConfirmation: service-id=34, is-reentrant=true, is-synchronous=true, call-type=CALLBACK, execution-context=UNSPECIFIED
      sw service arg network: direction=IN, implementation-data-type=NetworkHandleType
      sw service arg success: direction=IN, implementation-data-type=boolean
    LinSM_Init: service-id=1, is-reentrant=false, is-synchronous=true, call-type=REGULAR, execution-context=UNSPECIFIED
      sw service arg ConfigPtr: category=DATA_REFERENCE, direction=IN, sw-pointer-target-props={target-category=TYPE_REFERENCE, implementation-data-type=LinSM_ConfigType, sw-impl-policy=CONST}
    LinSM_MainFunction: service-id=48, call-type=SCHEDULED, execution-context=TASK
    LinSM_RequestComMode: service-id=18, is-reentrant=true, is-synchronous=false, call-type=REGULAR, execution-context=UNSPECIFIED
      return type Std_ReturnType: implementation-data-type=Std_ReturnType
      sw service arg network: direction=IN, implementation-data-type=NetworkHandleType
      sw service arg mode: direction=IN, implementation-data-type=ComM_ModeType
    LinSM_ScheduleRequest: service-id=16, is-reentrant=true, is-synchronous=false, call-type=REGULAR, execution-context=UNSPECIFIED
      return type Std_ReturnType: implementation-data-type=Std_ReturnType
      sw service arg network: direction=IN, implementation-data-type=NetworkHandleType
      sw service arg schedule: direction=IN, implementation-data-type=uint8
    LinSM_ScheduleRequestConfirmation: service-id=32, is-reentrant=true, is-synchronous=true, call-type=CALLBACK, execution-context=UNSPECIFIED
      sw service arg network: direction=IN, implementation-data-type=NetworkHandleType
      sw service arg schedule: direction=IN, implementation-data-type=uint8
    LinSM_WakeupConfirmation: service-id=33, is-reentrant=true, is-synchronous=true, call-type=CALLBACK, execution-context=UNSPECIFIED
      sw service arg network: direction=IN, implementation-data-type=NetworkHandleType
      sw service arg success: direction=IN, implementation-data-type=boolean
package /Bsw_LinSM/ImplementationDataTypes
  impl type LinSM_ConfigType: category=STRUCTURE, type-emitter=LinSM.h
    element u8Dummy: category=VALUE, base-type=uint8
  impl type LinSM_ModeType: compu {1=LINSM_FULL_COM, 2=LINSM_NO_COM}, range raw 1..2, implementation-data-type=uint8, type-emitter=LinSM.h
