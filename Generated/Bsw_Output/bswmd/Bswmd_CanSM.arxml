AUTOSAR XML (schema 00047)
package /Bsw_CanSM
  bsw implementation BswImplementation_CanSM: programming-language=C, sw-version=1.0.9, vendor-id=76, ar-release-version=4.4.0, behavior=BswInternalBehavior_CanSM
    code-descriptors:
      code Code_CanSM
        artifact-descriptors:
          short-label=CanSM_Baudrate, category=SWSRC
          short-label=CanSM_CanIf, category=SWSRC
          short-label=CanSM_CanIf, category=SWHDR
          short-label=CanSM_Error, category=SWHDR
          short-label=CanSM_Internal, category=SWHDR
          short-label=CanSM_InternalTypes, category=SWHDR
          short-label=CanSM_Main, category=SWSRC
          short-label=CanSM_Mode, category=SWSRC
          short-label=CanSM_Ram, category=SWSRC
          short-label=CanSM_Ram, category=SWHDR
          short-label=CanSM_Types, category=SWHDR
          short-label=CanSM_Version, category=SWSRC
          short-label=CanSM_Version, category=SWHDR
          short-label=CanSM, category=SWSRC
          short-label=CanSM, category=SWHDR
    resource consumption ResourceConsumption_CanSM
  bsw module description CanSM: module-id=140
    implemented-entrys:
      CanSM_CheckTransceiverWakeFlagIndication
      CanSM_ClearTrcvWufFlagIndication
      CanSM_ConfirmPnAvailability
      CanSM_ControllerBusOff
      CanSM_ControllerModeIndication
      CanSM_DeInit
      CanSM_GetCurrentComMode
      CanSM_GetVersionInfo
      CanSM_Init
      CanSM_MainFunction
      CanSM_RequestComMode
      CanSM_StartWakeupSource
      CanSM_StopWakeupSource
      CanSM_TransceiverModeIndication
      CanSM_TxTimeoutException
    bsw internal behavior BswInternalBehavior_CanSM
      exclusive area BUSOFF_STATUS_PROTECTION
      exclusive area MODE_STATUS_PROTECTION
      exclusive-area-policys:
        api-principle=COMMON, exclusive-area=MODE_STATUS_PROTECTION
        api-principle=COMMON, exclusive-area=BUSOFF_STATUS_PROTECTION
      14 x bsw called entity:
        BswCE_CanSM_CheckTransceiverWakeFlagIndication: can-enter-exclusive-area=MODE_STATUS_PROTECTION, implemented-entry=CanSM_CheckTransceiverWakeFlagIndication
        BswCE_CanSM_ClearTrcvWufFlagIndication: can-enter-exclusive-area=MODE_STATUS_PROTECTION, implemented-entry=CanSM_ClearTrcvWufFlagIndication
        BswCE_CanSM_ConfirmPnAvailability: can-enter-exclusive-area=MODE_STATUS_PROTECTION, implemented-entry=CanSM_ConfirmPnAvailability
        BswCE_CanSM_ControllerBusOff: can-enter-exclusive-area=BUSOFF_STATUS_PROTECTION, implemented-entry=CanSM_ControllerBusOff
        BswCE_CanSM_ControllerModeIndication: can-enter-exclusive-area=[BUSOFF_STATUS_PROTECTION, MODE_STATUS_PROTECTION], implemented-entry=CanSM_ControllerModeIndication
        BswCE_CanSM_DeInit: can-enter-exclusive-area=MODE_STATUS_PROTECTION, implemented-entry=CanSM_DeInit
        BswCE_CanSM_GetCurrentComMode: can-enter-exclusive-area=[BUSOFF_STATUS_PROTECTION, MODE_STATUS_PROTECTION], implemented-entry=CanSM_GetCurrentComMode
        BswCE_CanSM_GetVersionInfo: implemented-entry=CanSM_GetVersionInfo
        BswCE_CanSM_Init: implemented-entry=CanSM_Init
        BswCE_CanSM_RequestComMode: can-enter-exclusive-area=MODE_STATUS_PROTECTION, implemented-entry=CanSM_RequestComMode
        BswCE_CanSM_StartWakeupSource: can-enter-exclusive-area=MODE_STATUS_PROTECTION, implemented-entry=CanSM_StartWakeupSource
        BswCE_CanSM_StopWakeupSource: can-enter-exclusive-area=MODE_STATUS_PROTECTION, implemented-entry=CanSM_StopWakeupSource
        BswCE_CanSM_TransceiverModeIndication: can-enter-exclusive-area=MODE_STATUS_PROTECTION, implemented-entry=CanSM_TransceiverModeIndication
        BswCE_CanSM_TxTimeoutException: can-enter-exclusive-area=MODE_STATUS_PROTECTION, implemented-entry=CanSM_TxTimeoutException
      bsw schedulable entity BswSE_CanSM_MainFunction: can-enter-exclusive-area=[BUSOFF_STATUS_PROTECTION, MODE_STATUS_PROTECTION], implemented-entry=CanSM_MainFunction
      bsw timing event BswTE_CanSM_MainFunction: context-limitation=BswDistinguishedPartition_CanSM, starts-on-event=BswSE_CanSM_MainFunction, period=0.01
      bsw distinguished partition BswDistinguishedPartition_CanSM
package /Bsw_CanSM/BswModuleEntries
  15 x bsw module entry, all with sw-service-impl-policy=STANDARD:
    CanSM_CheckTransceiverWakeFlagIndication: service-id=10, is-reentrant=false, is-synchronous=true, call-type=CALLBACK, execution-context=UNSPECIFIED
      sw service arg Transceiver: implementation-data-type=uint8
    CanSM_ClearTrcvWufFlagIndication: service-id=8, is-reentrant=false, is-synchronous=true, call-type=CALLBACK, execution-context=UNSPECIFIED
      sw service arg Transceiver: implementation-data-type=uint8
    CanSM_ConfirmPnAvailability: service-id=6, is-reentrant=true, is-synchronous=true, call-type=CALLBACK, execution-context=UNSPECIFIED
      sw service arg TransceiverId: implementation-data-type=uint8
    CanSM_ControllerBusOff: service-id=4, is-reentrant=true, is-synchronous=true, call-type=CALLBACK, execution-context=UNSPECIFIED
      sw service arg ControllerId: implementation-data-type=uint8
    CanSM_ControllerModeIndication: service-id=7, is-reentrant=true, is-synchronous=true, call-type=CALLBACK, execution-context=UNSPECIFIED
      sw service arg ControllerId: implementation-data-type=uint8
      sw service arg ControllerMode: implementation-data-type=Can_ControllerStateType
    CanSM_DeInit: service-id=20, is-reentrant=false, is-synchronous=true, call-type=REGULAR, execution-context=UNSPECIFIED
    CanSM_GetCurrentComMode: service-id=3, is-reentrant=true, is-synchronous=true, call-type=REGULAR, execution-context=UNSPECIFIED
      return type Std_ReturnType: implementation-data-type=Std_ReturnType
      sw service arg network: implementation-data-type=NetworkHandleType
      sw service arg ComM_ModePtr: sw-alignment=PTR, implementation-data-type=ComM_ModeType
    CanSM_GetVersionInfo: service-id=1, is-reentrant=true, is-synchronous=true, call-type=REGULAR, execution-context=UNSPECIFIED
      sw service arg VersionInfo: sw-alignment=PTR, implementation-data-type=Std_VersionInfoType
    CanSM_Init: service-id=0, is-reentrant=false, is-synchronous=true, call-type=REGULAR, execution-context=UNSPECIFIED
      sw service arg ConfigPtr: direction=IN, sw-alignment=PTR, implementation-data-type=CanSM_ConfigType, sw-impl-policy=CONST
    CanSM_MainFunction: service-id=5, is-reentrant=false, is-synchronous=false, call-type=SCHEDULED, execution-context=TASK
    CanSM_RequestComMode: service-id=2, is-reentrant=false, is-synchronous=true, call-type=REGULAR, execution-context=UNSPECIFIED
      return type Std_ReturnType: implementation-data-type=Std_ReturnType
      sw service arg network: implementation-data-type=NetworkHandleType
      sw service arg ComM_Mode: implementation-data-type=ComM_ModeType
    CanSM_StartWakeupSource: service-id=17, is-reentrant=false, is-synchronous=true, call-type=REGULAR, execution-context=UNSPECIFIED
      return type Std_ReturnType: implementation-data-type=Std_ReturnType
      sw service arg network: implementation-data-type=NetworkHandleType
    CanSM_StopWakeupSource: service-id=18, is-reentrant=false, is-synchronous=true, call-type=REGULAR, execution-context=UNSPECIFIED
      return type Std_ReturnType: implementation-data-type=Std_ReturnType
      sw service arg network: implementation-data-type=NetworkHandleType
    CanSM_TransceiverModeIndication: service-id=9, is-reentrant=false, is-synchronous=true, call-type=CALLBACK, execution-context=UNSPECIFIED
      sw service arg TransceiverId: implementation-data-type=uint8
      sw service arg TransceiverMode: implementation-data-type=CanTrcv_TrcvModeType
    CanSM_TxTimeoutException: service-id=11, is-reentrant=true, is-synchronous=true, call-type=CALLBACK, execution-context=UNSPECIFIED
      sw service arg Channel: implementation-data-type=NetworkHandleType
