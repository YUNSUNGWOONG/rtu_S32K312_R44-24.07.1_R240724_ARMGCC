AUTOSAR XML (schema 00047)
package /Bsw_CanTrcv
  bsw implementation BswImplementation_CanTrcv: programming-language=C, sw-version=1.0.11, swc-bsw-mapping=SwcBswMapping, vendor-id=76, ar-release-version=4.4.0, behavior=BswInternalBehavior_CanTrcv
    code-descriptors:
      code Code_CanTrcv
        artifact-descriptors:
          short-label=CanTrcv, category=SWSRC
          short-label=CanTrcv, category=SWHDR
          short-label=CanTrcv_Globals, category=SWSRC
          short-label=CanTrcv_Globals, category=SWHDR
          short-label=CanTrcv_IntFunc, category=SWSRC
          short-label=CanTrcv_IntFunc, category=SWHDR
          short-label=CanTrcv_IntTypes, category=SWHDR
          short-label=CanTrcv_Version, category=SWSRC
          short-label=CanTrcv_Version, category=SWHDR
    resource consumption ResourceConsumption
      memory section MemorySection
  bsw module description CanTrcv: category=BSW_MODULE, module-id=71
    implemented-entrys:
      CanTrcv_Init
      CanTrcv_SetOpMode
      CanTrcv_GetOpMode
      CanTrcv_GetVersionInfo
      CanTrcv_CheckWakeup
      CanTrcv_CheckWakeFlag
      CanTrcv_SetWakeupMode
      CanTrcv_GetBusWuReason
      CanTrcv_GetTrcvSystemData
      CanTrcv_ReadTrcvTimeoutFlag
      CanTrcv_ClearTrcvTimeoutFlag
      CanTrcv_ReadTrcvSilenceFlag
      CanTrcv_SetPNActivationState
      CanTrcv_ClearTrcvWufFlag
      CanTrcv_DeInit
      CanTrcv_MainFunction
    4 x bsw module dependency:
      BswModuleDependency_CanIf: target-module-id=60
      BswModuleDependency_Det: target-module-id=15
      BswModuleDependency_Dio: target-module-id=120
      BswModuleDependency_EcuM: target-module-id=10
    bsw internal behavior BswInternalBehavior_CanTrcv: bsw-exclusive-area-policy{api-principle=COMMON, exclusive-area=INTERRUPT_PROTECTION_AREA}
      exclusive area INTERRUPT_PROTECTION_AREA
      15 x bsw called entity, all with reentrancy-level=NON-REENTRANT:
        BswCE_CanTrcv_CheckWakeFlag: implemented-entry=CanTrcv_CheckWakeFlag
        BswCE_CanTrcv_CheckWakeup: implemented-entry=CanTrcv_CheckWakeup
        BswCE_CanTrcv_ClearTrcvTimeoutFlag: can-enter-exclusive-area=INTERRUPT_PROTECTION_AREA, implemented-entry=CanTrcv_ClearTrcvTimeoutFlag
        BswCE_CanTrcv_ClearTrcvWufFlag: can-enter-exclusive-area=INTERRUPT_PROTECTION_AREA, implemented-entry=CanTrcv_ClearTrcvWufFlag
        BswCE_CanTrcv_DeInit: can-enter-exclusive-area=INTERRUPT_PROTECTION_AREA, implemented-entry=CanTrcv_DeInit
        BswCE_CanTrcv_GetBusWuReason: implemented-entry=CanTrcv_GetBusWuReason
        BswCE_CanTrcv_GetOpMode: implemented-entry=CanTrcv_GetOpMode
        BswCE_CanTrcv_GetTrcvSystemData: implemented-entry=CanTrcv_GetTrcvSystemData
        BswCE_CanTrcv_GetVersionInfo: implemented-entry=CanTrcv_GetVersionInfo
        BswCE_CanTrcv_Init: can-enter-exclusive-area=INTERRUPT_PROTECTION_AREA, implemented-entry=CanTrcv_Init
        BswCE_CanTrcv_ReadTrcvSilenceFlag: can-enter-exclusive-area=INTERRUPT_PROTECTION_AREA, implemented-entry=CanTrcv_ReadTrcvSilenceFlag
        BswCE_CanTrcv_ReadTrcvTimeoutFlag: can-enter-exclusive-area=INTERRUPT_PROTECTION_AREA, implemented-entry=CanTrcv_ReadTrcvTimeoutFlag
        BswCE_CanTrcv_SetOpMode: can-enter-exclusive-area=INTERRUPT_PROTECTION_AREA, implemented-entry=CanTrcv_SetOpMode
        BswCE_CanTrcv_SetPNActivationState: can-enter-exclusive-area=INTERRUPT_PROTECTION_AREA, implemented-entry=CanTrcv_SetPNActivationState
        BswCE_CanTrcv_SetWakeupMode: implemented-entry=CanTrcv_SetWakeupMode
      bsw schedulable entity BswSE_CanTrcv_MainFunction: can-enter-exclusive-area=INTERRUPT_PROTECTION_AREA, minimum-start-interval=0.005, reentrancy-level=NON-REENTRANT, implemented-entry=CanTrcv_MainFunction
      bsw timing event BswTE_CanTrcv_MainFunction: starts-on-event=BswSE_CanTrcv_MainFunction, period=0.005
      bsw distinguished partition BswDistinguishedPartition_CanTrcv
  swc bsw mapping SwcBswMapping_CanTrcv: bsw-behavior=BswInternalBehavior_CanTrcv, swc-behavior=SwcInternalBehavior_CanTrcv
package /Bsw_CanTrcv/BswModuleEntries
  16 x bsw module entry, all with sw-service-impl-policy=STANDARD, bsw-entry-kind=CONCRETE:
    CanTrcv_CheckWakeFlag: service-id=14, is-reentrant=false, is-synchronous=false, call-type=REGULAR, execution-context=UNSPECIFIED
      return type Std_ReturnType: sw-arraysize=[E_OK, E_NOT_OK], implementation-data-type=Std_ReturnType
      sw service arg Transceiver: direction=IN, implementation-data-type=uint8, base-type=uint8
    CanTrcv_CheckWakeup: service-id=7, is-reentrant=true, is-synchronous=true, call-type=REGULAR, execution-context=UNSPECIFIED
      return type Std_ReturnType: sw-arraysize=[E_OK, E_NOT_OK], implementation-data-type=Std_ReturnType
      sw service arg Transceiver: direction=IN, implementation-data-type=uint8, base-type=uint8
    CanTrcv_ClearTrcvTimeoutFlag: service-id=12, is-reentrant=false, is-synchronous=true, call-type=REGULAR, execution-context=UNSPECIFIED
      return type Std_ReturnType: sw-arraysize=[E_OK, E_NOT_OK], implementation-data-type=Std_ReturnType
      sw service arg Transceiver: direction=IN, implementation-data-type=uint8, base-type=uint8
    CanTrcv_ClearTrcvWufFlag: service-id=10, is-reentrant=true, is-synchronous=true, call-type=REGULAR, execution-context=UNSPECIFIED
      return type Std_ReturnType: sw-arraysize=[E_OK, E_NOT_OK], implementation-data-type=Std_ReturnType
      sw service arg Transceiver: direction=IN, implementation-data-type=uint8, base-type=uint8
    CanTrcv_DeInit: service-id=16, is-reentrant=false, is-synchronous=true, call-type=REGULAR, execution-context=UNSPECIFIED
    CanTrcv_GetBusWuReason: service-id=3, is-reentrant=true, is-synchronous=true, call-type=REGULAR, execution-context=UNSPECIFIED
      return type Std_ReturnType: sw-arraysize=[E_OK, E_NOT_OK], implementation-data-type=Std_ReturnType
      sw service arg Transceiver: direction=IN, implementation-data-type=uint8, base-type=uint8
      sw service arg reason: direction=OUT, sw-arraysize=[CANTRCV_WU_ERROR, CANTRCV_WU_NOT_SUPPORTED, CANTRCV_WU_BY_BUS, CANTRCV_WU_INTERNALLY, CANTRCV_WU_RESET, CANTRCV_WU_POWER_ON, CANTRCV_WU_BY_PIN, CANTRCV_WU_BY_SYSERR], implementation-data-type=CanTrcv_TrcvWakeupReasonType
    CanTrcv_GetOpMode: service-id=2, is-reentrant=true, is-synchronous=true, call-type=REGULAR, execution-context=UNSPECIFIED
      return type Std_ReturnType: sw-arraysize=[E_OK, E_NOT_OK], implementation-data-type=Std_ReturnType
      sw service arg Transceiver: direction=IN, implementation-data-type=uint8, base-type=uint8
      sw service arg OpMode: direction=OUT, sw-arraysize=[CANTRCV_TRCVMODE_NORMAL, CANTRCV_TRCVMODE_SLEEP, CANTRCV_TRCVMODE_STANDBY], implementation-data-type=CanTrcv_TrcvModeType
    CanTrcv_GetTrcvSystemData: service-id=9, is-reentrant=false, is-synchronous=true, call-type=REGULAR, execution-context=UNSPECIFIED
      return type Std_ReturnType: sw-arraysize=[E_OK, E_NOT_OK], implementation-data-type=Std_ReturnType
      sw service arg Transceiver: direction=IN, implementation-data-type=uint8, base-type=uint8
      sw service arg TrcvSysData: direction=OUT, implementation-data-type=uint32, base-type=uint32
    CanTrcv_GetVersionInfo: service-id=4, is-reentrant=true, is-synchronous=true, call-type=REGULAR, execution-context=UNSPECIFIED
      sw service arg versioninfo: direction=OUT, implementation-data-type=Std_VersionInfoType
    CanTrcv_Init: service-id=0, is-reentrant=false, is-synchronous=true, call-type=REGULAR, execution-context=UNSPECIFIED
      sw service arg ConfigPtr: direction=IN, implementation-data-type=CanTrcv_ConfigType
    CanTrcv_MainFunction: service-id=6, call-type=SCHEDULED, execution-context=TASK
    CanTrcv_ReadTrcvSilenceFlag: service-id=13, is-reentrant=false, is-synchronous=true, call-type=REGULAR, execution-context=UNSPECIFIED
      return type Std_ReturnType: sw-arraysize=[E_OK, E_NOT_OK], implementation-data-type=Std_ReturnType
      sw service arg Transceiver: direction=IN, implementation-data-type=uint8, base-type=uint8
      sw service arg FlagState: direction=OUT, sw-arraysize=[CANTRCV_FLAG_CLEARED, CANTRCV_FLAG_SET], implementation-data-type=CanTrcv_TrcvFlagStateType
    CanTrcv_ReadTrcvTimeoutFlag: service-id=11, is-reentrant=false, is-synchronous=true, call-type=REGULAR, execution-context=UNSPECIFIED
      return type Std_ReturnType: sw-arraysize=[E_OK, E_NOT_OK], implementation-data-type=Std_ReturnType
      sw service arg Transceiver: direction=IN, implementation-data-type=uint8, base-type=uint8
      sw service arg FlagState: direction=OUT, sw-arraysize=[CANTRCV_FLAG_CLEARED, CANTRCV_FLAG_SET], implementation-data-type=CanTrcv_TrcvFlagStateType
    CanTrcv_SetOpMode: service-id=1, is-reentrant=true, is-synchronous=false, call-type=REGULAR, execution-context=UNSPECIFIED
      return type Std_ReturnType: sw-arraysize=[E_OK, E_NOT_OK], implementation-data-type=Std_ReturnType
      sw service arg Transceiver: direction=IN, implementation-data-type=uint8, base-type=uint8
      sw service arg OpMode: direction=IN, sw-arraysize=[CANTRCV_TRCVMODE_NORMAL, CANTRCV_TRCVMODE_SLEEP, CANTRCV_TRCVMODE_STANDBY], implementation-data-type=CanTrcv_TrcvModeType
    CanTrcv_SetPNActivationState: service-id=15, is-reentrant=false, is-synchronous=true, call-type=REGULAR, execution-context=UNSPECIFIED
      return type Std_ReturnType: sw-arraysize=[E_OK, E_NOT_OK], implementation-data-type=Std_ReturnType
      sw service arg ActivationState: direction=IN, sw-arraysize=[PN_DISABLED, PN_ENABLED], implementation-data-type=CanTrcv_PNActivationType
    CanTrcv_SetWakeupMode: service-id=5, is-reentrant=true, is-synchronous=true, call-type=REGULAR, execution-context=UNSPECIFIED
      return type Std_ReturnType: sw-arraysize=[E_OK, E_NOT_OK], implementation-data-type=Std_ReturnType
      sw service arg Transceiver: direction=IN, implementation-data-type=uint8, base-type=uint8
      sw service arg TrcvWakeupMode: direction=IN, sw-arraysize=[CANTRCV_WUMODE_ENABLE, CANTRCV_WUMODE_DISABLE, CANTRCV_WUMODE_CLEAR], implementation-data-type=CanTrcv_TrcvWakeupModeType
