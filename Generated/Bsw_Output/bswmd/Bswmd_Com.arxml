AUTOSAR XML (schema 00047)
package /Bsw_Com
  bsw implementation BswImplementation_Com: programming-language=C, sw-version=1.1.11, vendor-id=76, ar-release-version=4.4.0, behavior=BswInternalBehavior_Com
  bsw module description Com: category=BSW_MODULE, module-id=50
    bsw module dependency BswModuleDependency_PduR: target-module-id=51
    bsw internal behavior BswInternalBehavior_Com
      16 x exclusive area:
        IPDU_COUNTER_PROTECTION
        IPDU_GROUP_STATUS_PROTECTION
        RX_DM_STS_PROTECTION_AREA
        RX_EXT_SIG_DATA_PROTECTION_AREA
        RX_FIFO_PROTECTION_AREA
        RX_GW_STS_PROTECTION_AREA
        RX_IPDU_DATA_PROTECTION_AREA
        RX_IPDU_STS_PROTECTION_AREA
        SIG_DATA_PROTECTION_AREA
        SWITCH_CORE_PROTECTION_AREA
        TX_EXT_SIG_DATA_PROTECTION_AREA
        TX_IPDU_BUFFER_PROTECTION_AREA
        TX_IPDU_DATA_PROTECTION
        TX_IPDU_STATUS_PROTECTION_AREA
        TX_MDT_PROTECTION_AREA
        TX_TMS_STATUS_PROTECTION_AREA
      19 x bsw called entity:
        BswCE_Com_CopyRxData: implemented-entry=Com_CopyRxData
        BswCE_Com_CopyTxData: implemented-entry=Com_CopyTxData
        BswCE_Com_GetStatus: implemented-entry=Com_GetStatus
        BswCE_Com_IpduGroupStart: implemented-entry=Com_IpduGroupStart
        BswCE_Com_IpduGroupStop: implemented-entry=Com_IpduGroupStop
        BswCE_Com_ReceiveSignal: implemented-entry=Com_ReceiveSignal
        BswCE_Com_ReceiveSignalGroup: implemented-entry=Com_ReceiveSignalGroup
        BswCE_Com_ReceiveSignalGroupArray: implemented-entry=Com_ReceiveSignalGroupArray
        BswCE_Com_RxIndication: implemented-entry=Com_RxIndication
        BswCE_Com_SendSignal: implemented-entry=Com_SendSignal
        BswCE_Com_SendSignalGroup: implemented-entry=Com_SendSignalGroup
        BswCE_Com_SendSignalGroupArray: implemented-entry=Com_SendSignalGroupArray
        BswCE_Com_StartOfReception: implemented-entry=Com_StartOfReception
        BswCE_Com_SwitchIpduTxMode: implemented-entry=Com_SwitchIpduTxMode
        BswCE_Com_TpRxIndication: implemented-entry=Com_TpRxIndication
        BswCE_Com_TpTxConfirmation: implemented-entry=Com_TpTxConfirmation
        BswCE_Com_TriggerIPDUSend: implemented-entry=Com_TriggerIPDUSend
        BswCE_Com_TriggerTransmit: implemented-entry=Com_TriggerTransmit
        BswCE_Com_TxConfirmation: implemented-entry=Com_TxConfirmation
      bsw schedulable entity BswSE_Com_MainFunctionRouteSignals:
        can-enter-exclusive-area=[IPDU_COUNTER_PROTECTION, IPDU_GROUP_STATUS_PROTECTION, RX_DM_STS_PROTECTION_AREA, RX_EXT_SIG_DATA_PROTECTION_AREA, RX_FIFO_PROTECTION_AREA, RX_GW_STS_PROTECTION_AREA, RX_IPDU_DATA_PROTECTION_AREA, RX_IPDU_STS_PROTECTION_AREA, TX_EXT_SIG_DATA_PROTECTION_AREA, TX_IPDU_BUFFER_PROTECTION_AREA, TX_IPDU_DATA_PROTECTION, TX_IPDU_STATUS_PROTECTION_AREA, TX_MDT_PROTECTION_AREA, TX_TMS_STATUS_PROTECTION_AREA]
        minimum-start-interval=0.005
        implemented-entry=Com_MainFunctionRouteSignals
      bsw schedulable entity BswSE_Com_MainFunctionRx:
        can-enter-exclusive-area=[IPDU_COUNTER_PROTECTION, IPDU_GROUP_STATUS_PROTECTION, RX_DM_STS_PROTECTION_AREA, RX_EXT_SIG_DATA_PROTECTION_AREA, RX_FIFO_PROTECTION_AREA, RX_GW_STS_PROTECTION_AREA, RX_IPDU_DATA_PROTECTION_AREA, RX_IPDU_STS_PROTECTION_AREA, SIG_DATA_PROTECTION_AREA, TX_EXT_SIG_DATA_PROTECTION_AREA, TX_IPDU_BUFFER_PROTECTION_AREA, TX_IPDU_DATA_PROTECTION, TX_IPDU_STATUS_PROTECTION_AREA, TX_MDT_PROTECTION_AREA, TX_TMS_STATUS_PROTECTION_AREA]
        minimum-start-interval=0.005
        implemented-entry=Com_MainFunctionRx
      bsw schedulable entity BswSE_Com_MainFunctionTx:
        can-enter-exclusive-area=[IPDU_COUNTER_PROTECTION, IPDU_GROUP_STATUS_PROTECTION, RX_DM_STS_PROTECTION_AREA, RX_EXT_SIG_DATA_PROTECTION_AREA, RX_FIFO_PROTECTION_AREA, RX_GW_STS_PROTECTION_AREA, RX_IPDU_DATA_PROTECTION_AREA, RX_IPDU_STS_PROTECTION_AREA, SIG_DATA_PROTECTION_AREA, TX_EXT_SIG_DATA_PROTECTION_AREA, TX_IPDU_BUFFER_PROTECTION_AREA, TX_IPDU_DATA_PROTECTION, TX_IPDU_STATUS_PROTECTION_AREA, TX_MDT_PROTECTION_AREA, TX_TMS_STATUS_PROTECTION_AREA]
        minimum-start-interval=0.005
        implemented-entry=Com_MainFunctionTx
      bsw timing event BswTE_Com_MainFunctionRx: starts-on-event=BswSE_Com_MainFunctionRx, period=0.005
      bsw timing event BswTE_Com_MainFunctionTx: starts-on-event=BswSE_Com_MainFunctionTx, period=0.005
      bsw distinguished partition BswDistinguishedPartition_Com
package /Bsw_Com/ExpectedEntries
  bsw module entry PduR_ComTransmit: service-id=73, is-reentrant=false, is-synchronous=true, call-type=CALLOUT, execution-context=TASK, sw-service-impl-policy=STANDARD, bsw-entry-kind=CONCRETE
    return type Std_ReturnType: direction=OUT
    sw service arg TxPduId: direction=IN
    sw service arg PduInfoPtr: direction=IN
package /Bsw_Com/ImplementedEntries/ComBswComponents
  22 x bsw module entry, all with call-type=REGULAR, sw-service-impl-policy=STANDARD, bsw-entry-kind=CONCRETE:
    Com_CopyRxData: service-id=68, is-reentrant=true, is-synchronous=true, execution-context=UNSPECIFIED
      sw service arg bufferSizePtr: direction=OUT
      sw service arg id: direction=IN
      sw service arg info: direction=IN
    Com_CopyTxData: service-id=67, is-reentrant=true, is-synchronous=true, execution-context=UNSPECIFIED
      4 x sw service arg:
        availableDataPtr: direction=OUT
        id: direction=IN
        retry: direction=IN
        info: direction=IN
    Com_Deinit: service-id=2, is-reentrant=false, is-synchronous=true, execution-context=TASK
    Com_GetStatus: service-id=7, is-reentrant=true, is-synchronous=true, execution-context=UNSPECIFIED
    Com_GetVersionInfo: service-id=9, is-reentrant=true, is-synchronous=true, execution-context=UNSPECIFIED
      sw service arg versionInfo: direction=OUT
    Com_Init: service-id=1, is-reentrant=false, is-synchronous=true, execution-context=TASK
      sw service arg ConfigPtr: direction=IN
    Com_IpduGroupStart: service-id=3, is-reentrant=false, is-synchronous=true, execution-context=UNSPECIFIED
      sw service arg IpduGroupId: direction=IN
      sw service arg initialize: direction=IN
    Com_IpduGroupStop: service-id=4, is-reentrant=false, is-synchronous=true, execution-context=UNSPECIFIED
      sw service arg IpduGroupId: direction=IN
      sw service arg initialize: direction=IN
    Com_ReceiveSignal: service-id=11, is-reentrant=false, is-synchronous=true, execution-context=UNSPECIFIED
      sw service arg SignalDataPtr: direction=IN
      sw service arg SignalId: direction=IN
    Com_ReceiveSignalGroup: service-id=14, is-reentrant=false, is-synchronous=true, execution-context=UNSPECIFIED
      sw service arg SignalGroupId: direction=IN
    Com_ReceiveSignalGroupArray: service-id=36, is-reentrant=false, is-synchronous=true, execution-context=UNSPECIFIED
      sw service arg SignalGroupArrayPtr: direction=IN
      sw service arg SignalGroupId: direction=IN
    Com_RxIndication: service-id=66, is-reentrant=false, is-synchronous=true, execution-context=UNSPECIFIED
      sw service arg PduInfoPtr: direction=IN
      sw service arg RxPduId: direction=IN
    Com_SendSignal: service-id=10, is-reentrant=false, is-synchronous=false, execution-context=UNSPECIFIED
      sw service arg SignalDataPtr: direction=IN
      sw service arg SignalId: direction=IN
    Com_SendSignalGroup: service-id=34, is-reentrant=false, is-synchronous=false, execution-context=UNSPECIFIED
      sw service arg SignalGroupId: direction=IN
    Com_SendSignalGroupArray: service-id=35, is-reentrant=false, is-synchronous=false, execution-context=UNSPECIFIED
      sw service arg SignalGroupArrayPtr: direction=IN
      sw service arg SignalGroupId: direction=IN
    Com_StartOfReception: service-id=70, is-reentrant=true, is-synchronous=true, execution-context=UNSPECIFIED
      4 x sw service arg:
        TpSduLength: direction=IN
        bufferSizePtr: direction=OUT
        id: direction=IN
        info: direction=IN
    Com_SwitchIpduTxMode: service-id=39, is-reentrant=false, is-synchronous=true, execution-context=UNSPECIFIED
      sw service arg Mode: direction=IN
      sw service arg PduId: direction=IN
    Com_TpRxIndication: service-id=69, is-reentrant=true, is-synchronous=true, execution-context=UNSPECIFIED
      sw service arg result: direction=IN
      sw service arg id: direction=IN
    Com_TpTxConfirmation: service-id=72, is-reentrant=true, is-synchronous=true, execution-context=UNSPECIFIED
      sw service arg result: direction=IN
      sw service arg id: direction=IN
    Com_TriggerIPDUSend: service-id=23, is-reentrant=false, is-synchronous=true, execution-context=UNSPECIFIED
      sw service arg PduId: direction=IN
    Com_TriggerTransmit: service-id=65, is-reentrant=false, is-synchronous=true, execution-context=UNSPECIFIED
      sw service arg PduInfoPtr: direction=IN
      sw service arg TxPduId: direction=IN
    Com_TxConfirmation: service-id=64, is-reentrant=false, is-synchronous=true, execution-context=UNSPECIFIED
      sw service arg result: direction=IN
      sw service arg TxPduId: direction=IN
package /Bsw_Com/ImplementedEntries/ComSchedules
  bsw module entry Com_MainFunctionRouteSignals: service-id=27, is-reentrant=false, is-synchronous=false, call-type=SCHEDULED, execution-context=TASK, sw-service-impl-policy=STANDARD, bsw-entry-kind=CONCRETE
  bsw module entry Com_MainFunctionRx: service-id=24, is-reentrant=false, is-synchronous=false, call-type=SCHEDULED, execution-context=TASK, sw-service-impl-policy=STANDARD, bsw-entry-kind=CONCRETE
  bsw module entry Com_MainFunctionTx: service-id=25, is-reentrant=false, is-synchronous=false, call-type=SCHEDULED, execution-context=TASK, sw-service-impl-policy=STANDARD, bsw-entry-kind=CONCRETE
