AUTOSAR XML (schema 00047)
package /Bsw_CanIf
  bsw implementation BswImplementation_CanIf: programming-language=C, sw-version=1.1.0, vendor-id=76, ar-release-version=4.4.0, behavior=BswInternalBehavior_CanIf
    code-descriptors:
      code Code_CanIf
        artifact-descriptors:
          short-label=CanDrv_422_Compat, category=SWHDR
          short-label=CanIf, category=SWHDR
          short-label=CanIf_BaudRate, category=SWSRC
          short-label=CanIf_BaudRate, category=SWHDR
          short-label=CanIf_CanTrcv, category=SWSRC
          short-label=CanIf_Trcv, category=SWHDR
          short-label=CanIf_Config, category=SWSRC
          short-label=CanIf_Dbg, category=SWHDR
          short-label=CanIf_Error, category=SWHDR
          short-label=CanIf_Init, category=SWHDR
          short-label=CanIf_Init, category=SWSRC
          short-label=CanIf_IntTypes, category=SWHDR
          short-label=CanIf_ModeCntrl, category=SWHDR
          short-label=CanIf_ModeCntrl, category=SWSRC
          short-label=CanIf_Notif, category=SWSRC
          short-label=CanIf_Notif, category=SWHDR
          short-label=CanIf_PCTypes, category=SWHDR
          short-label=CanIf_Ram, category=SWHDR
          short-label=CanIf_Ram, category=SWSRC
          short-label=CanIf_Rx, category=SWSRC
          short-label=CanIf_Rx, category=SWHDR
          short-label=CanIf_Tx, category=SWHDR
          short-label=CanIf_Tx, category=SWSRC
          short-label=CanIf_TxConfirm, category=SWSRC
          short-label=CanIf_TxConfirm, category=SWHDR
          short-label=CanIf_Types, category=SWHDR
          short-label=CanIf_Version, category=SWHDR
          short-label=CanIf_Version, category=SWSRC
    resource consumption ResourceConsumption
  bsw module description CanIf: category=BSW_MODULE, module-id=60
    implemented-entrys:
      CanIf_Init
      CanIf_DeInit
      CanIf_SetControllerMode
      CanIf_GetControllerMode
      CanIf_GetControllerErrorState
      CanIf_Transmit
      CanIf_SetPduMode
      CanIf_GetPduMode
      CanIf_GetVersionInfo
      CanIf_SetTrcvMode
      CanIf_GetTrcvMode
      CanIf_GetTxConfirmationState
      CanIf_ClearTrcvWufFlag
      CanIf_CheckTrcvWakeFlag
      CanIf_GetControllerRxErrorCounter
      CanIf_GetControllerTxErrorCounter
      CanIf_TriggerTransmit
      CanIf_TxConfirmation
      CanIf_RxIndication
      CanIf_ControllerBusOff
      CanIf_ConfirmPnAvailability
      CanIf_ClearTrcvWufFlagIndication
      CanIf_CheckTrcvWakeFlagIndication
      CanIf_ControllerModeIndication
      CanIf_TrcvModeIndication
    bsw internal behavior BswInternalBehavior_CanIf
      6 x exclusive area:
        MODE_STATUS_PROTECTION
        RX_DATA_PROTECTION
        RX_NOTIFSTATUS_PROTECTION
        TX_DYNCANID_PROTECTION
        TX_NOTIFSTATUS_PROTECTION
        TX_QUEUE_PROTECTION
      25 x bsw called entity:
        BswCE_CanIf_CheckTrcvWakeFlag: reentrancy-level=SINGLE-CORE-REENTRANT, implemented-entry=CanIf_CheckTrcvWakeFlag
        BswCE_CanIf_CheckTrcvWakeFlagIndication: reentrancy-level=SINGLE-CORE-REENTRANT, implemented-entry=CanIf_CheckTrcvWakeFlagIndication
        BswCE_CanIf_ClearTrcvWufFlag: reentrancy-level=SINGLE-CORE-REENTRANT, implemented-entry=CanIf_ClearTrcvWufFlag
        BswCE_CanIf_ClearTrcvWufFlagIndication: reentrancy-level=SINGLE-CORE-REENTRANT, implemented-entry=CanIf_ClearTrcvWufFlagIndication
        BswCE_CanIf_ConfirmPnAvailability: reentrancy-level=SINGLE-CORE-REENTRANT, implemented-entry=CanIf_ConfirmPnAvailability
        BswCE_CanIf_ControllerBusOff: can-enter-exclusive-area=[MODE_STATUS_PROTECTION, RX_DATA_PROTECTION, RX_NOTIFSTATUS_PROTECTION, TX_DYNCANID_PROTECTION, TX_NOTIFSTATUS_PROTECTION, TX_QUEUE_PROTECTION], reentrancy-level=SINGLE-CORE-REENTRANT, implemented-entry=CanIf_ControllerBusOff
        BswCE_CanIf_ControllerModeIndication: can-enter-exclusive-area=[MODE_STATUS_PROTECTION, RX_DATA_PROTECTION, RX_NOTIFSTATUS_PROTECTION, TX_DYNCANID_PROTECTION, TX_NOTIFSTATUS_PROTECTION, TX_QUEUE_PROTECTION], reentrancy-level=SINGLE-CORE-REENTRANT, implemented-entry=CanIf_ControllerModeIndication
        BswCE_CanIf_DeInit: reentrancy-level=NON-REENTRANT, implemented-entry=CanIf_DeInit
        BswCE_CanIf_GetControllerErrorState: reentrancy-level=NON-REENTRANT, implemented-entry=CanIf_GetControllerErrorState
        BswCE_CanIf_GetControllerMode: reentrancy-level=NON-REENTRANT, implemented-entry=CanIf_GetControllerMode
        BswCE_CanIf_GetControllerRxErrorCounter: reentrancy-level=NON-REENTRANT, implemented-entry=CanIf_GetControllerRxErrorCounter
        BswCE_CanIf_GetControllerTxErrorCounter: reentrancy-level=NON-REENTRANT, implemented-entry=CanIf_GetControllerTxErrorCounter
        BswCE_CanIf_GetPduMode: reentrancy-level=SINGLE-CORE-REENTRANT, implemented-entry=CanIf_GetPduMode
        BswCE_CanIf_GetTrcvMode: reentrancy-level=NON-REENTRANT, implemented-entry=CanIf_GetTrcvMode
        BswCE_CanIf_GetTxConfirmationState: reentrancy-level=SINGLE-CORE-REENTRANT, implemented-entry=CanIf_GetTxConfirmationState
        BswCE_CanIf_GetVersionInfo: reentrancy-level=SINGLE-CORE-REENTRANT, implemented-entry=CanIf_GetVersionInfo
        BswCE_CanIf_Init: can-enter-exclusive-area=[MODE_STATUS_PROTECTION, RX_DATA_PROTECTION, RX_NOTIFSTATUS_PROTECTION, TX_DYNCANID_PROTECTION, TX_NOTIFSTATUS_PROTECTION, TX_QUEUE_PROTECTION], reentrancy-level=NON-REENTRANT, implemented-entry=CanIf_Init
        BswCE_CanIf_RxIndication: can-enter-exclusive-area=[MODE_STATUS_PROTECTION, RX_DATA_PROTECTION, RX_NOTIFSTATUS_PROTECTION, TX_DYNCANID_PROTECTION, TX_NOTIFSTATUS_PROTECTION, TX_QUEUE_PROTECTION], reentrancy-level=SINGLE-CORE-REENTRANT, implemented-entry=CanIf_RxIndication
        BswCE_CanIf_SetControllerMode: can-enter-exclusive-area=[MODE_STATUS_PROTECTION, RX_DATA_PROTECTION, RX_NOTIFSTATUS_PROTECTION, TX_DYNCANID_PROTECTION, TX_NOTIFSTATUS_PROTECTION, TX_QUEUE_PROTECTION], reentrancy-level=SINGLE-CORE-REENTRANT, implemented-entry=CanIf_SetControllerMode
        BswCE_CanIf_SetPduMode: can-enter-exclusive-area=[MODE_STATUS_PROTECTION, RX_DATA_PROTECTION, RX_NOTIFSTATUS_PROTECTION, TX_DYNCANID_PROTECTION, TX_NOTIFSTATUS_PROTECTION, TX_QUEUE_PROTECTION], reentrancy-level=NON-REENTRANT, implemented-entry=CanIf_SetPduMode
        BswCE_CanIf_SetTrcvMode: reentrancy-level=NON-REENTRANT, implemented-entry=CanIf_SetTrcvMode
        BswCE_CanIf_Transmit: can-enter-exclusive-area=[MODE_STATUS_PROTECTION, RX_DATA_PROTECTION, RX_NOTIFSTATUS_PROTECTION, TX_DYNCANID_PROTECTION, TX_NOTIFSTATUS_PROTECTION, TX_QUEUE_PROTECTION], reentrancy-level=SINGLE-CORE-REENTRANT, implemented-entry=CanIf_Transmit
        BswCE_CanIf_TrcvModeIndication: reentrancy-level=SINGLE-CORE-REENTRANT, implemented-entry=CanIf_TrcvModeIndication
        BswCE_CanIf_TriggerTransmit: reentrancy-level=SINGLE-CORE-REENTRANT, implemented-entry=CanIf_TriggerTransmit
        BswCE_CanIf_TxConfirmation: reentrancy-level=SINGLE-CORE-REENTRANT, implemented-entry=CanIf_TxConfirmation
      bsw distinguished partition BswDistinguishedPartition_CanIf
package /Bsw_CanIf/BswModuleEntries
  25 x bsw module entry, all with execution-context=UNSPECIFIED, sw-service-impl-policy=STANDARD, bsw-entry-kind=CONCRETE:
    CanIf_CheckTrcvWakeFlag: service-id=31, is-reentrant=true, is-synchronous=false, call-type=REGULAR
      return type Std_ReturnType: implementation-data-type=Std_ReturnType
      sw service arg TransceiverId: direction=IN, implementation-data-type=uint8
    CanIf_CheckTrcvWakeFlagIndication: service-id=33, is-reentrant=true, is-synchronous=true, call-type=CALLBACK
      sw service arg TransceiverId: direction=IN, implementation-data-type=uint8
    CanIf_ClearTrcvWufFlag: service-id=30, is-reentrant=true, is-synchronous=false, call-type=REGULAR
      return type Std_ReturnType: implementation-data-type=Std_ReturnType
      sw service arg TransceiverId: direction=IN, implementation-data-type=uint8
    CanIf_ClearTrcvWufFlagIndication: service-id=32, is-reentrant=true, is-synchronous=true, call-type=CALLBACK
      sw service arg TransceiverId: direction=IN, implementation-data-type=uint8
    CanIf_ConfirmPnAvailability: service-id=26, is-reentrant=true, is-synchronous=true, call-type=CALLBACK
      sw service arg TransceiverId: direction=IN, implementation-data-type=uint8
    CanIf_ControllerBusOff: service-id=22, is-reentrant=true, is-synchronous=true, call-type=CALLBACK
      sw service arg ControllerId: direction=IN, implementation-data-type=uint8
    CanIf_ControllerModeIndication: service-id=23, is-reentrant=true, is-synchronous=true, call-type=CALLBACK
      sw service arg ControllerId: direction=IN, implementation-data-type=uint8
      sw service arg ControllerMode: direction=IN, implementation-data-type=Can_ControllerStateType
    CanIf_DeInit: service-id=2, is-reentrant=false, is-synchronous=true, call-type=REGULAR
    CanIf_GetControllerErrorState: service-id=75, is-reentrant=false, is-synchronous=true, call-type=REGULAR
      return type Std_ReturnType: implementation-data-type=Std_ReturnType
      sw service arg ControllerId: direction=IN, implementation-data-type=uint8
      sw service arg ErrorStatePtr: direction=OUT, sw-alignment=PTR, implementation-data-type=Can_ErrorStateType
    CanIf_GetControllerMode: service-id=4, is-reentrant=false, is-synchronous=true, call-type=REGULAR
      return type Std_ReturnType: implementation-data-type=Std_ReturnType
      sw service arg ControllerModePtr: direction=OUT, sw-alignment=PTR, implementation-data-type=Can_ControllerStateType
      sw service arg ControllerId: direction=IN, implementation-data-type=uint8
    CanIf_GetControllerRxErrorCounter: service-id=77, is-reentrant=false, is-synchronous=true, call-type=REGULAR
      return type Std_ReturnType: implementation-data-type=Std_ReturnType
      sw service arg ControllerId: direction=IN, implementation-data-type=uint8
      sw service arg RxErrorCounterPtr: direction=OUT, sw-alignment=PTR, implementation-data-type=uint8
    CanIf_GetControllerTxErrorCounter: service-id=78, is-reentrant=false, is-synchronous=true, call-type=REGULAR
      return type Std_ReturnType: implementation-data-type=Std_ReturnType
      sw service arg ControllerId: direction=IN, implementation-data-type=uint8
      sw service arg TxErrorCounterPtr: direction=OUT, sw-alignment=PTR, implementation-data-type=uint8
    CanIf_GetPduMode: service-id=10, is-reentrant=true, is-synchronous=true, call-type=REGULAR
      return type Std_ReturnType: implementation-data-type=Std_ReturnType
      sw service arg ControllerId: direction=IN, implementation-data-type=uint8
      sw service arg PduModePtr: direction=OUT, sw-alignment=PTR, implementation-data-type=CanIf_PduModeType
    CanIf_GetTrcvMode: service-id=14, is-reentrant=false, is-synchronous=true, call-type=REGULAR
      return type Std_ReturnType: implementation-data-type=Std_ReturnType
      sw service arg TransceiverId: direction=IN, implementation-data-type=uint8
      sw service arg TransceiverModePtr: direction=OUT, sw-alignment=PTR, implementation-data-type=CanTrcv_TrcvModeType
    CanIf_GetTxConfirmationState: service-id=25, is-reentrant=true, is-synchronous=true, call-type=REGULAR
      return type CanIf_NotifStatus: implementation-data-type=Std_ReturnType
      sw service arg ControllerId: direction=IN, implementation-data-type=uint8
    CanIf_GetVersionInfo: service-id=11, is-reentrant=true, is-synchronous=true, call-type=REGULAR
      sw service arg VersionInfo: direction=OUT, sw-alignment=PTR, implementation-data-type=Std_VersionInfoType
    CanIf_Init: service-id=1, is-reentrant=false, is-synchronous=true, call-type=REGULAR
      sw service arg ConfigPtr: direction=IN, sw-alignment=PTR, implementation-data-type=CanIf_ConfigType, sw-impl-policy=CONST
    CanIf_RxIndication: service-id=20, is-reentrant=true, is-synchronous=true, call-type=CALLBACK
      sw service arg Mailbox: direction=IN, sw-alignment=PTR, implementation-data-type=Can_HwType
      sw service arg PduInfoPtr: direction=IN, sw-alignment=PTR, implementation-data-type=PduInfoType, sw-impl-policy=CONST
    CanIf_SetControllerMode: service-id=3, is-reentrant=true, is-synchronous=false, call-type=REGULAR
      return type Std_ReturnType: implementation-data-type=Std_ReturnType
      sw service arg ControllerId: direction=IN, implementation-data-type=uint8
      sw service arg ControllerMode: direction=IN, implementation-data-type=Can_ControllerStateType
    CanIf_SetPduMode: service-id=9, is-reentrant=false, is-synchronous=true, call-type=REGULAR
      return type Std_ReturnType: implementation-data-type=Std_ReturnType
      sw service arg ControllerId: direction=IN, implementation-data-type=uint8
      sw service arg PduModeRequest: direction=IN, implementation-data-type=CanIf_PduModeType
    CanIf_SetTrcvMode: service-id=13, is-reentrant=false, is-synchronous=false, call-type=REGULAR
      return type Std_ReturnType: implementation-data-type=Std_ReturnType
      sw service arg TransceiverId: direction=IN, implementation-data-type=uint8
      sw service arg TransceiverMode: direction=IN, implementation-data-type=CanTrcv_TrcvModeType
    CanIf_Transmit: service-id=73, is-reentrant=true, is-synchronous=true, call-type=REGULAR
      return type Std_ReturnType: implementation-data-type=Std_ReturnType
      sw service arg TxPduId: direction=IN, implementation-data-type=PduIdType
      sw service arg PduInfoPtr: direction=IN, sw-alignment=PTR, implementation-data-type=PduInfoType, sw-impl-policy=CONST
    CanIf_TrcvModeIndication: service-id=34, is-reentrant=true, is-synchronous=true, call-type=CALLBACK
      sw service arg TransceiverId: direction=IN, implementation-data-type=uint8
      sw service arg TransceiverMode: direction=IN, implementation-data-type=CanTrcv_TrcvModeType
    CanIf_TriggerTransmit: service-id=65, is-reentrant=true, is-synchronous=true, call-type=CALLBACK
      return type Std_ReturnType: implementation-data-type=Std_ReturnType
      sw service arg TxPduId: direction=IN, implementation-data-type=PduIdType
      sw service arg PduInfoPtr: direction=INOUT, sw-alignment=PTR, implementation-data-type=PduInfoType
    CanIf_TxConfirmation: service-id=19, is-reentrant=true, is-synchronous=true, call-type=CALLBACK
      sw service arg CanTxPduId: direction=IN, implementation-data-type=PduIdType
