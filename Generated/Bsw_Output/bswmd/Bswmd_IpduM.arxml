AUTOSAR XML (schema 00047)
package /Bsw_IpduM
  bsw implementation BswImplementation_IpduM: sw-version=1.0.8, vendor-id=76, ar-release-version=4.4.0, behavior=BswInternalBehavior_IpduM
  bsw module description IpduM: module-id=52
    bsw internal behavior BswInternalBehavior_IpduM
      exclusive area DEST_DATA_PROTECTION_AREA
      exclusive area TX_STATUS_PROTECTION_AREA
      bsw called entity Bsw_CE_IpduM_GetVersionInfo: implemented-entry=IpduM_GetVersionInfo
      bsw called entity Bsw_CE_IpduM_Init: implemented-entry=IpduM_Init
      bsw distinguished partition BswDistinguishedPartition_IpduM
  bsw module entry IpduM_GetVersionInfo: service-id=1, is-reentrant=true, is-synchronous=true, call-type=REGULAR
  bsw module entry IpduM_Init: service-id=0, is-reentrant=false, is-synchronous=true, call-type=REGULAR
