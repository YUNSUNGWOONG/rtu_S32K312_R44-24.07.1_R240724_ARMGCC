AUTOSAR XML (schema 00047)
package /Bsw_ComM
  bsw implementation BswImplementation_ComM: programming-language=C, sw-version=1.1.7, vendor-id=76, ar-release-version=4.4.0, behavior=BswIB_ComM, vendor-specific-module-def=ComM
    code-descriptors:
      code Code_ComM
        artifact-descriptors:
          short-label=ComM, category=SWSRC
          short-label=ComM, category=SWSHDR
          short-label=ComM_BswM, category=SWSRC
          short-label=ComM_BswM, category=SWSHDR
          short-label=ComM_Config, category=SWSHDR
          short-label=ComM_Dbg, category=SWSHDR
          short-label=ComM_Dcm, category=SWSRC
          short-label=ComM_Dcm, category=SWSHDR
          short-label=ComM_EcuM, category=SWSRC
          short-label=ComM_EcuM, category=SWSHDR
          short-label=ComM_Internal, category=SWSRC
          short-label=ComM_Internal, category=SWSHDR
          short-label=ComM_Main, category=SWSRC
          short-label=ComM_Nm, category=SWSRC
          short-label=ComM_Nm, category=SWSHDR
          short-label=ComM_PCTypes, category=SWSHDR
          short-label=ComM_Ram, category=SWSRC
          short-label=ComM_Ram, category=SWSHDR
          short-label=ComM_Types, category=SWSHDR
          short-label=ComM_Version, category=SWSRC
          short-label=ComM_Version, category=SWSHDR
  bsw module description ComM: category=BSW_MODULE, module-id=12
    implemented-entrys:
      ComM_BusSM_BusSleepMode
      ComM_BusSM_ModeIndication
      ComM_CommunicationAllowed
      ComM_DCM_ActiveDiagnostic
      ComM_DCM_InactiveDiagnostic
      ComM_EcuM_WakeUpIndication
      ComM_GetCurrentComMode
      ComM_GetMaxComMode
      ComM_GetRequestedComMode
      ComM_GetStatus
      ComM_GetVersionInfo
      ComM_Nm_BusSleepMode
      ComM_Nm_NetworkMode
      ComM_Nm_NetworkStartIndication
      ComM_Nm_PrepareBusSleepMode
      ComM_Nm_RestartIndication
      ComM_RequestComMode
      ComM_Init
      ComM_DeInit
      ComM_COMCbk_ComISignal_Tx_PncVector_FD_CAN1
      ComM_COMCbk_ComISignal_Rx_EIRA_CanNm
      ComM_MainFunction_ComMChannel_FD_CAN1
      ComM_MainFunction_ComMChannel_LIN1
      ComM_MainFunction_ComMChannel_LIN2
    12 x bsw module dependency:
      BswM: target-module-id=42
      CanSM: target-module-id=140
      Com: target-module-id=50
      Dcm: target-module-id=53
      Det: target-module-id=15
      EcuM: target-module-id=10
      EthSM: target-module-id=143
      FrSM: target-module-id=142
      LinSM: target-module-id=141
      Nm: target-module-id=29
      NvM: target-module-id=20
      Rte: target-module-id=2
    bsw internal behavior BswIB_ComM
      8 x exclusive area:
        CURRENT_MODE_PROTECTION
        DCM_DIAGNOSTIC_PROTECTION
        ECUM_WAKEUP_IND
        INHIBIT_CNT_PROTECTION
        NM_INDICATION_PROTECTION
        PNC_PREPARE_TIMER
        PNC_WAKEUP_IND
        REQ_MODECNT_PROTECTION
      exclusive-area-policys:
        api-principle=COMMON, exclusive-area=INHIBIT_CNT_PROTECTION
        api-principle=COMMON, exclusive-area=REQ_MODECNT_PROTECTION
        api-principle=COMMON, exclusive-area=CURRENT_MODE_PROTECTION
        api-principle=COMMON, exclusive-area=DCM_DIAGNOSTIC_PROTECTION
        api-principle=COMMON, exclusive-area=ECUM_WAKEUP_IND
        api-principle=COMMON, exclusive-area=NM_INDICATION_PROTECTION
        api-principle=COMMON, exclusive-area=PNC_PREPARE_TIMER
        api-principle=COMMON, exclusive-area=PNC_WAKEUP_IND
      21 x bsw called entity:
        BswCE_ComM_BusSM_BusSleepMode: reentrancy-level=MULTICORE-REENTRANT, implemented-entry=ComM_BusSM_BusSleepMode
        BswCE_ComM_BusSM_ModeIndication: reentrancy-level=MULTICORE-REENTRANT, implemented-entry=ComM_BusSM_ModeIndication
        BswCE_ComM_COMCbk_ComISignal_Rx_EIRA_CanNm: reentrancy-level=MULTICORE-REENTRANT, implemented-entry=ComM_COMCbk_ComISignal_Rx_EIRA_CanNm
        BswCE_ComM_COMCbk_ComISignal_Tx_PncVector_FD_CAN1: reentrancy-level=MULTICORE-REENTRANT, implemented-entry=ComM_COMCbk_ComISignal_Tx_PncVector_FD_CAN1
        BswCE_ComM_CommunicationAllowed: reentrancy-level=MULTICORE-REENTRANT, implemented-entry=ComM_CommunicationAllowed
        BswCE_ComM_DCM_ActiveDiagnostic: reentrancy-level=MULTICORE-REENTRANT, implemented-entry=ComM_DCM_ActiveDiagnostic
        BswCE_ComM_DCM_InactiveDiagnostic: reentrancy-level=MULTICORE-REENTRANT, implemented-entry=ComM_DCM_InactiveDiagnostic
        BswCE_ComM_DeInit: reentrancy-level=NON-REENTRANT, implemented-entry=ComM_DeInit
        BswCE_ComM_EcuM_WakeUpIndication: reentrancy-level=MULTICORE-REENTRANT, implemented-entry=ComM_EcuM_WakeUpIndication
        BswCE_ComM_GetCurrentComMode: reentrancy-level=MULTICORE-REENTRANT, implemented-entry=ComM_GetCurrentComMode
        BswCE_ComM_GetMaxComMode: reentrancy-level=MULTICORE-REENTRANT, implemented-entry=ComM_GetMaxComMode
        BswCE_ComM_GetRequestedComMode: reentrancy-level=MULTICORE-REENTRANT, implemented-entry=ComM_GetRequestedComMode
        BswCE_ComM_GetStatus: reentrancy-level=NON-REENTRANT, implemented-entry=ComM_GetStatus
        BswCE_ComM_GetVersionInfo: reentrancy-level=NON-REENTRANT, implemented-entry=ComM_GetVersionInfo
        BswCE_ComM_Init: reentrancy-level=NON-REENTRANT, implemented-entry=ComM_Init
        BswCE_ComM_Nm_BusSleepMode: reentrancy-level=MULTICORE-REENTRANT, implemented-entry=ComM_Nm_BusSleepMode
        BswCE_ComM_Nm_NetworkMode: reentrancy-level=MULTICORE-REENTRANT, implemented-entry=ComM_Nm_NetworkMode
        BswCE_ComM_Nm_NetworkStartIndication: reentrancy-level=MULTICORE-REENTRANT, implemented-entry=ComM_Nm_NetworkStartIndication
        BswCE_ComM_Nm_PrepareBusSleepMode: reentrancy-level=MULTICORE-REENTRANT, implemented-entry=ComM_Nm_PrepareBusSleepMode
        BswCE_ComM_Nm_RestartIndication: reentrancy-level=MULTICORE-REENTRANT, implemented-entry=ComM_Nm_RestartIndication
        BswCE_ComM_RequestComMode: reentrancy-level=MULTICORE-REENTRANT, implemented-entry=ComM_RequestComMode
      bsw schedulable entity BswSE_ComM_MainFunction_ComMChannel_FD_CAN1: can-enter-exclusive-area=[CURRENT_MODE_PROTECTION, DCM_DIAGNOSTIC_PROTECTION, ECUM_WAKEUP_IND, INHIBIT_CNT_PROTECTION, NM_INDICATION_PROTECTION, PNC_PREPARE_TIMER, PNC_WAKEUP_IND, REQ_MODECNT_PROTECTION], implemented-entry=ComM_MainFunction_ComMChannel_FD_CAN1
      bsw schedulable entity BswSE_ComM_MainFunction_ComMChannel_LIN1: can-enter-exclusive-area=[CURRENT_MODE_PROTECTION, DCM_DIAGNOSTIC_PROTECTION, ECUM_WAKEUP_IND, INHIBIT_CNT_PROTECTION, NM_INDICATION_PROTECTION, PNC_PREPARE_TIMER, PNC_WAKEUP_IND, REQ_MODECNT_PROTECTION], implemented-entry=ComM_MainFunction_ComMChannel_LIN1
      bsw schedulable entity BswSE_ComM_MainFunction_ComMChannel_LIN2: can-enter-exclusive-area=[CURRENT_MODE_PROTECTION, DCM_DIAGNOSTIC_PROTECTION, ECUM_WAKEUP_IND, INHIBIT_CNT_PROTECTION, NM_INDICATION_PROTECTION, PNC_PREPARE_TIMER, PNC_WAKEUP_IND, REQ_MODECNT_PROTECTION], implemented-entry=ComM_MainFunction_ComMChannel_LIN2
      bsw timing event BswTE_ComM_MainFunction_ComMChannel_FD_CAN1: starts-on-event=BswSE_ComM_MainFunction_ComMChannel_FD_CAN1, period=0.005
      bsw timing event BswTE_ComM_MainFunction_ComMChannel_LIN1: starts-on-event=BswSE_ComM_MainFunction_ComMChannel_LIN1, period=0.005
      bsw timing event BswTE_ComM_MainFunction_ComMChannel_LIN2: starts-on-event=BswSE_ComM_MainFunction_ComMChannel_LIN2, period=0.005
      bsw distinguished partition BswDistinguishedPartition_ComM
  24 x bsw module entry, all with execution-context=TASK, sw-service-impl-policy=STANDARD:
    ComM_BusSM_BusSleepMode: service-id=52, is-reentrant=true, is-synchronous=true, call-type=CALLBACK
      sw service arg Channel: direction=IN, implementation-data-type=NetworkHandleType
    ComM_BusSM_ModeIndication: service-id=51, is-reentrant=true, is-synchronous=false, call-type=CALLBACK
      sw service arg Channel: direction=IN, implementation-data-type=NetworkHandleType
      sw service arg ComMode: direction=IN, implementation-data-type=ComM_ModeType
    ComM_COMCbk_ComISignal_Rx_EIRA_CanNm: service-id=54, is-reentrant=false, is-synchronous=true, call-type=CALLBACK
    ComM_COMCbk_ComISignal_Tx_PncVector_FD_CAN1: service-id=54, is-reentrant=false, is-synchronous=true, call-type=CALLBACK
    ComM_CommunicationAllowed: service-id=53, is-reentrant=false, is-synchronous=false, call-type=CALLBACK
      sw service arg Channel: direction=IN, implementation-data-type=NetworkHandleType
      sw service arg Allowed: direction=IN, implementation-data-type=boolean
    ComM_DCM_ActiveDiagnostic: service-id=31, is-reentrant=true, is-synchronous=true, call-type=CALLBACK
      sw service arg Channel: direction=IN, implementation-data-type=NetworkHandleType
    ComM_DCM_InactiveDiagnostic: service-id=32, is-reentrant=true, is-synchronous=true, call-type=CALLBACK
      sw service arg Channel: direction=IN, implementation-data-type=NetworkHandleType
    ComM_DeInit: service-id=2, is-reentrant=false, is-synchronous=true, call-type=REGULAR
    ComM_EcuM_WakeUpIndication: service-id=42, is-reentrant=true, is-synchronous=true, call-type=CALLBACK
      sw service arg Channel: direction=IN, implementation-data-type=NetworkHandleType
    ComM_GetCurrentComMode: service-id=8, is-reentrant=true, is-synchronous=true, call-type=REGULAR
      return type Std_ReturnType: implementation-data-type=Std_ReturnType
      sw service arg User: direction=IN, implementation-data-type=ComM_UserHandleType
      sw service arg ComMode: direction=OUT, implementation-data-type=ComM_ModeType
    ComM_GetMaxComMode: service-id=6, is-reentrant=true, is-synchronous=true, call-type=REGULAR
      return type Std_ReturnType: implementation-data-type=Std_ReturnType
      sw service arg User: direction=IN, implementation-data-type=ComM_UserHandleType
      sw service arg ComMode: direction=OUT, implementation-data-type=ComM_ModeType
    ComM_GetRequestedComMode: service-id=7, is-reentrant=true, is-synchronous=true, call-type=REGULAR
      return type Std_ReturnType: implementation-data-type=Std_ReturnType
      sw service arg User: direction=IN, implementation-data-type=ComM_UserHandleType
      sw service arg ComMode: direction=OUT, implementation-data-type=ComM_ModeType
    ComM_GetStatus: service-id=3, is-reentrant=false, is-synchronous=true, call-type=REGULAR
      return type Std_ReturnType: implementation-data-type=Std_ReturnType
      sw service arg Status: direction=IN, implementation-data-type=ComM_InhibitionStatusType
    ComM_GetVersionInfo: service-id=16, is-reentrant=true, is-synchronous=true, call-type=REGULAR
      sw service arg Versioninfo: direction=OUT, implementation-data-type=Std_VersionInfoType
    ComM_Init: service-id=1, is-reentrant=false, is-synchronous=true, call-type=REGULAR
      sw service arg ConfigPtr: direction=IN, implementation-data-type=ComM_ConfigType
    ComM_MainFunction_ComMChannel_FD_CAN1: service-id=96, call-type=SCHEDULED
    ComM_MainFunction_ComMChannel_LIN1: service-id=96, call-type=SCHEDULED
    ComM_MainFunction_ComMChannel_LIN2: service-id=96, call-type=SCHEDULED
    ComM_Nm_BusSleepMode: service-id=26, is-reentrant=true, is-synchronous=false, call-type=CALLBACK
      sw service arg Channel: direction=IN, implementation-data-type=NetworkHandleType
    ComM_Nm_NetworkMode: service-id=24, is-reentrant=true, is-synchronous=false, call-type=CALLBACK
      sw service arg Channel: direction=IN, implementation-data-type=NetworkHandleType
    ComM_Nm_NetworkStartIndication: service-id=21, is-reentrant=true, is-synchronous=false, call-type=CALLBACK
      sw service arg Channel: direction=IN, implementation-data-type=NetworkHandleType
    ComM_Nm_PrepareBusSleepMode: service-id=25, is-reentrant=true, is-synchronous=false, call-type=CALLBACK
      sw service arg Channel: direction=IN, implementation-data-type=NetworkHandleType
    ComM_Nm_RestartIndication: service-id=27, is-reentrant=true, is-synchronous=false, call-type=CALLBACK
      sw service arg Channel: direction=IN, implementation-data-type=NetworkHandleType
    ComM_RequestComMode: service-id=5, is-reentrant=true, is-synchronous=true, call-type=REGULAR
      return type Std_ReturnType: implementation-data-type=Std_ReturnType
      sw service arg User: direction=IN, implementation-data-type=ComM_UserHandleType
      sw service arg ComMode: direction=IN, implementation-data-type=ComM_ModeType
package /Bsw_ComM/SwcBswMapping
  swc bsw mapping SwcBswMapping_ComM: bsw-behavior=BswIB_ComM, swc-behavior=SwcIB_ComM
    runnable-mappings:
      bsw-entity=BswCE_ComM_GetCurrentComMode, swc-runnable=GetCurrentComMode
      bsw-entity=BswCE_ComM_GetMaxComMode, swc-runnable=GetMaxComMode
      bsw-entity=BswCE_ComM_GetRequestedComMode, swc-runnable=GetRequestedComMode
      bsw-entity=BswCE_ComM_RequestComMode, swc-runnable=RequestComMode
      GetInhibitionStatus
      LimitChannelToNoComMode
      LimitECUToNoComMode
      SetECUGroupClassification
      PreventWakeUp
package /Bsw_ComM/TypeDefinitions
  compu method ComM_InitStatusType: 0=COMM_UNINIT, 1=COMM_INIT
  compu method ComM_PncModeType: 0=COMM_PNC_REQUESTED, 1=COMM_PNC_READY_SLEEP, 2=COMM_PNC_PREPARE_SLEEP, 3=COMM_PNC_NO_COMMUNICATION
  compu method ComM_StateType: 0=COMM_NO_COM_NO_PENDING_REQUEST, 1=COMM_NO_COM_REQUEST_PENDING, 2=COMM_FULL_COM_NETWORK_REQUESTED, 3=COMM_FULL_COM_READY_SLEEP, 4=COMM_SILENT_COM
