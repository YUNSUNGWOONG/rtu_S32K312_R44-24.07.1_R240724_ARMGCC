AUTOSAR XML (schema 00047)
# (C) 2021 HYUNDAI AUTOEVER Corp.
# Confidential Proprietary Information. Distribution Limited.
# Do Not Copy Without Prior Permission
package /Bsw_FiM
  bsw implementation BswImplementation_FiM: programming-language=C, sw-version=1.0.0, vendor-id=76, ar-release-version=4.4.0, behavior=BswInternalBehavior_FiM
  bsw module description FiM: module-id=11
    implemented-entrys:
      FiM_DemInit
      FiM_DemTriggerOnComponentStatus
      FiM_DemTriggerOnMonitorStatus
      FiM_GetFunctionPermission
      FiM_GetVersionInfo
      FiM_Init
      FiM_MainFunction
      FiM_SetFunctionAvailable
    bsw module dependency BswModuleDependency_DEM: target-module-id=54
    bsw module dependency BswModuleDependency_Det: target-module-id=15
    bsw module dependency BswModuleDependency_EcuM: target-module-id=10
    bsw internal behavior BswInternalBehavior_FiM
      exclusive area REQUEST_EVENTID_PROTECTION
      exclusive area REQUEST_FID_PROTECTION
      6 x bsw called entity:
        BswSE_FiM_DemInit: implemented-entry=FiM_DemInit
        BswSE_FiM_DemTriggerOnComponentStatus: implemented-entry=FiM_DemTriggerOnComponentStatus
        BswSE_FiM_DemTriggerOnMonitorStatus: implemented-entry=FiM_DemTriggerOnMonitorStatus
        BswSE_FiM_GetFunctionPermission: implemented-entry=FiM_GetFunctionPermission
        BswSE_FiM_GetVersionInfo: implemented-entry=FiM_GetVersionInfo
        BswSE_FiM_Init: implemented-entry=FiM_Init
      bsw schedulable entity BswSE_FiM_MainFunction: can-enter-exclusive-area=[REQUEST_EVENTID_PROTECTION, REQUEST_FID_PROTECTION], implemented-entry=FiM_MainFunction
      bsw called entity BswSE_FiM_SetFunctionAvailable: implemented-entry=FiM_SetFunctionAvailable
      bsw timing event BswTE_FiM_MainFunction: starts-on-event=BswSE_FiM_MainFunction, period=0.01
      bsw distinguished partition BswDistinguishedPartition_FiM
  8 x bsw module entry:
    FiM_DemInit: service-id=3, is-reentrant=false, is-synchronous=true, call-type=REGULAR, bsw-entry-kind=CONCRETE  # This service re-initializes the FIM.
    FiM_DemTriggerOnComponentStatus: service-id=6, is-reentrant=false, is-synchronous=true, call-type=REGULAR, bsw-entry-kind=CONCRETE  # Triggers on changes of the component failed status.
      sw service arg ComponentId: direction=IN, implementation-data-type=Dem_ComponentIdType
      sw service arg ComponentFailedStatus: direction=IN, implementation-data-type=boolean
    FiM_DemTriggerOnMonitorStatus: service-id=2, is-reentrant=true, is-synchronous=true, call-type=REGULAR, bsw-entry-kind=CONCRETE  # This service is provided to be called by the Dem in order to inform the Fim about monitor status changes.
      sw service arg EventId: direction=IN, implementation-data-type=Dem_EventIdType  # Identification of an Event by assigned event number. The Event Number is configured in the DEM. Min.: 1 (0: Indication of no Event or Failure) Max.: Result of configuration of Event Numbers in DEM (Max is either 255 or 65535)
    FiM_GetFunctionPermission: service-id=1, is-reentrant=true, is-synchronous=true, call-type=REGULAR, bsw-entry-kind=CONCRETE  # This service reports the permission state to the functionality.
      return type Std_ReturnType: implementation-data-type=Std_ReturnType
      sw service arg FID: direction=IN, implementation-data-type=FiM_FunctionIdType  # Identification of a functionality by assigned FID. The FunctionId is configured in the FIM. Min.: 1 (0: Indication of no functionality) Max.: Result of configuration of FIDs in FIM (Max is either 255 or 65535)
      sw service arg Permission: category=DATA_REFERENCE, direction=OUT, sw-pointer-target-props=boolean  # TRUE: FID has permission to run FALSE: FID has no permission to run, i.e. shall not be executed
    FiM_GetVersionInfo: service-id=4, is-reentrant=true, is-synchronous=true, call-type=REGULAR, bsw-entry-kind=CONCRETE  # This service returns the version information of this module.
      sw service arg versioninfo: category=DATA_REFERENCE, direction=OUT, sw-pointer-target-props=Std_VersionInfoType  # Pointer to where to store the version information of this module.
    FiM_Init: service-id=0, is-reentrant=false, is-synchronous=true, call-type=REGULAR, bsw-entry-kind=CONCRETE  # This service initializes the FIM.
      sw service arg FiMConfigPtr: category=DATA_REFERENCE, direction=IN, sw-pointer-target-props={implementation-data-type=FiM_ConfigType, sw-impl-policy=CONST}
    FiM_MainFunction: service-id=5, is-reentrant=false, is-synchronous=false, call-type=SCHEDULED, execution-context=TASK, sw-service-impl-policy=STANDARD
    FiM_SetFunctionAvailable: service-id=7, is-reentrant=true, is-synchronous=true, call-type=REGULAR, bsw-entry-kind=CONCRETE  # This service sets the availability of a function. The function is only available if FiMAvailabilitySupport is configured as True.
      return type Std_ReturnType: implementation-data-type=Std_ReturnType
      sw service arg FID: direction=IN, implementation-data-type=FiM_FunctionIdType  # Identification of a functionality by assigned FID.
      sw service arg Availability: direction=IN, implementation-data-type=boolean  # The permission of the requested FID: TRUE: Function is available. FALSE: Function is not available.
  swc implementation FiM_SwcImplementation0: programming-language=C, sw-version=1.0.0.0, swc-bsw-mapping=SwcBswMapping, vendor-id=76, behavior=SwcInternalBehavior
    code-descriptors:
      code CodeDescription
    resource consumption ResourceConsumption
  swc bsw mapping SwcBswMapping: bsw-behavior=BswInternalBehavior_FiM, swc-behavior=SwcInternalBehavior
