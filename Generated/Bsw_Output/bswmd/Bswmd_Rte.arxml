AUTOSAR XML (schema 00047)
# (C) 2023 HYUNDAI AUTOEVER Corp.
package /AUTOSAR_Rte
  bsw implementation BswImplementation_Rte: programming-language=C, sw-version=1.8.0.0, used-code-generator=1.8.0.0, vendor-id=76, ar-release-version=4.4.0, behavior=BswInternalBehavior_Rte
  bsw module description Rte: module-id=2
    bsw internal behavior BswInternalBehavior_Rte
