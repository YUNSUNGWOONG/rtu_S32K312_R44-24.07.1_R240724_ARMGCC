AUTOSAR XML (schema 00047)
package /Bsw_IoHwAb
  bsw implementation BswImplementation_IoHwAb: sw-version=1.7.1, swc-bsw-mapping=SwcBswMapping_IoHwAb, vendor-id=76, ar-release-version=4.4.0, behavior=BswInternalBehavior_IoHwAb
  bsw module description IoHwAb: module-id=254
    bsw internal behavior BswInternalBehavior_IoHwAb: data-type-mapping=EcuModeMap
      exclusive area IoHwAbProtection
      10 x bsw called entity, all with can-enter-exclusive-area=IoHwAbProtection:
        IoHwAb_AnaInDirReadDirect: implemented-entry=IoHwAb_AnaInDirReadDirect
        IoHwAb_DigDirIsInput: implemented-entry=IoHwAb_DigDirIsInput
        IoHwAb_DigDirIsOutput: implemented-entry=IoHwAb_DigDirIsOutput
        IoHwAb_DigDirReadDirect: implemented-entry=IoHwAb_DigDirReadDirect
        IoHwAb_DigDirSetToInput: implemented-entry=IoHwAb_DigDirSetToInput
        IoHwAb_DigDirSetToOutput: implemented-entry=IoHwAb_DigDirSetToOutput
        IoHwAb_DigDirWriteDirect: implemented-entry=IoHwAb_DigDirWriteDirect
        IoHwAb_GptStartTimer: implemented-entry=IoHwAb_GptStartTimer
        IoHwAb_GptStopTimer: implemented-entry=IoHwAb_GptStopTimer
        IoHwAb_IcuSetActivationCondition: implemented-entry=IoHwAb_IcuSetActivationCondition
      bsw distinguished partition BswDistinguishedPartition_IoHwAb
  10 x bsw module entry, all with is-synchronous=true, call-type=REGULAR, execution-context=UNSPECIFIED, sw-service-impl-policy=STANDARD:
    IoHwAb_AnaInDirReadDirect: service-id=23, is-reentrant=false
      sw service arg ChIdx: direction=IN
      sw service arg Value: direction=OUT
      sw service arg AnaInDirLength: direction=IN
    IoHwAb_DigDirIsInput: service-id=35, is-reentrant=true
      sw service arg ChIdx: direction=IN
      sw service arg blResult: direction=OUT
    IoHwAb_DigDirIsOutput: service-id=34, is-reentrant=true
      sw service arg ChIdx: direction=IN
      sw service arg blResult: direction=OUT
    IoHwAb_DigDirReadDirect: service-id=32, is-reentrant=true
      sw service arg ChIdx: direction=IN
      sw service arg Level: direction=OUT
    IoHwAb_DigDirSetToInput: service-id=30, is-reentrant=true
      sw service arg ChIdx: direction=IN
    IoHwAb_DigDirSetToOutput: service-id=31, is-reentrant=true
      sw service arg ChIdx: direction=IN
    IoHwAb_DigDirWriteDirect: service-id=33, is-reentrant=true
      sw service arg ChIdx: direction=IN
      sw service arg Level: direction=IN
    IoHwAb_GptStartTimer: service-id=4, is-reentrant=true
      sw service arg ChIdx: direction=IN
      sw service arg Value: direction=IN
    IoHwAb_GptStopTimer: service-id=0, is-reentrant=true
      sw service arg ChIdx: direction=IN
    IoHwAb_IcuSetActivationCondition: service-id=20, is-reentrant=true
      sw service arg ChIdx: direction=IN
      sw service arg Activation: direction=IN
  swc bsw mapping SwcBswMapping_IoHwAb: bsw-behavior=BswInternalBehavior_IoHwAb, swc-behavior=IB_IoHwAb
    runnable-mappings:
      bsw-entity=IoHwAb_GptStopTimer, swc-runnable=IoHwAb_Re_Gpt_StopTimer
      bsw-entity=IoHwAb_GptStartTimer, swc-runnable=IoHwAb_Re_Gpt_StartTimer
      bsw-entity=IoHwAb_IcuSetActivationCondition, swc-runnable=IoHwAb_Re_Icu_SetActivationCondition
      bsw-entity=IoHwAb_AnaInDirReadDirect, swc-runnable=IoHwAb_Re_AnaInDir_ReadDirect
      bsw-entity=IoHwAb_DigDirSetToInput, swc-runnable=IoHwAb_Re_DigDir_SetToInput
      bsw-entity=IoHwAb_DigDirSetToOutput, swc-runnable=IoHwAb_Re_DigDir_SetToOutput
      bsw-entity=IoHwAb_DigDirReadDirect, swc-runnable=IoHwAb_Re_DigDir_ReadDirect
      bsw-entity=IoHwAb_DigDirWriteDirect, swc-runnable=IoHwAb_Re_DigDir_WriteDirect
      bsw-entity=IoHwAb_DigDirIsOutput, swc-runnable=IoHwAb_Re_DigDir_IsOutput
      bsw-entity=IoHwAb_DigDirIsInput, swc-runnable=IoHwAb_Re_DigDir_IsInput
