AUTOSAR XML (schema 00047)
# (C) 2021 HYUNDAI AUTOEVER Corp.
package /Bsw_LinTrcv
  bsw implementation BswImplementation_LinTrcv: sw-version=1.0.7, vendor-id=76, ar-release-version=4.4.0, behavior=BswInternalBehavior_LinTrcv
  bsw module description LinTrcv: category=BSW_MODULE, module-id=64
    bsw module dependency BswModuleDependency_Dio: target-module-id=120
    bsw internal behavior BswInternalBehavior_LinTrcv
      exclusive area DIO_READ_WRITE_PROTECTION
      7 x bsw called entity:
        BswCE_LinTrcv_CheckWakeup: implemented-entry=LinTrcv_CheckWakeup
        BswCE_LinTrcv_GetBusWuReason: implemented-entry=LinTrcv_GetBusWuReason
        BswCE_LinTrcv_GetOpMode: implemented-entry=LinTrcv_GetOpMode
        BswCE_LinTrcv_GetVersionInfo: implemented-entry=LinTrcv_GetVersionInfo
        BswCE_LinTrcv_Init: implemented-entry=LinTrcv_Init
        BswCE_LinTrcv_SetOpMode: can-enter-exclusive-area=DIO_READ_WRITE_PROTECTION, implemented-entry=LinTrcv_SetOpMode
        BswCE_LinTrcv_SetWakeupMode: implemented-entry=LinTrcv_SetWakeupMode
      bsw distinguished partition BswDistinguishedPartition_LinTrcv
package /Bsw_LinTrcv/ExpectedEntries
  6 x bsw module entry, all with is-reentrant=true, is-synchronous=true, call-type=REGULAR, execution-context=UNSPECIFIED, sw-service-impl-policy=STANDARD, bsw-entry-kind=CONCRETE:
    Dio_ReadChannel: service-id=0
      return type Dio_LevelType: direction=OUT
      sw service arg ChannelId: direction=IN
    Dio_ReadChannelGroup: service-id=4
      return type Dio_PortLevelType: direction=OUT
      sw service arg ChannelGroupIdPtr: direction=IN
    Dio_ReadPort: service-id=2
      return type Dio_PortLevelType: direction=OUT
      sw service arg PortId: direction=IN
    Dio_WriteChannel: service-id=1
      sw service arg ChannelId: direction=IN
      sw service arg Level: direction=IN
    Dio_WriteChannelGroup: service-id=5
      sw service arg ChannelGroupIdPtr: direction=IN
      sw service arg Level: direction=IN
    Dio_WritePort: service-id=3
      sw service arg PortId: direction=IN
      sw service arg Level: direction=IN
package /Bsw_LinTrcv/ImplementedEntries
  7 x bsw module entry, all with is-synchronous=true, call-type=REGULAR, execution-context=UNSPECIFIED, sw-service-impl-policy=STANDARD, bsw-entry-kind=CONCRETE:
    LinTrcv_CheckWakeup: service-id=7, is-reentrant=true
      return type Std_ReturnType: direction=OUT
      sw service arg LinNetwork: direction=IN
    LinTrcv_GetBusWuReason: service-id=3, is-reentrant=true
      return type Std_ReturnType: direction=OUT
      sw service arg LinNetwork: direction=IN
      sw service arg *Reason: direction=IN
    LinTrcv_GetOpMode: service-id=2, is-reentrant=true
      return type Std_ReturnType: direction=OUT
      sw service arg LinNetwork: direction=IN
      sw service arg *OpMode: direction=IN
    LinTrcv_GetVersionInfo: service-id=4, is-reentrant=true
      sw service arg versionInfo: direction=OUT
    LinTrcv_Init: service-id=0, is-reentrant=false
      sw service arg ConfigPtr: direction=IN
    LinTrcv_SetOpMode: service-id=1, is-reentrant=false
      return type Std_ReturnType: direction=OUT
      sw service arg LinNetwork: direction=IN
      sw service arg OpMode: direction=IN
    LinTrcv_SetWakeupMode: service-id=5, is-reentrant=false
      return type Std_ReturnType: direction=OUT
      sw service arg LinNetwork: direction=IN
      sw service arg TrcvWakupMode: direction=IN
