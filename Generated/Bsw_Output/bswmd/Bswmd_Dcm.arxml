AUTOSAR XML (schema 00047)
# (C) 2021 HYUNDAI AUTOEVER Corp.
# Confidential Proprietary Information. Distribution Limited.
# Do Not Copy Without Prior Permission
package /Bsw_Dcm
  bsw implementation BswImplementation_Dcm: programming-language=C, sw-version=1.0.0, swc-bsw-mapping=SwcBswMapping_Dcm, vendor-id=76, ar-release-version=4.4.0, behavior=BswInternalBehavior_Dcm
  bsw module description Dcm: category=BSW_MODULE, module-id=53
    9 x bsw module dependency:
      BswModuleDependency_BswM: target-module-id=42
      BswModuleDependency_ComM: target-module-id=12
      BswModuleDependency_Csm: target-module-id=110
      BswModuleDependency_Dem: target-module-id=54
      BswModuleDependency_EcuM: target-module-id=10
      BswModuleDependency_IoHwAb: target-module-id=254
      BswModuleDependency_KeyM: target-module-id=109
      BswModuleDependency_NvM: target-module-id=20
      BswModuleDependency_PduR: target-module-id=51
    provided-mode-groups:
      9 x mode declaration group prototype:
        DcmApplicationUpdated: type=DcmApplicationUpdated
        DcmCommunicationControl_ComMChannel_FD_CAN1: type=DcmCommunicationControl
        DcmControlDTCSetting: type=DcmControlDTCSetting
        DcmDiagnosticSessionControl: type=DcmDiagnosticSessionControl
        DcmEcuReset: type=DcmEcuReset
        DcmModeRapidPowerShutDown: type=DcmModeRapidPowerShutDown
        DcmResponseOnEvent_OnChangeOfDataIdentifier: type=DcmResponseOnEvent
        DcmResponseOnEvent_OnDTCStatusChange: type=DcmResponseOnEvent
        DcmSecurityAccess: type=DcmSecurityAccess
    bsw internal behavior BswInternalBehavior_Dcm: data-type-mapping=[DcmDiagnosticSessionControl, DcmSecurityAccess, DcmEcuReset, DcmModeRapidPowerShutDown, DcmControlDTCSetting, DcmResponseOnEvent, DcmCommunicationControl, DcmApplicationUpdated]
      6 x exclusive area:
        DATA_UPDATE
        ProtclProtection
        RxLengthProtection
        RxPduIdProtection
        SIGNAL_DATA_PROTECTION_AREA
        TimerProtection
      bsw schedulable entity BswSE_Dcm_MainFunction: can-enter-exclusive-area=[DATA_UPDATE, ProtclProtection, RxLengthProtection, RxPduIdProtection, SIGNAL_DATA_PROTECTION_AREA, TimerProtection], implemented-entry=Dcm_MainFunction
        accessed-mode-groups:
          DcmDiagnosticSessionControl
          DcmSecurityAccess
          DcmEcuReset
          DcmModeRapidPowerShutDown
          DcmControlDTCSetting
          DcmResponseOnEvent_OnDTCStatusChange
          DcmResponseOnEvent_OnChangeOfDataIdentifier
          DcmCommunicationControl_ComMChannel_FD_CAN1
          DcmApplicationUpdated
        managed-mode-groups:
          DcmDiagnosticSessionControl
          DcmSecurityAccess
          DcmEcuReset
          DcmModeRapidPowerShutDown
          DcmControlDTCSetting
          DcmResponseOnEvent_OnDTCStatusChange
          DcmResponseOnEvent_OnChangeOfDataIdentifier
          DcmCommunicationControl_ComMChannel_FD_CAN1
          DcmApplicationUpdated
      bsw timing event BswTE_Dcm_MainFunction: starts-on-event=BswSE_Dcm_MainFunction, period=0.005
      mode-sender-policys:
        enhanced-mode-api=false, provided-mode-group=DcmDiagnosticSessionControl, queue-length=1
        enhanced-mode-api=false, provided-mode-group=DcmSecurityAccess, queue-length=1
        enhanced-mode-api=false, provided-mode-group=DcmEcuReset, queue-length=1
        enhanced-mode-api=false, provided-mode-group=DcmModeRapidPowerShutDown, queue-length=1
        enhanced-mode-api=false, provided-mode-group=DcmControlDTCSetting, queue-length=1
        enhanced-mode-api=false, provided-mode-group=DcmResponseOnEvent_OnDTCStatusChange, queue-length=1
        enhanced-mode-api=false, provided-mode-group=DcmResponseOnEvent_OnChangeOfDataIdentifier, queue-length=1
        enhanced-mode-api=false, provided-mode-group=DcmCommunicationControl_ComMChannel_FD_CAN1, queue-length=1
        enhanced-mode-api=false, provided-mode-group=DcmApplicationUpdated, queue-length=1
      bsw-service-dependency assigned-entry-roles=role-based-bsw-module-entry-assignment=Dcm_MainFunction:
        service-needs:
          bsw mgr needs BswMgrNeeds
      bsw distinguished partition BswDistinguishedPartition_Dcm
package /Bsw_Dcm/DataTypeMappingSet
  8 x data type mapping set:
    DcmApplicationUpdated: mode-request-type-map{implementation-data-type=uint8, mode-group=DcmApplicationUpdated}
    DcmCommunicationControl: mode-request-type-map{implementation-data-type=uint8, mode-group=DcmCommunicationControl}
    DcmControlDTCSetting: mode-request-type-map{implementation-data-type=uint8, mode-group=DcmControlDTCSetting}
    DcmDiagnosticSessionControl: mode-request-type-map{implementation-data-type=uint8, mode-group=DcmDiagnosticSessionControl}
    DcmEcuReset: mode-request-type-map{implementation-data-type=uint8, mode-group=DcmEcuReset}
    DcmModeRapidPowerShutDown: mode-request-type-map{implementation-data-type=uint8, mode-group=DcmModeRapidPowerShutDown}
    DcmResponseOnEvent: mode-request-type-map{implementation-data-type=uint8, mode-group=DcmResponseOnEvent}
    DcmSecurityAccess: mode-request-type-map{implementation-data-type=uint8, mode-group=DcmSecurityAccess}
package /Bsw_Dcm/ExpectedEntries
  bsw module entry ComM_DCM_ActiveDiagnostic: service-id=31, is-reentrant=true, is-synchronous=true, call-type=CALLOUT, execution-context=TASK, sw-service-impl-policy=STANDARD, bsw-entry-kind=CONCRETE
    sw service arg Channel: direction=IN
  bsw module entry ComM_DCM_InactiveDiagnostic: service-id=32, is-reentrant=true, is-synchronous=true, call-type=CALLOUT, execution-context=TASK, sw-service-impl-policy=STANDARD, bsw-entry-kind=CONCRETE
    sw service arg Channel: direction=IN
  bsw module entry PduR_DcmTransmit: service-id=73, is-reentrant=false, is-synchronous=true, call-type=CALLOUT, execution-context=TASK, sw-service-impl-policy=STANDARD, bsw-entry-kind=CONCRETE
    return type Std_ReturnType: direction=OUT
    sw service arg TxPduId: direction=IN
    sw service arg PduInfoPtr: direction=IN
package /Bsw_Dcm/ImplementedEntries/DcmBswComponents
  4 x bsw module entry, all with is-synchronous=true, call-type=REGULAR, sw-service-impl-policy=STANDARD, bsw-entry-kind=CONCRETE:
    Dcm_DemTriggerOnDTCStatus: service-id=43, is-reentrant=true, execution-context=UNSPECIFIED
      return type Std_ReturnType: direction=OUT
      sw service arg DTC: direction=IN
      sw service arg DTCStatusOld: direction=IN
      sw service arg DTCStatusNew: direction=IN
    Dcm_GetVersionInfo: service-id=36, is-reentrant=true, execution-context=UNSPECIFIED
      sw service arg versionInfo: direction=OUT
    Dcm_GetVin: service-id=7, is-reentrant=true, execution-context=UNSPECIFIED
      return type Std_ReturnType: direction=OUT
      sw service arg Data: direction=OUT
    Dcm_Init: service-id=1, is-reentrant=false, execution-context=TASK
      sw service arg ConfigPtr: direction=IN
package /Bsw_Dcm/ImplementedEntries/DcmCallbacks
  11 x bsw module entry, all with is-synchronous=true, call-type=CALLBACK, execution-context=UNSPECIFIED, sw-service-impl-policy=STANDARD:
    Dcm_ComM_FullComModeEntered: service-id=35, is-reentrant=true, bsw-entry-kind=ABSTRACT
      sw service arg NetworkId: direction=IN
    Dcm_ComM_NoComModeEntered: service-id=33, is-reentrant=true, bsw-entry-kind=CONCRETE
      sw service arg NetworkId: direction=IN
    Dcm_ComM_SilentComModeEntered: service-id=34, is-reentrant=true, bsw-entry-kind=CONCRETE
      sw service arg NetworkId: direction=IN
    Dcm_CopyRxData: service-id=68, is-reentrant=true, bsw-entry-kind=CONCRETE
      return type BufReq_ReturnType: direction=OUT
      sw service arg id: direction=IN
      sw service arg info: direction=IN
      sw service arg bufferSizePtr: direction=OUT
    Dcm_CopyTxData: service-id=67, is-reentrant=true, bsw-entry-kind=CONCRETE
      return type BufReq_ReturnType: direction=OUT
      4 x sw service arg:
        id: direction=IN
        info: direction=IN
        retry: direction=IN
        availableDataPtr: direction=OUT
    Dcm_CsmAsyncJobFinished: is-reentrant=true, bsw-entry-kind=CONCRETE
      return type Std_ReturnType: direction=OUT
      sw service arg result: direction=IN
    Dcm_KeyMAsyncCertificateVerifyFinished: is-reentrant=true, bsw-entry-kind=CONCRETE
      return type Std_ReturnType: direction=OUT
      sw service arg result: direction=IN
      sw service arg certId: direction=IN
    Dcm_StartOfReception: service-id=70, is-reentrant=true, bsw-entry-kind=CONCRETE
      return type BufReq_ReturnType: direction=OUT
      4 x sw service arg:
        id: direction=IN
        info: direction=IN
        TpSduLength: direction=IN
        bufferSizePtr: direction=OUT
    Dcm_TpRxIndication: service-id=69, is-reentrant=true, bsw-entry-kind=CONCRETE
      sw service arg id: direction=IN
      sw service arg result: direction=IN
    Dcm_TpTxConfirmation: service-id=72, is-reentrant=true, bsw-entry-kind=CONCRETE
      sw service arg id: direction=IN
      sw service arg result: direction=IN
    Dcm_TxConfirmation: service-id=64, is-reentrant=false, bsw-entry-kind=CONCRETE
      sw service arg TxPduId: direction=IN
      sw service arg result: direction=IN
package /Bsw_Dcm/ImplementedEntries/DcmSchedules
  bsw module entry Dcm_MainFunction: service-id=37, is-reentrant=false, is-synchronous=false, call-type=SCHEDULED, execution-context=TASK, sw-service-impl-policy=STANDARD, bsw-entry-kind=CONCRETE
package /Bsw_Dcm/ImplementedEntries/DcmSwComponents
  7 x bsw module entry, all with is-reentrant=true, is-synchronous=true, call-type=REGULAR, execution-context=UNSPECIFIED, sw-service-impl-policy=STANDARD, bsw-entry-kind=CONCRETE:
    Dcm_GetActiveProtocol: service-id=15
      return type Std_ReturnType: direction=OUT
      sw service arg ActiveProtocolType: direction=IN
      sw service arg ConnectionId: direction=IN
      sw service arg TesterSourceAddress: direction=IN
    Dcm_GetSecurityLevel: service-id=13
      return type Std_ReturnType: direction=OUT
      sw service arg SecLevel: direction=OUT
    Dcm_GetSesCtrlType: service-id=6
      return type Std_ReturnType: direction=OUT
      sw service arg SesCtrlType: direction=OUT
    Dcm_ResetToDefaultSession: service-id=42
      return type Std_ReturnType: direction=OUT
    Dcm_SetActiveDiagnostic: service-id=86
      return type Std_ReturnType: direction=OUT
      sw service arg active: direction=IN
    Dcm_SetDeauthenticatedRole: service-id=121
      return type Std_ReturnType: direction=OUT
      sw service arg connectionId: direction=IN
      sw service arg deauthenticatedRole: direction=IN
    Dcm_TriggerOnEvent: service-id=45
      return type Std_ReturnType: direction=OUT
      sw service arg RoeEventId: direction=IN
package /Bsw_Dcm/ModeDeclarationGroup
  8 x mode declaration group, all with category=EXPLICIT_ORDER, on-transition-value=255:
    DcmApplicationUpdated: initial-mode=APP_NOT_UPDATED
      mode APP_NOT_UPDATED: value=0
      mode APP_UPDATED: value=1
    DcmCommunicationControl: initial-mode=DCM_ENABLE_RX_TX_NORM_NM
      12 x mode:
        DCM_DISABLE_RX_ENABLE_TX_NM: value=6
        DCM_DISABLE_RX_ENABLE_TX_NORM: value=2
        DCM_DISABLE_RX_ENABLE_TX_NORM_NM: value=10
        DCM_DISABLE_RX_TX_NM: value=7
        DCM_DISABLE_RX_TX_NORMAL: value=3
        DCM_DISABLE_RX_TX_NORM_NM: value=11
        DCM_ENABLE_RX_DISABLE_TX_NM: value=5
        DCM_ENABLE_RX_DISABLE_TX_NORM: value=1
        DCM_ENABLE_RX_DISABLE_TX_NORM_NM: value=9
        DCM_ENABLE_RX_TX_NM: value=4
        DCM_ENABLE_RX_TX_NORM: value=0
        DCM_ENABLE_RX_TX_NORM_NM: value=8
    DcmControlDTCSetting: initial-mode=DCM_ENABLEDTCSETTING
      mode DCM_DISABLEDTCSETTING: value=1
      mode DCM_ENABLEDTCSETTING: value=0
    DcmDiagnosticSessionControl: initial-mode=DCM_DEFAULT_SESSION
      8 x mode:
        DCM_DEFAULT_SESSION: value=1
        DCM_ECU_PROGRAMMING_MODE: value=5
        DCM_EXTENDED_DIAGNOSTIC_MODE: value=16
        DCM_EXTENDED_DIAGNOSTIC_SESSION: value=3
        DCM_PROGRAMMING_SESSION: value=2
        DCM_QUIESCENT_CURRENT_DIAGNOSTIC_MODE_START: value=80
        DCM_SAFETY_SYSTEM_DIAGNOSTIC_SESSION: value=4
        DCM_SLEEP_MODE_START_REQUEST: value=81
    DcmEcuReset: initial-mode=DCM_NONE
      7 x mode:
        DCM_EXECUTE: value=6
        DCM_HARD: value=1
        DCM_JUMPTOBOOTLOADER: value=4
        DCM_JUMPTOSYSSUPPLIERBOOTLOADER: value=5
        DCM_KEYONOFF: value=2
        DCM_NONE: value=0
        DCM_SOFT: value=3
    DcmModeRapidPowerShutDown: initial-mode=DCM_ENABLE_RAPIDPOWERSHUTDOWN
      mode DCM_DISABLE_RAPIDPOWERSHUTDOWN: value=1
      mode DCM_ENABLE_RAPIDPOWERSHUTDOWN: value=0
    DcmResponseOnEvent: initial-mode=DCM_EVENT_CLEARED
      mode DCM_EVENT_CLEARED: value=2
      mode DCM_EVENT_STARTED: value=0
      mode DCM_EVENT_STOPPED: value=1
    DcmSecurityAccess: initial-mode=DCM_SEC_LEV_LOCKED
      mode DCM_SEC_LEV_L9: value=9
      mode DCM_SEC_LEV_LOCKED: value=0
package /Bsw_Dcm/ModeSwitchInterface
  9 x mode switch interface, all with is-service=true:
    Dcm_ApplicationUpdatedModeSwitchInterface
      mode group Dcm_ApplicationUpdatedModeSwitchInterface: type=DcmApplicationUpdated
    Dcm_CommunicationControlModeSwitchInterface_ComMChannel_FD_CAN1
      mode group Dcm_CommunicationControlModeSwitchInterface_ComMChannel_FD_CAN1: type=DcmCommunicationControl
    Dcm_ControlDTCSettingModeSwitchInterface
      mode group Dcm_ControlDTCSettingModeSwitchInterface: type=DcmControlDTCSetting
    Dcm_DiagnosticSessionControlModeSwitchInterface
      mode group Dcm_DiagnosticSessionControlModeSwitchInterface: type=DcmDiagnosticSessionControl
    Dcm_EcuResetModeSwitchInterface
      mode group Dcm_EcuResetModeSwitchInterface: type=DcmEcuReset
    Dcm_ModeRapidPowerShutDownModeSwitchInterface
      mode group Dcm_ModeRapidPowerShutDownModeSwitchInterface: type=DcmModeRapidPowerShutDown
    Dcm_ResponseOnEventModeSwitchInterface_OnChangeOfDataIdentifier
      mode group Dcm_ResponseOnEventModeSwitchInterface_OnChangeOfDataIdentifier: type=DcmResponseOnEvent
    Dcm_ResponseOnEventModeSwitchInterface_OnDTCStatusChange
      mode group Dcm_ResponseOnEventModeSwitchInterface_OnDTCStatusChange: type=DcmResponseOnEvent
    Dcm_SecurityAccessModeSwitchInterface
      mode group Dcm_SecurityAccessModeSwitchInterface: type=DcmSecurityAccess
