AUTOSAR XML (schema 00047)
package /Bsw_Crc
  bsw implementation BswImplementation_Crc: programming-language=C, sw-version=1.0.3, vendor-id=76, ar-release-version=4.4.0, behavior=BswInternalBehavior_Crc
  bsw module description BswModuleDescription_Crc: category=BSW_MODULE, module-id=201
    bsw internal behavior BswInternalBehavior_Crc
      bsw distinguished partition BswDistinguishedPartition_Crc
  8 x bsw module entry, all with is-reentrant=true, is-synchronous=true, call-type=REGULAR, execution-context=UNSPECIFIED, sw-service-impl-policy=STANDARD:
    Crc_CalculateCRC16  # This service makes a CRC16 calculation on Crc_Length data bytes.
      return type uint16: implementation-data-type=uint16
      4 x sw service arg, all with direction=IN:
        Crc_DataPtr: category=DATA_REFERENCE, sw-pointer-target-props={implementation-data-type=uint8, sw-impl-policy=CONST}  # Pointer to start address of data block to be calculated.
        Crc_Length: implementation-data-type=uint32  # Length of data block to be calculated in bytes.
        Crc_StartValue16: implementation-data-type=uint16  # Start value when the algorithm starts.
        Crc_IsFirstCall: implementation-data-type=boolean  # TRUE: First call in a sequence or individual CRC calculation; start from initial value, ignore Crc_StartValue16. FALSE: Subsequent call in a call sequence; Crc_StartValue16 is interpreted to be the return value of the previous function call.
    Crc_CalculateCRC16ARC: service-id=0x08  # This service makes a CRC16 calculation on Crc_Length data bytes, using the polynomial 0x8005.
      return type uint16: implementation-data-type=uint16
      4 x sw service arg, all with direction=IN:
        Crc_DataPtr: category=DATA_REFERENCE, sw-pointer-target-props={implementation-data-type=uint8, sw-impl-policy=CONST}  # Pointer to start address of data block to be calculated.
        Crc_Length: implementation-data-type=uint32  # Length of data block to be calculated in bytes.
        Crc_StartValue16: implementation-data-type=uint16  # Start value when the algorithm starts.
        Crc_IsFirstCall: implementation-data-type=boolean  # TRUE: First call in a sequence or individual CRC calculation; start from initial value, ignore Crc_StartValue16. FALSE: Subsequent call in a call sequence; Crc_StartValue16 is interpreted to be the return value of the previous function call.
    Crc_CalculateCRC32: service-id=0x03  # This service makes a CRC32 calculation on Crc_Length data bytes.
      return type uint32: implementation-data-type=uint32
      4 x sw service arg, all with direction=IN:
        Crc_DataPtr: category=DATA_REFERENCE, sw-pointer-target-props={implementation-data-type=uint8, sw-impl-policy=CONST}  # Pointer to start address of data block to be calculated.
        Crc_Length: implementation-data-type=uint32  # Length of data block to be calculated in bytes.
        Crc_StartValue32: implementation-data-type=uint32  # Start value when the algorithm starts.
        Crc_IsFirstCall: implementation-data-type=boolean  # TRUE: First call in a sequence or individual CRC calculation; start from initial value, ignore Crc_StartValue32. FALSE: Subsequent call in a call sequence; Crc_StartValue32 is interpreted to be the return value of the previous function call.
    Crc_CalculateCRC32P4: service-id=0x06  # This service makes a CRC32 calculation on Crc_Length data bytes, using the polynomial 0xF4ACFB13. | This CRC routine is used by E2E Profile 4.
      return type uint32: implementation-data-type=uint32
      4 x sw service arg, all with direction=IN:
        Crc_DataPtr: category=DATA_REFERENCE, sw-pointer-target-props={implementation-data-type=uint8, sw-impl-policy=CONST}  # Pointer to start address of data block to be calculated.
        Crc_Length: implementation-data-type=uint32  # Length of data block to be calculated in bytes.
        Crc_StartValue32: implementation-data-type=uint32  # Start value when the algorithm starts.
        Crc_IsFirstCall: implementation-data-type=boolean  # TRUE: First call in a sequence or individual CRC calculation; start from initial value, ignore Crc_StartValue32. FALSE: Subsequent call in a call sequence; Crc_StartValue32 is interpreted to be the return value of the previous function call.
    Crc_CalculateCRC64: service-id=0x07  # This service makes a CRC64 calculation on Crc_Length data bytes, using the polynomial 0x42F0E1EBA9EA3693. | This CRC routine is used by E2E Profile 7.
      return type uint64: implementation-data-type=uint64
      4 x sw service arg, all with direction=IN:
        Crc_DataPtr: category=DATA_REFERENCE, sw-pointer-target-props={implementation-data-type=uint8, sw-impl-policy=CONST}  # Pointer to start address of data block to be calculated.
        Crc_Length: implementation-data-type=uint32  # Length of data block to be calculated in bytes.
        Crc_StartValue64: implementation-data-type=uint64  # Start value when the algorithm starts.
        Crc_IsFirstCall: implementation-data-type=boolean  # TRUE: First call in a sequence or individual CRC calculation; start from initial value, ignore Crc_StartValue64. FALSE: Subsequent call in a call sequence; Crc_StartValue64 is interpreted to be the return value of the previous function call.
    Crc_CalculateCRC8: service-id=0x01  # This service makes a CRC8 calculation on Crc_Length data bytes, with SAE J1850 parameters
      return type uint8: implementation-data-type=uint8
      4 x sw service arg, all with direction=IN:
        Crc_DataPtr: category=DATA_REFERENCE, sw-pointer-target-props={implementation-data-type=uint8, sw-impl-policy=CONST}  # Pointer to start address of data block to be calculated.
        Crc_Length: implementation-data-type=uint32  # Length of data block to be calculated in bytes.
        Crc_StartValue8: implementation-data-type=uint8  # Start value when the algorithm starts.
        Crc_IsFirstCall: implementation-data-type=boolean  # TRUE: First call in a sequence or individual CRC calculation; start from initial value, ignore Crc_StartValue8. FALSE: Subsequent call in a call sequence; Crc_StartValue8 is interpreted to be the return value of the previous function call.
    Crc_CalculateCRC8H2F: service-id=0x05  # This service makes a CRC8 calculation with the Polynomial 0x2F on Crc_Length
      return type uint8: implementation-data-type=uint8
      4 x sw service arg, all with direction=IN:
        Crc_DataPtr: category=DATA_REFERENCE, sw-pointer-target-props={implementation-data-type=uint8, sw-impl-policy=CONST}  # Pointer to start address of data block to be calculated.
        Crc_Length: implementation-data-type=uint32  # Length of data block to be calculated in bytes.
        Crc_StartValue8H2F: implementation-data-type=uint8  # Start value when the algorithm starts.
        Crc_IsFirstCall: implementation-data-type=boolean  # TRUE: First call in a sequence or individual CRC calculation; start from initial value, ignore Crc_StartValue8H2F. FALSE: Subsequent call in a call sequence; Crc_StartValue8H2F is interpreted to be the return value of the previous function call.
    Crc_GetVersionInfo: service-id=0x04  # This service returns the version information of this module.
      sw service arg Versioninfo: category=DATA_REFERENCE, direction=OUT, sw-pointer-target-props=Std_VersionInfoType  # Pointer to where to store the version information of this module.
