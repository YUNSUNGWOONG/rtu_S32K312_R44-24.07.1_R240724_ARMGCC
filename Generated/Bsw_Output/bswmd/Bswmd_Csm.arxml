AUTOSAR XML (schema 00047)
# (C) 2021 HYUNDAI AUTOEVER Corp.
package /Bsw_Csm
  bsw implementation BswImplementation_Csm: programming-language=C, sw-version=1.0.10, swc-bsw-mapping=SwcBswMapping_Csm, vendor-id=76, ar-release-version=4.4.0, behavior=BswInternalBehavior_Csm, vendor-specific-module-def=Csm
  bsw module description Csm: module-id=110
    required-mode-groups:
      mode declaration group prototype modeNotificationPort_CsmEcuShutdown: type=EcuMode
    bsw internal behavior BswInternalBehavior_Csm: data-type-mapping=EcuModeMap, bsw-exclusive-area-policy{api-principle=COMMON, exclusive-area=GLOBALVAR_PROTECTION}, bsw-mode-receiver-policy{enhanced-mode-api=true, required-mode-group=modeNotificationPort_CsmEcuShutdown, supports-asynchronous-mode-switch=true}
      exclusive area GLOBALVAR_PROTECTION
      32 x bsw called entity:
        BswCE_Csm_AEADDecrypt: implemented-entry=Csm_AEADDecrypt
        BswCE_Csm_AEADEncrypt: implemented-entry=Csm_AEADEncrypt
        BswCE_Csm_ApplicationCallbackNotification: implemented-entry=Csm_ApplicationCallbackNotification
        BswCE_Csm_CallbackNotification: implemented-entry=Csm_CallbackNotification
        BswCE_Csm_CancelJob: implemented-entry=Csm_CancelJob
        BswCE_Csm_Decrypt: implemented-entry=Csm_Decrypt
        BswCE_Csm_Encrypt: implemented-entry=Csm_Encrypt
        BswCE_Csm_GetVersionInfo: implemented-entry=Csm_GetVersionInfo
        BswCE_Csm_Hash: implemented-entry=Csm_Hash
        BswCE_Csm_Init: implemented-entry=Csm_Init
        BswCE_Csm_JobKeyDerive: implemented-entry=Csm_JobKeyDerive
        BswCE_Csm_JobKeyExchangeCalcPubVal: implemented-entry=Csm_JobKeyExchangeCalcPubVal
        BswCE_Csm_JobKeyExchangeCalcSecret: implemented-entry=Csm_JobKeyExchangeCalcSecret
        BswCE_Csm_JobKeyGenerate: implemented-entry=Csm_JobKeyGenerate
        BswCE_Csm_JobKeySetValid: implemented-entry=Csm_JobKeySetValid
        BswCE_Csm_JobRandomSeed: implemented-entry=Csm_JobRandomSeed
        BswCE_Csm_KeyCopy: implemented-entry=Csm_KeyCopy
        BswCE_Csm_KeyDerive: implemented-entry=Csm_KeyDerive
        BswCE_Csm_KeyElementCopy: implemented-entry=Csm_KeyElementCopy
        BswCE_Csm_KeyElementCopyPartial: implemented-entry=Csm_KeyElementCopyPartial
        BswCE_Csm_KeyElementGet: implemented-entry=Csm_KeyElementGet
        BswCE_Csm_KeyElementSet: implemented-entry=Csm_KeyElementSet
        BswCE_Csm_KeyExchangeCalcPubVal: implemented-entry=Csm_KeyExchangeCalcPubVal
        BswCE_Csm_KeyExchangeCalcSecret: implemented-entry=Csm_KeyExchangeCalcSecret
        BswCE_Csm_KeyGenerate: implemented-entry=Csm_KeyGenerate
        BswCE_Csm_KeySetValid: implemented-entry=Csm_KeySetValid
        BswCE_Csm_MacGenerate: implemented-entry=Csm_MacGenerate
        BswCE_Csm_MacVerify: implemented-entry=Csm_MacVerify
        BswCE_Csm_RandomGenerate: implemented-entry=Csm_RandomGenerate
        BswCE_Csm_RandomSeed: implemented-entry=Csm_RandomSeed
        BswCE_Csm_SignatureGenerate: implemented-entry=Csm_SignatureGenerate
        BswCE_Csm_SignatureVerify: implemented-entry=Csm_SignatureVerify
      bsw schedulable entity BswSE_Csm_MainFunction: can-enter-exclusive-area=GLOBALVAR_PROTECTION, accessed-mode-groups=modeNotificationPort_CsmEcuShutdown, implemented-entry=Csm_MainFunction
      bsw timing event BswTE_Csm_MainFunction: context-limitation=BswDistinguishedPartition_Csm, disabled-in-mode=modeNotificationPort_CsmEcuShutdown.ECUM_STATE_SHUTDOWN, starts-on-event=BswSE_Csm_MainFunction, period=0.01
      bsw distinguished partition BswDistinguishedPartition_Csm
  33 x bsw module entry, all with execution-context=TASK, sw-service-impl-policy=STANDARD, bsw-entry-kind=CONCRETE:
    Csm_AEADDecrypt: service-id=0x63, is-reentrant=true, is-synchronous=false, call-type=REGULAR  # Uses the given data to perform an AEAD encryption and stores the ciphertext and the MAC in the memory locations pointed by the ciphertext pointer and Tag pointer.
      return type Std_ReturnType: implementation-data-type=Std_ReturnType
      11 x sw service arg:
        jobId: direction=IN, implementation-data-type=uint32  # Holds the identifier of the job using the CSM service.
        mode: direction=IN, implementation-data-type=Crypto_OperationModeType  # Indicates which operation mode(s) to perfom.
        ciphertextPtr: direction=IN, sw-pointer-target-props={implementation-data-type=uint8, sw-impl-policy=CONST}  # Contains the pointer to the data to be decrypted.
        ciphertextLength: direction=IN, implementation-data-type=uint32  # Contains the number of bytes to decrypt.
        associatedDataPtr: direction=IN, sw-pointer-target-props={implementation-data-type=uint8, sw-impl-policy=CONST}  # Contains the pointer to the associated data.
        associatedDataLength: direction=IN, implementation-data-type=uint32  # Contains the length in bytes of the associated data.
        tagPtr: direction=IN, sw-pointer-target-props={implementation-data-type=uint8, sw-impl-policy=CONST}  # Contains the pointer to the Tag to be verified.
        tagLength: direction=IN, implementation-data-type=uint32  # Contains the length in bytes of the Tag to be verified.
        plaintextPtr: direction=OUT, sw-pointer-target-props=uint8  # Contains the pointer to the data where the decrypted data shall be stored.
        plaintextLengthPtr: direction=INOUT, sw-pointer-target-props=uint32  # Holds a pointer to the memory location in which the output length in bytes of the paintext is stored. On calling this function, this parameter shall contain the size of the buffer provided by plaintextPtr. When the request has finished, the actual length of the returned value shall be stored.
        verifyPtr: direction=OUT, sw-pointer-target-props=Crypto_VerifyResultType  # Contains the pointer to the result of the verification.
    Csm_AEADEncrypt: service-id=0x62, is-reentrant=true, is-synchronous=false, call-type=REGULAR  # Uses the given input data to perform a AEAD encryption and stores the ciphertext and the MAC in the memory locations pointed by the ciphertext pointer and Tag pointer.
      return type Std_ReturnType: implementation-data-type=Std_ReturnType
      10 x sw service arg:
        jobId: direction=IN, implementation-data-type=uint32  # Holds the identifier of the job using the CSM service.
        mode: direction=IN, implementation-data-type=Crypto_OperationModeType  # Indicates which operation mode(s) to perfom.
        plaintextPtr: direction=IN, sw-pointer-target-props={implementation-data-type=uint8, sw-impl-policy=CONST}  # Contains the pointer to the data to be encrypted.
        plaintextLength: direction=IN, implementation-data-type=uint32  # Contains the number of bytes to encrypt.
        associatedDataPtr: direction=IN, sw-pointer-target-props={implementation-data-type=uint8, sw-impl-policy=CONST}  # Contains the pointer to the associated data.
        associatedDataLength: direction=IN, implementation-data-type=uint32  # Contains the number of bytes of the associated data.
        ciphertextPtr: direction=OUT, sw-pointer-target-props=uint8  # Contains the pointer to the data where the encrypted data shall be stored.
        ciphertextLengthPtr: direction=INOUT, sw-pointer-target-props=uint32  # Holds a pointer to the memory location in which the output length in bytes of the ciphertext is stored. On calling this function, this parameter shall contain the size of the buffer in bytes provided by resultPtr. When the request has finished, the actual length of the returned value shall be stored.
        tagPtr: direction=OUT, sw-pointer-target-props=uint8  # Contains the pointer to the data where the Tag shall be stored.
        tagLengthPtr: direction=INOUT, sw-pointer-target-props=uint32  # Holds a pointer to the memory location in which the output length in bytes of the Tag is stored. On calling this function, this parameter shall contain the size of the buffer in bytes provided by resultPtr. When the request has finished, the actual length of the returned value shall be stored.
    Csm_ApplicationCallbackNotification: service-id=0x80, is-reentrant=true, is-synchronous=true, call-type=REGULAR  # CSM notifies the application that a job has finished. The function name is configurable.
      sw service arg jobID: direction=IN, implementation-data-type=uint32, sw-impl-policy=CONST  # JobID of the operation that caused the callback
      sw service arg result: direction=IN, implementation-data-type=Csm_ResultType  # Contains the result of the cryptographic operation.
    Csm_CallbackNotification: service-id=0x70, is-reentrant=true, is-synchronous=true, call-type=REGULAR  # Notifies the CSM that a job has finished. This function is used by the underlying layer (CRYIF). | Variation: {ecuc(Csm/CsmJob/CsmJobUsePort == false)} && {ecuc(Csm/CsmJobs/CsmJob.CsmJobPrimitiveRef->CsmPrimitives/{Primitive}Config/{Primitive}Processing == CRYPTO_PROCESSING_ASYNC)}
      sw service arg job: direction=IN, sw-pointer-target-props=Crypto_JobType  # Holds a pointer to the job, which has finished.
      sw service arg result: direction=IN, implementation-data-type=Csm_ResultType  # Contains the result of the cryptographic operation.
    Csm_CancelJob: service-id=0x6f, is-reentrant=false, is-synchronous=true, call-type=REGULAR  # Cancels the job processing from asynchronous or streaming jobs.
      return type Std_ReturnType: implementation-data-type=Std_ReturnType
      sw service arg job: direction=IN, implementation-data-type=uint32  # Holds the identifier of the job to be canceled
      sw service arg mode: direction=IN, implementation-data-type=Crypto_OperationModeType  # Not used, just for interface compatibility provided.
    Csm_Decrypt: service-id=0x5f, is-reentrant=true, is-synchronous=false, call-type=REGULAR  # Decrypts the given encrypted data and store the decrypted plaintext in the memory location pointed by the result pointer.
      return type Std_ReturnType: implementation-data-type=Std_ReturnType
      6 x sw service arg:
        jobId: direction=IN, implementation-data-type=uint32  # Holds the identifier of the job using the CSM service.
        mode: direction=IN, implementation-data-type=Crypto_OperationModeType  # Indicates which operation mode(s) to perfom.
        dataPtr: direction=IN, sw-pointer-target-props={implementation-data-type=uint8, sw-impl-policy=CONST}  # Contains the pointer to the data to be decrypted.
        dataLength: direction=IN, implementation-data-type=uint32  # Contains the number of bytes to decrypt.
        resultPtr: direction=OUT, sw-pointer-target-props=uint8  # Contains the pointer to the memory location where the decrypted data shall be stored.
        resultLengthPtr: direction=INOUT, sw-pointer-target-props=uint32  # Holds a pointer to the memory location in which the output length information is stored in bytes. On calling this function, this parameter shall contain the size of the buffer provided by resultPtr. When the request has finished, the actual length of the returned value shall be stored.
    Csm_Encrypt: service-id=0x5e, is-reentrant=true, is-synchronous=false, call-type=REGULAR  # Encrypts the given data and store the ciphertext in the memory location pointed by the result pointer.
      return type Std_ReturnType: implementation-data-type=Std_ReturnType
      6 x sw service arg:
        jobId: direction=IN, implementation-data-type=uint32  # Holds the identifier of the job using the CSM service.
        mode: direction=IN, implementation-data-type=Crypto_OperationModeType  # Indicates which operation mode(s) to perfom.
        dataPtr: direction=IN, sw-pointer-target-props={implementation-data-type=uint8, sw-impl-policy=CONST}  # Contains the pointer to the data to be encrypted.
        dataLength: direction=IN, implementation-data-type=uint32  # Contains the number of bytes to encrypt.
        resultPtr: direction=OUT, sw-pointer-target-props=uint8  # Contains the pointer to the data where the encrypted data shall be stored.
        resultLengthPtr: direction=INOUT, sw-pointer-target-props=uint32  # Holds a pointer to the memory location in which the output length information is stored in bytes. On calling this function, this parameter shall contain the size of the buffer provided by resultPtr. When the request has finished, the actual length of the returned value shall be stored.
    Csm_GetVersionInfo: service-id=0x3b, is-reentrant=true, is-synchronous=true, call-type=REGULAR  # Returns the version information of this module.
      sw service arg versioninfo: direction=OUT, sw-pointer-target-props=Std_VersionInfoType  # Pointer to where to store the version information of this module.
    Csm_Hash: service-id=0x5d, is-reentrant=true, is-synchronous=false, call-type=REGULAR  # Uses the given data to perform the hash calculation and stores the hash.
      return type Std_ReturnType: implementation-data-type=Std_ReturnType
      6 x sw service arg:
        jobId: direction=IN, implementation-data-type=uint32  # Holds the identifier of the job using the CSM service.
        mode: direction=IN, implementation-data-type=Crypto_OperationModeType  # Indicates which operation mode(s) to perfom.
        dataPtr: direction=IN, sw-pointer-target-props={implementation-data-type=uint8, sw-impl-policy=CONST}  # Contains the pointer to the data for which the hash shall be computed.
        dataLength: direction=IN, implementation-data-type=uint32  # Contains the number of bytes to be hashed.
        resultPtr: direction=OUT, sw-pointer-target-props=uint8  # Contains the pointer to the data where the hash value shall be stored.
        resultLengthPtr: direction=INOUT, sw-pointer-target-props=uint32  # Holds a pointer to the memory location in which the output length in bytes is stored. On calling this function, this parameter shall contain the size of the buffer provided by resultPtr. When the request has finished, the actual length of the returned value shall be stored.
    Csm_Init: service-id=0x00, is-reentrant=false, is-synchronous=true, call-type=REGULAR  # Initializes the CSM module.
      sw service arg configPtr: direction=IN, sw-pointer-target-props={implementation-data-type=Csm_ConfigType, sw-impl-policy=CONST}  # Pointer to a selected configuration structure
    Csm_JobKeyDerive: service-id=0x7d, is-reentrant=true, is-synchronous=false, call-type=REGULAR  # Derives a new key by using the key elements in the given key identified by the keyId. The given key contains the key elements for the password and salt. The derived key is stored in the key element with the id 1 of the key identified by targetCryptoKeyId.
      return type Std_ReturnType: implementation-data-type=Std_ReturnType
      sw service arg jobId: direction=IN, implementation-data-type=uint32  # Holds the identifier of the job using the CSM service.
      sw service arg keyId: direction=IN, implementation-data-type=uint32  # Holds the identifier of the key which is used for key derivation.
      sw service arg targetKeyId: direction=IN, implementation-data-type=uint32  # Holds the identifier of the key which is used to store the derived key.
    Csm_JobKeyExchangeCalcPubVal: service-id=0x7e, is-reentrant=true, is-synchronous=false, call-type=REGULAR  # Calculates the public value of the current user for the key exchange and stores the public key in the memory location pointed by the public value pointer.
      return type Std_ReturnType: implementation-data-type=Std_ReturnType
      4 x sw service arg:
        jobId: direction=IN, implementation-data-type=uint32  # Holds the identifier of the job using the CSM service.
        keyId: direction=IN, implementation-data-type=uint32  # Holds the identifier of the key which shall be used for the key exchange protocol.
        publicValuePtr: direction=IN, sw-pointer-target-props=uint8  # Contains the pointer to the data where the public value shall be stored.
        publicValueLengthPtr: direction=OUT, sw-pointer-target-props=uint32  # Holds a pointer to the memory location in which the public value length information is stored. On calling this function, this parameter shall contain the size of the buffer provided by publicValuePtr. When the request has finished, the actual length of the returned value shall be stored.
    Csm_JobKeyExchangeCalcSecret: service-id=0x7f, is-reentrant=true, is-synchronous=false, call-type=REGULAR  # Calculates the shared secret key for the key exchange with the key material of the key identified by the keyId and the partner public key. The shared secret key is stored as a key element in the same key.
      return type Std_ReturnType: implementation-data-type=Std_ReturnType
      4 x sw service arg, all with direction=IN:
        jobId: implementation-data-type=uint32  # Holds the identifier of the job using the CSM service.
        keyId: implementation-data-type=uint32  # Holds the identifier of the key which shall be used for the key exchange protocol.
        partnerPublicValuePtr: sw-pointer-target-props={implementation-data-type=uint8, sw-impl-policy=CONST}  # Holds the pointer to the memory location which contains the partner's public value.
        partnerPublicValueLength: implementation-data-type=uint32  # Contains the length of the partner's public value in bytes.
    Csm_JobKeyGenerate: service-id=0x7c, is-reentrant=true, is-synchronous=false, call-type=REGULAR  # Generates new key material and stores it in the key identified by keyId.
      return type Std_ReturnType: implementation-data-type=Std_ReturnType
      sw service arg jobId: direction=IN, implementation-data-type=uint32  # Holds the identifier of the job using the CSM service.
      sw service arg keyId: direction=IN, implementation-data-type=uint32  # Holds the identifier of the key for which a new material shall be generated.
    Csm_JobKeySetValid: service-id=0x7a, is-reentrant=true, is-synchronous=false, call-type=REGULAR  # Stores the key if necessary and sets the key state of the key identified by keyId to valid.
      return type Std_ReturnType: implementation-data-type=Std_ReturnType
      sw service arg jobId: direction=IN, implementation-data-type=uint32  # Holds the identifier of the job using the CSM service.
      sw service arg keyId: direction=IN, implementation-data-type=uint32  # Holds the identifier of the key for which a new material shall be validated.
    Csm_JobRandomSeed: service-id=0x7b, is-reentrant=true, is-synchronous=false, call-type=REGULAR  # This function shall dispatch the random seed function to the configured crypto driver object.
      return type Std_ReturnType: implementation-data-type=Std_ReturnType
      4 x sw service arg, all with direction=IN:
        jobId: implementation-data-type=uint32  # Holds the identifier of the job using the CSM service.
        keyId: implementation-data-type=uint32  # Holds the identifier of the key for which a new seed shall be generated.
        seedPtr: sw-pointer-target-props={implementation-data-type=uint8, sw-impl-policy=CONST}  # Holds a pointer to the memory location which contains the data to feed the seed.
        seedLength: implementation-data-type=uint32  # Contains the length of the seed in bytes.
    Csm_KeyCopy: service-id=0x73, is-reentrant=true, is-synchronous=true, call-type=REGULAR  # This function shall copy all key elements from the source key to a target key.
      return type Std_ReturnType: implementation-data-type=Std_ReturnType
      sw service arg keyId: direction=IN, implementation-data-type=uint32, sw-impl-policy=CONST  # Holds the identifier of the key whose key element shall be the source element.
      sw service arg targetKeyId: direction=IN, implementation-data-type=uint32, sw-impl-policy=CONST  # Holds the identifier of the key whose key element shall be the destination element.
    Csm_KeyDerive: service-id=0x6b, is-reentrant=true, is-synchronous=true, call-type=REGULAR  # Derives a new key by using the key elements in the given key identified by the keyId. The given key contains the key elements for the password and salt. The derived key is stored in the key element with the id 1 of the key identified by targetCryptoKeyId.
      return type Std_ReturnType: implementation-data-type=Std_ReturnType
      sw service arg keyId: direction=IN, implementation-data-type=uint32  # Holds the identifier of the key which is used for key derivation.
      sw service arg targetKeyId: direction=IN, implementation-data-type=uint32  # Holds the identifier of the key which is used to store the derived key.
    Csm_KeyElementCopy: service-id=0x71, is-reentrant=true, is-synchronous=true, call-type=REGULAR  # This function shall copy a key elements from one key to a target key.
      return type Std_ReturnType: implementation-data-type=Std_ReturnType
      4 x sw service arg, all with direction=IN, implementation-data-type=uint32, sw-impl-policy=CONST:
        keyId  # Holds the identifier of the key whose key element shall be the source element.
        keyElementId  # Holds the identifier of the key element which shall be the source for the copy operation.
        targetKeyId  # Holds the identifier of the key whose key element shall be the destination element.
        targetKeyElementId  # Holds the identifier of the key element which shall be the destination for the copy operation.
    Csm_KeyElementCopyPartial: service-id=0x79, is-reentrant=true, is-synchronous=true, call-type=REGULAR  # Copies a key element to another key element in the same crypto driver. The keyElementSourceOffset and keyElementCopyLength allows to copy just a part of the source key element into the destination. The offset into the target key is also specified with this function.
      return type Std_ReturnType: implementation-data-type=Std_ReturnType
      7 x sw service arg, all with direction=IN, implementation-data-type=uint32:
        keyId  # Holds the identifier of the key whose key element shall be the source element for copy operation.
        keyElementId  # Holds the identifier of the key element which shall be the source for the copy operation.
        keyElementSourceOffset  # This is the offset of the source key element indicating the start index of the copy operation.
        keyElementTargetOffset  # This is the offset of the destination key element indicating the start index of the copy operation.
        keyElementCopyLength  # Specifies the number of bytes that shall be copied.
        targetKeyId  # Holds the identifier of the key whose key element shall be the destination element.
        targetKeyElementId  # Holds the identifier of the key element which shall be the destination for the copy operation.
    Csm_KeyElementGet: service-id=0x68, is-reentrant=true, is-synchronous=true, call-type=REGULAR  # Retrieves the key element bytes from a specific key element of the key identified by the keyId and stores the key element in the memory location pointed by the key pointer.
      return type Std_ReturnType: implementation-data-type=Std_ReturnType
      4 x sw service arg:
        keyId: direction=IN, implementation-data-type=uint32  # Holds the identifier of the key from which a key element shall be extracted.
        keyElementId: direction=IN, implementation-data-type=uint32  # Holds the identifier of the key element to be extracted.
        keyPtr: direction=OUT, sw-pointer-target-props=uint8  # Holds the pointer to the memory location where the key shall be copied to.
        keyLengthPtr: direction=INOUT, sw-pointer-target-props=uint32  # Holds a pointer to the memory location in which the output buffer length in bytes is stored. On calling this function, this parameter shall contain the buffer length in bytes of the keyPtr. When the request has finished, the actual size of the written input bytes shall be stored.
    Csm_KeyElementSet: service-id=0x78, is-reentrant=false, is-synchronous=true, call-type=REGULAR  # Sets the given key element bytes to the key identified by keyId.
      return type Std_ReturnType: implementation-data-type=Std_ReturnType
      4 x sw service arg, all with direction=IN:
        keyId: implementation-data-type=uint32  # Holds the identifier of the key for which a new material shall be set.
        keyElementId: implementation-data-type=uint32  # Holds the identifier of the key element to be written.
        keyPtr: sw-pointer-target-props={implementation-data-type=uint8, sw-impl-policy=CONST}  # Holds the pointer to the key element bytes to be processed.
        keyLength: implementation-data-type=uint32  # Contains the number of key element bytes.
    Csm_KeyExchangeCalcPubVal: service-id=0x6c, is-reentrant=true, is-synchronous=true, call-type=REGULAR  # Calculates the public value of the current user for the key exchange and stores the public key in the memory location pointed by the public value pointer.
      return type Std_ReturnType: implementation-data-type=Std_ReturnType
      sw service arg keyId: direction=IN, implementation-data-type=uint32  # Holds the identifier of the key which shall be used for the key exchange protocol.
      sw service arg publicValuePtr: direction=OUT, sw-pointer-target-props=uint8  # Contains the pointer to the data where the public value shall be stored.
      sw service arg publicValueLengthPtr: direction=INOUT, sw-pointer-target-props=uint32  # Holds a pointer to the memory location in which the public value length information is stored. On calling this function, this parameter shall contain the size of the buffer provided by publicValuePtr. When the request has finished, the actual length of the returned value shall be stored.
    Csm_KeyExchangeCalcSecret: service-id=0x6d, is-reentrant=true, is-synchronous=true, call-type=REGULAR  # Calculates the shared secret key for the key exchange with the key material of the key identified by the keyId and the partner public key. The shared secret key is stored as a key element in the same key.
      return type Std_ReturnType: implementation-data-type=Std_ReturnType
      sw service arg keyId: direction=IN, implementation-data-type=uint32  # Holds the identifier of the key which shall be used for the key exchange protocol.
      sw service arg partnerPublicValuePtr: direction=IN, sw-pointer-target-props={implementation-data-type=uint8, sw-impl-policy=CONST}  # Holds the pointer to the memory location which contains the partner's public value.
      sw service arg partnerPublicValueLength: direction=IN, implementation-data-type=uint32  # Contains the length of the partner's public value in bytes.
    Csm_KeyGenerate: service-id=0x6a, is-reentrant=true, is-synchronous=true, call-type=REGULAR  # Generates new key material and store it in the key identified by keyId.
      return type Std_ReturnType: implementation-data-type=Std_ReturnType
      sw service arg keyId: direction=IN, implementation-data-type=uint32  # Holds the identifier of the key for which a new material shall be generated.
    Csm_KeySetValid: service-id=0x67, is-reentrant=false, is-synchronous=true, call-type=REGULAR  # Sets the key state of the key identified by keyId to valid.
      return type Std_ReturnType: implementation-data-type=Std_ReturnType
      sw service arg keyId: direction=IN, implementation-data-type=uint32  # Holds the identifier of the key for which a new material shall be validated.
    Csm_MacGenerate: service-id=0x60, is-reentrant=true, is-synchronous=false, call-type=REGULAR  # Uses the given data to perform a MAC generation and stores the MAC in the memory location pointed to by the MAC pointer.
      return type Std_ReturnType: implementation-data-type=Std_ReturnType
      6 x sw service arg:
        jobId: direction=IN, implementation-data-type=uint32  # Holds the identifier of the job using the CSM service.
        mode: direction=IN, implementation-data-type=Crypto_OperationModeType  # Indicates which operation mode(s) to perfom.
        dataPtr: direction=IN, sw-pointer-target-props={implementation-data-type=uint8, sw-impl-policy=CONST}  # Contains the pointer to the data for which the MAC shall be computed.
        dataLength: direction=IN, implementation-data-type=uint32  # Contains the number of bytes to be hashed.
        macPtr: direction=OUT, sw-pointer-target-props=uint8  # Contains the pointer to the data where the MAC shall be stored.
        macLengthPtr: direction=INOUT, sw-pointer-target-props=uint32  # Holds a pointer to the memory location in which the output length in bytes is stored. On calling this function, this parameter shall contain the size of the buffer provided by macPtr. When the request has finished, the actual length of the returned MAC shall be stored.
    Csm_MacVerify: service-id=0x61, is-reentrant=true, is-synchronous=false, call-type=REGULAR  # Verifies the given MAC by comparing if the MAC is generated with the given data.
      return type Std_ReturnType: implementation-data-type=Std_ReturnType
      7 x sw service arg:
        jobId: direction=IN, implementation-data-type=uint32  # Indicates which operation mode(s) to perfom.
        mode: direction=IN, implementation-data-type=Crypto_OperationModeType  # Indicates which operation mode(s) to perfom.
        dataPtr: direction=IN, sw-pointer-target-props={implementation-data-type=uint8, sw-impl-policy=CONST}  # Holds a pointer to the data for which the MAC shall be verified.
        dataLength: direction=IN, implementation-data-type=uint32  # Contains the number of data bytes for which the MAC shall be verified.
        macPtr: direction=IN, sw-pointer-target-props={implementation-data-type=uint8, sw-impl-policy=CONST}  # Holds a pointer to the MAC to be verified.
        macLength: direction=IN, implementation-data-type=uint32, sw-impl-policy=CONST  # Contains the MAC length in BITS to be verified.
        verifyPtr: direction=OUT, sw-pointer-target-props=Crypto_VerifyResultType  # Holds a pointer to the memory location, which will hold the result of the MAC verification.
    Csm_MainFunction: service-id=0x01, is-reentrant=false, is-synchronous=true, call-type=SCHEDULED  # API to be called cyclically to process the requested jobs. The Csm_MainFunction shall check the queues for jobs to pass to the underlying CRYIF.
    Csm_RandomGenerate: service-id=0x72, is-reentrant=true, is-synchronous=false, call-type=REGULAR  # Generate a random number and stores it in the memory location pointed by the result pointer.
      return type Std_ReturnType: implementation-data-type=Std_ReturnType
      sw service arg jobId: direction=IN, implementation-data-type=uint32  # Holds the identifier of the job using the CSM service.
      sw service arg resultPtr: direction=OUT, sw-pointer-target-props=uint8  # Holds a pointer to the memory location which will hold the result of the random number generation.
      sw service arg resultLengthPtr: direction=INOUT, sw-pointer-target-props=uint32  # Holds a pointer to the memory location in which the result length in bytes is stored. On calling this function, this parameter shall contain the number of random bytes, which shall be stored to the buffer provided by resultPtr. When the request has finished, the actual length of the returned value shall be stored.
    Csm_RandomSeed: service-id=0x69, is-reentrant=true, is-synchronous=true, call-type=REGULAR  # Feeds the key element CRYPTO_KE_RANDOM_SEED with a random seed.
      return type Std_ReturnType: implementation-data-type=Std_ReturnType
      sw service arg keyId: direction=IN, implementation-data-type=uint32  # Holds the identifier of the key for which a new seed shall be generated.
      sw service arg seedPtr: direction=IN, sw-pointer-target-props={implementation-data-type=uint8, sw-impl-policy=CONST}  # Holds a pointer to the memory location which contains the data to feed the seed.
      sw service arg seedLength: direction=IN, implementation-data-type=uint32  # Contains the length of the seed in bytes.
    Csm_SignatureGenerate: service-id=0x76, is-reentrant=true, is-synchronous=false, call-type=REGULAR  # Uses the given data to perform the signature calculation and stores the signature in the memory location pointed by the result pointer.
      return type Std_ReturnType: implementation-data-type=Std_ReturnType
      6 x sw service arg:
        jobId: direction=IN, implementation-data-type=uint32  # Holds the identifier of the job using the CSM service.
        mode: direction=IN, implementation-data-type=Crypto_OperationModeType  # Indicates which operation mode(s) to perform.
        dataPtr: direction=IN, sw-pointer-target-props={implementation-data-type=uint8, sw-impl-policy=CONST}  # Contains the pointer to the data to be signed.
        dataLength: direction=IN, implementation-data-type=uint32  # Contains the number of bytes to sign.
        resultPtr: direction=OUT, sw-pointer-target-props=uint8  # Contains the pointer to the data where the signature shall be stored.
        resultLengthPtr: direction=INOUT, sw-pointer-target-props=uint32  # Holds a pointer to the memory location in which the output length in bytes of the signature is stored. On calling this function, this parameter shall contain the size of the buffer provided by resultPtr. When the request has finished, the actual length of the returned value shall be stored.
    Csm_SignatureVerify: service-id=0x64, is-reentrant=true, is-synchronous=false, call-type=REGULAR  # Verifies the given MAC by comparing if the signature is generated with the given data.
      return type Std_ReturnType: implementation-data-type=Std_ReturnType
      7 x sw service arg:
        jobId: direction=IN, implementation-data-type=uint32  # Holds the identifier of the job using the CSM service.
        mode: direction=IN, implementation-data-type=Crypto_OperationModeType  # The Crypto_JobInfoType job with the corresponding jobId shall be modified in the following way:
        dataPtr: direction=IN, sw-pointer-target-props={implementation-data-type=uint8, sw-impl-policy=CONST}  # Contains the pointer to the data to be verified.
        dataLength: direction=IN, implementation-data-type=uint32  # Contains the number of data bytes.
        signaturePtr: direction=IN, sw-pointer-target-props={implementation-data-type=uint8, sw-impl-policy=CONST}  # Holds a pointer to the signature to be verified.
        signatureLength: direction=IN, implementation-data-type=uint32  # Contains the signature length in bytes.
        verifyPtr: direction=OUT, sw-pointer-target-props=Crypto_VerifyResultType  # Holds a pointer to the memory location, which will hold the result of the signature verification.
