AUTOSAR XML (schema 00047)
# (C) 2021 HYUNDAI AUTOEVER Corp.
package /Bsw_LinIf
  bsw implementation BswImplementation_LinIf: programming-language=C, sw-version=1.0.15, vendor-id=76, ar-release-version=4.4.0, behavior=BswInternalBehavior_LinIf, vendor-specific-module-def=LinIf
    code-descriptors:
      code Code_LinIf
        artifact-descriptors:
          short-label=LinIf, category=SWHDR
          short-label=LinIf, category=SWSRC
          short-label=LinIf_Cfg, category=SWHDR
          short-label=LinIf_Cfg, category=SWSRC
          short-label=LinIf_Ram, category=SWHDR
          short-label=LinIf_Ram, category=SWSRC
          short-label=LinIf_SubProcess, category=SWHDR
          short-label=LinIf_SubProcess, category=SWSRC
          short-label=LinIf_Version, category=SWHDR
          short-label=LinIf_Version, category=SWSRC
          short-label=LinTp, category=SWHDR
          short-label=LinTp, category=SWSRC
          short-label=LinTp_Ram, category=SWHDR
          short-label=LinTp_Ram, category=SWSRC
          short-label=LinTp_Rx, category=SWHDR
          short-label=LinTp_Rx, category=SWSRC
          short-label=LinTp_Tx, category=SWHDR
          short-label=LinTp_Tx, category=SWSRC
          short-label=LinIf_Types, category=SWHDR
          short-label=LinIf_PCTypes, category=SWHDR
          short-label=LinTp_PCTypes, category=SWHDR
  bsw module description LinIf: implemented-entrys=LinIf_Init, module-id=62
    bsw module dependency LinSM: target-module-id=12
    bsw module dependency LinTrcv: target-module-id=11
    bsw internal behavior BswInternalBehavior_LinIf
      5 x exclusive area:
        CHANNEL_STATUS_PROTECTION
        SLEEP_REQUEST_STATUS_PROTECTION
        SPORADIC_STATUS_PROTECTION
        STATUS_PROTECTION
        WAKEUP_CONFCOUNT_PROTECTION
      exclusive-area-policys:
        api-principle=COMMON, exclusive-area=WAKEUP_CONFCOUNT_PROTECTION
        api-principle=COMMON, exclusive-area=CHANNEL_STATUS_PROTECTION
        api-principle=COMMON, exclusive-area=SLEEP_REQUEST_STATUS_PROTECTION
        api-principle=COMMON, exclusive-area=STATUS_PROTECTION
        api-principle=COMMON, exclusive-area=SPORADIC_STATUS_PROTECTION
      bsw schedulable entity BswSE_LinIf_MainFunction_LinIfChannel_LIN1: can-enter-exclusive-area=[CHANNEL_STATUS_PROTECTION, SLEEP_REQUEST_STATUS_PROTECTION, SPORADIC_STATUS_PROTECTION, STATUS_PROTECTION, WAKEUP_CONFCOUNT_PROTECTION], reentrancy-level=NON-REENTRANT, implemented-entry=LinIf_MainFunction_LinIfChannel_LIN1
      bsw schedulable entity BswSE_LinIf_MainFunction_LinIfChannel_LIN2: can-enter-exclusive-area=[CHANNEL_STATUS_PROTECTION, SLEEP_REQUEST_STATUS_PROTECTION, SPORADIC_STATUS_PROTECTION, STATUS_PROTECTION, WAKEUP_CONFCOUNT_PROTECTION], reentrancy-level=NON-REENTRANT, implemented-entry=LinIf_MainFunction_LinIfChannel_LIN2
      bsw timing event BswTE_LinIf_MainFunction_LinIfChannel_LIN1: starts-on-event=BswSE_LinIf_MainFunction_LinIfChannel_LIN1, period=0.005
      bsw timing event BswTE_LinIf_MainFunction_LinIfChannel_LIN2: starts-on-event=BswSE_LinIf_MainFunction_LinIfChannel_LIN2, period=0.005
      bsw distinguished partition BswDistinguishedPartition_LinIf
package /Bsw_LinIf/BswModuleEntries
  23 x bsw module entry, all with sw-service-impl-policy=STANDARD:
    LinIf_CheckWakeup: service-id=96, is-reentrant=true, is-synchronous=false, call-type=REGULAR
      return type Std_ReturnType: implementation-data-type=Std_ReturnType
      sw service arg WakeupSource: direction=IN, implementation-data-type=EcuM_WakeupSourceType
    LinIf_EnableBusMirroring: service-id=127, is-reentrant=true, is-synchronous=true, call-type=REGULAR
      return type Std_ReturnType: implementation-data-type=Std_ReturnType
      sw service arg Channel: direction=IN, implementation-data-type=NetworkHandleType
      sw service arg MirroringActive: direction=IN, implementation-data-type=boolean
    LinIf_GetConfiguredNAD: service-id=112, is-reentrant=false, is-synchronous=true, call-type=REGULAR
      return type Std_ReturnType: implementation-data-type=Std_ReturnType
      sw service arg Channel: direction=IN, implementation-data-type=NetworkHandleType
      sw service arg Nad: direction=OUT, implementation-data-type=uint8
    LinIf_GetPIDTable: service-id=114, is-reentrant=true, is-synchronous=true, call-type=REGULAR
      return type Std_ReturnType: implementation-data-type=Std_ReturnType
      sw service arg Channel: direction=IN, implementation-data-type=NetworkHandleType
      sw service arg PidBuffer: direction=OUT, implementation-data-type=Lin_FramePidType
      sw service arg PidBufferLength: direction=OUT, implementation-data-type=uint8
    LinIf_GetTrcvMode: service-id=9, is-reentrant=true, is-synchronous=true, call-type=REGULAR
      return type Std_ReturnType: implementation-data-type=Std_ReturnType
      sw service arg Channel: direction=IN, implementation-data-type=NetworkHandleType
      sw service arg TransceiverModePtr: direction=OUT
    LinIf_GetTrcvWakeupReason: service-id=10, is-reentrant=true, is-synchronous=true, call-type=REGULAR
      sw service arg Channel: direction=IN, implementation-data-type=NetworkHandleType
      sw service arg TrcvWuReasonPtr: direction=OUT, implementation-data-type=LinTrcv_TrcvWakeupReasonType
    LinIf_GetVersionInfo: service-id=3, is-reentrant=true, is-synchronous=true, call-type=REGULAR
      sw service arg versioninfo: direction=OUT, implementation-data-type=Std_VersionInfoType
    LinIf_GotoSleep: service-id=6, is-reentrant=false, is-synchronous=false, call-type=REGULAR
      return type Std_ReturnType: implementation-data-type=Std_ReturnType
      sw service arg Channel: direction=IN, implementation-data-type=NetworkHandleType
    LinIf_Init: service-id=0x01, is-reentrant=false, is-synchronous=true, call-type=REGULAR
      sw service arg ConfigPtr: direction=IN, implementation-data-type=LinIf_ConfigType
    LinIf_MainFunction_LinIfChannel_LIN1: is-reentrant=true, is-synchronous=false, call-type=SCHEDULED  # Cyclic Main Function which is called from the Scheduler.
    LinIf_MainFunction_LinIfChannel_LIN2: is-reentrant=true, is-synchronous=false, call-type=SCHEDULED  # Cyclic Main Function which is called from the Scheduler.
    LinIf_ScheduleRequest: service-id=5, is-reentrant=true, is-synchronous=false, call-type=REGULAR
      return type Std_ReturnType: implementation-data-type=Std_ReturnType
      sw service arg Channel: direction=IN, implementation-data-type=NetworkHandleType
      sw service arg Schedule: direction=IN, implementation-data-type=LinIf_SchHandleType
    LinIf_SetConfiguredNAD: service-id=113, is-reentrant=false, is-synchronous=true, call-type=REGULAR
      sw service arg Channel: direction=IN, implementation-data-type=NetworkHandleType
      sw service arg Nad: direction=IN, implementation-data-type=uint8
    LinIf_SetPIDTable: service-id=115, is-reentrant=false, is-synchronous=true, call-type=REGULAR
      return type Std_ReturnType: implementation-data-type=Std_ReturnType
      sw service arg Channel: direction=IN, implementation-data-type=NetworkHandleType
      sw service arg PidBuffer: direction=IN, implementation-data-type=Lin_FramePidType
      sw service arg PidBufferLength: direction=IN, implementation-data-type=uint8
    LinIf_SetTrcvMode: service-id=8, is-reentrant=true, is-synchronous=true, call-type=REGULAR
      sw service arg Channel: direction=IN, implementation-data-type=NetworkHandleType
      sw service arg TransceiverMode: direction=IN, implementation-data-type=LinTrcv_TrcvModeType
    LinIf_SetTrcvWakeupMode: service-id=11, is-reentrant=true, is-synchronous=true, call-type=REGULAR
      sw service arg Channel: direction=IN, implementation-data-type=NetworkHandleType
      sw service arg LinTrcvWakeupMode: direction=IN, implementation-data-type=LinTrcv_TrcvWakeupModeType
    LinIf_Transmit: service-id=73, is-reentrant=false, is-synchronous=true, call-type=REGULAR
      sw service arg TxPduId: direction=IN, implementation-data-type=PduIdType
      sw service arg PduInfoPtr: direction=IN, implementation-data-type=PduInfoType
    LinIf_Wakeup: service-id=7, is-reentrant=true, is-synchronous=false, call-type=REGULAR
      sw service arg Channel: direction=IN, implementation-data-type=NetworkHandleType
    LinTp_ChangeParameter: service-id=75, is-reentrant=false, is-synchronous=true, call-type=REGULAR
      sw service arg id: direction=IN, implementation-data-type=PduIdType
      sw service arg parameter: direction=IN, implementation-data-type=TPParameterType
      sw service arg value: direction=IN, implementation-data-type=uint16
    LinTp_GetVersionInfo: service-id=66, is-reentrant=false, is-synchronous=true, call-type=REGULAR
      sw service arg versioninfo: direction=OUT, implementation-data-type=Std_VersionInfoType
    LinTp_Init: service-id=64, is-reentrant=false, is-synchronous=true, call-type=REGULAR
      sw service arg ConfigPtr: direction=IN, implementation-data-type=LinTp_ConfigType
    LinTp_Shutdown: service-id=67, is-reentrant=false, is-synchronous=true, call-type=REGULAR
    LinTp_Transmit: service-id=73, is-reentrant=false, is-synchronous=true, call-type=REGULAR
      sw service arg TxPduId: direction=IN, implementation-data-type=PduIdType
      sw service arg PduInfoPtr: direction=IN, implementation-data-type=PduInfoType
package /Bsw_LinIf/ImplementationDataTypes
  7 x impl type:
    LinIf_ConfigType: category=STRUCTURE, type-emitter=LinIf.h
      element u8Dummy: category=VALUE, base-type=uint8
      symbol props LinIf_ConfigType
    LinIf_SchHandleType: category=VALUE, base-type=uint8, data-constr=uint8, type-emitter=LinIf.h
    LinTp_ConfigType: category=STRUCTURE, type-emitter=LinTp.h
      element u8Dummy: category=VALUE, base-type=uint8
    LinTrcv_TrcvModeType: category=STRUCTURE, type-emitter=LinTrcv.h
      element u8Dummy: category=VALUE, base-type=uint8
    LinTrcv_TrcvWakeupModeType: category=STRUCTURE, type-emitter=Lin_GeneralTypes.h
      element u8Dummy: category=VALUE, base-type=uint8
    LinTrcv_TrcvWakeupReasonType: category=STRUCTURE, type-emitter=Lin_GeneralTypes.h
      element u8Dummy: category=VALUE, base-type=uint8
    Lin_FramePidType: category=VALUE, base-type=uint8, data-constr=uint8, type-emitter=Lin_GeneralTypes.h
