AUTOSAR XML (schema 00047)
package /Bsw_StbM
  bsw implementation BswImplementation_StbM: programming-language=C, sw-version=1.0.7, swc-bsw-mapping=SwcBswMapping_StbM, vendor-id=76, ar-release-version=4.4.0, behavior=BswInternalBehavior_StbM
  bsw module description StbM: category=BSW_MODULE, module-id=160
    bsw module dependency BswModuleDependency_EthIf: target-module-id=65
    bsw module dependency BswModuleDependency_Gpt: target-module-id=100
    bsw module dependency BswModuleDependency_Os: target-module-id=1
    bsw internal behavior BswInternalBehavior_StbM: bsw-exclusive-area-policy{api-principle=COMMON, exclusive-area=RAM_DATA_PROTECTION}
      exclusive area RAM_DATA_PROTECTION
      20 x bsw called entity:
        BswCE_StbM_BusGetCurrentTime: implemented-entry=StbM_BusGetCurrentTime
        BswCE_StbM_BusSetGlobalTime: can-enter-exclusive-area=RAM_DATA_PROTECTION, implemented-entry=StbM_BusSetGlobalTime
        BswCE_StbM_GetCurrentTime: implemented-entry=StbM_GetCurrentTime
        BswCE_StbM_GetCurrentTimeExtended: implemented-entry=StbM_GetCurrentTimeExtended
        BswCE_StbM_GetCurrentVirtualLocalTime: implemented-entry=StbM_GetCurrentVirtualLocalTime
        BswCE_StbM_GetMasterConfig: implemented-entry=StbM_GetMasterConfig
        BswCE_StbM_GetOffset: implemented-entry=StbM_GetOffset
        BswCE_StbM_GetOffsetTimeRecordHead: implemented-entry=StbM_GetOffsetTimeRecordHead
        BswCE_StbM_GetRateDeviation: implemented-entry=StbM_GetRateDeviation
        BswCE_StbM_GetSyncTimeRecordHead: implemented-entry=StbM_GetSyncTimeRecordHead
        BswCE_StbM_GetTimeBaseStatus: implemented-entry=StbM_GetTimeBaseStatus
        BswCE_StbM_GetTimeBaseUpdateCounter: implemented-entry=StbM_GetTimeBaseUpdateCounter
        BswCE_StbM_GetTimeLeap: implemented-entry=StbM_GetTimeLeap
        BswCE_StbM_SetGlobalTime: can-enter-exclusive-area=RAM_DATA_PROTECTION, implemented-entry=StbM_SetGlobalTime
        BswCE_StbM_SetOffset: can-enter-exclusive-area=RAM_DATA_PROTECTION, implemented-entry=StbM_SetOffset
        BswCE_StbM_SetRateCorrection: can-enter-exclusive-area=RAM_DATA_PROTECTION, implemented-entry=StbM_SetRateCorrection
        BswCE_StbM_SetUserData: implemented-entry=StbM_SetUserData
        BswCE_StbM_StartTimer: implemented-entry=StbM_StartTimer
        BswCE_StbM_TriggerTimeTransmission: implemented-entry=StbM_TriggerTimeTransmission
        BswCE_StbM_UpdateGlobalTime: can-enter-exclusive-area=RAM_DATA_PROTECTION, implemented-entry=StbM_UpdateGlobalTime
      bsw schedulable entity BswSE_StbM_MainFunction: can-enter-exclusive-area=RAM_DATA_PROTECTION, minimum-start-interval=0.005, implemented-entry=StbM_MainFunction
      bsw timing event BswTE_StbM_MainFunction: starts-on-event=BswSE_StbM_MainFunction, period=0.01
      bsw distinguished partition BswDistinguishedPartition_StbM
package /Bsw_StbM/ExpectedEntries
  5 x bsw module entry, all with is-synchronous=true, call-type=CALLOUT, execution-context=TASK, sw-service-impl-policy=STANDARD, bsw-entry-kind=CONCRETE:
    EthIf_GetCurrentTime: service-id=34, is-reentrant=false
      return type Std_ReturnType: direction=OUT
      sw service arg CtrlIdx: direction=IN
      sw service arg timeQualPtr: direction=OUT
      sw service arg timeStampPtr: direction=OUT
    GetCounterValue: service-id=16, is-reentrant=true
      return type StatusType: direction=OUT
      sw service arg CounterID: direction=IN
      sw service arg Value: direction=OUT
    GetScheduleTableStatus: service-id=15, is-reentrant=true
      return type StatusType: direction=OUT
      sw service arg ScheduleTableID: direction=IN
      sw service arg ScheduleStatus: direction=OUT
    Gpt_StartTimer: service-id=5, is-reentrant=true
      sw service arg Channel: direction=IN
      sw service arg Value: direction=IN
    SyncScheduleTable: service-id=12, is-reentrant=true
      return type StatusType: direction=OUT
      sw service arg ScheduleTableID: direction=IN
      sw service arg Value: direction=IN
package /Bsw_StbM/ImplementedEntries/StbMBswComponents
  bsw module entry StbM_GetVersionInfo: service-id=5, is-reentrant=true, is-synchronous=true, call-type=REGULAR, execution-context=UNSPECIFIED, sw-service-impl-policy=STANDARD, bsw-entry-kind=CONCRETE
    sw service arg versionInfo: direction=OUT
  bsw module entry StbM_Init: service-id=0, is-reentrant=false, is-synchronous=true, call-type=REGULAR, execution-context=TASK, sw-service-impl-policy=STANDARD, bsw-entry-kind=CONCRETE
    sw service arg ConfigPtr: direction=IN
package /Bsw_StbM/ImplementedEntries/StbMSchedules
  bsw module entry StbM_MainFunction: service-id=4, is-reentrant=false, is-synchronous=false, call-type=SCHEDULED, execution-context=TASK, sw-service-impl-policy=STANDARD, bsw-entry-kind=CONCRETE
package /Bsw_StbM/ImplementedEntries/StbMSwComponents
  20 x bsw module entry, all with is-reentrant=true, is-synchronous=true, call-type=REGULAR, execution-context=UNSPECIFIED, sw-service-impl-policy=STANDARD, bsw-entry-kind=CONCRETE:
    StbM_BusGetCurrentTime: service-id=7
      return type Std_ReturnType: direction=OUT
      4 x sw service arg:
        timeBaseId: direction=IN
        globalTimePtr: direction=OUT
        localTimePtr: direction=OUT
        userData: direction=OUT
    StbM_BusSetGlobalTime: service-id=15
      return type Std_ReturnType: direction=OUT
      5 x sw service arg, all with direction=IN:
        timeBaseId
        globalTimePtr
        userData
        localTimePtr
        measureDataPtr
    StbM_GetCurrentTime: service-id=7
      return type Std_ReturnType: direction=OUT
      sw service arg timeBaseId: direction=IN
      sw service arg timeStamp: direction=OUT
      sw service arg userData: direction=OUT
    StbM_GetCurrentTimeExtended: service-id=8
      return type Std_ReturnType: direction=OUT
      sw service arg timeBaseId: direction=IN
      sw service arg timeStamp: direction=OUT
      sw service arg userData: direction=OUT
    StbM_GetCurrentVirtualLocalTime: service-id=30
      return type Std_ReturnType: direction=OUT
      sw service arg timeBaseId: category=TYPE_REFERENCE, direction=IN
      sw service arg localTimePtr: category=DATA_REFERENCE, direction=OUT
    StbM_GetMasterConfig: service-id=30
      return type Std_ReturnType: direction=OUT
      sw service arg timeBaseId: direction=IN
      sw service arg masterConfig: direction=OUT
    StbM_GetOffset: service-id=14
      return type Std_ReturnType: direction=OUT
      sw service arg timeBaseId: direction=IN
      sw service arg timeStamp: direction=OUT
      sw service arg userData: direction=OUT
    StbM_GetOffsetTimeRecordHead: service-id=23
      return type Std_ReturnType: direction=OUT
      sw service arg timeBaseId: direction=IN
      sw service arg offsetRecordTableHead: direction=OUT
    StbM_GetRateDeviation: service-id=17
      return type Std_ReturnType: direction=OUT
      sw service arg timeBaseId: direction=IN
      sw service arg rateDeviation: direction=OUT
    StbM_GetSyncTimeRecordHead: service-id=22
      return type Std_ReturnType: direction=OUT
      sw service arg timeBaseId: direction=IN
      sw service arg syncRecordTableHead: direction=OUT
    StbM_GetTimeBaseStatus: service-id=20
      return type Std_ReturnType: direction=OUT
      sw service arg timeBaseId: direction=IN
      sw service arg syncTimeBaseStatus: direction=OUT
      sw service arg offsetTimeBaseStatus: direction=OUT
    StbM_GetTimeBaseUpdateCounter: service-id=27
      return type uint8: direction=OUT
      sw service arg timeBaseId: direction=IN
    StbM_GetTimeLeap: service-id=18
      return type Std_ReturnType: direction=OUT
      sw service arg timeBaseId: direction=IN
      sw service arg timeJump: direction=OUT
    StbM_SetGlobalTime: service-id=11
      return type Std_ReturnType: direction=OUT
      sw service arg timeBaseId: direction=IN
      sw service arg timeStamp: direction=IN
      sw service arg userData: direction=IN
    StbM_SetOffset: service-id=13
      return type Std_ReturnType: direction=OUT
      sw service arg timeBaseId: direction=IN
      sw service arg timeStamp: direction=IN
      sw service arg userData: direction=IN
    StbM_SetRateCorrection: service-id=18
      return type Std_ReturnType: direction=OUT
      sw service arg timeBaseId: direction=IN
      sw service arg rateDeviation: direction=IN
    StbM_SetUserData: service-id=12
      return type Std_ReturnType: direction=OUT
      sw service arg timeBaseId: direction=IN
      sw service arg userData: direction=IN
    StbM_StartTimer: service-id=21
      return type Std_ReturnType: direction=OUT
      sw service arg timeBaseId: direction=IN
      sw service arg syncTimeBaseStatus: direction=IN
      sw service arg expireTime: direction=IN
    StbM_TriggerTimeTransmission: service-id=28
      return type Std_ReturnType: direction=OUT
      sw service arg timeBaseId: direction=IN
    StbM_UpdateGlobalTime: service-id=16
      return type Std_ReturnType: direction=OUT
      sw service arg timeBaseId: direction=IN
      sw service arg timeStamp: direction=IN
      sw service arg userData: direction=IN
