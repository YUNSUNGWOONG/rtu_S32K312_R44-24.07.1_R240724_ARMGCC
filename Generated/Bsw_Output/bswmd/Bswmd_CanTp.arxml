AUTOSAR XML (schema 00047)
package /Bsw_CanTp
  bsw implementation BswImplementation_CanTp: programming-language=C, sw-version=1.1.0, swc-bsw-mapping=SwcBswMapping, vendor-id=76, ar-release-version=4.4.0, behavior=BswInternalBehavior_CanTp
    code-descriptors:
      code Code0
  bsw module description CanTp: category=LIBRARY, module-id=35
    implemented-entrys:
      CanTp_Init
      CanTp_GetVersionInfo
      CanTp_Transmit
      CanTp_Shutdown
      CanTp_CancelTransmit
      CanTp_CancelReceive
      CanTp_ChangeParameter
      CanTp_ReadParameter
      CanTp_RxIndication
      CanTp_TxConfirmation
      CanTp_MainFunction
    bsw module dependency BswModuleDependency0
    bsw internal behavior BswInternalBehavior_CanTp
      exclusive area TIMER_PROTECTION
      9 x bsw called entity:
        BswCE_CanTp_CancelReceive: implemented-entry=CanTp_CancelReceive
        BswCE_CanTp_CancelTransmit: implemented-entry=CanTp_CancelTransmit
        BswCE_CanTp_GetVersionInfo: implemented-entry=CanTp_GetVersionInfo
        BswCE_CanTp_Init: implemented-entry=CanTp_Init
        BswCE_CanTp_MainFunction: implemented-entry=CanTp_MainFunction
        BswCE_CanTp_RxIndication: implemented-entry=CanTp_RxIndication
        BswCE_CanTp_Shutdown: implemented-entry=CanTp_Shutdown
        BswCE_CanTp_Transmit: implemented-entry=CanTp_Transmit
        BswCE_CanTp_TxConfirmation: implemented-entry=CanTp_TxConfirmation
      bsw schedulable entity BswSE_CanTp_MainFunction: can-enter-exclusive-area=TIMER_PROTECTION, implemented-entry=CanTp_MainFunction
      bsw timing event BswTE_CanTp_MainFunction: context-limitation=BswDistinguishedPartition_CanTp, starts-on-event=BswSE_CanTp_MainFunction, period=0.005
      bsw distinguished partition BswDistinguishedPartition_CanTp
package /Bsw_CanTp/BswModuleEntries
  11 x bsw module entry, all with execution-context=UNSPECIFIED:
    CanTp_CancelReceive: service-id=76, is-reentrant=false, is-synchronous=true, call-type=REGULAR, sw-service-impl-policy=STANDARD
      return type Std_ReturnType: implementation-data-type=Std_ReturnType
      sw service arg RxPduId: direction=IN, implementation-data-type=PduIdType
    CanTp_CancelTransmit: service-id=74, is-reentrant=true, is-synchronous=true, call-type=REGULAR, sw-service-impl-policy=STANDARD
      return type Std_ReturnType: implementation-data-type=Std_ReturnType
      sw service arg TxPduId: direction=IN, implementation-data-type=PduIdType
    CanTp_ChangeParameter: service-id=75, is-reentrant=false, is-synchronous=true, call-type=REGULAR, sw-service-impl-policy=STANDARD
      return type Std_ReturnType: implementation-data-type=Std_ReturnType
      sw service arg id: direction=IN, implementation-data-type=PduIdType
      sw service arg parameter: direction=IN, implementation-data-type=TPParameterType
      sw service arg value: direction=IN, implementation-data-type=uint16
    CanTp_GetVersionInfo: service-id=7, is-reentrant=true, is-synchronous=true, call-type=REGULAR, sw-service-impl-policy=STANDARD
      sw service arg versioninfo: direction=OUT, sw-alignment=PTR, implementation-data-type=Std_VersionInfoType
    CanTp_Init: service-id=0, is-reentrant=false, is-synchronous=true, call-type=REGULAR, sw-service-impl-policy=INLINE-CONDITIONAL
      sw service arg CfgPtr: direction=IN, sw-alignment=PTR, implementation-data-type=CanTp_ConfigType, sw-impl-policy=CONST
    CanTp_MainFunction: service-id=6, call-type=SCHEDULED, sw-service-impl-policy=STANDARD
    CanTp_ReadParameter: service-id=11, is-reentrant=false, is-synchronous=true, call-type=REGULAR, sw-service-impl-policy=STANDARD
      return type Std_ReturnType: implementation-data-type=Std_ReturnType
      sw service arg id: direction=IN, implementation-data-type=PduIdType
      sw service arg parameter: direction=IN, implementation-data-type=TPParameterType
      sw service arg value: direction=OUT, sw-alignment=PTR, implementation-data-type=uint16
    CanTp_RxIndication: service-id=66, is-reentrant=true, is-synchronous=true, call-type=CALLBACK, sw-service-impl-policy=STANDARD
      sw service arg RxPduId: direction=IN, implementation-data-type=PduIdType
      sw service arg PduInfoPtr: direction=IN, sw-alignment=PTR, implementation-data-type=PduInfoType, sw-impl-policy=CONST
    CanTp_Shutdown: service-id=2, is-reentrant=false, is-synchronous=true, call-type=REGULAR, sw-service-impl-policy=STANDARD
    CanTp_Transmit: service-id=73, is-reentrant=true, is-synchronous=true, call-type=REGULAR, sw-service-impl-policy=STANDARD
      return type Std_ReturnType: implementation-data-type=Std_ReturnType
      sw service arg TxPduId: direction=IN, implementation-data-type=PduIdType
      sw service arg PduInfoPtr: direction=IN, sw-alignment=PTR, implementation-data-type=PduInfoType, sw-impl-policy=CONST
    CanTp_TxConfirmation: service-id=64, is-reentrant=true, is-synchronous=true, call-type=CALLBACK, sw-service-impl-policy=STANDARD
      sw service arg TxPduId: direction=IN, implementation-data-type=PduIdType
      sw service arg result: direction=IN, implementation-data-type=Std_ReturnType
