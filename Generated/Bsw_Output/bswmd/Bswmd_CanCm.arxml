AUTOSAR XML (schema 00047)
package /Bsw_CanCm
  bsw implementation BswImplementation_CanCM: programming-language=C, sw-version=1.0.8, vendor-id=76, ar-release-version=4.4.0, behavior=BswInternalBehavior_CanCM
  bsw module description CanCM: category=BSW_MODULE, module-id=502
    implemented-entrys:
      CanCM_Init
      CanCM_MainFunction
      CanCM_CheckWakeup
      CanCM_GetCurrentVoltageMode
      CanCM_GetVoltageFailCount
      CanCM_GetCurrentNetworkState
      CanCM_ComModeIndication
      CanCM_GetVersionInfo
    7 x bsw module dependency:
      BswM: target-module-id=13
      CanIf: target-module-id=14
      CanSM: target-module-id=15
      Dem: target-module-id=11
      Det: target-module-id=10
      EcuM: target-module-id=16
      IoHwAb: target-module-id=12
    required-mode-groups:
      mode declaration group prototype CanCM_EM_R: type=EcuMode
    bsw internal behavior BswInternalBehavior_CanCM: data-type-mapping=EcuModeMap
      exclusive area MAIN_PROTECTION
      bsw schedulable entity BswSE_CanCM_MainFunction: can-enter-exclusive-area=MAIN_PROTECTION, accessed-mode-groups=CanCM_EM_R, implemented-entry=CanCM_MainFunction
      bsw timing event BswTE_CanCM_MainFunction: context-limitation=BswDistinguishedPartition_CanCM, disabled-in-mode=[CanCM_EM_R.ECUM_STATE_STARTUP_ONE, CanCM_EM_R.ECUM_STATE_STARTUP_TWO], starts-on-event=BswSE_CanCM_MainFunction, period=0.005
      bsw distinguished partition BswDistinguishedPartition_CanCM
package /Bsw_CanCm/BswModuleEntries
  8 x bsw module entry, all with is-reentrant=false, is-synchronous=false, sw-service-impl-policy=STANDARD:
    CanCM_CheckWakeup: service-id=8, call-type=REGULAR, execution-context=UNSPECIFIED
      sw service arg source: direction=IN, implementation-data-type=EcuM_WakeupSourceType
    CanCM_ComModeIndication: service-id=3, call-type=CALLBACK, execution-context=UNSPECIFIED
      sw service arg channelIdComm: direction=IN, implementation-data-type=NetworkHandleType
      sw service arg commState: direction=IN, implementation-data-type=ComM_ModeType
    CanCM_GetCurrentNetworkState: service-id=5, call-type=REGULAR, execution-context=UNSPECIFIED
      sw service arg channelIdCanCm: direction=IN, implementation-data-type=NetworkHandleType
      sw service arg ptrCommStat: direction=OUT, sw-alignment=PTR, implementation-data-type=CanCM_CommStatType
    CanCM_GetCurrentVoltageMode: service-id=4, call-type=REGULAR, execution-context=UNSPECIFIED
      return type Std_ReturnType: implementation-data-type=Std_ReturnType
      sw service arg channelIdCanCm: direction=IN, implementation-data-type=CanCM_ChannelType
      sw service arg ptrVolMode: direction=OUT, sw-alignment=PTR, implementation-data-type=CanCM_VolModType
    CanCM_GetVersionInfo: service-id=7, call-type=REGULAR, execution-context=UNSPECIFIED
      sw service arg ptrVersionInfo: direction=OUT, sw-alignment=PTR, implementation-data-type=Std_VersionInfoType
    CanCM_GetVoltageFailCount: service-id=6, call-type=REGULAR, execution-context=UNSPECIFIED
      sw service arg ptrCount: direction=OUT, sw-alignment=PTR, implementation-data-type=uint16
    CanCM_Init: service-id=1, call-type=REGULAR, execution-context=UNSPECIFIED
    CanCM_MainFunction: service-id=2, call-type=SCHEDULED, execution-context=TASK
