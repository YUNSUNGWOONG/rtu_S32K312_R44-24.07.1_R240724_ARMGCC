AUTOSAR XML (schema 00047)
package /Bsw_Nm
  bsw implementation BswImplementation_Nm: programming-language=C, sw-version=1.0.5, vendor-id=76, ar-release-version=4.4.0, behavior=BswInternalBehavior_Nm
    code-descriptors:
      code Code_Nm
        artifact-descriptors:
          short-label=Nm.c, category=SWSRC
          short-label=Nm.h, category=SWHDR
          short-label=Nm_Globals.c, category=SWSRC
          short-label=Nm_Globals.h, category=SWHDR
          short-label=Nm_IntFunc.c, category=SWSRC
          short-label=Nm_IntFunc.h, category=SWHDR
          short-label=Nm_IntTypes.h, category=SWHDR
          short-label=Nm_Version.c, category=SWSRC
          short-label=Nm_Version.h, category=SWHDR
          short-label=NmStack_Types.h, category=SWHDR
          short-label=Nm_Dbg.h, category=SWHDR
          short-label=Nm_Cfg.c, category=SWSRC
          short-label=Nm_Cfg.h, category=SWHDR
  bsw module description Nm: module-id=29
    implemented-entrys:
      Nm_PassiveStartUp
      Nm_NetworkRequest
      Nm_NetworkRelease
      Nm_GetPduData
      Nm_RepeatMessageRequest
      Nm_GetNodeIdentifier
      Nm_GetLocalNodeIdentifier
      Nm_GetState
      Nm_NetworkStartIndication
      Nm_NetworkMode
      Nm_BusSleepMode
      Nm_PrepareBusSleepMode
      Nm_RepeatMessageIndication
      Nm_TxTimeoutException
      Nm_DisableCommunication
      Nm_EnableCommunication
      Nm_SetUserData
      Nm_GetUserData
      Nm_GetVersionInfo
    bsw module dependency BswModuleDependency_CanNm: target-module-id=31, target-module=CanNm
    bsw module dependency BswModuleDependency_ComM: target-module-id=12, target-module=ComM
    bsw module dependency BswModuleDependency_Det: target-module-id=15, target-module=Det
    bsw internal behavior BswInternalBehavior_Nm
      exclusive area UPDATE_NETWORK_STATUS_NW0
      19 x bsw called entity:
        BswCE_Nm_BusSleepMode: reentrancy-level=SINGLE-CORE-REENTRANT, implemented-entry=Nm_BusSleepMode
        BswCE_Nm_DisableCommunication: reentrancy-level=NON-REENTRANT, implemented-entry=Nm_DisableCommunication
        BswCE_Nm_EnableCommunication: reentrancy-level=NON-REENTRANT, implemented-entry=Nm_EnableCommunication
        BswCE_Nm_GetLocalNodeIdentifier: reentrancy-level=NON-REENTRANT, implemented-entry=Nm_GetLocalNodeIdentifier
        BswCE_Nm_GetNodeIdentifier: reentrancy-level=NON-REENTRANT, implemented-entry=Nm_GetNodeIdentifier
        BswCE_Nm_GetPduData: reentrancy-level=SINGLE-CORE-REENTRANT, implemented-entry=Nm_GetPduData
        BswCE_Nm_GetState: reentrancy-level=SINGLE-CORE-REENTRANT, implemented-entry=Nm_GetState
        BswCE_Nm_GetUserData: reentrancy-level=SINGLE-CORE-REENTRANT, implemented-entry=Nm_GetUserData
        BswCE_Nm_GetVersionInfo: reentrancy-level=NON-REENTRANT, implemented-entry=Nm_GetVersionInfo
        BswCE_Nm_NetworkMode: reentrancy-level=SINGLE-CORE-REENTRANT, implemented-entry=Nm_NetworkMode
        BswCE_Nm_NetworkRelease: reentrancy-level=NON-REENTRANT, implemented-entry=Nm_NetworkRelease
        BswCE_Nm_NetworkRequest: reentrancy-level=NON-REENTRANT, implemented-entry=Nm_NetworkRequest
        BswCE_Nm_NetworkStartIndication: reentrancy-level=SINGLE-CORE-REENTRANT, implemented-entry=Nm_NetworkStartIndication
        BswCE_Nm_PassiveStartUp: reentrancy-level=NON-REENTRANT, implemented-entry=Nm_PassiveStartUp
        BswCE_Nm_PrepareBusSleepMode: reentrancy-level=SINGLE-CORE-REENTRANT, implemented-entry=Nm_PrepareBusSleepMode
        BswCE_Nm_RepeatMessageIndication: reentrancy-level=SINGLE-CORE-REENTRANT, implemented-entry=Nm_RepeatMessageIndication
        BswCE_Nm_RepeatMessageRequest: reentrancy-level=NON-REENTRANT, implemented-entry=Nm_RepeatMessageRequest
        BswCE_Nm_SetUserData: reentrancy-level=NON-REENTRANT, implemented-entry=Nm_SetUserData
        BswCE_Nm_TxTimeoutException: reentrancy-level=SINGLE-CORE-REENTRANT, implemented-entry=Nm_TxTimeoutException
      bsw distinguished partition BswDistinguishedPartition_Nm
  19 x bsw module entry, all with execution-context=UNSPECIFIED, sw-service-impl-policy=STANDARD, bsw-entry-kind=CONCRETE:
    Nm_BusSleepMode: service-id=20, is-reentrant=true, is-synchronous=false, call-type=CALLBACK
      sw service arg nmNetworkHandle: direction=IN, implementation-data-type=NetworkHandleType
    Nm_DisableCommunication: service-id=4, is-reentrant=false, is-synchronous=false, call-type=REGULAR
      return type Std_ReturnType: implementation-data-type=Std_ReturnType
      sw service arg NetworkHandle: direction=IN, implementation-data-type=NetworkHandleType
    Nm_EnableCommunication: service-id=5, is-reentrant=false, is-synchronous=false, call-type=REGULAR
      return type Std_ReturnType: implementation-data-type=Std_ReturnType
      sw service arg NetworkHandle: direction=IN, implementation-data-type=NetworkHandleType
    Nm_GetLocalNodeIdentifier: service-id=11, is-reentrant=false, is-synchronous=true, call-type=REGULAR
      return type Std_ReturnType: implementation-data-type=Std_ReturnType
      sw service arg NetworkHandle: direction=IN, implementation-data-type=NetworkHandleType
      sw service arg nmNodeIdPtr: category=DATA_REFERENCE, direction=OUT, sw-pointer-target-props={target-category=TYPE_REFERENCE, implementation-data-type=uint8}
    Nm_GetNodeIdentifier: service-id=10, is-reentrant=true, is-synchronous=true, call-type=REGULAR
      return type Std_ReturnType: implementation-data-type=Std_ReturnType
      sw service arg NetworkHandle: direction=IN, implementation-data-type=NetworkHandleType
      sw service arg nmNodeIdPtr: category=DATA_REFERENCE, direction=OUT, sw-pointer-target-props={target-category=TYPE_REFERENCE, implementation-data-type=uint8}
    Nm_GetPduData: service-id=8, is-reentrant=true, is-synchronous=true, call-type=REGULAR
      return type Std_ReturnType: implementation-data-type=Std_ReturnType
      sw service arg NetworkHandle: direction=IN, implementation-data-type=NetworkHandleType
      sw service arg nmPduData: category=DATA_REFERENCE, direction=OUT, sw-pointer-target-props={target-category=TYPE_REFERENCE, implementation-data-type=uint8}
    Nm_GetState: service-id=14, is-reentrant=true, is-synchronous=true, call-type=REGULAR
      return type Std_ReturnType: implementation-data-type=Std_ReturnType
      sw service arg nmNetworkHandle: direction=IN, implementation-data-type=NetworkHandleType
      sw service arg nmStatePtr: category=DATA_REFERENCE, direction=OUT, sw-pointer-target-props={target-category=TYPE_REFERENCE, implementation-data-type=Nm_StateType}
      sw service arg nmModePtr: category=DATA_REFERENCE, direction=OUT, sw-pointer-target-props={target-category=TYPE_REFERENCE, implementation-data-type=Nm_ModeType}
    Nm_GetUserData: service-id=7, is-reentrant=true, is-synchronous=true, call-type=REGULAR
      return type Std_ReturnType: implementation-data-type=Std_ReturnType
      sw service arg NetworkHandle: direction=IN, implementation-data-type=NetworkHandleType
      sw service arg nmUserDataPtr: category=DATA_REFERENCE, direction=OUT, sw-pointer-target-props={target-category=TYPE_REFERENCE, implementation-data-type=uint8}
    Nm_GetVersionInfo: service-id=15, is-reentrant=true, is-synchronous=true, call-type=REGULAR
      sw service arg nmVerInfoPtr: category=DATA_REFERENCE, direction=OUT, sw-pointer-target-props={target-category=TYPE_REFERENCE, implementation-data-type=Std_VersionInfoType}
    Nm_NetworkMode: service-id=18, is-reentrant=true, is-synchronous=false, call-type=CALLBACK
      sw service arg nmNetworkHandle: direction=IN, implementation-data-type=NetworkHandleType
    Nm_NetworkRelease: service-id=3, is-reentrant=false, is-synchronous=false, call-type=REGULAR
      return type Std_ReturnType: implementation-data-type=Std_ReturnType
      sw service arg NetworkHandle: direction=IN, implementation-data-type=NetworkHandleType
    Nm_NetworkRequest: service-id=2, is-reentrant=false, is-synchronous=false, call-type=REGULAR
      return type Std_ReturnType: implementation-data-type=Std_ReturnType
      sw service arg NetworkHandle: direction=IN, implementation-data-type=NetworkHandleType
    Nm_NetworkStartIndication: service-id=17, is-reentrant=true, is-synchronous=false, call-type=CALLBACK
      sw service arg nmNetworkHandle: direction=IN, implementation-data-type=NetworkHandleType
    Nm_PassiveStartUp: service-id=1, is-reentrant=false, is-synchronous=false, call-type=REGULAR
      return type Std_ReturnType: implementation-data-type=Std_ReturnType
      sw service arg NetworkHandle: direction=IN, implementation-data-type=NetworkHandleType
    Nm_PrepareBusSleepMode: service-id=19, is-reentrant=true, is-synchronous=false, call-type=CALLBACK
      sw service arg nmNetworkHandle: direction=IN, implementation-data-type=NetworkHandleType
    Nm_RepeatMessageIndication: service-id=26, is-reentrant=true, is-synchronous=false, call-type=CALLBACK
      sw service arg nmNetworkHandle: direction=IN, implementation-data-type=NetworkHandleType
    Nm_RepeatMessageRequest: service-id=9, is-reentrant=false, is-synchronous=false, call-type=REGULAR
      return type Std_ReturnType: implementation-data-type=Std_ReturnType
      sw service arg NetworkHandle: direction=IN, implementation-data-type=NetworkHandleType
    Nm_SetUserData: service-id=6, is-reentrant=false, is-synchronous=true, call-type=REGULAR
      return type Std_ReturnType: implementation-data-type=Std_ReturnType
      sw service arg NetworkHandle: direction=IN, sw-calibration-access=READ-ONLY, implementation-data-type=NetworkHandleType, sw-impl-policy=CONST
      sw service arg nmUserDataPtr: category=DATA_REFERENCE, direction=IN, sw-pointer-target-props={target-category=TYPE_REFERENCE, implementation-data-type=uint8, sw-impl-policy=CONST}
    Nm_TxTimeoutException: service-id=27, is-reentrant=true, is-synchronous=false, call-type=CALLBACK
      sw service arg nmNetworkHandle: direction=IN, implementation-data-type=NetworkHandleType
package /Bsw_Nm/ImplementationDataTypes
  4 x impl type:
    Nm_BusNmType: compu {0=NM_BUSNM_CANNM, 1=NM_BUSNM_FRNM, 2=NM_BUSNM_UDPNM, 3=NM_BUSNM_GENERICNM, 4=NM_BUSNM_J1939NM, 5=NM_BUSNM_LOCALNM, 255=NM_BUSNM_UNDEF}, range raw 0..255, implementation-data-type=uint8, type-emitter=NmStack_Types.h
    Nm_ConfigType: category=STRUCTURE, type-emitter=Nm.h
      element Dummy: category=VALUE, base-type=uint8
    Nm_ModeType: compu {0=NM_MODE_BUS_SLEEP, 1=NM_MODE_PREPARE_BUS_SLEEP, 2=NM_MODE_SYNCHRONIZE, 3=NM_MODE_NETWORK}, range raw 0..3, implementation-data-type=uint8, type-emitter=NmStack_Types.h
    Nm_StateType: compu {0x00=NM_STATE_UNINIT, 0x01=NM_STATE_BUS_SLEEP, 0x02=NM_STATE_PREPARE_BUS_SLEEP, 0x03=NM_STATE_READY_SLEEP, 0x04=NM_STATE_NORMAL_OPERATION, 0x05=NM_STATE_REPEAT_MESSAGE, 0x06=NM_STATE_SYNCHRONIZE, 0x07=NM_STATE_OFFLINE}, range raw 0x00..0x07, implementation-data-type=uint8, type-emitter=NmStack_Types.h
