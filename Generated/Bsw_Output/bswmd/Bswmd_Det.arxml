AUTOSAR XML (schema 00047)
package /Bsw_Det
  bsw implementation BswImplementation_Det: programming-language=C, sw-version=1.0.0, vendor-id=76, ar-release-version=4.4.0, behavior=BswInternalBehavior_Det, vendor-specific-module-def=Det
  bsw module description Det: module-id=15
    bsw internal behavior BswInternalBehavior_Det
      exclusive area RAM_DATA_PROTECTION
      bsw called entity BswCE_Det_ReportError: can-enter-exclusive-area=RAM_DATA_PROTECTION, implemented-entry=Det_ReportError
      bsw called entity BswCE_Det_ReportRuntimeError: can-enter-exclusive-area=RAM_DATA_PROTECTION, implemented-entry=Det_ReportRuntimeError
      bsw called entity BswCE_Det_ReportTransientFault: can-enter-exclusive-area=RAM_DATA_PROTECTION, implemented-entry=Det_ReportTransientFault
      bsw distinguished partition BswDistinguishedPartition_Det
package /Bsw_Det/ImplementedEntries/DetBswComponents
  bsw module entry Det_GetVersionInfo: service-id=3, is-reentrant=true, is-synchronous=true, call-type=REGULAR, execution-context=UNSPECIFIED, sw-service-impl-policy=STANDARD, bsw-entry-kind=CONCRETE
    sw service arg versionInfo: direction=OUT
  bsw module entry Det_Init: service-id=0, is-reentrant=false, is-synchronous=true, call-type=REGULAR, execution-context=TASK, sw-service-impl-policy=STANDARD, bsw-entry-kind=CONCRETE
    sw service arg ConfigPtr: direction=IN
  bsw module entry Det_Start: service-id=2, is-reentrant=false, is-synchronous=true, call-type=REGULAR, execution-context=TASK, sw-service-impl-policy=STANDARD, bsw-entry-kind=CONCRETE
package /Bsw_Det/ImplementedEntries/DetSwComponents
  bsw module entry Det_ReportError: service-id=1, is-reentrant=true, is-synchronous=false, call-type=REGULAR, execution-context=UNSPECIFIED, sw-service-impl-policy=STANDARD
    4 x sw service arg, all with direction=IN:
      ModuleId
      InstanceId
      ApiId
      ErrorId
  bsw module entry Det_ReportRuntimeError: service-id=4, is-reentrant=true, is-synchronous=false, call-type=REGULAR, execution-context=UNSPECIFIED, sw-service-impl-policy=STANDARD
    4 x sw service arg, all with direction=IN:
      ErrorId
      InstanceId
      ModuleId
      ApiId
  bsw module entry Det_ReportTransientFault: service-id=1, is-reentrant=true, is-synchronous=false, call-type=REGULAR, execution-context=UNSPECIFIED, sw-service-impl-policy=STANDARD
    4 x sw service arg, all with direction=IN:
      ErrorId
      InstanceId
      ModuleId
      ApiId
