AUTOSAR XML (schema 00047)
package /Bsw_WdgIf
  bsw implementation BswImplementation_WdgIf: sw-version=1.0.0, vendor-id=76, ar-release-version=4.4.0, behavior=BswInternalBehavior_WdgIf
  bsw module description WdgIf: module-id=43, provided-entrys=[WdgIf_SetMode, WdgIf_SetTriggerCondition, WdgIf_GetVersionInfo]
    bsw internal behavior BswInternalBehavior_WdgIf
      bsw called entity WdgIf_GetVersionInfo: implemented-entry=WdgIf_GetVersionInfo
      bsw called entity WdgIf_SetMode: implemented-entry=WdgIf_SetMode
      bsw called entity WdgIf_SetTriggerCondition: implemented-entry=WdgIf_SetTriggerCondition
      bsw distinguished partition BswDistinguishedPartition_WdgIf
  bsw module entry WdgIf_GetVersionInfo: service-id=3, is-reentrant=true, is-synchronous=true, call-type=REGULAR, execution-context=UNSPECIFIED, sw-service-impl-policy=STANDARD
  bsw module entry WdgIf_SetMode: service-id=1, is-reentrant=false, is-synchronous=true, call-type=REGULAR, execution-context=UNSPECIFIED, sw-service-impl-policy=STANDARD
  bsw module entry WdgIf_SetTriggerCondition: service-id=2, is-reentrant=false, is-synchronous=true, call-type=REGULAR, execution-context=UNSPECIFIED, sw-service-impl-policy=STANDARD
