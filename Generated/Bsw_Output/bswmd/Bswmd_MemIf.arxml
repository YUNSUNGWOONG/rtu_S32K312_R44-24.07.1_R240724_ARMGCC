AUTOSAR XML (schema 00047)
package /Bsw_MemIf
  bsw implementation BswImplementation_MemIf: sw-version=1.0.4, vendor-id=76, ar-release-version=4.4.0, behavior=BswInternalBehavior_MemIf
  bsw module description MemIf: module-id=22
    bsw internal behavior BswInternalBehavior_MemIf
      bsw distinguished partition BswDistinguishedPartition_MemIf
