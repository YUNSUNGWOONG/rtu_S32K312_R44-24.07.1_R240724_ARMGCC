AUTOSAR XML (schema 00047)
package /Bsw_Wdg_76_Acw
  bsw implementation BswImplementation_Wdg_76_Acw: sw-version=1.0.0, vendor-id=76, ar-release-version=4.4.0, behavior=BswInternalBehavior_Wdg_76_Acw, vendor-api-infix=Acw
  bsw module description Wdg_76_Acw: module-id=102, provided-entrys=[Wdg_76_Acw_Init, Wdg_76_Acw_SetMode, Wdg_76_Acw_SetTriggerCondition, Wdg_76_Acw_GetVersionInfo]
    bsw internal behavior BswInternalBehavior_Wdg_76_Acw
      exclusive area WDG_EXCLUSIVE_AREA
      4 x bsw called entity, all with can-enter-exclusive-area=WDG_EXCLUSIVE_AREA:
        Wdg_76_Acw_GetVersionInfo: implemented-entry=Wdg_76_Acw_GetVersionInfo
        Wdg_76_Acw_Init: implemented-entry=Wdg_76_Acw_Init
        Wdg_76_Acw_SetMode: implemented-entry=Wdg_76_Acw_SetMode
        Wdg_76_Acw_SetTriggerCondition: implemented-entry=Wdg_76_Acw_SetTriggerCondition
      bsw distinguished partition BswDistinguishedPartition_Wdg_76_Acw
  4 x bsw module entry, all with is-reentrant=false, is-synchronous=true, call-type=REGULAR, execution-context=UNSPECIFIED, sw-service-impl-policy=STANDARD:
    Wdg_76_Acw_GetVersionInfo: service-id=4
    Wdg_76_Acw_Init: service-id=0
    Wdg_76_Acw_SetMode: service-id=1
    Wdg_76_Acw_SetTriggerCondition: service-id=3
