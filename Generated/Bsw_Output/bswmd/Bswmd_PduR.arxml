AUTOSAR XML (schema 00047)
package /Bsw_PduR
  bsw implementation BswImplementation_PduR: programming-language=C, sw-version=1.0.9, vendor-id=76, ar-release-version=4.4.0, behavior=BswInternalBehavior_PduR
  bsw module description PduR: category=BSW_MODULE, module-id=51
    bsw internal behavior BswInternalBehavior_PduR
      6 x exclusive area:
        DATA_BUFFER_PROTECTION_AREA
        FIFO_STATUS_PROTECTION_AREA
        GROUP_STATUS_PROTECTION_AREA
        MULTICAST_PROTECTION_AREA
        TP_GATEWAY_PROTECTION_AREA
        TP_TX_PROTECTION_AREA
      bsw called entity BswCalledEntity0: can-enter-exclusive-area=[DATA_BUFFER_PROTECTION_AREA, FIFO_STATUS_PROTECTION_AREA, GROUP_STATUS_PROTECTION_AREA, MULTICAST_PROTECTION_AREA, TP_GATEWAY_PROTECTION_AREA, TP_TX_PROTECTION_AREA], implemented-entry=PduR_LoTpTxConfirmation
      bsw distinguished partition BswDistinguishedPartition_PduR
  bsw module entry PduR_LoTpTxConfirmation: service-id=55, is-reentrant=false, is-synchronous=false, call-type=REGULAR, execution-context=UNSPECIFIED, sw-service-impl-policy=STANDARD
