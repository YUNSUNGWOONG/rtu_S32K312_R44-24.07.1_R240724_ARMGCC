AUTOSAR XML (schema 00047)
package /Bsw_EcuM/BswImplementations
  bsw implementation BswImplementation_EcuM: sw-version=1.2.4, swc-bsw-mapping=SwcBswMapping_EcuM, vendor-id=76, ar-release-version=4.4.0, behavior=BswIB_EcuM
package /Bsw_EcuM/BswModuleDescriptions
  bsw module description EcuM: module-id=10
    bsw internal behavior BswIB_EcuM: included-data-type-set=data-type=EcuM_RequestType
      7 x exclusive area:
        ALARM_TIME_PROTECTION
        BOOT_TARGET_PROTECTION
        SHUTDOWN_CAUSE
        SHUTDOWN_OR_SLEEP_FLAG_PROTECTION
        SHUTDOWN_TARGET_PROTECTION
        STATE_PROTECTION
        WAKEUP_STATUS_PROTECTION
      bsw schedulable entity BswSE_EcuM_MainFunction: can-enter-exclusive-area=[ALARM_TIME_PROTECTION, BOOT_TARGET_PROTECTION, SHUTDOWN_CAUSE, SHUTDOWN_OR_SLEEP_FLAG_PROTECTION, SHUTDOWN_TARGET_PROTECTION, STATE_PROTECTION, WAKEUP_STATUS_PROTECTION], implemented-entry=EcuM_MainFunction
      bsw timing event BswTE_EcuM_MainFunction: starts-on-event=BswSE_EcuM_MainFunction, period=0.01
      6 x bsw distinguished partition:
        BswDistinguishedPartition_EcuM_Core{0..5}
package /Bsw_EcuM/BswModuleEntrys
  bsw module entry EcuM_MainFunction: service-id=24, is-reentrant=false, is-synchronous=false, call-type=SCHEDULED, execution-context=TASK, sw-service-impl-policy=STANDARD
