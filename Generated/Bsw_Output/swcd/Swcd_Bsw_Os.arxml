AUTOSAR XML (schema 00047)
package /Os/CompositionSwComponentTypes
  composition sw component type CSwc_Os
    component Os_Master: type=Os_Master
package /Os/ServiceSwComponentTypes
  service sw component type Os_Master
    behavior SwcIB_Os_Master: handle-termination-and-restart=NO-SUPPORT
      timing event Os_TE_10ms_Master: start-on-event=Os_MeasureCPULoad0, period=0.01
      runnable Os_MeasureCPULoad0: symbol=Os_MeasureCPULoad
