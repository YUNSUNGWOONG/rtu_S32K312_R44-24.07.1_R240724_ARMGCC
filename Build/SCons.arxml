AUTOSAR XML (schema 4-3-0)
package /AUTRON
  module config SCons
    RTSW (Build): McuFamilyType=S32KX, CopyToCProject=1
      Compile:
        CompilerPath = C:\ts_mirr\gcc\gcc-arm-none-eabi-7-2017-q4-major\bin\arm-none-eabi-gcc.exe
        CompilerType = armgcc
        LibraryFiles = m
        LibraryFiles = c
        LibraryFiles = nosys
        ReleaseExceptedDirectory = ext_lib
        DefaultCompileOption = -c
        DefaultCompileOption = -Os
        DefaultCompileOption = -ggdb3
        DefaultCompileOption = -mcpu=cortex-m7
        DefaultCompileOption = -mthumb
        DefaultCompileOption = -mlittle-endian
        DefaultCompileOption = -fomit-frame-pointer
        DefaultCompileOption = -msoft-float
        DefaultCompileOption = -fno-common
        DefaultCompileOption = -Wall
        DefaultCompileOption = -Wextra
        DefaultCompileOption = -Wstrict-prototypes
        CompilerLicense = ip=10.208.199.229
        LibraryDirectory = CryptoLib\DummyCrypto
        ReleaseExceptedDirectory = lib
        LibraryDirectory = C:\NXP\S32DS.3.5\S32DS\build_tools\gcc_b1620\gcc-6.3-arm32-eabi\lib\gcc\arm-none-eabi\6.3.1\thumb
        LibraryFiles = gcc
        DefaultCompileOption = -Wno-sign-compare
        DefaultCompileOption = -fstack-usage
        DefaultCompileOption = -fdump-ipa-all
        DefaultDefineOption = FLS_CONFIGSET=&Fls_Config
        DefaultDefineOption = __GCC__
        DefaultDefineOption = __GNU__
        DefaultDefineOption = DISABLE_MCAL_INTERMODULE_ASR_CHECK
        DefaultDefineOption = FLASH_START
        DefaultDefineOption = NO_STDINT_H
        LibraryDirectory = C:\NXP\S32DS.3.5\S32DS\build_tools\gcc_b1620\gcc-6.3-arm32-eabi\arm-none-eabi\newlib\lib\thumb
        DefaultCompileOption = -Werror=implicit-function-declaration
        DefaultCompileOption = -DLINARO
        DefaultCompileOption = -DS32K312
        DefaultDefineOption = CUSTON_STDINT_H=<BasicTypes.h>
        CSuffixes = C
        CSuffixes = S
        CSuffixes = c
        CSuffixes = s
        CSuffixes = asm
        DefaultDefineOption = MCAL_SUPPORT_MOBILGENE_2_0
        DefaultDefineOption = __CORETEX_M7__
        DefaultDefineOption = __S32K312__
        DefaultCompileOption = -Wno-unknown-pragmas
        DefaultCompileOption = -DSTART_OS_MEMMAP
        LinkDiscriptFile = Build\linker_flash_s32k314.ld
        DefaultCompileOption = -v
        3 x CompileCmdChoice:
          Build
            Build:
              ExcludeList = CryptoLib\NXP_HSE\install
              ExcludeList = Static_Code\Modules\b_mcal_nxp_S32K3xx\b_mcal_Eth_nxp_S32K3xx
              ExcludeList = Static_Code\Modules\CanIf_R44\delivery\src\CanIf_Version.c
              ExcludeList = Static_Code\Modules\CanTrcv_R44\delivery\src\CanTrcv_Version.c
              ExcludeList = Static_Code\Modules\IoHwAb_R44\delivery\src\IoHwAb_Version.c
              ExcludeList = Static_Code\Modules\LinTrcv_R44\delivery\src\LinTrcv_Version.c
              ExcludeList = Static_Code\Modules\MemIf_R44\delivery\src\MemIf_Version.c
              ExcludeList = Static_Code\Modules\Tm_R44\delivery\src\Tm_Version.c
              ExcludeList = Static_Code\Modules\LinIf_R44\delivery\src\LinIf_Version.c
              ExcludeList = Static_Code\Modules\E2EXf_R44\delivery\src\E2EXf_Version.c
              ExcludeList = Static_Code\Modules\WdgM_R44\delivery\src\WdgM_Version.c
              ExcludeList = CryptoLib\NXP_HSE\hse_ab_swap
          Compile
            Compile:
              ExcludeList = CryptoLib\NXP_HSE\install
              ExcludeList = Static_Code\Modules\b_mcal_nxp_S32K3xx\b_mcal_Eth_nxp_S32K3xx
              ExcludeList = Static_Code\Modules\CanIf_R44\delivery\src\CanIf_Version.c
              ExcludeList = Static_Code\Modules\CanTrcv_R44\delivery\src\CanTrcv_Version.c
              ExcludeList = Static_Code\Modules\IoHwAb_R44\delivery\src\IoHwAb_Version.c
              ExcludeList = Static_Code\Modules\LinTrcv_R44\delivery\src\LinTrcv_Version.c
              ExcludeList = Static_Code\Modules\MemIf_R44\delivery\src\MemIf_Version.c
              ExcludeList = Static_Code\Modules\Tm_R44\delivery\src\Tm_Version.c
              ExcludeList = Static_Code\Modules\LinIf_R44\delivery\src\LinIf_Version.c
              ExcludeList = Static_Code\Modules\E2EXf_R44\delivery\src\E2EXf_Version.c
              ExcludeList = Static_Code\Modules\WdgM_R44\delivery\src\WdgM_Version.c
              ExcludeList = CryptoLib\NXP_HSE\hse_ab_swap
          Release
            Release:
              ExcludeList = CryptoLib\NXP_HSE\install
              ExcludeList = Static_Code\Modules\b_mcal_nxp_S32K3xx\b_mcal_Eth_nxp_S32K3xx
              ExcludeList = Static_Code\Modules\CanIf_R44\delivery\src\CanIf_Version.c
              ExcludeList = Static_Code\Modules\CanTrcv_R44\delivery\src\CanTrcv_Version.c
              ExcludeList = Static_Code\Modules\IoHwAb_R44\delivery\src\IoHwAb_Version.c
              ExcludeList = Static_Code\Modules\LinTrcv_R44\delivery\src\LinTrcv_Version.c
              ExcludeList = Static_Code\Modules\MemIf_R44\delivery\src\MemIf_Version.c
              ExcludeList = Static_Code\Modules\Tm_R44\delivery\src\Tm_Version.c
              ExcludeList = Static_Code\Modules\LinIf_R44\delivery\src\LinIf_Version.c
              ExcludeList = Static_Code\Modules\E2EXf_R44\delivery\src\E2EXf_Version.c
              ExcludeList = Static_Code\Modules\WdgM_R44\delivery\src\WdgM_Version.c
              ExcludeList = CryptoLib\NXP_HSE\hse_ab_swap
        3 x Pattern, all with CompileOption=-Os, CompileOption=-Wall, CompileOption=-Werror=implicit-function-declaration, CompileOption=-Wextra, CompileOption=-Wno-sign-compare, CompileOption=-Wstrict-prototypes, CompileOption=-fdump-ipa-all, CompileOption=-fno-common, CompileOption=-fomit-frame-pointer, CompileOption=-fstack-usage, CompileOption=-ggdb3, CompileOption=-mcpu=cortex-m7, CompileOption=-mlittle-endian, DefineOption=DISABLE_MCAL_INTERMODULE_ASR_CHECK, DefineOption=FLS_CONFIGSET=&Fls_Config, DefineOption=__CORTEX_M7__, DefineOption=__GCC__, CompileOption=-msoft-float, CompileOption=-mthumb, DefineOption=__S32K312__, DefineOption=MCAL_SUPPORT_MOBILGENE_2_0, DefineOption=NO_STDINT_H, DefineOption=CUSTON_STDINT_H=<BasicTypes.h>, CompileOption=-c:
          ASW: PatternType=ASW, SourcePath=Static_Code\Reference_Code, IsInternalFile=0, CompileOption=-DLINARO, CompileOption=-DS32K312, DefineOption=__DSB()=__asm("dsb")
          BSW: PatternType=BSW, IsInternalFile=1, CompileOption=-DLINARO, CompileOption=-DS32K312, SourcePath=CryptoLib, SourcePath=Generated\Bsw_Output, SourcePath=Static_Code\Integration_Code, SourcePath=Static_Code\Modules\b_autosar_cdd_OsProfiler, SourcePath=Static_Code\Modules\b_autosar_HwResource, SourcePath=Static_Code\Modules\b_autosar_imp_Os_s32k31x, SourcePath=Static_Code\Modules\BswM_R44, SourcePath=Static_Code\Modules\CanCM_R44, SourcePath=Static_Code\Modules\CanIf_R44, SourcePath=Static_Code\Modules\CanNm_R44, SourcePath=Static_Code\Modules\CanSM_R44, SourcePath=Static_Code\Modules\CanTp_R44, SourcePath=Static_Code\Modules\CanTrcv_R44, SourcePath=Static_Code\Modules\CanTSyn_R44, SourcePath=Static_Code\Modules\Com_R44, SourcePath=Static_Code\Modules\ComM_R44, SourcePath=Static_Code\Modules\ComXf_R44, SourcePath=Static_Code\Modules\Crc_R44, SourcePath=Static_Code\Modules\CryIf_R44, SourcePath=Static_Code\Modules\Crypto_76_dummy_R44, SourcePath=Static_Code\Modules\Csm_R44, SourcePath=Static_Code\Modules\Dcm_R44, SourcePath=Static_Code\Modules\Dem_R44, SourcePath=Static_Code\Modules\Det_R44, SourcePath=Static_Code\Modules\E2E_R44, SourcePath=Static_Code\Modules\E2EXf_R44, SourcePath=Static_Code\Modules\Ea_R44, SourcePath=Static_Code\Modules\EcuM_R44, SourcePath=Static_Code\Modules\Eep_R44, SourcePath=Static_Code\Modules\FiM_R44, SourcePath=Static_Code\Modules\GeneralTypes_R44, SourcePath=Static_Code\Modules\IoHwAb_R44, SourcePath=Static_Code\Modules\IpduM_R44, SourcePath=Static_Code\Modules\KeyM_R44, SourcePath=Static_Code\Modules\LinIf_R44, SourcePath=Static_Code\Modules\LinSM_R44, SourcePath=Static_Code\Modules\LinTrcv_R44, SourcePath=Static_Code\Modules\MemIf_R44, SourcePath=Static_Code\Modules\Nm_R44, SourcePath=Static_Code\Modules\NvM_R44, SourcePath=Static_Code\Modules\Os_S32K31x_R44, SourcePath=Static_Code\Modules\OsekNm_R44, SourcePath=Static_Code\Modules\PduR_R44, SourcePath=Static_Code\Modules\Rte_R44, SourcePath=Static_Code\Modules\StbM_R44, SourcePath=Static_Code\Modules\Tm_R44, SourcePath=Static_Code\Modules\Wdg_R44, SourcePath=Static_Code\Modules\WdgIf_R44, SourcePath=Static_Code\Modules\WdgM_R44
          MCAL: PatternType=MCAL, SourcePath=Generated\Mcal_Output, SourcePath=Static_Code\Modules\b_mcal_nxp_S32K3xx, IsInternalFile=0
      Generation:
        TransformerGeneratorPath = C:\ts_mirr\xml
        McalGeneratorPath = C:\ts_mirr\xml\eb-tresos-S32K3xx_RTD_3.0.0_P01_HF01\bin\tresos_cmd.bat
        JavaHomePath = C:\ts_mirr\xml\eb-tresos-S32K3xx_RTD_3.0.0_P01_HF01\jre\bin\java.exe
        109 x Module, all with Used=1:
          Adc: ModuleName=Adc, InputFilesList=Ecud_Adc, InputFilesList=Ecud_Base, InputFilesList=Ecud_EcuM_Mcal, ExpectedFilesList=Adc_Cfg.c, ExpectedFilesList=Adc_Cfg.h, IsMCAL=1, McalDefineTarget=CORTEXM, McalDefineDerivate=S32K3XX, MCAL_GeneratorPostfix=_TS_T40D34M30I0R0, ExpectedFilesList=Adc_PBcfg.c, InputFilesList=Ecud_Mcu, ExpectedFilesList=Adc_PBcfg.h, ExpectedFilesList=Adc_CfgDefines.h, ExpectedFilesList=Adc_Ipw_Cfg.h, ExpectedFilesList=Adc_Ipw_CfgDefines.h, ExpectedFilesList=Adc_Ipw_PBcfg.c, ExpectedFilesList=Adc_Ipw_PBcfg.h, ExpectedFilesList=Adc_Sar_Ip_Cfg.h, ExpectedFilesList=Adc_Sar_Ip_CfgDefines.h, ExpectedFilesList=Adc_Sar_Ip_PBcfg.c, ExpectedFilesList=Adc_Sar_Ip_PBcfg.h, ExpectedFilesList=Bctu_Ip_Cfg.h, ExpectedFilesList=Bctu_Ip_CfgDefines.h, ExpectedFilesList=Bctu_Ip_PBcfg.c, ExpectedFilesList=Bctu_Ip_PBcfg.h, ExpectedFilesList=Sdadc_Ip_Cfg.h, ExpectedFilesList=Sdadc_Ip_CfgDefines.h, ExpectedFilesList=Sdadc_Ip_PBcfg.h, ExpectedFilesList=Sdadc_Ip_PBcfg.c
          BaseNXP: ModuleName=Other, InputFilesList=Ecud_Resource, InputFilesList=Ecud_Base, ExpectedFilesList=modules.h, ExpectedFilesList=OsIf_Cfg.h, ExpectedFilesList=OsIf_ArchCfg.h, ExpectedFilesList=OsIf_Cfg.c, IsMCAL=1, McalDefineTarget=CORTEXM, McalDefineDerivate=S32K3XX, MCAL_GeneratorPostfix=_TS_T40D34M30I0R0
          Can: ModuleName=Can, ExpectedFilesList=FlexCAN_Ip_Cfg.h, IsMCAL=1, ExpectedFilesList=FlexCAN_Ip_PBcfg.c, InputFilesList=Ecud_Can, McalDefineTarget=CORTEXM, McalDefineDerivate=S32K3XX, MCAL_GeneratorPostfix=_43_FLEXCAN_TS_T40D34M30I0R0, ExpectedFilesList=FlexCAN_Ip_PBcfg.h, ExpectedFilesList=FlexCAN_Ip_CfgDefines.h, ExpectedFilesList=Can_43_FLEXCAN_Cfg.h, ExpectedFilesList=Can_43_FLEXCAN_Externals.h, ExpectedFilesList=Can_43_FLEXCAN_Ipw_Cfg.h, ExpectedFilesList=Can_43_FLEXCAN_Ipw_PBcfg.h, ExpectedFilesList=Can_43_FLEXCAN_PBcfg.h, ExpectedFilesList=Can_43_FLEXCAN_Ipw_PBcfg.c, ExpectedFilesList=Can_43_FLEXCAN_PBcfg.c
          Crypto: ModuleName=Crypto, IsMCAL=1, ExpectedFilesList=Hse_Ip_Cfg.h, ExpectedFilesList=Crypto_Cfg.h, InputFilesList=Ecud_Resource, InputFilesList=Ecud_Crypto, InputFilesList=Ecud_Base, InputFilesList=Ecud_EcuM_Mcal, ExpectedFilesList=Crypto_Cfg.c, McalDefineTarget=CORTEXM, McalDefineDerivate=S32K3XX, MCAL_GeneratorPostfix=_TS_T40D34M30I0R0
          Dio: ModuleName=Dio, ExpectedFilesList=Dio_Cfg.c, InputFilesList=Ecud_Resource, ExpectedFilesList=Dio_Cfg.h, InputFilesList=Ecud_Dio, IsMCAL=1, McalDefineTarget=CORTEXM, McalDefineDerivate=S32K3XX, MCAL_GeneratorPostfix=_TS_T40D34M30I0R0, InputFilesList=Ecud_Base, ExpectedFilesList=Siul2_Dio_Ip_Cfg.h
          Fee: ModuleName=Fee, ExpectedFilesList=Fee_Cfg.h, IsMCAL=1, ExpectedFilesList=Fee_Cfg.c, McalDefineTarget=CORTEXM, McalDefineDerivate=S32K3XX, MCAL_GeneratorPostfix=_TS_T40D34M30I0R0, InputFilesList=Ecud_Resource, InputFilesList=Ecud_Fee, InputFilesList=Ecud_Base, ExpectedFilesList=Fee_Features.h, InputFilesList=Ecud_Fls
          Fls: ModuleName=Fls, IsMCAL=1, InputFilesList=Ecud_Resource, ExpectedFilesList=Fls_Cfg.h, McalDefineTarget=CORTEXM, McalDefineDerivate=S32K3XX, InputFilesList=Ecud_Fls, MCAL_GeneratorPostfix=_TS_T40D34M30I0R0, InputFilesList=Ecud_Base, ExpectedFilesList=Fls_Cfg.c, ExpectedFilesList=Fls_PBcfg.h, InputFilesList=Ecud_Mcl, ExpectedFilesList=Fls_PBcfg.c, ExpectedFilesList=Qspi_Ip_Cfg.h, ExpectedFilesList=Qspi_Ip_PBcfg.h, ExpectedFilesList=Qspi_Ip_Features.h, ExpectedFilesList=Qspi_Ip_CfgDefines.h, ExpectedFilesList=Qspi_Ip_PBcfg.c, ExpectedFilesList=C40_Ip_Cfg.h, ExpectedFilesList=C40_Ip_PBcfg.c, ExpectedFilesList=Fls_Cfg_Defines.h
          Gpt: ModuleName=Gpt, ExpectedFilesList=Gpt_Cfg.h, IsMCAL=1, ExpectedFilesList=Pit_Ip_Cfg.h, McalDefineTarget=CORTEXM, McalDefineDerivate=S32K3XX, MCAL_GeneratorPostfix=_TS_T40D34M30I0R0, InputFilesList=Ecud_Resource, InputFilesList=Ecud_Gpt, InputFilesList=Ecud_Base, ExpectedFilesList=Pit_Ip_Cfg_Defines.h, ExpectedFilesList=Rtc_Ip_Cfg.h, ExpectedFilesList=Rtc_Ip_Cfg_Defines.h, ExpectedFilesList=Stm_Ip_Cfg.h, ExpectedFilesList=Stm_Ip_Cfg_Defines.h, ExpectedFilesList=Emios_Gpt_Ip_Cfg.h, ExpectedFilesList=Emios_Gpt_Ip_Cfg_Defines.h, ExpectedFilesList=Gpt_Ipw_PBcfg.h, ExpectedFilesList=Gpt_PBcfg.h, ExpectedFilesList=Pit_Ip_PBcfg.h, ExpectedFilesList=Rtc_Ip_PBcfg.h, ExpectedFilesList=Stm_Ip_PBcfg.h, ExpectedFilesList=Emios_Gpt_Ip_PBcfg.h, ExpectedFilesList=Gpt_Cfg.c, ExpectedFilesList=Gpt_PBcfg.c, ExpectedFilesList=Pit_Ip_PBcfg.c, ExpectedFilesList=Rtc_Ip_PBcfg.c, ExpectedFilesList=Stm_Ip_PBcfg.c, ExpectedFilesList=Emios_Gpt_Ip_PBcfg.c, ExpectedFilesList=Gpt_Ipw_PBcfg.c
          Icu: ModuleName=Icu, IsMCAL=1, McalDefineTarget=CORTEXM, McalDefineDerivate=S32K3XX, MCAL_GeneratorPostfix=_TS_T40D34M30I0R0, InputFilesList=Ecud_Icu, InputFilesList=Ecud_Base, InputFilesList=Ecud_Dem_Mcal, InputFilesList=Ecud_EcuM_Mcal, ExpectedFilesList=Icu_Cfg.c, ExpectedFilesList=Icu_PBcfg.c, ExpectedFilesList=Emios_Icu_Ip_Cfg.h, InputFilesList=Ecud_Mcl, ExpectedFilesList=Emios_Icu_Ip_Defines.h, ExpectedFilesList=Emios_Icu_Ip_PBcfg.h, ExpectedFilesList=Icu_Cfg.h, ExpectedFilesList=Icu_Ipw_Cfg.h, ExpectedFilesList=Icu_Ipw_PBcfg.h, ExpectedFilesList=Icu_PBcfg.h, ExpectedFilesList=Siul2_Icu_Ip_Cfg.h, ExpectedFilesList=Siul2_Icu_Ip_Defines.h, ExpectedFilesList=Siul2_Icu_Ip_PBcfg.h, ExpectedFilesList=Wkpu_Ip_Cfg.h, ExpectedFilesList=Wkpu_Ip_Defines.h, ExpectedFilesList=Wkpu_Ip_PBcfg.h, ExpectedFilesList=Cmp_Ip_Cfg.h, ExpectedFilesList=Cmp_Ip_PBcfg.h, ExpectedFilesList=Emios_Icu_Ip_PBcfg.c, ExpectedFilesList=Icu_DmaNotification.c, ExpectedFilesList=Icu_Ipw_PBcfg.c, ExpectedFilesList=Siul2_Icu_Ip_PBcfg.c, ExpectedFilesList=Wkpu_Ip_PBcfg.c, ExpectedFilesList=Cmp_Ip_Defines.h, ExpectedFilesList=Cmp_Ip_PBcfg.c
          Lin: ModuleName=Lin, IsMCAL=1, McalDefineTarget=CORTEXM, McalDefineDerivate=S32K3XX, MCAL_GeneratorPostfix=_43_LPUART_FLEXIO_TS_T40D34M30I0R0, InputFilesList=Ecud_Lin, InputFilesList=Ecud_Base, InputFilesList=Ecud_Dem_Mcal, InputFilesList=Ecud_EcuM_Mcal, ExpectedFilesList=Lpuart_Lin_Ip_Cfg.h, ExpectedFilesList=Lpuart_Lin_Ip_Defines.h, ExpectedFilesList=Flexio_Lin_Ip_CfgDefines.h, InputFilesList=Ecud_Mcl, ExpectedFilesList=Flexio_Lin_Ip_Defines.h, ExpectedFilesList=Flexio_Lin_Ip_Cfg.h, ExpectedFilesList=Lpuart_Lin_Ip_PBcfg.c, ExpectedFilesList=Flexio_Lin_Ip_PBcfg.c, ExpectedFilesList=Lpuart_Lin_Ip_PBcfg.h, ExpectedFilesList=Flexio_Lin_Ip_PBcfg.h, ExpectedFilesList=Lin_43_LPUART_FLEXIO_Cfg.h, ExpectedFilesList=Lin_43_LPUART_FLEXIO_Defines.h, ExpectedFilesList=Lin_43_LPUART_FLEXIO_Ipw_Cfg.h, ExpectedFilesList=Lin_43_LPUART_FLEXIO_Ipw_PBcfg.h, ExpectedFilesList=Lin_43_LPUART_FLEXIO_PBcfg.h, ExpectedFilesList=Lin_43_LPUART_FLEXIO_Cfg.c, ExpectedFilesList=Lin_43_LPUART_FLEXIO_Ipw_PBcfg.c, ExpectedFilesList=Lin_43_LPUART_FLEXIO_PBcfg.c
          Mcl: ModuleName=Mcl, InputFilesList=Ecud_Resource, InputFilesList=Ecud_Mcl, InputFilesList=Ecud_Base, InputFilesList=Ecud_Dem_Mcal, InputFilesList=Ecud_Mcu, ExpectedFilesList=Cache_Ip_Cfg_Defines.h, ExpectedFilesList=Cache_Ip_Cfg_DeviceRegisters.h, ExpectedFilesList=CDD_Mcl_Cfg.h, ExpectedFilesList=CDD_Mcl_Cfg_Defines.h, ExpectedFilesList=Dma_Ip_Cfg.h, ExpectedFilesList=Dma_Ip_Cfg_Defines.h, ExpectedFilesList=Dma_Ip_Cfg_DeviceRegistersV3.h, ExpectedFilesList=Dma_Ip_Cfg_Devices.h, ExpectedFilesList=Emios_Mcl_Ip_Cfg.h, ExpectedFilesList=Emios_Mcl_Ip_Cfg_DeviceRegisters.h, ExpectedFilesList=Flexio_Mcl_Ip_Cfg.h, ExpectedFilesList=Flexio_Mcl_Ip_Cfg_Defines.h, ExpectedFilesList=Flexio_Mcl_Ip_Cfg_DeviceRegisters.h, ExpectedFilesList=Lcu_Ip_Cfg.h, ExpectedFilesList=Lcu_Ip_Cfg_Defines.h, ExpectedFilesList=Lcu_Ip_Features.h, ExpectedFilesList=Lcu_Ip_Regs.h, ExpectedFilesList=Trgmux_Ip_Cfg.h, ExpectedFilesList=Trgmux_Ip_Cfg_Defines.h, ExpectedFilesList=Trgmux_Ip_Cfg_DeviceRegisters.h, ExpectedFilesList=CDD_Mcl_Cfg.c, ExpectedFilesList=Dma_Ip_Cfg.c, ExpectedFilesList=Lcu_Ip_Cfg.c, ExpectedFilesList=Trgmux_Ip_Cfg.c, ExpectedFilesList=CDD_Mcl_PBcfg.h, ExpectedFilesList=Clock_Ip_PBcfg.h, ExpectedFilesList=Dma_Ip_PBcfg.h, ExpectedFilesList=Emios_Mcl_Ip_Cfg_Defines.h, ExpectedFilesList=Emios_Mcl_Ip_PBcfg.h, ExpectedFilesList=Flexio_Mcl_Ip_PBcfg.h, ExpectedFilesList=CDD_Mcl_PBcfg.c, ExpectedFilesList=Dma_Ip_PBcfg.c, ExpectedFilesList=Emios_Mcl_Ip_PBcfg.c, ExpectedFilesList=Flexio_Mcl_Ip_PBcfg.c, IsMCAL=1, McalDefineTarget=CORTEXM, McalDefineDerivate=S32K3XX, MCAL_GeneratorPostfix=_TS_T40D34M30I0R0
          Mcu: ModuleName=Mcu, ExpectedFilesList=Clock_Ip_Cfg.h, IsMCAL=1, ExpectedFilesList=Clock_Ip_Cfg_Defines.h, InputFilesList=Ecud_Resource, InputFilesList=Ecud_Mcu, McalDefineTarget=CORTEXM, McalDefineDerivate=S32K3XX, MCAL_GeneratorPostfix=_TS_T40D34M30I0R0, ExpectedFilesList=Mcu_Cfg.h, InputFilesList=Ecud_Dem_Mcal, ExpectedFilesList=Power_Ip_Cfg.h, ExpectedFilesList=Power_Ip_Cfg_Defines.h, ExpectedFilesList=Ram_Ip_Cfg.h, ExpectedFilesList=Ram_Ip_Cfg_Defines.h, ExpectedFilesList=Mcu_Cfg.c, ExpectedFilesList=Clock_Ip_Cfg.c, ExpectedFilesList=Power_Ip_Cfg.c, ExpectedFilesList=Ram_Ip_Cfg.c, ExpectedFilesList=Mcu_PBcfg.c, ExpectedFilesList=Clock_Ip_PBcfg.c, ExpectedFilesList=Lcu_Ip_PBcfg.h, ExpectedFilesList=Mcu_Ipw_Cfg_Defines.h, ExpectedFilesList=Mcu_PBcfg.h, ExpectedFilesList=Power_Ip_PBcfg.h, ExpectedFilesList=Ram_Ip_PBcfg.h, ExpectedFilesList=Trgmux_Ip_PBcfg.h, ExpectedFilesList=Lcu_Ip_PBcfg.c, ExpectedFilesList=Power_Ip_PBcfg.c, ExpectedFilesList=Ram_Ip_PBcfg.c, ExpectedFilesList=Trgmux_Ip_PBcfg.c
          Port: ModuleName=Port, ExpectedFilesList=Port_Cfg.c, IsMCAL=1, InputFilesList=Ecud_Resource, ExpectedFilesList=Port_Cfg.h, McalDefineTarget=CORTEXM, McalDefineDerivate=S32K3XX, MCAL_GeneratorPostfix=_TS_T40D34M30I0R0, InputFilesList=Ecud_Port, InputFilesList=Ecud_Base, ExpectedFilesList=Port_PBcfg.c, ExpectedFilesList=Port_PBcfg.h, ExpectedFilesList=Siul2_Port_Ip_Cfg.h, ExpectedFilesList=Tspc_Port_Ip_Cfg.h, ExpectedFilesList=Siul2_Port_Ip_PBcfg.c, ExpectedFilesList=Siul2_Port_Ip_PBcfg.h, ExpectedFilesList=Siul2_Port_Ip_Defines.h, ExpectedFilesList=Tspc_Port_Ip_PBcfg.h, ExpectedFilesList=Tspc_Port_Ip_PBcfg.c, ExpectedFilesList=Igf_Port_Ip_Cfg.h, ExpectedFilesList=Igf_Port_Ip_PBcfg.h, ExpectedFilesList=Igf_Port_Ip_PBcfg.c
          Pwm: ModuleName=Pwm, IsMCAL=1, McalDefineTarget=CORTEXM, McalDefineDerivate=S32K3XX, MCAL_GeneratorPostfix=_TS_T40D34M30I0R0, InputFilesList=Ecud_Resource, InputFilesList=Ecud_Pwm, InputFilesList=Ecud_Base, InputFilesList=Ecud_Mcl, InputFilesList=Ecud_Mcu, ExpectedFilesList=Pwm_Cfg.h, ExpectedFilesList=Pwm_PBcfg.c, ExpectedFilesList=Pwm_PBcfg.h, ExpectedFilesList=Pwm_Ipw_Cfg.h, ExpectedFilesList=Emios_Pwm_Ip_Cfg.h, ExpectedFilesList=Emios_Pwm_Ip_CfgDefines.h, ExpectedFilesList=Emios_Pwm_Ip_PBcfg.c, ExpectedFilesList=Emios_Pwm_Ip_PBcfg.h, ExpectedFilesList=Flexio_Pwm_Ip_Cfg.h, ExpectedFilesList=Flexio_Pwm_Ip_CfgDefines.h, ExpectedFilesList=Flexio_Pwm_Ip_PBcfg.c, ExpectedFilesList=Flexio_Pwm_Ip_PBcfg.h, ExpectedFilesList=FlexPwm_Ip_Cfg.h, ExpectedFilesList=FlexPwm_Ip_CfgDefines.h, ExpectedFilesList=FlexPwm_Ip_PBcfg.h, ExpectedFilesList=FlexPwm_Ip_PBcfg.c
          Spi: ModuleName=Spi, ExpectedFilesList=Spi_PBcfg.c, IsMCAL=1, ExpectedFilesList=Spi_Ipw_PBcfg.c, McalDefineTarget=CORTEXM, McalDefineDerivate=S32K3XX, MCAL_GeneratorPostfix=_TS_T40D34M30I0R0, InputFilesList=Ecud_Resource, InputFilesList=Ecud_Spi, InputFilesList=Ecud_Base, InputFilesList=Ecud_Dem_Mcal, ExpectedFilesList=Lpspi_Ip_PBcfg.c, InputFilesList=Ecud_Mcu, InputFilesList=Ecud_Mcl, ExpectedFilesList=Flexio_Spi_Ip_PBcfg.c, ExpectedFilesList=Spi_PBcfg.h, ExpectedFilesList=Spi_Ipw_PBcfg.h, ExpectedFilesList=Spi_Ipw_Cfg.h, ExpectedFilesList=Spi_Cfg.h, ExpectedFilesList=Lpspi_Ip_PBcfg.h, ExpectedFilesList=Flexio_Spi_Ip_PBcfg.h, ExpectedFilesList=Lpspi_Ip_Cfg.h, ExpectedFilesList=Flexio_Spi_Ip_Cfg.h, ExpectedFilesList=Flexio_Spi_Ip_CfgDefines.h
          Wdg: ModuleName=Wdg, IsMCAL=1, McalDefineTarget=CORTEXM, McalDefineDerivate=S32K3XX, MCAL_GeneratorPostfix=_TS_T40D34M30I0R0, InputFilesList=Ecud_Resource, InputFilesList=Ecud_Wdg, InputFilesList=Ecud_Gpt, InputFilesList=Ecud_Mcu, InputFilesList=Ecud_EcuM_Mcal, ExpectedFilesList=Wdg_43_Instance0_PBcfg.c, ExpectedFilesList=Wdg_43_Instance1_PBcfg.c, ExpectedFilesList=Wdg_43_Instance0_PBcfg.h, InputFilesList=Ecud_Dem_Mcal, InputFilesList=Ecud_Base, InputFilesList=Ecud_Mcl, ExpectedFilesList=Wdg_43_Instance1_PBcfg.h, ExpectedFilesList=Wdg_43_Instance0_Ipw_PBcfg.c, ExpectedFilesList=Wdg_43_Instance1_Ipw_PBcfg.c, ExpectedFilesList=Wdg_43_Instance0_Ipw_PBcfg.h, ExpectedFilesList=Wdg_43_Instance1_Ipw_PBcfg.h, ExpectedFilesList=Swt_43_Instance0_Ip_PBcfg.c, ExpectedFilesList=Swt_43_Instance1_Ip_PBcfg.c, ExpectedFilesList=Swt_43_Instance0_Ip_PBcfg.h, ExpectedFilesList=Swt_43_Instance1_Ip_PBcfg.h, ExpectedFilesList=Swt_Ip_Cfg_Defines.h, ExpectedFilesList=Swt_Ip_DeviceRegisters.h, ExpectedFilesList=Wdg_Ipw_Cfg_Defines.h, ExpectedFilesList=Wdg_Cfg_Defines.h, ExpectedFilesList=Wdg_Cfg.h, ExpectedFilesList=Wdg_CfgExt.h, ExpectedFilesList=Wdg_CfgExt.c, ExpectedFilesList=Swt_43_Instance2_Ip_PBcfg.h, ExpectedFilesList=Wdg_43_Instance2_Ipw_PBcfg.h, ExpectedFilesList=Wdg_43_Instance2_PBcfg.h, ExpectedFilesList=Swt_43_Instance2_Ip_PBcfg.c, ExpectedFilesList=Wdg_43_Instance0_Cfg.c, ExpectedFilesList=Wdg_43_Instance0_Lcfg.c, ExpectedFilesList=Wdg_43_Instance1_Cfg.c, ExpectedFilesList=Wdg_43_Instance1_Lcfg.c, ExpectedFilesList=Wdg_43_Instance2_Cfg.c, ExpectedFilesList=Wdg_43_Instance2_Ipw_PBcfg.c, ExpectedFilesList=Wdg_43_Instance2_Lcfg.c, ExpectedFilesList=Wdg_43_Instance2_PBcfg.c, InputFilesList=Gpt_s32k312_mqfp172.epd, ExpectedFilesList=AeWdog_Ip_Cfg.h, ExpectedFilesList=AeWdog_Ip_Cfg_Defines.h, ExpectedFilesList=AeWdog_Ip_DeviceRegisters.h, ExpectedFilesList=AeWdog_Ip_PBcfg.h, ExpectedFilesList=Swt_43_Instance3_Ip_PBcfg.h, ExpectedFilesList=Swt_Ip_Cfg.h, ExpectedFilesList=Wdg_43_Instance3_Ipw_PBcfg.h, ExpectedFilesList=Wdg_43_Instance3_PBcfg.h, ExpectedFilesList=Wdg_43_Instance4_Ipw_PBcfg.h, ExpectedFilesList=Wdg_43_Instance4_PBcfg.h, ExpectedFilesList=AeWdog_Ip_PBcfg.c, ExpectedFilesList=Swt_43_Instance3_Ip_PBcfg.c, ExpectedFilesList=Wdg_43_Instance3_Cfg.c, ExpectedFilesList=Wdg_43_Instance3_Ipw_PBcfg.c, ExpectedFilesList=Wdg_43_Instance3_Lcfg.c, ExpectedFilesList=Wdg_43_Instance3_PBcfg.c, ExpectedFilesList=Wdg_43_Instance4_Cfg.c, ExpectedFilesList=Wdg_43_Instance4_Ipw_PBcfg.c, ExpectedFilesList=Wdg_43_Instance4_Lcfg.c, ExpectedFilesList=Wdg_43_Instance4_PBcfg.c
          Bswmd_EcuM: ModuleName=EcuM, InputFilesList=Ecud_EcuM, ExpectedFilesList=Bswmd_EcuM.arxml, BswDefines=B, IsMCAL=0, GeneratorName=EcuM.bat
          Bswmd_IoHwAb: ModuleName=IoHwAb, InputFilesList=Ecud_IoHwAb, ExpectedFilesList=Bswmd_IoHwAb.arxml, BswDefines=B, IsMCAL=0, GeneratorName=IoHwAb.bat
          Bswmd_WdgM: ModuleName=WdgM, ExpectedFilesList=Bswmd_WdgM.arxml, BswDefines=B, IsMCAL=0, InputFilesList=Ecud_Dem, InputFilesList=Ecud_Mcu, InputFilesList=Ecud_Os, InputFilesList=Ecud_WdgIf, InputFilesList=Ecud_WdgM, InputFilesList=Ecud_EcuC, GeneratorName=WdgM.bat
          Bswmd_Det: ModuleName=Det, InputFilesList=Ecud_Det, ExpectedFilesList=Bswmd_Det.arxml, BswDefines=B, IsMCAL=0, GeneratorName=Det.bat
          Bswmd_Dem: ModuleName=Dem, InputFilesList=Ecud_Dem, ExpectedFilesList=Bswmd_Dem.arxml, BswDefines=B, IsMCAL=0, GeneratorName=Dem.bat
          Bswmd_PduR: ModuleName=PduR, InputFilesList=Ecud_PduR, ExpectedFilesList=Bswmd_PduR.arxml, BswDefines=B, IsMCAL=0, GeneratorName=PduR.bat
          Bswmd_NvM: ModuleName=NvM, InputFilesList=Ecud_NvM, ExpectedFilesList=Bswmd_NvM.arxml, BswDefines=B, IsMCAL=0, GeneratorName=NvM.bat
          Bswmd_Wdg_76_Acw: ModuleName=Wdg, InputFilesList=Ecud_Wdg_76_Acw, ExpectedFilesList=Bswmd_Wdg_76_Acw.arxml, BswDefines=B, IsMCAL=0, GeneratorName=Wdg.bat
          Bswmd_Crc: ModuleName=Crc, InputFilesList=Ecud_Crc, ExpectedFilesList=Bswmd_Crc.arxml, BswDefines=B, IsMCAL=0, GeneratorName=Crc.bat
          Bswmd_MemIf: ModuleName=MemIf, InputFilesList=Ecud_MemIf, ExpectedFilesList=Bswmd_MemIf.arxml, BswDefines=B, IsMCAL=0, GeneratorName=MemIf.bat
          Bswmd_Dcm: ModuleName=Dcm, InputFilesList=Ecud_Dcm, ExpectedFilesList=Bswmd_Dcm.arxml, BswDefines=B, IsMCAL=0, GeneratorName=Dcm.bat
          Bswmd_CanCM: ModuleName=CanCM, InputFilesList=Ecud_CanCM, ExpectedFilesList=Bswmd_CanCM.arxml, BswDefines=B, IsMCAL=0, GeneratorName=CanCM.bat
          Bswmd_StbM: ModuleName=StbM, InputFilesList=Ecud_StbM, ExpectedFilesList=Bswmd_StbM.arxml, BswDefines=B, IsMCAL=0, GeneratorName=StbM.bat
          Bswmd_ComM: ModuleName=ComM, InputFilesList=Ecud_ComM, ExpectedFilesList=Bswmd_ComM.arxml, BswDefines=B, IsMCAL=0, GeneratorName=ComM.bat
          Bswmd_Tm: ModuleName=Tm, InputFilesList=Ecud_Tm, ExpectedFilesList=Bswmd_Tm.arxml, BswDefines=B, IsMCAL=0, GeneratorName=Tm.bat
          Bswmd_FiM: ModuleName=FiM, InputFilesList=Ecud_FiM.arxml, ExpectedFilesList=Bswmd_FiM.arxml, IsMCAL=0, BswDefines=B, GeneratorName=FiM.bat
          Bswmd_LinTrcv: ModuleName=LinTrcv, InputFilesList=Ecud_LinTrcv, ExpectedFilesList=Bswmd_LinTrcv.arxml, BswDefines=B, IsMCAL=0, GeneratorName=LinTrcv.bat
          Bswmd_CanIf: ModuleName=CanIf, InputFilesList=Ecud_CanIf, ExpectedFilesList=Bswmd_CanIf.arxml, BswDefines=B, IsMCAL=0, GeneratorName=CanIf.bat
          Bswmd_Com: ModuleName=Com, InputFilesList=Ecud_Com, ExpectedFilesList=Bswmd_Com.arxml, BswDefines=B, IsMCAL=0, GeneratorName=Com.bat
          Bswmd_CanTp: ModuleName=CanTp, InputFilesList=Ecud_CanTp.arxml, ExpectedFilesList=Bswmd_CanTp.arxml, BswDefines=B, IsMCAL=0, GeneratorName=CanTp.bat
          Bswmd_Os: ModuleName=Os, InputFilesList=Ecud_Os, ExpectedFilesList=Bswmd_Os.arxml, BswDefines=B, IsMCAL=0, GeneratorName=Os.bat
          Bswmd_LinSM: ModuleName=LinSM, InputFilesList=Ecud_LinSM, ExpectedFilesList=Bswmd_LinSM.arxml, BswDefines=B, IsMCAL=0, GeneratorName=LinSM.bat
          Bswmd_WdgIf: ModuleName=WdgIf, InputFilesList=Ecud_WdgIf, ExpectedFilesList=Bswmd_WdgIf.arxml, BswDefines=B, IsMCAL=0, GeneratorName=WdgIf.bat
          Bswmd_CanTrcv: ModuleName=CanTrcv, InputFilesList=Ecud_CanTrcv, ExpectedFilesList=Bswmd_CanTrcv.arxml, BswDefines=B, IsMCAL=0, GeneratorName=CanTrcv.bat
          Bswmd_Nm: ModuleName=Nm, InputFilesList=Ecud_Nm, ExpectedFilesList=Bswmd_Nm.arxml, BswDefines=B, IsMCAL=0, GeneratorName=Nm.bat
          Bswmd_CryIf: ModuleName=CryIf, ExpectedFilesList=Bswmd_CryIf.arxml, InputFilesList=Ecud_Crypto_76_HaeModule, BswDefines=B, IsMCAL=0, InputFilesList=Ecud_CryIf, GeneratorName=CryIf.bat, AUTOSAR44=0, InputFilesList=Crypto_s32k312_mqfp172.epd, InputFilesList=Ecud_Crypto
          Bswmd_Csm: ModuleName=Csm, ExpectedFilesList=Bswmd_Csm.arxml, BswDefines=B, IsMCAL=0, InputFilesList=Ecud_Csm, InputFilesList=Ecud_CryIf, InputFilesList=Ecud_Crypto_76_HaeModule, GeneratorName=Csm.bat, InputFilesList=Ecud_Crypto, InputFilesList=Crypto_s32k312_mqfp172.epd
          Bswmd_CanSM: ModuleName=CanSM, InputFilesList=Ecud_CanSM, ExpectedFilesList=Bswmd_CanSM.arxml, BswDefines=B, IsMCAL=0, GeneratorName=CanSM.bat
          Bswmd_LinIf: ModuleName=LinIf, InputFilesList=Ecud_LinIf, ExpectedFilesList=Bswmd_LinIf.arxml, BswDefines=B, IsMCAL=0, GeneratorName=LinIf.bat
          Bswmd_IpduM: ModuleName=IpduM, InputFilesList=Ecud_IpduM, ExpectedFilesList=Bswmd_IpduM.arxml, BswDefines=B, IsMCAL=0, GeneratorName=IpduM.bat
          Bswmd_KeyM: InputFilesList=Ecud_KeyM, ExpectedFilesList=Bswmd_KeyM.arxml, IsMCAL=0, ModuleName=KeyM, BswDefines=B, GeneratorName=KeyM.bat, AUTOSAR44=0
          Bswmd_CanNm: ExpectedFilesList=Bswmd_CanNm.arxml, BswDefines=B, InputFilesList=Ecud_CanNm, ModuleName=CanNm, IsMCAL=0, GeneratorName=CanNm.bat, InputFilesList=AUTOSAR_DataTypes, InputFilesList=CanStack_DataTypes
          Bswmd_Fota: ModuleName=Fota, InputFilesList=Ecud_Fota, ExpectedFilesList=Bswmd_Fota.arxml, BswDefines=B, IsMCAL=0, AUTOSAR44=1, GeneratorName=Fota.bat
          Bswmd_Mem_76_Pfls: ModuleName=Mem, InputFilesList=Ecud_Mem_76_Pfls, InputFilesList=Mem_76_Pfls_ECU_Configuration_PDF, ExpectedFilesList=Bswmd_Mem_76_Pfls.arxml, BswDefines=B, IsMCAL=0, GeneratorName=Mem_76_Pfls.bat, AUTOSAR44=1
          CanIf: ModuleName=CanIf, IsMCAL=0, ExpectedFilesList=CanIf_Cbk.h, ExpectedFilesList=CanIf_Cfg.c, ExpectedFilesList=CanIf_Cfg.h, ExpectedFilesList=CanIf_UserInc.h, ExpectedFilesList=CanIf_Can.h, ExpectedFilesList=CanIf_CanTrcv.h, AUTOSAR44=1, InputFilesList=CanIf_ECU_Configuration_PDF, InputFilesList=CanNm_ECU_Configuration_PDF, InputFilesList=CanSM_ECU_Configuration_PDF, InputFilesList=CanTp_ECU_Configuration_PDF, InputFilesList=CanTrcv_ECU_Configuration_PDF, InputFilesList=PduR_ECU_Configuration_PDF, InputFilesList=Bswmd_Can, InputFilesList=Bswmd_CanIf, InputFilesList=Bswmd_CanTp, InputFilesList=Bswmd_CanTrcv, InputFilesList=ECUConfigurationParameters, InputFilesList=Ecud_Can, InputFilesList=Ecud_CanNm, InputFilesList=Ecud_CanSM, InputFilesList=Ecud_CanTp, InputFilesList=Ecud_CanTrcv, InputFilesList=Ecud_EcuC, InputFilesList=Ecud_PduR, InputFilesList=Ecud_CanIf, InputFilesList=Can_43_FLEXCAN_s32k312_mqfp172.epd, InputFilesList=Ecud_Nm, InputFilesList=Ecud_EcuM, InputFilesList=EcuM_ECU_Configuration_PDF
          CanSM: ModuleName=CanSM, IsMCAL=0, ExpectedFilesList=CanSM_Cfg.c, ExpectedFilesList=CanSM_Cfg.h, AUTOSAR44=1, InputFilesList=CanIf_ECU_Configuration_PDF, InputFilesList=CanSM_ECU_Configuration_PDF, InputFilesList=ComM_ECU_Configuration_PDF, InputFilesList=Dem_ECU_Configuration_PDF, InputFilesList=Bswmd_CanSM, InputFilesList=Ecud_CanIf, InputFilesList=Ecud_CanSM, InputFilesList=Ecud_Com, InputFilesList=Ecud_ComM, InputFilesList=Ecud_Dem, InputFilesList=Ecud_EcuC, InputFilesList=ECUConfigurationParameters, InputFilesList=CanTrcv_ECU_Configuration_PDF, InputFilesList=Ecud_CanTrcv
          CanTp: ModuleName=CanTp, IsMCAL=0, ExpectedFilesList=CanTp_Cfg.c, ExpectedFilesList=CanTp_Cfg.h, AUTOSAR44=1, InputFilesList=CanIf_ECU_Configuration_PDF, InputFilesList=CanTp_ECU_Configuration_PDF, InputFilesList=Com_ECU_Configuration_PDF, InputFilesList=PduR_ECU_Configuration_PDF, InputFilesList=Bswmd_CanTp, InputFilesList=Ecud_CanTp, InputFilesList=Ecud_Com, InputFilesList=Ecud_EcuC, InputFilesList=Ecud_PduR, InputFilesList=Ecud_CanIf, InputFilesList=ECUConfigurationParameters
          CanTrcv: ModuleName=CanTrcv, BswDefines=Prefix, IsMCAL=0, ExpectedFilesList=CanTrcv_Cfg.c, ExpectedFilesList=CanTrcv_Cfg.h, AUTOSAR44=1, InputFilesList=AUTOSAR_DataTypes, InputFilesList=CanTrcv_ECU_Configuration_PDF, InputFilesList=EcuM_ECU_Configuration_PDF, InputFilesList=Bswmd_CanTrcv, InputFilesList=CanStack_DataTypes, InputFilesList=Ecud_CanTrcv, InputFilesList=Ecud_EcuM, InputFilesList=Ecud_Dio, InputFilesList=Bswmd_Dio, InputFilesList=Dio_s32k312_mqfp172.epd
          Com: ModuleName=Com, BswDefines=Lend, IsMCAL=0, ExpectedFilesList=Com_Cfg.c, ExpectedFilesList=Com_Cfg.h, AUTOSAR44=1, InputFilesList=Com_ECU_Configuration_PDF, InputFilesList=PduR_ECU_Configuration_PDF, InputFilesList=Bswmd_Com, InputFilesList=Ecud_Com, InputFilesList=Ecud_PduR, InputFilesList=Ecud_EcuC, InputFilesList=ECUConfigurationParameters, InputFilesList=Ecud_ComM, InputFilesList=ComM_ECU_Configuration_PDF
          ComM: ModuleName=ComM, IsMCAL=0, ExpectedFilesList=ComM_Cfg.c, ExpectedFilesList=ComM_Cfg.h, AUTOSAR44=1, InputFilesList=AUTOSAR_DataTypes, InputFilesList=ComM_ECU_Configuration_PDF, InputFilesList=Bswmd_ComM, InputFilesList=ComStack_DataTypes, InputFilesList=Ecud_Com, InputFilesList=Ecud_EcuC, InputFilesList=Ecud_NvM, InputFilesList=ECUConfigurationParameters, InputFilesList=Swcd_Bsw_ComM, InputFilesList=Ecud_ComM, InputFilesList=Ecud_CanNm, InputFilesList=Com_ECU_Configuration_PDF, InputFilesList=CanNm_ECU_Configuration_PDF, ExpectedFilesList=ComM_Com.h
          Crc: ModuleName=Crc, ExpectedFilesList=Crc_Cfg.h, IsMCAL=0, AUTOSAR44=1, InputFilesList=Bswmd_Crc, InputFilesList=Ecud_Crc, InputFilesList=Crc_ECU_Configuration_PDF
          Det: ModuleName=Det, IsMCAL=0, ExpectedFilesList=Det_Cfg.h, ExpectedFilesList=Det_Cfg.c, AUTOSAR44=1, InputFilesList=AUTOSAR_DataTypes, InputFilesList=Det_ECU_Configuration_PDF, InputFilesList=ECUConfigurationParameters, InputFilesList=Ecud_Det, InputFilesList=Bswmd_Det
          WdgM: ModuleName=WdgM, IsMCAL=0, ExpectedFilesList=WdgM_Cfg.c, ExpectedFilesList=WdgM_Cfg.h, AUTOSAR44=1, InputFilesList=Dem_ECU_Configuration_PDF, InputFilesList=WdgIf_ECU_Configuration_PDF, InputFilesList=WdgM_ECU_Configuration_PDF, InputFilesList=Bswmd_WdgM, InputFilesList=ECUConfigurationParameters, InputFilesList=Ecud_EcuC, InputFilesList=Ecud_Mcu, InputFilesList=Ecud_Os, InputFilesList=Ecud_Rte, InputFilesList=Ecud_WdgIf, InputFilesList=Ecud_WdgM, InputFilesList=SafeRTE_PDF, InputFilesList=Ecud_Dem, InputFilesList=Os_ECU_Configuration_PDF_S32K312, ExpectedFilesList=WdgM_Ram.h, ExpectedFilesList=WdgM_Cores.c, ExpectedFilesList=WdgM_Ram.c
          HwResource: ModuleName=HwResource, ExpectedFilesList=HwResource.h, InputFilesList=Ecud_HwResource, IsMCAL=0, AUTOSAR44=0
          IoHwAb: ModuleName=IoHwAb, IsMCAL=0, ExpectedFilesList=IoHwAb_Cfg.h, ExpectedFilesList=IoHwAb_Cfg.c, AUTOSAR44=1, InputFilesList=AUTOSAR_DataTypes, InputFilesList=IoHwAb_ECU_Configuration_PDF, InputFilesList=Bswmd_IoHwAb, InputFilesList=Ecud_Dem, InputFilesList=Ecud_Dio, InputFilesList=Ecud_Gpt, InputFilesList=Ecud_Icu, InputFilesList=Ecud_IoHwAb, InputFilesList=Ecud_Mcu, InputFilesList=Ecud_Os, InputFilesList=Ecud_Port, InputFilesList=Ecud_Pwm, InputFilesList=Ecud_Adc
          Os: ModuleName=Os, IsMCAL=0, ExpectedFilesList=Os_Vector.c, ExpectedFilesList=Os_PCfg.h, ExpectedFilesList=Os_PCfg.c, AUTOSAR44=1, InputFilesList=Ecud_Os, InputFilesList=Bswmd_Os, InputFilesList=Ecud_EcuC, InputFilesList=ECUConfigurationParameters, InputFilesList=Bswmdt_Os.template, InputFilesList=Swcdt_Bsw_Os.template, BswDefines=ldfile, BswDefines=Build\S32K31x_RTSW.ld, InputFilesList=Os_ECU_Configuration_PDF_S32K312, GeneratorName=Os.bat, ExpectedFilesList=Os_MemMap.h, ModuleOptions=LinkerFile : Build\S32K31x_RTSW.ld
          OsImp: ModuleName=OsImp, ExpectedFilesList=Os_Imp_Cfg.h, IsMCAL=0, InputFilesList=Ecud_OsImp, AUTOSAR44=0, InputFilesList=Bswmd_OsImp, ExpectedFilesList=Os_Imp_Cfg.c
          OsProfiler: ModuleName=OsProfiler, IsMCAL=0, InputFilesList=Ecud_Os, InputFilesList=Bswmd_OsProfiler, InputFilesList=Ecud_OsProfiler, ExpectedFilesList=Opf_Cfg.h, ExpectedFilesList=Opf_Cfg.c
          Os_Common: ModuleName=Os_Common, IsMCAL=0, BswDefines=ORTI, BswDefines=rteiocspinlock, ExpectedFilesList=Os_Cfg.h, ExpectedFilesList=Os_Cfg.c, ExpectedFilesList=Os_IocCfg.h, ExpectedFilesList=Ioc.h, ExpectedFilesList=Os_IocCfg.c, ExpectedFilesList=Ioc.c, AUTOSAR44=1, ModuleOptions=msnAlias: Os ORTI:, InputFilesList=AUTOSAR_DataTypes, InputFilesList=Bswmd_Os, InputFilesList=Ecud_Os, InputFilesList=Ecud_EcuC, InputFilesList=Swcd_Bsw_Os, InputFilesList=ECUConfigurationParameters, InputFilesList=Os_ECU_Configuration_PDF_S32K312
          PduR: ModuleName=PduR, IsMCAL=0, ExpectedFilesList=PduR_Cfg.c, ExpectedFilesList=PduR_Cfg.h, ExpectedFilesList=PduR_Com.h, ExpectedFilesList=PduR_Incl.h, ExpectedFilesList=PduR_CallBk.c, AUTOSAR44=1, InputFilesList=CanIf_ECU_Configuration_PDF, InputFilesList=CanNm_ECU_Configuration_PDF, InputFilesList=CanTp_ECU_Configuration_PDF, InputFilesList=Com_ECU_Configuration_PDF, InputFilesList=Dcm_ECU_Configuration_PDF, InputFilesList=LinIf_ECU_Configuration_PDF, InputFilesList=PduR_ECU_Configuration_PDF, InputFilesList=Bswmd_LinIf, InputFilesList=ECUConfigurationParameters, InputFilesList=Ecud_CanIf, InputFilesList=Ecud_CanNm, InputFilesList=Ecud_CanTp, InputFilesList=Ecud_Com, InputFilesList=Ecud_Dcm, InputFilesList=Ecud_EcuC, InputFilesList=Ecud_IpduM, InputFilesList=Ecud_LinIf, InputFilesList=Ecud_PduR, InputFilesList=Bswmd_PduR, InputFilesList=IpduM_ECU_Configuration_PDF
          Dem: ModuleName=Dem, IsMCAL=0, ExpectedFilesList=Dem_Cfg.c, ExpectedFilesList=Dem_Cfg.h, AUTOSAR44=1, InputFilesList=AUTOSAR_DataTypes, InputFilesList=Dcm_ECU_Configuration_PDF, InputFilesList=Dem_ECU_Configuration_PDF, InputFilesList=FiM_ECU_Configuration_PDF, InputFilesList=NvM_ECU_Configuration_PDF, InputFilesList=Bswmd_Dem, InputFilesList=Ecud_Dem, InputFilesList=Ecud_FiM, InputFilesList=Ecud_NvM, InputFilesList=Ecud_Dcm
          Csm: ModuleName=Csm, IsMCAL=0, ExpectedFilesList=Csm_Cfg.c, ExpectedFilesList=Csm_Cfg.h, AUTOSAR44=1, InputFilesList=CryIf_ECU_Configuration_PDF, InputFilesList=AUTOSAR_Crypto_76_HaeModule_ECU_Configuration_PDF, InputFilesList=Csm_ECU_Configuration_PDF, InputFilesList=Bswmd_CryIf, InputFilesList=ECUConfigurationParameters, InputFilesList=Ecud_CryIf, InputFilesList=Ecud_Csm, InputFilesList=Bswmd_Csm, InputFilesList=Bswmd_Crypto_76_HaeModule, InputFilesList=Ecud_Crypto_76_HaeModule
          Dcm: ModuleName=Dcm, ExpectedFilesList=Dcm_Cfg.c, ExpectedFilesList=Dcm_Cfg.h, IsMCAL=0, AUTOSAR44=1, InputFilesList=AUTOSAR_DataTypes, InputFilesList=ComM_ECU_Configuration_PDF, InputFilesList=Csm_ECU_Configuration_PDF, InputFilesList=Dcm_ECU_Configuration_PDF, InputFilesList=Dem_ECU_Configuration_PDF, InputFilesList=KeyM_ECU_Configuration_PDF, InputFilesList=NvM_ECU_Configuration_PDF, InputFilesList=PduR_ECU_Configuration_PDF, InputFilesList=Bswmd_Dcm, InputFilesList=Bswmd_Dem, InputFilesList=Bswmd_NvM, InputFilesList=ECUConfigurationParameters, InputFilesList=Ecud_ComM, InputFilesList=Ecud_Csm, InputFilesList=Ecud_Dem, InputFilesList=Ecud_EcuC, InputFilesList=Ecud_KeyM, InputFilesList=Ecud_NvM, InputFilesList=Ecud_PduR, InputFilesList=Ecud_Dcm, ExpectedFilesList=Dcm_APIs.h, ExpectedFilesList=Dcm_APIs.c
          ComXf: ModuleName=ComXf, IsMCAL=0, ExpectedFilesList=ComXf_Cfg.h, ExpectedFilesList=ComXf_Cfg.c, AUTOSAR44=1, InputFilesList=ComXf_ECU_Configuration_PDF, InputFilesList=Com_ECU_Configuration_PDF, InputFilesList=App_E2EXf, InputFilesList=Bswmd_ComXf, InputFilesList=EcuExtract, InputFilesList=Ecud_Com, InputFilesList=Ecud_ComXf, InputFilesList=FD_CAN1, InputFilesList=Transformer, InputFilesList=AUTOSAR_DataTypes, ExpectedFilesList=ComXf_APIs.h, ExpectedFilesList=ComXf_PbCfg.h, ExpectedFilesList=ComXf_APIs.c, ExpectedFilesList=ComXf_PbCfg.c
          E2EXf: ModuleName=E2EXf, IsMCAL=0, ExpectedFilesList=E2EXf_Cfg.h, ExpectedFilesList=E2EXf_APIs.h, ExpectedFilesList=E2EXf_APIs.c, AUTOSAR44=1, InputFilesList=Dem_ECU_Configuration_PDF, InputFilesList=E2EXf_ECU_Configuration_PDF, InputFilesList=Bswmd_E2EXf, InputFilesList=Ecud_Dem, InputFilesList=FD_CAN1, InputFilesList=Transformer, InputFilesList=Ecud_E2EXf, ExpectedFilesList=E2EXf_PbCfg.h, ExpectedFilesList=E2EXf_PbCfg.c
          BswM: ModuleName=BswM, IsMCAL=0, ExpectedFilesList=BswM.h, ExpectedFilesList=BswM_ActionList.h, ExpectedFilesList=BswM_Cfg.h, ExpectedFilesList=BswM_Rule.h, ExpectedFilesList=BswM.c, ExpectedFilesList=BswM_ActionList.c, ExpectedFilesList=BswM_Cfg.c, ExpectedFilesList=BswM_Ram.c, ExpectedFilesList=BswM_Rule.c, InputFilesList=BswM_ECU_Configuration_PDF, InputFilesList=ComM_ECU_Configuration_PDF, InputFilesList=Com_ECU_Configuration_PDF, AUTOSAR44=1, InputFilesList=EcuM_ECU_Configuration_PDF, InputFilesList=LinSM_ECU_Configuration_PDF, InputFilesList=NvM_ECU_Configuration_PDF, InputFilesList=Bswmd_BswM, InputFilesList=Bswmd_Dcm, InputFilesList=Bswmd_EcuM, InputFilesList=EcuM_PortInterface, InputFilesList=Ecud_BswM, InputFilesList=Ecud_Com, InputFilesList=Ecud_ComM, InputFilesList=Ecud_Crc, InputFilesList=Ecud_EcuC, InputFilesList=Ecud_EcuM, InputFilesList=Ecud_LinSM, InputFilesList=Ecud_NvM, InputFilesList=Ecud_Os, InputFilesList=Ecud_Rte, InputFilesList=MODE_PortInterfaces, InputFilesList=SafeRTE_PDF, InputFilesList=Swcd_Bsw_BswM, InputFilesList=AUTOSAR_DataTypes, InputFilesList=ECUConfigurationParameters, InputFilesList=Os_ECU_Configuration_PDF_S32K312, ExpectedFilesList=BswM_Generated_Types.h, ExpectedFilesList=BswM_MemMap.h, ExpectedFilesList=BswM_Ram.h, ModuleOptions=Compiler_Type: ghs
          WdgIf: ModuleName=WdgIf, IsMCAL=0, ExpectedFilesList=WdgIf_Cfg.h, AUTOSAR44=1, InputFilesList=WdgIf_ECU_Configuration_PDF, InputFilesList=Wdg_ECU_Configuration_PDF, InputFilesList=Bswmd_WdgIf, InputFilesList=Bswmd_Wdg_76_Acw, InputFilesList=Ecud_Wdg, InputFilesList=Ecud_Wdg_76_Acw, InputFilesList=Ecud_WdgIf, ExpectedFilesList=WdgIf_Cfg.c, InputFilesList=Bswmd_Wdg
          Wdg_76_Acw: ModuleName=Wdg, IsMCAL=0, ExpectedFilesList=Wdg_76_Acw_Cfg.c, ExpectedFilesList=Wdg_76_Acw_Cfg.h, AUTOSAR44=1, InputFilesList=Wdg_ECU_Configuration_PDF, InputFilesList=Bswmd_Wdg_76_Acw, InputFilesList=Ecud_Dio, InputFilesList=Ecud_EcuC, InputFilesList=Ecud_Gpt, InputFilesList=Ecud_Wdg_76_Acw, InputFilesList=Ecud_Dem, InputFilesList=Gpt_s32k312_mqfp172.epd
          MemIf: ModuleName=MemIf, IsMCAL=0, ExpectedFilesList=MemIf_Cfg.h, AUTOSAR44=1, InputFilesList=MemIf_ECU_Configuration_PDF, InputFilesList=Bswmd_MemIf, InputFilesList=Ecud_MemIf, InputFilesList=Ecud_Fee, InputFilesList=Ecud_Fls, InputFilesList=Fls_s32k312_mqfp172.epd, InputFilesList=Fee.epd
          NvM: ModuleName=NvM, IsMCAL=0, ExpectedFilesList=NvM_Cfg.h, ExpectedFilesList=NvM_Cfg.c, ExpectedFilesList=NvM_Dem_Cfg.h, AUTOSAR44=1, InputFilesList=Dem_ECU_Configuration_PDF, InputFilesList=NvM_ECU_Configuration_PDF, InputFilesList=Bswmd_NvM, InputFilesList=ECUConfigurationParameters, InputFilesList=Ecud_NvM, InputFilesList=Ecud_Dem, InputFilesList=Ecud_Fee, InputFilesList=Ecud_Fls, InputFilesList=Ecud_Os, InputFilesList=Os_ECU_Configuration_PDF_S32K312, InputFilesList=Fls_s32k312_mqfp172.epd, InputFilesList=Fee.epd
          LinTrcv: ModuleName=LinTrcv, IsMCAL=0, ExpectedFilesList=LinTrcv.h, ExpectedFilesList=LinTrcv_Cfg.h, ExpectedFilesList=LinTrcv_Driver.h, ExpectedFilesList=LinTrcv_Cfg.c, AUTOSAR44=1, InputFilesList=EcuM_ECU_Configuration_PDF, InputFilesList=LinTrcv_ECU_Configuration_PDF, InputFilesList=Bswmd_LinTrcv, InputFilesList=ECUConfigurationParameters, InputFilesList=Ecud_Dio, InputFilesList=Ecud_EcuM, InputFilesList=Ecud_LinTrcv, InputFilesList=Dio_s32k312_mqfp172.epd
          LinIf: ModuleName=LinIf, IsMCAL=0, ExpectedFilesList=LinIf_Cfg.c, ExpectedFilesList=LinIf_Cfg.h, AUTOSAR44=1, InputFilesList=ComM_ECU_Configuration_PDF, InputFilesList=Com_ECU_Configuration_PDF, InputFilesList=LinIf_ECU_Configuration_PDF, InputFilesList=LinTrcv_ECU_Configuration_PDF, InputFilesList=PduR_ECU_Configuration_PDF, InputFilesList=Bswmd_Lin, InputFilesList=Bswmd_LinIf, InputFilesList=Bswmd_LinTrcv, InputFilesList=Ecud_BswM, InputFilesList=Ecud_Com, InputFilesList=Ecud_ComM, InputFilesList=Ecud_EcuC, InputFilesList=Ecud_EcuM, InputFilesList=Ecud_Lin, InputFilesList=Ecud_LinIf, InputFilesList=Ecud_LinTrcv, InputFilesList=Ecud_PduR, InputFilesList=ECUConfigurationParameters, InputFilesList=Lin_43_LPUART_FLEXIO_s32k312_mqfp172.epd
          LinSM: ModuleName=LinSM, IsMCAL=0, ExpectedFilesList=LinSM_Cfg.c, ExpectedFilesList=LinSM_Cfg.h, AUTOSAR44=1, InputFilesList=ComM_ECU_Configuration_PDF, InputFilesList=LinIf_ECU_Configuration_PDF, InputFilesList=LinSM_ECU_Configuration_PDF, InputFilesList=Bswmd_LinSM, InputFilesList=ECUConfigurationParameters, InputFilesList=Ecud_ComM, InputFilesList=Ecud_LinIf, InputFilesList=Ecud_LinSM
          CryIf: ModuleName=CryIf, IsMCAL=0, ExpectedFilesList=CryIf_Cfg.c, ExpectedFilesList=CryIf_Cfg.h, AUTOSAR44=1, InputFilesList=CryIf_ECU_Configuration_PDF, InputFilesList=AUTOSAR_Crypto_76_HaeModule_ECU_Configuration_PDF, InputFilesList=Bswmd_CryIf, InputFilesList=Bswmd_Crypto, InputFilesList=ECUConfigurationParameters, InputFilesList=Ecud_CryIf, InputFilesList=Bswmd_Crypto_76_HaeModule, InputFilesList=Ecud_Crypto_76_HaeModule, InputFilesList=Ecud_Crypto, InputFilesList=Crypto_s32k312_mqfp172.epd
          Fota: ModuleName=Fota, InputFilesList=Ecud_Fota, InputFilesList=Ecud_Mem_76_Pfls, InputFilesList=Fota_ECU_Configuration_PDF, InputFilesList=Bswmd_Fota, InputFilesList=Ecud_Csm, InputFilesList=Csm_ECU_Configuration_PDF, InputFilesList=Ecud_CryIf, InputFilesList=CryIf_ECU_Configuration_PDF, InputFilesList=Ecud_Crypto, InputFilesList=Crypto_s32k312_mqfp172.epd, InputFilesList=AUTOSAR_Crypto_76_HaeModule_ECU_Configuration_PDF, InputFilesList=Ecud_Crypto_76_HaeModule, InputFilesList=Mem_76_Pfls_ECU_Configuration_PDF, ExpectedFilesList=Fota_Cfg.h, ExpectedFilesList=Fota_Cfg.c, IsMCAL=0, AUTOSAR44=1
          Mem_76_Pfls: ModuleName=Mem, InputFilesList=Bswmd_Mem_76_Pfls, InputFilesList=Mem_76_Pfls_ECU_Configuration_PDF, InputFilesList=Ecud_Mem_76_Pfls, ExpectedFilesList=Mem_76_Pfls_Cfg.h, ExpectedFilesList=Mem_76_Pfls_Cfg.c, IsMCAL=0, AUTOSAR44=1, GeneratorName=Mem_76_Pfls.bat
          Rte: ModuleName=Rte, IsMCAL=0, ExpectedFilesList=Rte.c, ExpectedFilesList=Rte_Cbk.h, ExpectedFilesList=Rte_Hook.h, InputFilesList=AUTOSAR_DataTypes, InputFilesList=Bswmd_BswM, InputFilesList=Bswmd_CanIf, InputFilesList=Bswmd_CanSM, InputFilesList=Bswmd_CanTrcv, InputFilesList=Bswmd_Can, InputFilesList=Bswmd_Com, InputFilesList=Bswmd_ComM, InputFilesList=Bswmd_EcuM, InputFilesList=Bswmd_Gpt, InputFilesList=Bswmd_Mcu, InputFilesList=Bswmd_PduR, InputFilesList=EcuExtract, InputFilesList=EcuM_PortInterface, InputFilesList=Ecud_Com, InputFilesList=Ecud_EcuC, InputFilesList=Ecud_Os, InputFilesList=Transformer, InputFilesList=App_Mode, InputFilesList=ECUCD_EcucValueCollection, InputFilesList=Ecud_Rte, InputFilesList=MODE_PortInterfaces, InputFilesList=Swcd_Bsw_BswM, InputFilesList=Swcd_Bsw_EcuM, InputFilesList=Swcd_Bsw_Os, InputFilesList=Bswmd_Adc, InputFilesList=Ecud_Adc, InputFilesList=Bswmd_Det, InputFilesList=Bswmd_Icu, InputFilesList=Bswmd_Pwm, InputFilesList=Bswmd_IoHwAb, InputFilesList=Ecud_CanTp, InputFilesList=Bswmd_CanTp, InputFilesList=Ecud_Wdg, InputFilesList=Bswmd_Crc, InputFilesList=Bswmd_Fee, InputFilesList=Bswmd_Fee, InputFilesList=Bswmd_Fee, InputFilesList=Bswmd_Fee, InputFilesList=Bswmd_Fee, InputFilesList=Bswmd_Fee, InputFilesList=Bswmd_Fee, InputFilesList=Bswmd_Fee, InputFilesList=Bswmd_Fee, InputFilesList=Bswmd_Fee, InputFilesList=Bswmd_MemIf, InputFilesList=Bswmd_Spi, InputFilesList=Swcd_Bsw_Dem, InputFilesList=Bswmd_Dem, InputFilesList=Bswmd_NvM, InputFilesList=Swcd_Bsw_NvM, InputFilesList=Bswmd_Dcm, InputFilesList=Swcd_Bsw_Dcm, InputFilesList=Bswmd_Csm, InputFilesList=Swcd_Bsw_Csm, InputFilesList=App_E2EXf, InputFilesList=Bswmd_E2EXf, InputFilesList=Bswmd_ComXf, InputFilesList=Ecud_E2EXf, InputFilesList=Ecud_ComXf, InputFilesList=Bswmd_Wdg_76_Acw, InputFilesList=Bswmd_Os, InputFilesList=Swcd_Bsw_ComM, InputFilesList=Swcd_Bsw_IoHwAb, InputFilesList=FD_CAN1, InputFilesList=Swcd_Bsw_Det, InputFilesList=Bswmd_WdgM, InputFilesList=Bswmd_CanCM, InputFilesList=Swcd_Bsw_WdgM, InputFilesList=ComStack_DataTypes, InputFilesList=Bswmd_Tm, InputFilesList=Bswmd_StbM, InputFilesList=Swcd_Bsw_StbM, InputFilesList=Bswmd_CanNm, InputFilesList=CanStack_DataTypes, InputFilesList=Bswmd_FiM, InputFilesList=Swcd_Bsw_FiM, InputFilesList=Bswmd_LinIf, InputFilesList=Bswmd_LinSM, InputFilesList=App_Lin, InputFilesList=Swcd_Lin, InputFilesList=LIN1, InputFilesList=Bswmd_Lin, InputFilesList=Bswmd_LinTrcv, InputFilesList=Ecud_BswM, InputFilesList=Ecud_CanCM, InputFilesList=Ecud_CanIf, InputFilesList=Ecud_CanNm, InputFilesList=Ecud_CanSM, InputFilesList=Ecud_CanTrcv, InputFilesList=Ecud_ComM, InputFilesList=Ecud_Crc, InputFilesList=Ecud_Csm, InputFilesList=Ecud_Dcm, InputFilesList=Ecud_Dem, InputFilesList=Ecud_Det, InputFilesList=Ecud_EcuM, InputFilesList=Ecud_FiM, InputFilesList=Ecud_IoHwAb, InputFilesList=Ecud_LinIf, InputFilesList=Ecud_LinSM, InputFilesList=Ecud_LinTrcv, InputFilesList=Ecud_MemIf, InputFilesList=Ecud_Nm, InputFilesList=Ecud_NvM, InputFilesList=Ecud_PduR, InputFilesList=Ecud_StbM, InputFilesList=Ecud_Tm, InputFilesList=Ecud_WdgIf, InputFilesList=Ecud_WdgM, InputFilesList=Ecud_Wdg_76_Acw, InputFilesList=Bswmd_IpduM, InputFilesList=Bswmd_WdgIf, InputFilesList=Bswmd_Nm, InputFilesList=Bswmd_CryIf, InputFilesList=Ecud_CryIf, InputFilesList=Bswmd_KeyM, InputFilesList=Swcd_Bsw_KeyM, InputFilesList=Bswmd_Crypto_76_HaeModule, InputFilesList=App_WdgM, InputFilesList=Bswmd_Fee, InputFilesList=Bswmd_Fls, InputFilesList=App_Dcm, InputFilesList=App_Dem, InputFilesList=Ecud_Crypto_76_HaeModule, InputFilesList=Os_ECU_Configuration_PDF_S32K312, InputFilesList=Bswmd_Dio, InputFilesList=Bswmd_Mcl, InputFilesList=Bswmd_Port, InputFilesList=Bswmd_Wdg, InputFilesList=Bswmd_Crypto, InputFilesList=Swcd_Fota, InputFilesList=Bswmd_Fota, InputFilesList=Bswmd_Mem_76_Pfls, InputFilesList=Ecud_Fota, InputFilesList=LIN2, BswDefines=TRANSFORMER, AUTOSAR44=1, ExpectedFilesList=Rte.h, ExpectedFilesList=Rte_Cfg.h, ExpectedFilesList=Rte_DataHandleType.h, ExpectedFilesList=Rte_Internal.h, ExpectedFilesList=Rte_IntMacros.h, ExpectedFilesList=Rte_Main.h, ExpectedFilesList=Rte_MemMap.h, ExpectedFilesList=Rte_Static.h, ExpectedFilesList=Rte_Type.h, ExpectedFilesList=Rte_User.h, ExpectedFilesList=SchM_Adc.h, ExpectedFilesList=SchM_Adc_Type.h, ExpectedFilesList=SchM_BswM.h, ExpectedFilesList=SchM_BswM_Type.h, ExpectedFilesList=SchM_CanCM.h, ExpectedFilesList=SchM_CanCM_Type.h, ExpectedFilesList=SchM_CanIf.h, ExpectedFilesList=SchM_CanIf_Type.h, ExpectedFilesList=SchM_CanNm.h, ExpectedFilesList=SchM_CanNm_Type.h, ExpectedFilesList=SchM_CanSM.h, ExpectedFilesList=SchM_CanSM_Type.h, ExpectedFilesList=SchM_CanTp.h, ExpectedFilesList=SchM_CanTp_Type.h, ExpectedFilesList=SchM_CanTrcv.h, ExpectedFilesList=SchM_CanTrcv_Type.h, ExpectedFilesList=SchM_CanTSyn.h, ExpectedFilesList=SchM_CanTSyn_Type.h, ExpectedFilesList=SchM_Com.h, ExpectedFilesList=SchM_ComM.h, ExpectedFilesList=SchM_ComM_Type.h, ExpectedFilesList=SchM_Com_Type.h, ExpectedFilesList=SchM_Crypto_76_Common.h, ExpectedFilesList=SchM_Crypto_76_CommonType.h, ExpectedFilesList=SchM_Csm.h, ExpectedFilesList=SchM_Csm_Type.h, ExpectedFilesList=SchM_Dcm.h, ExpectedFilesList=SchM_Dcm_Type.h, ExpectedFilesList=SchM_Dem.h, ExpectedFilesList=SchM_Dem_Type.h, ExpectedFilesList=SchM_Det.h, ExpectedFilesList=SchM_Det_Type.h, ExpectedFilesList=SchM_EcuM.h, ExpectedFilesList=SchM_EcuM_Type.h, ExpectedFilesList=SchM_Fee.h, ExpectedFilesList=SchM_Fee_Type.h, ExpectedFilesList=SchM_FiM.h, ExpectedFilesList=SchM_FiM_Type.h, ExpectedFilesList=SchM_Gpt.h, ExpectedFilesList=SchM_Gpt_Type.h, ExpectedFilesList=SchM_IoHwAb.h, ExpectedFilesList=SchM_IoHwAb_Type.h, ExpectedFilesList=SchM_IpduM.h, ExpectedFilesList=SchM_IpduM_Type.h, ExpectedFilesList=SchM_KeyM.h, ExpectedFilesList=SchM_KeyM_Type.h, ExpectedFilesList=SchM_LinIf.h, ExpectedFilesList=SchM_LinIf_Type.h, ExpectedFilesList=SchM_LinSM.h, ExpectedFilesList=SchM_LinSM_Type.h, ExpectedFilesList=SchM_LinTrcv.h, ExpectedFilesList=SchM_LinTrcv_Type.h, ExpectedFilesList=SchM_Mcu.h, ExpectedFilesList=SchM_Mcu_Type.h, ExpectedFilesList=SchM_Nm.h, ExpectedFilesList=SchM_Nm_Type.h, ExpectedFilesList=SchM_NvM.h, ExpectedFilesList=SchM_NvM_Type.h, ExpectedFilesList=SchM_OsekNm.h, ExpectedFilesList=SchM_OsekNm_Type.h, ExpectedFilesList=SchM_PduR.h, ExpectedFilesList=SchM_PduR_Type.h, ExpectedFilesList=SchM_Spi.h, ExpectedFilesList=SchM_Spi_Type.h, ExpectedFilesList=SchM_StbM.h, ExpectedFilesList=SchM_StbM_Type.h, ExpectedFilesList=SchM_WdgM.h, ExpectedFilesList=SchM_WdgM_Type.h, ExpectedFilesList=SchM_Wdg_76_Acw_76_Acw.h, ExpectedFilesList=SchM_Wdg_76_Acw_76_AcwType.h, ExpectedFilesList=Rte_User.c, ExpectedFilesList=SchM_Dio.h, ExpectedFilesList=SchM_Dio_Type.h, ExpectedFilesList=SchM_Fls.h, ExpectedFilesList=SchM_Fls_Type.h, ExpectedFilesList=SchM_Icu.h, ExpectedFilesList=SchM_Icu_Type.h, ExpectedFilesList=SchM_Mcl.h, ExpectedFilesList=SchM_Mcl_Type.h, ExpectedFilesList=SchM_Port.h, ExpectedFilesList=SchM_Port_Type.h, ExpectedFilesList=SchM_Pwm.h, ExpectedFilesList=SchM_Pwm_Type.h, ExpectedFilesList=SchM_Wdg_43_Instance0.h, ExpectedFilesList=SchM_Wdg_43_Instance0Type.h, ExpectedFilesList=SchM_Ea.h, ExpectedFilesList=SchM_Ea_Type.h, ExpectedFilesList=SchM_Eep.h, ExpectedFilesList=SchM_Eep_Type.h, ExpectedFilesList=SchM_Can_43_FLEXCAN.h, ExpectedFilesList=SchM_Can_43_FLEXCANType.h, ExpectedFilesList=SchM_Crypto.h, ExpectedFilesList=SchM_Crypto_Type.h, ExpectedFilesList=SchM_Lin_43_LPUART_FLEXIO.h, ExpectedFilesList=SchM_Lin_43_LPUART_FLEXIOType.h, BswIncludePath=Static_Code\Modules\Rte_R44, BswDefines=[XMS]1G, BswDefines=[XMX]1G, BswDefines=[HYP]generate, BswDefines=[HYP]logfile, BswDefines=[HYP]suppSchemaVal, BswDefines=[MOD]genIocOnly, BswDefines=[MOD]handleIDPrefix
          Swcd_Bsw_Dem: ModuleName=Dem, BswDefines=S, ExpectedFilesList=Swcd_Bsw_Dem.arxml, IsMCAL=0, InputFilesList=Ecud_Dem, InputFilesList=Bswmd_Dem, InputFilesList=Ecud_Dcm, InputFilesList=Ecud_NvM, AUTOSAR44=0, GeneratorName=Dem.bat
          Swcd_Bsw_Nvm: ModuleName=NvM, BswDefines=S, ExpectedFilesList=Swcd_Bsw_NvM.arxml, BswDefines=P, IsMCAL=0, InputFilesList=Ecud_Dem, InputFilesList=Bswmd_NvM, InputFilesList=Ecud_NvM, AUTOSAR44=0, GeneratorName=NvM.bat
          Swcd_Bsw_Csm: ModuleName=Csm, InputFilesList=Bswmd_Csm, InputFilesList=Ecud_HwResource, InputFilesList=Ecud_Csm, ExpectedFilesList=Swcd_Bsw_Csm.arxml, BswDefines=S, IsMCAL=0, AUTOSAR44=0, GeneratorName=Csm.bat
          Swcd_Bsw_EcuM: ModuleName=EcuM, InputFilesList=Ecud_EcuM, ExpectedFilesList=Swcd_Bsw_EcuM.arxml, BswDefines=S, IsMCAL=0, GeneratorName=EcuM.bat, AUTOSAR44=0, InputFilesList=Bswmd_EcuM
          Swcd_Bsw_IoHwAb: ModuleName=IoHwAb, ExpectedFilesList=Swcd_Bsw_IoHwAb.arxml, BswDefines=S, IsMCAL=0, InputFilesList=Ecud_Adc, InputFilesList=Ecud_IoHwAb, InputFilesList=Bswmd_IoHwAb, InputFilesList=Ecud_Mcu, InputFilesList=Ecud_Os, InputFilesList=Ecud_Dio, InputFilesList=Ecud_Port, InputFilesList=Bswmd_Icu, InputFilesList=Ecud_Icu, InputFilesList=Bswmd_Pwm, InputFilesList=Ecud_Pwm, InputFilesList=Ecud_Gpt, InputFilesList=Ecud_Spi, AUTOSAR44=0, GeneratorName=IoHwAb.bat
          Swcd_Bsw_Det: ModuleName=Det, BswDefines=S, ExpectedFilesList=Swcd_Bsw_Det.arxml, IsMCAL=0, InputFilesList=Ecud_Det, AUTOSAR44=0, GeneratorName=Det.bat, InputFilesList=Bswmd_Det
          Swcd_Bsw_Dcm: ModuleName=Dcm, InputFilesList=Ecud_Dcm, ExpectedFilesList=Swcd_Bsw_Dcm.arxml, BswDefines=S, IsMCAL=0, GeneratorName=Dcm.bat, AUTOSAR44=0, InputFilesList=Bswmd_Dcm
          Swcd_Bsw_WdgM: ModuleName=WdgM, InputFilesList=Ecud_WdgM, ExpectedFilesList=Swcd_Bsw_WdgM.arxml, BswDefines=S, IsMCAL=0, GeneratorName=WdgM.bat, AUTOSAR44=0, InputFilesList=Bswmd_WdgM
          Swcd_Bsw_ComM: ModuleName=ComM, InputFilesList=Ecud_ComM, ExpectedFilesList=Swcd_Bsw_ComM.arxml, BswDefines=S, IsMCAL=0, GeneratorName=ComM.bat, AUTOSAR44=0, InputFilesList=Bswmd_ComM
          Swcd_Bsw_StbM: ModuleName=StbM, InputFilesList=Ecud_StbM, ExpectedFilesList=Swcd_Bsw_StbM.arxml, BswDefines=S, IsMCAL=0, GeneratorName=StbM.bat, AUTOSAR44=0, InputFilesList=Bswmd_StbM
          Swcd_Bsw_FiM: ModuleName=FiM, InputFilesList=Ecud_FiM, ExpectedFilesList=Swcd_Bsw_FiM.arxml, IsMCAL=0, BswDefines=S, GeneratorName=FiM.bat, AUTOSAR44=0, InputFilesList=Bswmd_FiM
          Swcd_Bsw_CanTrcv: ModuleName=CanTrcv, InputFilesList=Ecud_CanTrcv, ExpectedFilesList=Swcd_Bsw_CanTrcv.arxml, BswDefines=S, IsMCAL=0, GeneratorName=CanTrcv.bat, AUTOSAR44=0, InputFilesList=Bswmd_CanTrcv
          Swcd_Bsw_Os: ModuleName=Os, InputFilesList=Ecud_Os, ExpectedFilesList=Swcd_Bsw_Os.arxml, BswDefines=S, IsMCAL=0, AUTOSAR44=0, GeneratorName=Os.bat, InputFilesList=Bswmd_Os
          Swcd_Bsw_KeyM: InputFilesList=Ecud_KeyM, ExpectedFilesList=Swcd_Bsw_KeyM.arxml, IsMCAL=0, ModuleName=KeyM, BswDefines=S, GeneratorName=KeyM.bat, AUTOSAR44=0, InputFilesList=Bswmd_KeyM
          Swcd_Fota: AUTOSAR44=0, BswDefines=S, ExpectedFilesList=Swcd_Fota.arxml, GeneratorName=Fota.bat, InputFilesList=Ecud_Fota, IsMCAL=0, ModuleName=Fota
          EcuM: ModuleName=EcuM, IsMCAL=0, AUTOSAR44=1, ExpectedFilesList=EcuM_Cfg.h, ExpectedFilesList=EcuM_Generated_Callouts.c, ExpectedFilesList=EcuM_Generated_Callouts.h, ExpectedFilesList=EcuM_Generated_Types.h, ExpectedFilesList=EcuM_PBcfg.c, ExpectedFilesList=EcuM_Cfg.c, InputFilesList=AUTOSAR_DataTypes, InputFilesList=CanIf_ECU_Configuration_PDF, InputFilesList=CanNm_ECU_Configuration_PDF, InputFilesList=CanSM_ECU_Configuration_PDF, InputFilesList=CanTp_ECU_Configuration_PDF, InputFilesList=CanTrcv_ECU_Configuration_PDF, InputFilesList=ComM_ECU_Configuration_PDF, InputFilesList=ComXf_ECU_Configuration_PDF, InputFilesList=Com_ECU_Configuration_PDF, InputFilesList=Crc_ECU_Configuration_PDF, InputFilesList=CryIf_ECU_Configuration_PDF, InputFilesList=AUTOSAR_Crypto_76_HaeModule_ECU_Configuration_PDF, InputFilesList=Csm_ECU_Configuration_PDF, InputFilesList=Dcm_ECU_Configuration_PDF, InputFilesList=Dem_ECU_Configuration_PDF, InputFilesList=Det_ECU_Configuration_PDF, InputFilesList=E2EXf_ECU_Configuration_PDF, InputFilesList=EcuM_ECU_Configuration_PDF, InputFilesList=FiM_ECU_Configuration_PDF, InputFilesList=IoHwAb_ECU_Configuration_PDF, InputFilesList=KeyM_ECU_Configuration_PDF, InputFilesList=LinIf_ECU_Configuration_PDF, InputFilesList=LinSM_ECU_Configuration_PDF, InputFilesList=LinTrcv_ECU_Configuration_PDF, InputFilesList=Nm_ECU_Configuration_PDF, InputFilesList=PduR_ECU_Configuration_PDF, InputFilesList=StbM_ECU_Configuration_PDF, InputFilesList=WdgM_ECU_Configuration_PDF, InputFilesList=Wdg_ECU_Configuration_PDF, InputFilesList=Bswmd_Adc, InputFilesList=Bswmd_Can, InputFilesList=Bswmd_CanCM, InputFilesList=Bswmd_CanIf, InputFilesList=Bswmd_CanSM, InputFilesList=Bswmd_CanTp, InputFilesList=Bswmd_CanTrcv, InputFilesList=Bswmd_Com, InputFilesList=Bswmd_ComM, InputFilesList=Bswmd_ComXf, InputFilesList=Bswmd_Crc, InputFilesList=Bswmd_CryIf, InputFilesList=Bswmd_Csm, InputFilesList=Bswmd_Dcm, InputFilesList=Bswmd_Dem, InputFilesList=Bswmd_Det, InputFilesList=Bswmd_Dio, InputFilesList=Bswmd_E2EXf, InputFilesList=Bswmd_EcuM, InputFilesList=Bswmd_FiM, InputFilesList=Bswmd_Gpt, InputFilesList=Bswmd_Icu, InputFilesList=Bswmd_IoHwAb, InputFilesList=Bswmd_Lin, InputFilesList=Bswmd_Mcu, InputFilesList=Bswmd_PduR, InputFilesList=Bswmd_Port, InputFilesList=Bswmd_Pwm, InputFilesList=Bswmd_Spi, InputFilesList=Bswmd_StbM, InputFilesList=Bswmd_Wdg_76_Acw, InputFilesList=EcuM_PortInterface, InputFilesList=Ecud_Adc, InputFilesList=Ecud_Can, InputFilesList=Ecud_CanCM, InputFilesList=Ecud_CanIf, InputFilesList=Ecud_CanNm, InputFilesList=Ecud_CanSM, InputFilesList=Ecud_CanTp, InputFilesList=Ecud_CanTrcv, InputFilesList=Ecud_Com, InputFilesList=Ecud_ComM, InputFilesList=Ecud_ComXf, InputFilesList=Ecud_Crc, InputFilesList=Ecud_CryIf, InputFilesList=Ecud_Csm, InputFilesList=Ecud_Dcm, InputFilesList=Ecud_Dem, InputFilesList=Ecud_Det, InputFilesList=Ecud_Dio, InputFilesList=Ecud_E2EXf, InputFilesList=Ecud_EcuC, InputFilesList=Ecud_EcuM, InputFilesList=Ecud_FiM, InputFilesList=Ecud_Gpt, InputFilesList=Ecud_Icu, InputFilesList=Ecud_IoHwAb, InputFilesList=Ecud_IpduM, InputFilesList=Ecud_KeyM, InputFilesList=Ecud_Lin, InputFilesList=Ecud_LinIf, InputFilesList=Ecud_LinSM, InputFilesList=Ecud_LinTrcv, InputFilesList=Ecud_Mcu, InputFilesList=Ecud_Nm, InputFilesList=Ecud_Os, InputFilesList=Ecud_PduR, InputFilesList=Ecud_Port, InputFilesList=Ecud_Pwm, InputFilesList=Ecud_Spi, InputFilesList=Ecud_StbM, InputFilesList=Ecud_Wdg, InputFilesList=Ecud_WdgM, InputFilesList=Ecud_Wdg_76_Acw, InputFilesList=Swcd_Bsw_EcuM.arxml, InputFilesList=Bswmd_Crypto_76_HaeModule, InputFilesList=PostBuildVariants, InputFilesList=CanCM_ECU_Configuration_PDF, InputFilesList=Ecud_Rte, InputFilesList=SafeRTE_PDF, InputFilesList=ECUConfigurationParameters, InputFilesList=OsImp_ECU_Configuration_PDF, InputFilesList=Bswmd_OsImp, InputFilesList=Ecud_OsImp, InputFilesList=Ecud_BswM, InputFilesList=BswM_ECU_Configuration_PDF, InputFilesList=Ecud_Crypto_76_HaeModule, InputFilesList=Adc_s32k312_mqfp172.epd, InputFilesList=Dio_s32k312_mqfp172.epd, InputFilesList=Gpt_s32k312_mqfp172.epd, InputFilesList=Icu_s32k312_mqfp172.epd, InputFilesList=Mcl_s32k312_mqfp172.epd, InputFilesList=Mcu_s32k312_mqfp172.epd, InputFilesList=Port_s32k312_mqfp172.epd, InputFilesList=Pwm_s32k312_mqfp172.epd, InputFilesList=Spi_s32k312_mqfp172.epd, InputFilesList=Wdg_s32k312_mqfp172.epd, InputFilesList=Os_ECU_Configuration_PDF_S32K312, InputFilesList=Ecud_Mcl, InputFilesList=Bswmd_Mcl, InputFilesList=Crypto_s32k312_mqfp172.epd, InputFilesList=Can_43_FLEXCAN_s32k312_mqfp172.epd, InputFilesList=Lin_43_LPUART_FLEXIO_s32k312_mqfp172.epd, InputFilesList=IpduM_ECU_Configuration_PDF, BswDefines=EcuMConfPrefix, ExpectedFilesList=EcuM_PBcfg.h
          CanCM: ModuleName=CanCM, ExpectedFilesList=CanCM_Cfg.h, ExpectedFilesList=CanCM_Cfg.c, IsMCAL=0, AUTOSAR44=1, InputFilesList=CanIf_ECU_Configuration_PDF, InputFilesList=CanSM_ECU_Configuration_PDF, InputFilesList=ComM_ECU_Configuration_PDF, InputFilesList=Dem_ECU_Configuration_PDF, InputFilesList=EcuM_ECU_Configuration_PDF, InputFilesList=IoHwAb_ECU_Configuration_PDF, InputFilesList=Bswmd_CanCM, InputFilesList=ECUConfigurationParameters, InputFilesList=Ecud_CanIf, InputFilesList=Ecud_CanSM, InputFilesList=Ecud_ComM, InputFilesList=Ecud_Dem, InputFilesList=Ecud_EcuM, InputFilesList=Ecud_IoHwAb, InputFilesList=Ecud_CanCM, InputFilesList=CanCM_ECU_Configuration_PDF
          Nm: ModuleName=Nm, ExpectedFilesList=Nm_Cfg.c, ExpectedFilesList=Nm_Cfg.h, IsMCAL=0, AUTOSAR44=1, InputFilesList=CanNm_ECU_Configuration_PDF, InputFilesList=ComM_ECU_Configuration_PDF, InputFilesList=Nm_ECU_Configuration_PDF, InputFilesList=ECUConfigurationParameters, InputFilesList=Ecud_CanNm, InputFilesList=Ecud_ComM, InputFilesList=Ecud_Nm, InputFilesList=Bswmd_Nm
          Tm: ModuleName=Tm, ExpectedFilesList=Tm_Cfg.h, IsMCAL=0, AUTOSAR44=1, InputFilesList=Tm_ECU_Configuration_PDF, InputFilesList=Bswmd_Tm, InputFilesList=Ecud_Tm
          StbM: ModuleName=StbM, ExpectedFilesList=StbM_Cfg.h, ExpectedFilesList=StbM_Cfg.c, IsMCAL=0, AUTOSAR44=1, InputFilesList=StbM_ECU_Configuration_PDF, InputFilesList=Bswmd_StbM, InputFilesList=Ecud_Gpt, InputFilesList=Ecud_Os, InputFilesList=Ecud_StbM, InputFilesList=Swcd_Bsw_StbM, InputFilesList=ECUConfigurationParameters, InputFilesList=Os_ECU_Configuration_PDF_S32K312, InputFilesList=Gpt_s32k312_mqfp172.epd
          CanNm: ModuleName=CanNm, IsMCAL=0, ExpectedFilesList=CanNm_Cfg.h, ExpectedFilesList=CanNm_Cfg.c, AUTOSAR44=1, InputFilesList=CanIf_ECU_Configuration_PDF, InputFilesList=CanNm_ECU_Configuration_PDF, InputFilesList=CanSM_ECU_Configuration_PDF, InputFilesList=ComM_ECU_Configuration_PDF, InputFilesList=Nm_ECU_Configuration_PDF, InputFilesList=PduR_ECU_Configuration_PDF, InputFilesList=Bswmd_CanNm, InputFilesList=Ecud_CanIf, InputFilesList=Ecud_CanSM, InputFilesList=Ecud_ComM, InputFilesList=Ecud_EcuC, InputFilesList=Ecud_Nm, InputFilesList=Ecud_PduR, InputFilesList=Ecud_CanNm, InputFilesList=AUTOSAR_DataTypes, InputFilesList=CanStack_DataTypes, InputFilesList=ECUConfigurationParameters
          FiM: ModuleName=FiM, IsMCAL=0, ExpectedFilesList=FiM_Cfg.h, ExpectedFilesList=FiM_Cfg.c, AUTOSAR44=1, InputFilesList=AUTOSAR_DataTypes, InputFilesList=Dem_ECU_Configuration_PDF, InputFilesList=FiM_ECU_Configuration_PDF, InputFilesList=Bswmd_FiM, InputFilesList=Ecud_Dem, InputFilesList=Ecud_FiM.arxml
          IpduM: ModuleName=IpduM, ExpectedFilesList=IpduM_Cfg.h, ExpectedFilesList=IpduM_Cfg.c, IsMCAL=0, AUTOSAR44=1, InputFilesList=Com_ECU_Configuration_PDF, InputFilesList=PduR_ECU_Configuration_PDF, InputFilesList=Bswmd_IpduM, InputFilesList=Ecud_Com, InputFilesList=Ecud_EcuC, InputFilesList=Ecud_PduR, InputFilesList=Ecud_IpduM, InputFilesList=ECUConfigurationParameters, InputFilesList=IpduM_ECU_Configuration_PDF
          KeyM: ExpectedFilesList=KeyM_Cfg.h, ExpectedFilesList=KeyM_Cfg.c, IsMCAL=0, ModuleName=KeyM, AUTOSAR44=1, InputFilesList=CryIf_ECU_Configuration_PDF, InputFilesList=AUTOSAR_Crypto_76_HaeModule_ECU_Configuration_PDF, InputFilesList=Csm_ECU_Configuration_PDF, InputFilesList=KeyM_ECU_Configuration_PDF, InputFilesList=NvM_ECU_Configuration_PDF, InputFilesList=StbM_ECU_Configuration_PDF, InputFilesList=Bswmd_CryIf, InputFilesList=Bswmd_Csm, InputFilesList=Bswmd_KeyM, InputFilesList=ECUConfigurationParameters, InputFilesList=Ecud_CryIf, InputFilesList=Ecud_KeyM, InputFilesList=Ecud_NvM, InputFilesList=Ecud_StbM, InputFilesList=Ecud_Csm, InputFilesList=Bswmd_Crypto_76_HaeModule, InputFilesList=Bswmd_NvM, InputFilesList=Bswmd_StbM, InputFilesList=Swcd_Bsw_StbM, InputFilesList=Ecud_Crypto_76_HaeModule
          Bswmd_Crypto_76_HaeModule: BswDefines=B, ExpectedFilesList=Bswmd_Crypto_76_HaeModule.arxml, GeneratorName=Crypto_76_HaeModule.bat, InputFilesList=Ecud_Crypto_76_HaeModule, IsMCAL=0, ModuleName=Crypto_76_HaeModule
          Crypto_76_HaeModule: AUTOSAR44=1, ExpectedFilesList=Crypto_76_HaeModule_Cfg.c, ExpectedFilesList=Crypto_76_HaeModule_Cfg.h, GeneratorName=Crypto_76_HaeModule.bat, InputFilesList=Ecud_Crypto_76_HaeModule, InputFilesList=Ecud_CryIf, InputFilesList=AUTOSAR_Crypto_76_HaeModule_ECU_Configuration_PDF, InputFilesList=Bswmd_Crypto_76_HaeModule, IsMCAL=0, ModuleName=Crypto_76_HaeModule
